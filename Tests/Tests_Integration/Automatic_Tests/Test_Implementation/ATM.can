/*@!Encoding:1252*/
/*------------------------------------------------------------------------------
                                IMPORT LIBRARY
 ------------------------------------------------------------------------------*/
/* To include all the libraries used by the .capl script. */
/* WARNING: Some things such as diagnostic functions are different from project
to project, change those according to your project requirements */
includes
{
  #include "..\Includes\SW_Modules\SW_Modules_Project\Project_Includes_Configuration.cin"
}


variables
{
  long result;
}


testcase InitTestModule()
{
  ConfigureTestModuleInformation(CGA);
  
  strncpy(cLogPath, "S:\\Tools\\CANoe\\Config\\DAIMLER_MMA_INTEGRATION\\Logs\\",  elcount(cLogPath));
}

/*------------------------------------------------------------------------------
                                TEST EXECUTION
------------------------------------------------------------------------------*/
  
  /*------------------------- Test scenario start ------------------------------*/



testcase SW_IT_ATM_CheckTimeout_SecTickCount_01() // ISSUE - no timeout autotest for frame VSS_TP_SecTickCount_Lvl2_ST3
{
  //***********************************Test report header*********************************
  testReportAddMiscInfoBlock("AUTOLIV ELECTRONICS document");
  TestReportAddMiscInfo("Nightly test", "No");
  TestReportAddMiscInfo("Test type", "Requirement-Based test");
  TestReportAddMiscInfo("Regression Test", "No");
  TestReportAddMiscInfo("Fault injection method used", "No");
  TestReportAddMiscInfo("Resource usage evaluation", "No");
  TestReportAddMiscInfo("Priority", "No");
  TestReportAddMiscInfo("Safety relevant", "No");
  
  AddRequirementInfo("Requirement under test", "ARCH_SW_ATM_0005");
  AddRequirementInfo("ARCH_SW_ATM_0005", "System shall check if timeout is present for VSS_TP_SecTickCount_Lvl2_ST3 frame.");
  //***************************************************************************************
  
  testCaseComment("Preconditions");
  testStep("STEP", "Bench Initialization");
  RunPreTs();
  
  
    testStep("STEP", "Set a breakpoint in ATM_runMainFunction() at line 'atm_PlayCyclicTests(castRunningCyclicList);'.");
    debugger_setRelativeFunctionBpAtLine("ATM_runMainFunction", 29);
  
    testStep("STEP", "Check if CPU stopped at line 'atm_PlayCyclicTests(castRunningCyclicList);'. --> CPU is Stopped");
    debugger_WaitUntilBPisReached(500);
    
    
    debugger_deleteAllBP();
    
    
    testStep("STEP", "Set a breakpoint in function atm_PlayCyclicTests() at line 'if (B_TRUE == atm_isAutoTestEnabled(u8AutotestID))' and press run.");
    debugger_setRelativeFunctionBpAtLine("atm_PlayCyclicTests", 9);
    
    debugger_reset();
    debugger_run();
    
    testStep("STEP", "Check if CPU stopped in function atm_PlayCyclicTests() at line 'if (B_TRUE == atm_isAutoTestEnabled(u8AutotestID))'. --> CPU is Stopped");
    debugger_WaitUntilBPisReached(500);
  
  
    debugger_deleteAllBP();
    
  
    testStep("STEP", "Set a breakpoint in function atm_executeAutoTest() at line 'u8InhibModesIndex = castATMConfig[cu8AutotestID].u8InhibIndex;'.");
    debugger_setBpAtLine("s:\\Components\\Application\\Autoliv\\ATM\\Implementation\\src\\ATM.c", 198);
    
    debugger_run();
    
    testCaseComment("Action: ARCH_SW_ATM_0005");
    testStep("STEP", "Check if CPU stopped in function atm_executeAutoTest() at line 'u8InhibModesIndex = castATMConfig[cu8AutotestID].u8InhibIndex;'. --> CPU is Stopped");
    debugger_WaitUntilBPisReached(500);
  
  
  testCaseComment("Postcondition");
  testStep("STEP", "Return ECU to default values");
  RunPostTs();
}



testcase SW_IT_ATM_CheckTimeout_BeltAdj_01()
{
  //***********************************Test report header*********************************
  testReportAddMiscInfoBlock("AUTOLIV ELECTRONICS document");
  TestReportAddMiscInfo("Nightly test", "No");
  TestReportAddMiscInfo("Test type", "Requirement-Based test");
  TestReportAddMiscInfo("Regression Test", "No");
  TestReportAddMiscInfo("Fault injection method used", "No");
  TestReportAddMiscInfo("Resource usage evaluation", "No");
  TestReportAddMiscInfo("Priority", "No");
  TestReportAddMiscInfo("Safety relevant", "No");
  
  AddRequirementInfo("Requirement under test", "ARCH_SW_ATM_0239");
  AddRequirementInfo("ARCH_SW_ATM_0239", "ATM_runMainFunction shall call the CIL_Autotest_CheckTimeout_BeltAdj function.");
  //***************************************************************************************
  
  testCaseComment("Preconditions");
  testStep("STEP", "Bench Initialization");
  RunPreTs();
  
  
    debugger_reset();
  
    testStep("STEP", "Set a breakpoint in ATM_runMainFunction() at line 'atm_PlayCyclicTests(castStartupCyclicList);'.");
    debugger_setRelativeFunctionBpAtLine("ATM_runMainFunction", 21);
  
    debugger_run();
  
    testStep("STEP", "Check if CPU stopped at line 'atm_PlayCyclicTests(castRunningCyclicList);'. --> CPU is Stopped");
    debugger_WaitUntilBPisReached(500);
    
    
    debugger_deleteAllBP();
    
    
    testStep("STEP", "Set a breakpoint in function atm_PlayCyclicTests() at line 'if (B_TRUE == atm_isAutoTestEnabled(u8AutotestID))' to step in atm_executeAutoTest().");
    debugger_setRelativeFunctionBpAtLine("atm_PlayCyclicTests", 9);
    
    debugger_run();
    
    testStep("STEP", "Check if CPU stopped in function atm_PlayCyclicTests() at line 'if (B_TRUE == atm_isAutoTestEnabled(u8AutotestID))' to step in atm_executeAutoTest(). --> CPU is Stopped");
    debugger_WaitUntilBPisReached(500);
  
  
    debugger_deleteAllBP();
    
  
    testStep("STEP", "Set a breakpoint in function atm_executeAutoTest() at line 'u8InhibModesIndex = castATMConfig[cu8AutotestID].u8InhibIndex;'.");
    debugger_setBpAtLine("s:\\Components\\Application\\Autoliv\\ATM\\Implementation\\src\\ATM.c", 194);
    
    debugger_run();
    
    testStep("STEP", "Check if CPU stopped in function atm_executeAutoTest() at line 'u8InhibModesIndex = castATMConfig[cu8AutotestID].u8InhibIndex;'. --> CPU is Stopped");
    debugger_WaitUntilBPisReached(500);
    
  
    debugger_deleteAllBP();
  
    
    testStep("STEP", "Set a breakpoint in function CIL_cbk_CheckTimeoutError_BeltAdj() at line 'Rte_Call_pclCheckTimeoutErrorBeltAdj_AutotestCallback(&u8TestResult);' and press run.");
    debugger_setRelativeFunctionBpAtLine("CIL_cbk_CheckTimeoutError_BeltAdj", 4);
    
    debugger_run();
    testWaitForTimeoutSilent(500);
    
    testStep("STEP", "Check if CPU stopped in function CIL_cbk_CheckTimeoutError_BeltAdj() at line 'Rte_Call_pclCheckTimeoutErrorBeltAdj_AutotestCallback(&u8TestResult);'. --> CPU is Stopped");
    debugger_WaitUntilBPisReached(500);
  
  
    debugger_deleteAllBP();
  
    
    testStep("STEP", "Set a breakpoint in function CIL_Autotest_CheckTimeoutError_BeltAdj()' and press run.");
    debugger_setRelativeFunctionBpAtLine("CIL_Autotest_CheckTimeoutError_BeltAdj", 0);
    
    debugger_run();
    testWaitForTimeoutSilent(500);
    
    testCaseComment("Action: ARCH_SW_ATM_0239");
    testStep("STEP", "Check if CPU stopped in function CIL_Autotest_CheckTimeoutError_BeltAdj() . --> CPU is Stopped");
    debugger_WaitUntilBPisReached(500);
  
    
  testCaseComment("Postcondition");
  testStep("STEP", "Return ECU to default values");
  RunPostTs();
}


testcase SW_IT_ATM_runMainFunction_01()
{
  //***********************************Test report header*********************************
  testReportAddMiscInfoBlock("AUTOLIV ELECTRONICS document");
  TestReportAddMiscInfo("Nightly test", "No");
  TestReportAddMiscInfo("Test type", "Requirement-Based test");
  TestReportAddMiscInfo("Regression Test", "No");
  TestReportAddMiscInfo("Fault injection method used", "No");
  TestReportAddMiscInfo("Resource usage evaluation", "No");
  TestReportAddMiscInfo("Priority", "No");
  TestReportAddMiscInfo("Safety relevant", "No");
  
  AddRequirementInfo("Requirement under test", "ARCH_SW_ATM_0004, ARCH_SW_ATM_0260, ARCH_SW_ATM_0111, ARCH_SW_ATM_0113");
  AddRequirementInfo("ARCH_SW_ATM_0004", "If critical Autotests are not passed or finished cyclic tests cannot run.");
  AddRequirementInfo("ARCH_SW_ATM_0260", "Verify if an auto-test cannot be executed ATM_runMainFunction shall set the status of the tests to “NOT DECIDED”.");
  //***************************************************************************************
  
  testCaseComment("Preconditions");
  testStep("STEP", "Bench Initialization");
  RunPreTs();
    
  
    testStep("STEP", "Set a breakpoint in ATM_runMainFunction() at line 'atm_PlayCyclicTests(castRunningCyclicList);'.");
    debugger_setRelativeFunctionBpAtLine("ATM_runMainFunction", 29);
    
    debugger_reset();
    debugger_run();
  
    testCaseComment("Action: ARCH_SW_ATM_0004, ARCH_SW_ATM_0260");
    testStep("STEP", "Check if CPU stopped at line 'atm_PlayCyclicTests(castRunningCyclicList);'. --> CPU is Stopped");
    debugger_WaitUntilBPisReached(500);
  
  
    debugger_deleteAllBP();
  
    
    testStep("STEP", "Set a breakpoint in function atm_PlayCyclicTests() at line 'if (B_TRUE == atm_isAutoTestEnabled(u8AutotestID))' and press run.");
    debugger_setRelativeFunctionBpAtLine("atm_PlayCyclicTests", 16);
    
    debugger_run();
    
    testStep("STEP", "Check if CPU stopped in function atm_PlayCyclicTests() at line 'if (B_TRUE == atm_isAutoTestEnabled(u8AutotestID))'. --> CPU is Stopped");
    debugger_WaitUntilBPisReached(500);
  

    debugger_deleteAllBP();

    
    testStep("STEP", "Step in function atm_executeAutoTest().");
    debugger_stepIn(); 

  
    testStep("STEP", "Set a breakpoint in function atm_executeAutoTest() at line 'atm_au8AtStatuses[cu8AutotestID] = u8ReturnedAutoTestStatus;' under 'case KU8_ATM_TEST_NOT_DECIDED' and 'case KU8_ATM_TEST_BAD_CONDITIONS'.");
    debugger_setBpAtLine("s:\\Components\\Application\\Autoliv\\ATM\\Implementation\\src\\ATM.c", 233);
    
    debugger_run();
    
    testCaseComment("Action: ARCH_SW_ATM_0260, ARCH_SW_ATM_0111, ARCH_SW_ATM_0113");
    testStep("STEP", "Check if CPU stopped in function atm_executeAutoTest() at line 'atm_au8AtStatuses[cu8AutotestID] = u8ReturnedAutoTestStatus;' under 'case KU8_ATM_TEST_NOT_DECIDED' and 'case KU8_ATM_TEST_BAD_CONDITIONS'. --> CPU is Stopped");
    debugger_WaitUntilBPisReached(500);
  

    debugger_deleteAllBP();
    debugger_reset();
    
    
    testStep("STEP", "Set a breakpoint in function atm_executeAutoTest() at line 'u8ReturnedAutoTestStatus = castATMConfig[cu8AutotestID].pfAutotestCallback();' and press run.");
    debugger_setBpAtLine("s:\\Components\\Application\\Autoliv\\ATM\\Implementation\\src\\ATM.c", 210);
    
    debugger_run();
  
    debugger_deleteAllBP();  
    testStep("STEP", "Set variable u8ReturnedAutoTestStatus to KU8_ATM_TEST_OK.");
    debugger_writeLocalVariable("u8ReturnedAutoTestStatus", 0);
        
  
    debugger_deleteAllBP();
  
  
    testStep("STEP", "Set a breakpoint in function atm_executeAutoTest() at line 'case KU8_ATM_TEST_OK:'.");
    debugger_setBpAtLine("s:\\Components\\Application\\Autoliv\\ATM\\Implementation\\src\\ATM.c", 215);
    
    debugger_run();
  
    testCaseComment("Action: ARCH_SW_ATM_0004");
    testStep("STEP", "Check if CPU stopped in function atm_executeAutoTest() at line 'case KU8_ATM_TEST_OK:'. --> CPU is Stopped");
    debugger_WaitUntilBPisReached(500);
    

    debugger_deleteAllBP();
    debugger_reset();
    
    
    testStep("STEP", "Set a breakpoint in function atm_executeAutoTest() at line 'u8ReturnedAutoTestStatus = castATMConfig[cu8AutotestID].pfAutotestCallback();' and press run.");
    debugger_setBpAtLine("s:\\Components\\Application\\Autoliv\\ATM\\Implementation\\src\\ATM.c", 210);
    
    debugger_run();
   
    testStep("STEP", "Set variable u8ReturnedAutoTestStatus to KU8_ATM_TEST_NOK.");
    debugger_writeLocalVariable("u8ReturnedAutoTestStatus", 0);
    
  
    debugger_deleteAllBP();
  
  
    testStep("STEP", "Set a breakpoint in function atm_executeAutoTest() at line 'case KU8_ATM_TEST_NOK:'.");
    debugger_setBpAtLine("s:\\Components\\Application\\Autoliv\\ATM\\Implementation\\src\\ATM.c", 215);
        
    debugger_run();
  
    testCaseComment("Action: ARCH_SW_ATM_0004");
    testStep("STEP", "Check if CPU stopped in function atm_executeAutoTest() at line 'case KU8_ATM_TEST_NOK:'. --> CPU is Stopped");
    debugger_WaitUntilBPisReached(500);
    
    
  testCaseComment("Postcondition");
  testStep("STEP", "Return ECU to default values");
  RunPostTs();
}


testcase SW_IT_ATM_CheckProductEndOfLifeLowForce_01()
{
  //***********************************Test report header*********************************
  testReportAddMiscInfoBlock("AUTOLIV ELECTRONICS document");
  TestReportAddMiscInfo("Nightly test", "No");
  TestReportAddMiscInfo("Test type", "Requirement-Based test");
  TestReportAddMiscInfo("Regression Test", "No");
  TestReportAddMiscInfo("Fault injection method used", "No");
  TestReportAddMiscInfo("Resource usage evaluation", "No");
  TestReportAddMiscInfo("Priority", "No");
  TestReportAddMiscInfo("Safety relevant", "No");
  
  AddRequirementInfo("Requirement under test", "ARCH_SW_ATM_0107, ARCH_SW_ATM_0213");
  AddRequirementInfo("ARCH_SW_ATM_0107", "ATM_runMainFunction shall call the EOL_Autotest_CheckProductEndOfLifeLowForce function.");
  AddRequirementInfo("ARCH_SW_ATM_0213", "ATM_runMainFunction shall call the EOL_cbk_CheckProductEndOfLifeLowForce function.");
  //***************************************************************************************
  
  testCaseComment("Preconditions");
  testStep("STEP", "Bench Initialization");
  RunPreTs();
   
  
    testStep("STEP", "Set a breakpoint in ATM_runMainFunction() at line 'atm_PlayCyclicTests(castRunningCyclicList);'.");
    debugger_setRelativeFunctionBpAtLine("ATM_runMainFunction", 29);

    debugger_reset(); 
    debugger_run();
  
    testCaseComment("Action: ARCH_SW_ATM_0107");
    testStep("STEP", "Check if CPU stopped in ATM_runMainFunction() at line 'atm_PlayCyclicTests(castRunningCyclicList);'. --> CPU is Stopped");
    debugger_WaitUntilBPisReached(500);
    

    debugger_deleteAllBP();
    
    
    testStep("STEP", "Set a breakpoint in function atm_PlayCyclicTests() at line 'atm_executeAutoTest(u8AutotestID);' under 'if (B_TRUE == atm_isAutoTestEnabled(u8AutotestID))' and press run.");
    debugger_setRelativeFunctionBpAtLine("atm_PlayCyclicTests", 9);

    debugger_run();
    
    testStep("STEP", "Check if CPU stopped in function atm_PlayCyclicTests() at line 'atm_executeAutoTest(u8AutotestID);' under 'if (B_TRUE == atm_isAutoTestEnabled(u8AutotestID))'. --> CPU is Stopped");
    debugger_WaitUntilBPisReached(500);
  
  
    debugger_deleteAllBP();
  
    
    testStep("STEP", "Set a breakpoint in function atm_executeAutoTest() at line 'u8InhibModesIndex = castATMConfig[cu8AutotestID].u8InhibIndex;'.");
    debugger_setBpAtLine("s:\\Components\\Application\\Autoliv\\ATM\\Implementation\\src\\ATM.c", 194);
    
    debugger_run();
    
    testStep("STEP", "Check if CPU stopped in function atm_executeAutoTest() at line 'u8InhibModesIndex = castATMConfig[cu8AutotestID].u8InhibIndex;'. --> CPU is Stopped");
    debugger_WaitUntilBPisReached(500);
  
     debugger_deleteAllBP();    
  
     
    testStep("STEP", "Set a breakpoint in EOL_cbk_CheckProductEndOfLifeLowForce().");
    debugger_setRelativeFunctionBpAtLine("EOL_cbk_CheckProductEndOfLifeLowForce", 0);
  
    debugger_run();
    
    testCaseComment("Action: ARCH_SW_ATM_0213");
    testStep("STEP", "Check if CPU stopped at EOL_cbk_CheckProductEndOfLifeLowForce()*. --> CPU is Stopped");
    debugger_WaitUntilBPisReached(500);
  
  
    debugger_deleteAllBP();
     
  
    testStep("STEP", "Set a breakpoint in EOL_cbk_CheckProductEndOfLifeLowForce() and press run.");
    debugger_setRelativeFunctionBpAtLine("EOL_cbk_CheckProductEndOfLifeLowForce", 0);
    
    debugger_run();
    
    testCaseComment("Action: ARCH_SW_ATM_0107");
    testStep("STEP", "Check if CPU stopped at EOL_cbk_CheckProductEndOfLifeLowForce()*. --> CPU is Stopped");
    debugger_WaitUntilBPisReached(500);

  
  testCaseComment("Postcondition");
  testStep("STEP", "Return ECU to default values");
  RunPostTs();
}


testcase SW_IT_ATM_CheckProductEndOfLifeHighForce_01()
{
  //***********************************Test report header*********************************
  testReportAddMiscInfoBlock("AUTOLIV ELECTRONICS document");
  TestReportAddMiscInfo("Nightly test", "No");
  TestReportAddMiscInfo("Test type", "Requirement-Based test");
  TestReportAddMiscInfo("Regression Test", "No");
  TestReportAddMiscInfo("Fault injection method used", "No");
  TestReportAddMiscInfo("Resource usage evaluation", "No");
  TestReportAddMiscInfo("Priority", "No");
  TestReportAddMiscInfo("Safety relevant", "No");
  
  AddRequirementInfo("Requirement under test", "ARCH_SW_ATM_0108, ARCH_SW_ATM_0218");
  AddRequirementInfo("ARCH_SW_ATM_0108", "ATM_runMainFunction shall call the EOL_Autotest_CheckProductEndOfLifeHighForce function.");
  AddRequirementInfo("ARCH_SW_ATM_0218", "ATM_runMainFunction shall call the EOL_cbk_CheckProductEndOfLifeHighForce function.");
  //***************************************************************************************
  
  testCaseComment("Preconditions");
  testStep("STEP", "Bench Initialization");
  RunPreTs();

  
    testStep("STEP", "Set a breakpoint in ATM_runMainFunction() at line 'atm_PlayCyclicTests(castRunningCyclicList);'.");
    debugger_setRelativeFunctionBpAtLine("ATM_runMainFunction", 29);

    debugger_reset();  
    debugger_run();
  
    testCaseComment("Action: ARCH_SW_ATM_0108");
    testStep("STEP", "Check if CPU stopped in ATM_runMainFunction() at line 'atm_PlayCyclicTests(castRunningCyclicList);'. --> CPU is Stopped");
    debugger_WaitUntilBPisReached(500);
    

    debugger_deleteAllBP();
    
    
    testStep("STEP", "Set a breakpoint in function atm_PlayCyclicTests() at line 'atm_executeAutoTest(u8AutotestID);' under 'if (B_TRUE == atm_isAutoTestEnabled(u8AutotestID))' and press run.");
    debugger_setRelativeFunctionBpAtLine("atm_PlayCyclicTests", 9);

    debugger_run();
    
    testStep("STEP", "Check if CPU stopped in function atm_PlayCyclicTests() at line 'atm_executeAutoTest(u8AutotestID);' under 'if (B_TRUE == atm_isAutoTestEnabled(u8AutotestID))'. --> CPU is Stopped");
    debugger_WaitUntilBPisReached(500);
  
  
    debugger_deleteAllBP();
     
  
    testStep("STEP", "Set a breakpoint in function atm_executeAutoTest() at line 'u8InhibModesIndex = castATMConfig[cu8AutotestID].u8InhibIndex;'.");
    debugger_setBpAtLine("s:\\Components\\Application\\Autoliv\\ATM\\Implementation\\src\\ATM.c", 194);
    
    debugger_run();
    
    testStep("STEP", "Check if CPU stopped in function atm_executeAutoTest() at line 'u8InhibModesIndex = castATMConfig[cu8AutotestID].u8InhibIndex;'. --> CPU is Stopped");
    debugger_WaitUntilBPisReached(500);
  
  
    debugger_deleteAllBP();    

    
    testStep("STEP", "Set a breakpoint in EOL_cbk_CheckProductEndOfLifeHighForce().");
    debugger_setRelativeFunctionBpAtLine("EOL_cbk_CheckProductEndOfLifeHighForce", 0);
    
    debugger_run();
    
    testCaseComment("Action: ARCH_SW_ATM_0218");
    testStep("STEP", "Check if CPU stopped at EOL_cbk_CheckProductEndOfLifeHighForce()*. --> CPU is Stopped");
    debugger_WaitUntilBPisReached(500);
  
  
    debugger_deleteAllBP();
  
  
    testStep("STEP", "Set a breakpoint in EOL_Autotest_CheckProductEndOfLifeHighForce() and press run.");
    debugger_setRelativeFunctionBpAtLine("EOL_Autotest_CheckProductEndOfLifeHighForce", 0);

    debugger_run();
    
    testCaseComment("Action: ARCH_SW_ATM_0108");
    testStep("STEP", "Check if CPU stopped at EOL_Autotest_CheckProductEndOfLifeHighForce()*. --> CPU is Stopped");
    debugger_WaitUntilBPisReached(500);
  
  
  testCaseComment("Postcondition");
  testStep("STEP", "Return ECU to default values");
  RunPostTs();
}


testcase SW_IT_ATM_CheckProductEndOfLifeComfort_01()
{
  //***********************************Test report header*********************************
  testReportAddMiscInfoBlock("AUTOLIV ELECTRONICS document");
  TestReportAddMiscInfo("Nightly test", "No");
  TestReportAddMiscInfo("Test type", "Requirement-Based test");
  TestReportAddMiscInfo("Regression Test", "No");
  TestReportAddMiscInfo("Fault injection method used", "No");
  TestReportAddMiscInfo("Resource usage evaluation", "No");
  TestReportAddMiscInfo("Priority", "No");
  TestReportAddMiscInfo("Safety relevant", "No");
  
  AddRequirementInfo("Requirement under test", "ARCH_SW_ATM_0109, ARCH_SW_ATM_0219");
  AddRequirementInfo("ARCH_SW_ATM_0109", "ATM_runMainFunction shall call the EOL_Autotest_CheckProductEndOfLifeComfort function.");
  AddRequirementInfo("ARCH_SW_ATM_0219", "ATM_runMainFunction shall call the EOL_cbk_CheckProductEndOfLifeComfort function.");
  //***************************************************************************************
  
  testCaseComment("Preconditions");
  testStep("STEP", "Bench Initialization");
	RunPreTs();

  
    testStep("STEP", "Set a breakpoint in ATM_runMainFunction() at line 'atm_PlayCyclicTests(castRunningCyclicList);'.");
    debugger_setRelativeFunctionBpAtLine("ATM_runMainFunction", 29);
  
    debugger_reset();
    debugger_run();
  
    testCaseComment("Action: ARCH_SW_ATM_0109");
    testStep("STEP", "Check if CPU stopped in ATM_runMainFunction() at line 'atm_PlayCyclicTests(castRunningCyclicList);'. --> CPU is Stopped");
    debugger_WaitUntilBPisReached(500);
    

    debugger_deleteAllBP();
    
    
    testStep("STEP", "Set a breakpoint in function atm_PlayCyclicTests() at line 'atm_executeAutoTest(u8AutotestID);' under 'if (B_TRUE == atm_isAutoTestEnabled(u8AutotestID))' and press run.");
    debugger_setRelativeFunctionBpAtLine("atm_PlayCyclicTests", 9);

    debugger_run();
    
    testStep("STEP", "Check if CPU stopped in function atm_PlayCyclicTests() at line 'atm_executeAutoTest(u8AutotestID);' under 'if (B_TRUE == atm_isAutoTestEnabled(u8AutotestID))'. --> CPU is Stopped");
    debugger_WaitUntilBPisReached(500);
  
  
    debugger_deleteAllBP();
  
  
    testStep("STEP", "Set a breakpoint in function atm_executeAutoTest() at line 'u8InhibModesIndex = castATMConfig[cu8AutotestID].u8InhibIndex;'.");
    debugger_setBpAtLine("s:\\Components\\Application\\Autoliv\\ATM\\Implementation\\src\\ATM.c", 194);
    
    debugger_run();
    
    testStep("STEP", "Check if CPU stopped in function atm_executeAutoTest() at line 'u8InhibModesIndex = castATMConfig[cu8AutotestID].u8InhibIndex;'. --> CPU is Stopped");
    debugger_WaitUntilBPisReached(500);
    
  
    debugger_deleteAllBP();    

    
    testStep("STEP", "Set a breakpoint in function EOL_cbk_CheckProductEndOfLifeComfort().");
    debugger_setRelativeFunctionBpAtLine("EOL_cbk_CheckProductEndOfLifeComfort", 0); 
    
    debugger_run();
    
    testCaseComment("Action: ARCH_SW_ATM_0219");
    testStep("STEP", "Check if CPU stopped in function EOL_cbk_CheckProductEndOfLifeComfort(). --> CPU is Stopped");
    debugger_WaitUntilBPisReached(500);
  
  
    debugger_deleteAllBP();
  
  
    testStep("STEP", "Set a breakpoint in EOL_Autotest_CheckProductEndOfLifeComfort() and press run.");
    debugger_setRelativeFunctionBpAtLine("EOL_Autotest_CheckProductEndOfLifeComfort", 0);
    
    debugger_run();
    
    testCaseComment("Action: ARCH_SW_ATM_0109");
    testStep("STEP", "Check if CPU stopped at EOL_Autotest_CheckProductEndOfLifeComfort()*. --> CPU is Stopped");
    debugger_WaitUntilBPisReached(500);

  
  testCaseComment("Postcondition");
  testStep("STEP", "Return ECU to default values");
  RunPostTs();
}


testcase SW_IT_ATM_CheckMosfetHighSC_01()
{
  //***********************************Test report header*********************************
  testReportAddMiscInfoBlock("AUTOLIV ELECTRONICS document");
  TestReportAddMiscInfo("Nightly test", "No");
  TestReportAddMiscInfo("Test type", "Requirement-Based test");
  TestReportAddMiscInfo("Regression Test", "No");
  TestReportAddMiscInfo("Fault injection method used", "No");
  TestReportAddMiscInfo("Resource usage evaluation", "No");
  TestReportAddMiscInfo("Priority", "No");
  TestReportAddMiscInfo("Safety relevant", "No");
  
  AddRequirementInfo("Requirement under test", "ARCH_SW_ATM_0116, ARCH_SW_ATM_0206");
  AddRequirementInfo("ARCH_SW_ATM_0116", "ATM_runMainFunction shall call the  PAL_Autotest_CheckMosfetHighSC function.");
  AddRequirementInfo("ARCH_SW_ATM_0206", "ATM_runMainFunction shall call the PAL_cbk_CheckMosfetHighSC function.");
  //***************************************************************************************
  
  testCaseComment("Preconditions");
  testStep("STEP", "Bench Initialization");
  RunPreTs();

  
    testStep("STEP", "Set a breakpoint in ATM_runMainFunction() at line 'atm_PlayCyclicTests(castRunningCyclicList);'.");
    debugger_setRelativeFunctionBpAtLine("ATM_runMainFunction", 29);

    debugger_reset();  
    debugger_run();
  
    testCaseComment("Action: ARCH_SW_ATM_0116");
    testStep("STEP", "Check if CPU stopped in ATM_runMainFunction() at line 'atm_PlayCyclicTests(castRunningCyclicList);'. --> CPU is Stopped");
    debugger_WaitUntilBPisReached(500);
    

    debugger_deleteAllBP();
    
    
    testStep("STEP", "Set a breakpoint in function atm_PlayCyclicTests() at line 'atm_executeAutoTest(u8AutotestID);' under 'if (B_TRUE == atm_isAutoTestEnabled(u8AutotestID))' and press run.");
    debugger_setRelativeFunctionBpAtLine("atm_PlayCyclicTests", 9);

    debugger_run();
    
    testStep("STEP", "Check if CPU stopped in function atm_PlayCyclicTests() at line 'atm_executeAutoTest(u8AutotestID);' under 'if (B_TRUE == atm_isAutoTestEnabled(u8AutotestID))'. --> CPU is Stopped");
    debugger_WaitUntilBPisReached(500);
  
  
    debugger_deleteAllBP();
  
  
    testStep("STEP", "Set a breakpoint in function atm_executeAutoTest() at line 'u8InhibModesIndex = castATMConfig[cu8AutotestID].u8InhibIndex;'.");
    debugger_setBpAtLine("s:\\Components\\Application\\Autoliv\\ATM\\Implementation\\src\\ATM.c", 194);
    
    debugger_run();
    
    testStep("STEP", "Check if CPU stopped in function atm_executeAutoTest() at line 'u8InhibModesIndex = castATMConfig[cu8AutotestID].u8InhibIndex;'. --> CPU is Stopped");
    debugger_WaitUntilBPisReached(500);
  
  
    debugger_deleteAllBP();
  
  
    testStep("STEP", "Set a breakpoint in PAL_cbk_CheckMosfetHighSC() and press run.");
    debugger_setRelativeFunctionBpAtLine("PAL_cbk_CheckMosfetHighSC", 0); 
    
    debugger_run();
    
    testCaseComment("Action: ARCH_SW_ATM_0206");
    testStep("STEP", "Check if CPU stopped at PAL_cbk_CheckMosfetHighSC()*. --> CPU is Stopped");
    debugger_WaitUntilBPisReached(500);
  
  
    debugger_deleteAllBP();
  
    
    testStep("STEP", "Set a breakpoint in PAL_Autotest_CheckMosfetHighSC() and press run.");
    debugger_setRelativeFunctionBpAtLine("PAL_Autotest_CheckMosfetHighSC", 0);

    debugger_run();
    
    testCaseComment("Action: ARCH_SW_ATM_0116");
    testStep("STEP", "Check if CPU stopped at PAL_Autotest_CheckMosfetHighSC()*. --> CPU is Stopped");
    debugger_WaitUntilBPisReached(500);

  
  testCaseComment("Postcondition");
  testStep("STEP", "Return ECU to default values");
  RunPostTs();
}


testcase SW_IT_ATM_CheckMosfetOCAT_01()
{
  //***********************************Test report header*********************************
  testReportAddMiscInfoBlock("AUTOLIV ELECTRONICS document");
  TestReportAddMiscInfo("Nightly test", "No");
  TestReportAddMiscInfo("Test type", "Requirement-Based test");
  TestReportAddMiscInfo("Regression Test", "No");
  TestReportAddMiscInfo("Fault injection method used", "No");
  TestReportAddMiscInfo("Resource usage evaluation", "No");
  TestReportAddMiscInfo("Priority", "No");
  TestReportAddMiscInfo("Safety relevant", "No");
  
  AddRequirementInfo("Requirement under test", "ARCH_SW_ATM_0120");
  AddRequirementInfo("ARCH_SW_ATM_0120", "ATM_runMainFunction shall call the PAL_Autotest_CheckMosfetOCAT function.");
  //***************************************************************************************
  
  testCaseComment("Preconditions");
  testStep("STEP", "Bench Initialization");
  RunPreTs();
  
  
    testStep("STEP", "Set a breakpoint in ATM_runMainFunction() at line 'atm_PlayCyclicTests(castRunningCyclicList);'.");
    debugger_setRelativeFunctionBpAtLine("ATM_runMainFunction", 29);

    debugger_reset();  
    debugger_run();
  
    testCaseComment("Action: ARCH_SW_ATM_0120");
    testStep("STEP", "Check if CPU stopped in ATM_runMainFunction() at line 'atm_PlayCyclicTests(castRunningCyclicList);'. --> CPU is Stopped");
    debugger_WaitUntilBPisReached(500);
    

    debugger_deleteAllBP();
    
    
    testStep("STEP", "Set a breakpoint in function atm_PlayCyclicTests() at line 'atm_executeAutoTest(u8AutotestID);' under 'if (B_TRUE == atm_isAutoTestEnabled(u8AutotestID))' and press run.");
    debugger_setRelativeFunctionBpAtLine("atm_PlayCyclicTests", 9);

    debugger_run();
    
    testStep("STEP", "Check if CPU stopped in function atm_PlayCyclicTests() at line 'atm_executeAutoTest(u8AutotestID);' under 'if (B_TRUE == atm_isAutoTestEnabled(u8AutotestID))'. --> CPU is Stopped");
    debugger_WaitUntilBPisReached(500);
  
  
    debugger_deleteAllBP();
  
  
    testStep("STEP", "Set a breakpoint in function atm_executeAutoTest() at line 'u8InhibModesIndex = castATMConfig[cu8AutotestID].u8InhibIndex;'.");
    debugger_setBpAtLine("s:\\Components\\Application\\Autoliv\\ATM\\Implementation\\src\\ATM.c", 194);
    
    debugger_run();
    
    testStep("STEP", "Check if CPU stopped in function atm_executeAutoTest() at line 'u8InhibModesIndex = castATMConfig[cu8AutotestID].u8InhibIndex;'. --> CPU is Stopped");
    debugger_WaitUntilBPisReached(500);
  
  
    debugger_deleteAllBP();
  

    testStep("STEP", "Set a breakpoint in PAL_Autotest_CheckMosfetOCAT() and press run.");
    debugger_setRelativeFunctionBpAtLine("PAL_Autotest_CheckMosfetOCAT", 0);
    
    debugger_reset();
    debugger_run();
    
    testCaseComment("Action: ARCH_SW_ATM_0120");
    testStep("STEP", "Check if CPU stopped at PAL_Autotest_CheckMosfetOCAT()*. --> CPU is Stopped");
    debugger_WaitUntilBPisReached(500);
  
  
  testCaseComment("Postcondition");
  testStep("STEP", "Return ECU to default values");
  RunPostTs();
}


testcase SW_IT_ATM_CheckSystemUV_01()
{
  //***********************************Test report header*********************************
  testReportAddMiscInfoBlock("AUTOLIV ELECTRONICS document");
  TestReportAddMiscInfo("Nightly test", "No");
  TestReportAddMiscInfo("Test type", "Requirement-Based test");
  TestReportAddMiscInfo("Regression Test", "No");
  TestReportAddMiscInfo("Fault injection method used", "No");
  TestReportAddMiscInfo("Resource usage evaluation", "No");
  TestReportAddMiscInfo("Priority", "No");
  TestReportAddMiscInfo("Safety relevant", "No");
  
  AddRequirementInfo("Requirement under test", "ARCH_SW_ATM_0152");
  AddRequirementInfo("ARCH_SW_ATM_0152", "ATM_runMainFunction shall call the PMP_Autotest_CheckSystemUV function.");
  //***************************************************************************************
  
  testCaseComment("Preconditions");
  testStep("STEP", "Bench Initialization");
  RunPreTs();
  
  
    testStep("STEP", "Set a breakpoint in ATM_runMainFunction() at line 'atm_PlayCyclicTests(castRunningCyclicList);'.");
    debugger_setRelativeFunctionBpAtLine("ATM_runMainFunction", 29);

    debugger_reset();  
    debugger_run();
  
    testCaseComment("Action: ARCH_SW_ATM_0152");
    testStep("STEP", "Check if CPU stopped in ATM_runMainFunction() at line 'atm_PlayCyclicTests(castRunningCyclicList);'. --> CPU is Stopped");
    debugger_WaitUntilBPisReached(500);
    

    debugger_deleteAllBP();
    
    
    testStep("STEP", "Set a breakpoint in function atm_PlayCyclicTests() at line 'atm_executeAutoTest(u8AutotestID);' under 'if (B_TRUE == atm_isAutoTestEnabled(u8AutotestID))' and press run.");
    debugger_setRelativeFunctionBpAtLine("atm_PlayCyclicTests", 9);

    debugger_run();
    
    testStep("STEP", "Check if CPU stopped in function atm_PlayCyclicTests() at line 'atm_executeAutoTest(u8AutotestID);' under 'if (B_TRUE == atm_isAutoTestEnabled(u8AutotestID))'. --> CPU is Stopped");
    debugger_WaitUntilBPisReached(500);
  
  
    debugger_deleteAllBP();
  
  
    testStep("STEP", "Set a breakpoint in function atm_executeAutoTest() at line 'u8InhibModesIndex = castATMConfig[cu8AutotestID].u8InhibIndex;'.");
    debugger_setBpAtLine("s:\\Components\\Application\\Autoliv\\ATM\\Implementation\\src\\ATM.c", 194);
    
    debugger_run();
    
    testStep("STEP", "Check if CPU stopped in function atm_executeAutoTest() at line 'u8InhibModesIndex = castATMConfig[cu8AutotestID].u8InhibIndex;'. --> CPU is Stopped");
    debugger_WaitUntilBPisReached(500);
  
  
    debugger_deleteAllBP();
  

    testStep("STEP", "Set a breakpoint in PMP_Autotest_CheckSystemUV() and press run.");
    debugger_setRelativeFunctionBpAtLine("PMP_Autotest_CheckSystemUV", 0);
    
    debugger_run();
    
    testCaseComment("Action: ARCH_SW_ATM_0152");
    testStep("STEP", "Check if CPU stopped at PMP_Autotest_CheckSystemUV()*. --> CPU is Stopped");
    debugger_WaitUntilBPisReached(500);
  
  
  testCaseComment("Postcondition");
  testStep("STEP", "Return ECU to default values");
  RunPostTs();
}


testcase SW_IT_ATM_CheckSystemOV_01()
{
  //***********************************Test report header*********************************
  testReportAddMiscInfoBlock("AUTOLIV ELECTRONICS document");
  TestReportAddMiscInfo("Nightly test", "No");
  TestReportAddMiscInfo("Test type", "Requirement-Based test");
  TestReportAddMiscInfo("Regression Test", "No");
  TestReportAddMiscInfo("Fault injection method used", "No");
  TestReportAddMiscInfo("Resource usage evaluation", "No");
  TestReportAddMiscInfo("Priority", "No");
  TestReportAddMiscInfo("Safety relevant", "No");
  
  AddRequirementInfo("Requirement under test", "ARCH_SW_ATM_0153");
  AddRequirementInfo("ARCH_SW_ATM_0153", "ATM_runMainFunction shall call the PMP_Autotest_CheckSystemOV function.");
  //***************************************************************************************
  
  testCaseComment("Preconditions");
  testStep("STEP", "Bench Initialization");
  RunPreTs();
  
  
    testStep("STEP", "Set a breakpoint in ATM_runMainFunction() at line 'atm_PlayCyclicTests(castRunningCyclicList);'.");
    debugger_setRelativeFunctionBpAtLine("ATM_runMainFunction", 29);

    debugger_reset();  
    debugger_run();
  
    testCaseComment("Action: ARCH_SW_ATM_0153");
    testStep("STEP", "Check if CPU stopped in ATM_runMainFunction() at line 'atm_PlayCyclicTests(castRunningCyclicList);'. --> CPU is Stopped");
    debugger_WaitUntilBPisReached(500);
    

    debugger_deleteAllBP();
    
    
    testStep("STEP", "Set a breakpoint in function atm_PlayCyclicTests() at line 'atm_executeAutoTest(u8AutotestID);' under 'if (B_TRUE == atm_isAutoTestEnabled(u8AutotestID))' and press run.");
    debugger_setRelativeFunctionBpAtLine("atm_PlayCyclicTests", 9);

    debugger_run();
    
    testStep("STEP", "Check if CPU stopped in function atm_PlayCyclicTests() at line 'atm_executeAutoTest(u8AutotestID);' under 'if (B_TRUE == atm_isAutoTestEnabled(u8AutotestID))'. --> CPU is Stopped");
    debugger_WaitUntilBPisReached(500);
  
  
    debugger_deleteAllBP();
  
  
    testStep("STEP", "Set a breakpoint in function atm_executeAutoTest() at line 'u8InhibModesIndex = castATMConfig[cu8AutotestID].u8InhibIndex;'.");
    debugger_setBpAtLine("s:\\Components\\Application\\Autoliv\\ATM\\Implementation\\src\\ATM.c", 194);
    
    debugger_run();
    
    testStep("STEP", "Check if CPU stopped in function atm_executeAutoTest() at line 'u8InhibModesIndex = castATMConfig[cu8AutotestID].u8InhibIndex;'. --> CPU is Stopped");
    debugger_WaitUntilBPisReached(500);
  
  
    debugger_deleteAllBP();
  

    testStep("STEP", "Set a breakpoint in PMP_Autotest_CheckSystemOV() and press run.");
    debugger_setRelativeFunctionBpAtLine("PMP_Autotest_CheckSystemOV", 0);
    
    debugger_run();
    
    testCaseComment("Action: ARCH_SW_ATM_0153");
    testStep("STEP", "Check if CPU stopped at PMP_Autotest_CheckSystemOV()*. --> CPU is Stopped");
    debugger_WaitUntilBPisReached(500);
  
  
  testCaseComment("Postcondition");
  testStep("STEP", "Return ECU to default values");
  RunPostTs();
}


testcase SW_IT_ATM_Init_01()
{
  //***********************************Test report header*********************************
  testReportAddMiscInfoBlock("AUTOLIV ELECTRONICS document");
  TestReportAddMiscInfo("Nightly test", "No");
  TestReportAddMiscInfo("Test type", "Requirement-Based test");
  TestReportAddMiscInfo("Regression Test", "No");
  TestReportAddMiscInfo("Fault injection method used", "No");
  TestReportAddMiscInfo("Resource usage evaluation", "No");
  TestReportAddMiscInfo("Priority", "No");
  TestReportAddMiscInfo("Safety relevant", "No");
  
  AddRequirementInfo("Requirement under test", "ARCH_SW_ATM_0001");
  AddRequirementInfo("ARCH_SW_ATM_0001", "Verify that all autotests are initialized with status NOT_DECIDED");
  //***************************************************************************************
  
  testCaseComment("Preconditions");
  testStep("STEP", "Bench Initialization");
  RunPreTs();
  
  
   debugger_reset();
  
   testStep("STEP", "Set a breakpoint in function ATM_Init() at line 'atm_au8AtStatuses [u8IdxAutotest] = KU8_ATM_TEST_NOT_DECIDED;'.");
   debugger_setRelativeFunctionBpAtLine("ATM_Init", 0);
    
   debugger_run();
   
   testCaseComment("Action: ARCH_SW_ATM_0001");
   testStep("STEP", "Check if CPU has stopped in function ATM_Init() at line 'atm_au8AtStatuses [u8IdxAutotest] = KU8_ATM_TEST_NOT_DECIDED;'. --> CPU is Stopped at BP.");
   debugger_WaitUntilBPisReached(500);
  
  
   debugger_run();
  
  
   testCaseComment("Action: ARCH_SW_ATM_0001");
   testStep("STEP", "Evaluate if atm_au8AtStatuses[u8IdxAutotest] is equal to KU8_ATM_TEST_NOT_DECIDED;'. --> atm_au8AtStatuses[u8IdxAutotest] == KU8_ATM_TEST_NOT_DECIDED");
   result = debugger_readGlobalVariable("uint8", "atm_au8AtStatuses,,,App/CPU0", 11);
   EvalManStepEqual("Expected test result", result, 4);
  
   
  testCaseComment("Postcondition");
  testStep("STEP", "Return ECU to default values");
  RunPostTs();
}


testcase SW_IT_ATM_autotest_result_01()
{
  //***********************************Test report header*********************************
  testReportAddMiscInfoBlock("AUTOLIV ELECTRONICS document");
  TestReportAddMiscInfo("Nightly test", "No");
  TestReportAddMiscInfo("Test type", "Requirement-Based test");
  TestReportAddMiscInfo("Regression Test", "No");
  TestReportAddMiscInfo("Fault injection method used", "No");
  TestReportAddMiscInfo("Resource usage evaluation", "No");
  TestReportAddMiscInfo("Priority", "No");
  TestReportAddMiscInfo("Safety relevant", "No");
  
  AddRequirementInfo("Requirement under test", "ARCH_SW_ATM_0002, ARCH_SW_ATM_0003");
  AddRequirementInfo("ARCH_SW_ATM_0002", "Each autotest shall return a result and report it to the rest of the application.");
  AddRequirementInfo("ARCH_SW_ATM_0003", "The Main entry for execution of Autotest is ATM_runMainFunction.");
  //***************************************************************************************
  
  testCaseComment("Preconditions");
  testStep("STEP", "Bench Initialization");
  RunPreTs();
  
  
    testStep("STEP", "Set a breakpoint in ATM_runMainFunction() function at line atm_PlayOneShotTests();.");
    debugger_setRelativeFunctionBpAtLine("ATM_runMainFunction", 23);
    
    debugger_reset();
    debugger_run();
    
    testCaseComment("Action:ARCH_SW_ATM_0003");
    testStep("STEP", "Check if CPU is stopped at the breakpoint in ATM_runMainFunction() function at line 'atm_PlayOneShotTests();'. --> CPU is Stopped");
    debugger_WaitUntilBPisReached(500);
    
    
    testStep("STEP", "Stept in atm_PlayOneShotTests() function. --> Stepped in function atm_PlayCyclicTests");
    debugger_stepIn();
    
  
    debugger_deleteAllBP();
    
    
    testStep("STEP", "Set a breakpoint in atm_PlayOneShotTests() function at line 'switch (atm_au8AtStatuses[u8AutotestID])'.");
    debugger_setRelativeFunctionBpAtLine("atm_PlayOneShotTests", 25);
    
    debugger_run();
    
    testCaseComment("Action: ARCH_SW_ATM_0003");
    testStep("STEP", "Check if CPU is stopped at the breakpoint in atm_PlayOneShotTests() function at line switch (atm_au8AtStatuses[u8AutotestID]). --> CPU is Stopped");
    debugger_WaitUntilBPisReached(500);
    
    
    debugger_deleteAllBP();
    debugger_reset();
    debugger_run();
    
  
    PowerOff();
    testWaitForTimeoutSilent(250);
  
  
    testStep("STEP", "Set a breakpoint in PAL_Autotest_CheckMotorConnection() at line Rte_Call_pclAutotestServices_GetTestResult(ATM_KU8_ID_TEST_MOSFET_HIGH_SHORT_CIRCUIT, &u8PreviousMosfetHighSCTestResult);.");
    debugger_setRelativeFunctionBpAtLine ("PAL_Autotest_CheckMotorConnection", 30);
  
    debugger_run();
    testWaitForTimeoutSilent(500);
      
    testCaseComment("Action: ARCH_SW_ATM_0002");
    testStep("STEP", "Check if CPU is stopped at PAL_Autotest_CheckMotorConnection() at line 'Rte_Call_pclAutotestServices_GetTestResult(ATM_KU8_ID_TEST_MOSFET_HIGH_SHORT_CIRCUIT, &u8PreviousMosfetHighSCTestResult);'. --> CPU is Stopped");
    debugger_WaitUntilBPisReached(500);
    
  
  testCaseComment("Postcondition");
  testStep("STEP", "Return ECU to default values");
  PowerOn();
  testWaitForTimeoutSilent(250);
  RunPostTs();
}



testcase SW_IT_ATM_inhibit_autotest_01() 
{
  //***********************************Test report header*********************************
  testReportAddMiscInfoBlock("AUTOLsIV ELECTRONICS document");
  TestReportAddMiscInfo("Nightly test", "No");
  TestReportAddMiscInfo("Test type", "Requirement-Based test");
  TestReportAddMiscInfo("Regression Test", "No");
  TestReportAddMiscInfo("Fault injection method used", "No");
  TestReportAddMiscInfo("Resource usage evaluation", "No");
  TestReportAddMiscInfo("Priority", "No");
  TestReportAddMiscInfo("Safety relevant", "No");
  
  AddRequirementInfo("Requirement under test", "ARCH_SW_ATM_0030");
  AddRequirementInfo("ARCH_SW_ATM_0030", "ATM_KU8_ID_TEST_HIGH_SIDE_SWITCH autotest is inhibited by KU8_MODES________VOLTAG_INHIB.");
  //***************************************************************************************
  
  testCaseComment("Preconditions");
  testStep("STEP", "Bench Initialization");
  RunPreTs();
  
  
    testStep("STEP", "Set a breakpoint in function ATM_runMainFunction() at line 'atm_PlayCyclicTests(castStartupCyclicList);'.");
    debugger_setRelativeFunctionBpAtLine("ATM_runMainFunction", 21);
    
    debugger_reset();
    debugger_run();
  
    testStep("STEP", "Check if CPU is stopped in function ATM_runMainFunction() at line 'atm_PlayCyclicTests(castStartupCyclicList);'.");
    debugger_WaitUntilBPisReached(500);
    
    
    debugger_deleteAllBP();
    
    
    testStep("STEP", "Set a breakpoint in atm_PlayCyclicTests() function at line 'atm_executeAutoTest(u8AutotestID);' under 'if (B_TRUE == atm_isAutoTestEnabled(u8AutotestID))'.");
    debugger_setRelativeFunctionBpAtLine("atm_PlayCyclicTests", 9);
    
    debugger_run();
    
    testStep("STEP", "Check if CPU is stopped at the breakpoint in atm_PlayCyclicTests() function at line 'atm_executeAutoTest(u8AutotestID);' under 'if (B_TRUE == atm_isAutoTestEnabled(u8AutotestID))'.");
    debugger_WaitUntilBPisReached(500);
  
  
    debugger_deleteAllBP();

  
    testStep("STEP", "Set a breakpoint in function atm_executeAutoTest() at line 'u8InhibModesIndex = castATMConfig[cu8AutotestID].u8InhibIndex;'.");
    debugger_setBpAtLine("s:\\Components\\Application\\Autoliv\\ATM\\Implementation\\src\\ATM.c", 194);
    
    debugger_run();
    
    testStep("STEP", "Check if CPU is stopped in function atm_executeAutoTest() at line 'u8InhibModesIndex = castATMConfig[cu8AutotestID].u8InhibIndex;'.");
    debugger_WaitUntilBPisReached(500);
  
  
    testCaseComment("Action: ARCH_SW_ATM_0030");
    testStep("STEP", "Evaluate if castATMConfig[cu8AutotestID].u8InhibIndex, with cu8AutotestID == ATM_KU8_ID_TEST_HIGH_SIDE_SWITCH, is equal to KU8_MODES________VOLTAG_INHIB. --> u8InhibIndex == KU8_MODES________VOLTAG_INHIB");
    result = debugger_readGlobalVariable("uint8", "castATMConfig", 0x0D);
    EvalManStepEqual("Expected Test Result", result, 0x01);
    
  
  testCaseComment("Postcondition");
  testStep("STEP", "Return ECU to default values");
  RunPostTs();
}


testcase SW_IT_ATM_inhibit_autotest_02() 
{
  //***********************************Test report header*********************************
  testReportAddMiscInfoBlock("AUTOLsIV ELECTRONICS document");
  TestReportAddMiscInfo("Nightly test", "No");
  TestReportAddMiscInfo("Test type", "Requirement-Based test");
  TestReportAddMiscInfo("Regression Test", "No");
  TestReportAddMiscInfo("Fault injection method used", "No");
  TestReportAddMiscInfo("Resource usage evaluation", "No");
  TestReportAddMiscInfo("Priority", "No");
  TestReportAddMiscInfo("Safety relevant", "No");
  
  AddRequirementInfo("Requirement under test", "ARCH_SW_ATM_0031");
  AddRequirementInfo("ARCH_SW_ATM_0031", "ATM_KU8_ID_TEST_DRIVER_COMMAND autotest is inhibited by KU8_MODES________________INHIB.");
  //***************************************************************************************
  
  testCaseComment("Preconditions");
  testStep("STEP", "Bench Initialization");
  RunPreTs();
  
  
    testStep("STEP", "Set a breakpoint in function ATM_runMainFunction() at line 'atm_PlayCyclicTests(castStartupCyclicList);'.");
    debugger_setRelativeFunctionBpAtLine("ATM_runMainFunction", 21);
    
    debugger_reset();
    debugger_run();
  
    testStep("STEP", "Check if CPU is stopped in function ATM_runMainFunction() at line 'atm_PlayCyclicTests(castStartupCyclicList);'.");
    debugger_WaitUntilBPisReached(500);
    
    
    debugger_deleteAllBP();
    
    
    testStep("STEP", "Set a breakpoint in function atm_PlayCyclicTests() at line 'atm_executeAutoTest(u8AutotestID);' under 'if (B_TRUE == atm_isAutoTestEnabled(u8AutotestID))'.");
    debugger_setRelativeFunctionBpAtLine("atm_PlayCyclicTests", 9);
    
    debugger_run();
    
    testStep("STEP", "Check if CPU is stopped in function atm_PlayCyclicTests() at line 'atm_executeAutoTest(u8AutotestID);' under 'if (B_TRUE == atm_isAutoTestEnabled(u8AutotestID))'.");
    debugger_WaitUntilBPisReached(500);
  
  
    debugger_deleteAllBP();

  
    testStep("STEP", "Set a breakpoint in function atm_executeAutoTest() at line 'u8InhibModesIndex = castATMConfig[cu8AutotestID].u8InhibIndex;'.");
    debugger_setBpAtLine("s:\\Components\\Application\\Autoliv\\ATM\\Implementation\\src\\ATM.c", 194);
    
    debugger_run();
    
    testStep("STEP", "Check if CPU is stopped in function atm_executeAutoTest() at line 'u8InhibModesIndex = castATMConfig[cu8AutotestID].u8InhibIndex;'.");
    debugger_WaitUntilBPisReached(500);
  
  
    testCaseComment("Action: ARCH_SW_ATM_0031");
    testStep("STEP", "Evaluate if castATMConfig[cu8AutotestID].u8InhibIndex, with cu8AutotestID == ATM_KU8_ID_TEST_DRIVER_COMMAND, is equal to KU8_MODES_______________INHIB. --> u8InhibIndex == KU8_MODES_______________INHIB");
    result = debugger_readGlobalVariable("uint8", "castATMConfig", 0x0F);
    EvalManStepEqual("Expected Test Result", result, 0x00);
    
  
  testCaseComment("Postcondition");
  testStep("STEP", "Return ECU to default values");
  RunPostTs();
}


testcase SW_IT_ATM_inhibit_autotest_03() 
{
  //***********************************Test report header*********************************
  testReportAddMiscInfoBlock("AUTOLsIV ELECTRONICS document");
  TestReportAddMiscInfo("Nightly test", "No");
  TestReportAddMiscInfo("Test type", "Requirement-Based test");
  TestReportAddMiscInfo("Regression Test", "No");
  TestReportAddMiscInfo("Fault injection method used", "No");
  TestReportAddMiscInfo("Resource usage evaluation", "No");
  TestReportAddMiscInfo("Priority", "No");
  TestReportAddMiscInfo("Safety relevant", "No");
  
  AddRequirementInfo("Requirement under test", "ARCH_SW_ATM_0032");
  AddRequirementInfo("ARCH_SW_ATM_0032", "ATM_KU8_ID_TEST_MOSFET_HIGH_SHORT_CIRCUIT autotest is inhibited by KU8_MODES_BELTFN_VOLTAG_INHIB.");
  //***************************************************************************************
  
  testCaseComment("Preconditions");
  testStep("STEP", "Bench Initialization");
  RunPreTs();
  
  
    testStep("STEP", "Set a breakpoint in function ATM_runMainFunction() at line 'atm_PlayCyclicTests(castStartupCyclicList);'.");
    debugger_setRelativeFunctionBpAtLine("ATM_runMainFunction", 21);
    
    debugger_reset();
    debugger_run();
  
    testStep("STEP", "Check if CPU is stopped in function ATM_runMainFunction() at line 'atm_PlayCyclicTests(castStartupCyclicList);'.");
    debugger_WaitUntilBPisReached(500);
    
    
    debugger_deleteAllBP();
    
    
    testStep("STEP", "Set a breakpoint in function atm_PlayCyclicTests() at line 'atm_executeAutoTest(u8AutotestID);' under 'if (B_TRUE == atm_isAutoTestEnabled(u8AutotestID))'.");
    debugger_setRelativeFunctionBpAtLine("atm_PlayCyclicTests", 9);
    
    debugger_run();
    
    testStep("STEP", "Check if CPU is stopped in function atm_PlayCyclicTests() at line 'atm_executeAutoTest(u8AutotestID);' under 'if (B_TRUE == atm_isAutoTestEnabled(u8AutotestID))'.");
    debugger_WaitUntilBPisReached(500);
  
  
    debugger_deleteAllBP();

  
    testStep("STEP", "Set a breakpoint in function atm_executeAutoTest() at line 'u8InhibModesIndex = castATMConfig[cu8AutotestID].u8InhibIndex;'.");
    debugger_setBpAtLine("s:\\Components\\Application\\Autoliv\\ATM\\Implementation\\src\\ATM.c", 194);
    
    debugger_run();
    
    testStep("STEP", "Check if CPU is stopped in function atm_executeAutoTest() at line 'u8InhibModesIndex = castATMConfig[cu8AutotestID].u8InhibIndex;'.");
    debugger_WaitUntilBPisReached(500);
  
  
    testCaseComment("Action: ARCH_SW_ATM_0032");
    testStep("STEP", "Evaluate if castATMConfig[cu8AutotestID].u8InhibIndex, with cu8AutotestID == ATM_KU8_ID_TEST_MOSFET_HIGH_SHORT_CIRCUIT, is equal to KU8_MODES_BELTFN_VOLTAG_INHIB. --> u8InhibIndex == KU8_MODES_BELTFN_VOLTAG_INHIB");
    result = debugger_readGlobalVariable("uint8", "castATMConfig", 0x1D);
    EvalManStepEqual("Expected Test Result", result, 0x02);
    
  
  testCaseComment("Postcondition");
  testStep("STEP", "Return ECU to default values");
  RunPostTs();
}


testcase SW_IT_ATM_inhibit_autotest_04() 
{
  //***********************************Test report header*********************************
  testReportAddMiscInfoBlock("AUTOLsIV ELECTRONICS document");
  TestReportAddMiscInfo("Nightly test", "No");
  TestReportAddMiscInfo("Test type", "Requirement-Based test");
  TestReportAddMiscInfo("Regression Test", "No");
  TestReportAddMiscInfo("Fault injection method used", "No");
  TestReportAddMiscInfo("Resource usage evaluation", "No");
  TestReportAddMiscInfo("Priority", "No");
  TestReportAddMiscInfo("Safety relevant", "No");
  
  AddRequirementInfo("Requirement under test", "ARCH_SW_ATM_0033");
  AddRequirementInfo("ARCH_SW_ATM_0033", "ATM_KU8_ID_TEST_MOSFET_LOW_SHORT_CIRCUIT autotest is inhibited by KU8_MODES_BELTFN_VOLTAG_INHIB.");
  //***************************************************************************************
  
  testCaseComment("Preconditions");
  testStep("STEP", "Bench Initialization");
  RunPreTs();
  
  
    testStep("STEP", "Set a breakpoint in function ATM_runMainFunction() at line 'atm_PlayCyclicTests(castStartupCyclicList);'.");
    debugger_setRelativeFunctionBpAtLine("ATM_runMainFunction", 21);
    
    debugger_reset();
    debugger_run();
  
    testStep("STEP", "Check if CPU is stopped in function ATM_runMainFunction() at line 'atm_PlayCyclicTests(castStartupCyclicList);'.");
    debugger_WaitUntilBPisReached(500);
    
    
    debugger_deleteAllBP();
    
    
    testStep("STEP", "Set a breakpoint in function atm_PlayCyclicTests() at line 'atm_executeAutoTest(u8AutotestID);' under 'if (B_TRUE == atm_isAutoTestEnabled(u8AutotestID))'.");
    debugger_setRelativeFunctionBpAtLine("atm_PlayCyclicTests", 9);
    
    debugger_run();
    
    testStep("STEP", "Check if CPU is stopped in function atm_PlayCyclicTests() at line 'atm_executeAutoTest(u8AutotestID);' under 'if (B_TRUE == atm_isAutoTestEnabled(u8AutotestID))'.");
    debugger_WaitUntilBPisReached(500);
  
  
    debugger_deleteAllBP();

  
    testStep("STEP", "Set a breakpoint in function atm_executeAutoTest() at line 'u8InhibModesIndex = castATMConfig[cu8AutotestID].u8InhibIndex;'.");
    debugger_setBpAtLine("s:\\Components\\Application\\Autoliv\\ATM\\Implementation\\src\\ATM.c", 194);
    
    debugger_run();
    
    testStep("STEP", "Check if CPU is stopped in function atm_executeAutoTest() at line 'u8InhibModesIndex = castATMConfig[cu8AutotestID].u8InhibIndex;'.");
    debugger_WaitUntilBPisReached(500);
  
  
    testCaseComment("Action: ARCH_SW_ATM_0033");
    testStep("STEP", "Evaluate if castATMConfig[cu8AutotestID].u8InhibIndex, with cu8AutotestID == ATM_KU8_ID_TEST_MOSFET_LOW_SHORT_CIRCUIT, is equal to KU8_MODES_BELTFN_VOLTAG_INHIB. --> u8InhibIndex == KU8_MODES_BELTFN_VOLTAG_INHIB");
    result = debugger_readGlobalVariable("uint8", "castATMConfig", 0x25);
    EvalManStepEqual("Expected Test Result", result, 0x02);
    
  
  testCaseComment("Postcondition");
  testStep("STEP", "Return ECU to default values");
  RunPostTs();
}


testcase SW_IT_ATM_inhibit_autotest_05() 
{
  //***********************************Test report header*********************************
  testReportAddMiscInfoBlock("AUTOLsIV ELECTRONICS document");
  TestReportAddMiscInfo("Nightly test", "No");
  TestReportAddMiscInfo("Test type", "Requirement-Based test");
  TestReportAddMiscInfo("Regression Test", "No");
  TestReportAddMiscInfo("Fault injection method used", "No");
  TestReportAddMiscInfo("Resource usage evaluation", "No");
  TestReportAddMiscInfo("Priority", "No");
  TestReportAddMiscInfo("Safety relevant", "No");
  
  AddRequirementInfo("Requirement under test", "ARCH_SW_ATM_0034");
  AddRequirementInfo("ARCH_SW_ATM_0034", "ATM_KU8_ID_TEST_MOTOR_DISCONNECTION autotest is inhibited by KU8_MODES_BELTFN_VOLTAG_INHIB.");
  //***************************************************************************************
  
  testCaseComment("Preconditions");
  testStep("STEP", "Bench Initialization");
  RunPreTs();
  
  
    testStep("STEP", "Set a breakpoint in function ATM_runMainFunction() at line 'atm_PlayCyclicTests(castStartupCyclicList);'.");
    debugger_setRelativeFunctionBpAtLine("ATM_runMainFunction", 21);
    
    debugger_reset();
    debugger_run();
  
    testStep("STEP", "Check if CPU is stopped in function ATM_runMainFunction() at line 'atm_PlayCyclicTests(castStartupCyclicList);'.");
    debugger_WaitUntilBPisReached(500);
    
    
    debugger_deleteAllBP();
    
    
    testStep("STEP", "Set a breakpoint in function atm_PlayCyclicTests() at line 'atm_executeAutoTest(u8AutotestID);' under 'if (B_TRUE == atm_isAutoTestEnabled(u8AutotestID))'.");
    debugger_setRelativeFunctionBpAtLine("atm_PlayCyclicTests", 9);
    
    debugger_run();
    
    testStep("STEP", "Check if CPU is stopped in function atm_PlayCyclicTests() at line 'atm_executeAutoTest(u8AutotestID);' under 'if (B_TRUE == atm_isAutoTestEnabled(u8AutotestID))'.");
    debugger_WaitUntilBPisReached(500);
  
  
    debugger_deleteAllBP();

  
    testStep("STEP", "Set a breakpoint in function atm_executeAutoTest() at line 'u8InhibModesIndex = castATMConfig[cu8AutotestID].u8InhibIndex;'.");
    debugger_setBpAtLine("s:\\Components\\Application\\Autoliv\\ATM\\Implementation\\src\\ATM.c", 194);
    
    debugger_run();
    
    testStep("STEP", "Check if CPU is stopped in function atm_executeAutoTest() at line 'u8InhibModesIndex = castATMConfig[cu8AutotestID].u8InhibIndex;'.");
    debugger_WaitUntilBPisReached(500);
  
  
    testCaseComment("Action: ARCH_SW_ATM_0034");
    testStep("STEP", "Evaluate if castATMConfig[cu8AutotestID].u8InhibIndex, with cu8AutotestID == ATM_KU8_ID_TEST_MOTOR_DISCONNECTION, is equal to KU8_MODES_BELTFN_VOLTAG_INHIB. --> u8InhibIndex == KU8_MODES_BELTFN_VOLTAG_INHIB");
    result = debugger_readGlobalVariable("uint8", "castATMConfig", 0x2D);
    EvalManStepEqual("Expected Test Result", result, 0x02);
    
  
  testCaseComment("Postcondition");
  testStep("STEP", "Return ECU to default values");
  RunPostTs();
}


testcase SW_IT_ATM_inhibit_autotest_06() 
{
  //***********************************Test report header*********************************
  testReportAddMiscInfoBlock("AUTOLsIV ELECTRONICS document");
  TestReportAddMiscInfo("Nightly test", "No");
  TestReportAddMiscInfo("Test type", "Requirement-Based test");
  TestReportAddMiscInfo("Regression Test", "No");
  TestReportAddMiscInfo("Fault injection method used", "No");
  TestReportAddMiscInfo("Resource usage evaluation", "No");
  TestReportAddMiscInfo("Priority", "No");
  TestReportAddMiscInfo("Safety relevant", "No");
  
  AddRequirementInfo("Requirement under test", "ARCH_SW_ATM_0035");
  AddRequirementInfo("ARCH_SW_ATM_0035", "ATM_KU8_ID_TEST_DRIVER_SELF_PROTECTION autotest is inhibited by KU8_MODES_______________INHIB.");
  //***************************************************************************************
  
  testCaseComment("Preconditions");
  testStep("STEP", "Bench Initialization");
  RunPreTs();
  
  
    testStep("STEP", "Set a breakpoint in function ATM_runMainFunction() at line 'atm_PlayCyclicTests(castStartupCyclicList);'.");
    debugger_setRelativeFunctionBpAtLine("ATM_runMainFunction", 21);
    
    debugger_reset();
    debugger_run();
  
    testStep("STEP", "Check if CPU is stopped in function ATM_runMainFunction() at line 'atm_PlayCyclicTests(castStartupCyclicList);'.");
    debugger_WaitUntilBPisReached(500);
    
    
    debugger_deleteAllBP();
    
    
    testStep("STEP", "Set a breakpoint in function atm_PlayCyclicTests() at line 'atm_executeAutoTest(u8AutotestID);' under 'if (B_TRUE == atm_isAutoTestEnabled(u8AutotestID))'.");
    debugger_setRelativeFunctionBpAtLine("atm_PlayCyclicTests", 9);
    
    debugger_run();
    
    testStep("STEP", "Check if CPU is stopped in function atm_PlayCyclicTests() at line 'atm_executeAutoTest(u8AutotestID);' under 'if (B_TRUE == atm_isAutoTestEnabled(u8AutotestID))'.");
    debugger_WaitUntilBPisReached(500);
  
  
    debugger_deleteAllBP();

  
    testStep("STEP", "Set a breakpoint in function atm_executeAutoTest() at line 'u8InhibModesIndex = castATMConfig[cu8AutotestID].u8InhibIndex;'.");
    debugger_setBpAtLine("s:\\Components\\Application\\Autoliv\\ATM\\Implementation\\src\\ATM.c", 194);
    
    debugger_run();
    
    testStep("STEP", "Check if CPU is stopped in function atm_executeAutoTest() at line 'u8InhibModesIndex = castATMConfig[cu8AutotestID].u8InhibIndex;'.");
    debugger_WaitUntilBPisReached(500);
  
  
    testCaseComment("Action: ARCH_SW_ATM_0035");
    testStep("STEP", "Evaluate if castATMConfig[cu8AutotestID].u8InhibIndex, with cu8AutotestID == ATM_KU8_ID_TEST_DRIVER_SELF_PROTECTION, is equal to KU8_MODES_______________INHIB. --> u8InhibIndex == KU8_MODES_______________INHIB");
    result = debugger_readGlobalVariable("uint8", "castATMConfig", 0x35);
    EvalManStepEqual("Expected Test Result", result, 0x00);
    
  
  testCaseComment("Postcondition");
  testStep("STEP", "Return ECU to default values");
  RunPostTs();
}


testcase SW_IT_ATM_inhibit_autotest_07() 
{
  //***********************************Test report header*********************************
  testReportAddMiscInfoBlock("AUTOLsIV ELECTRONICS document");
  TestReportAddMiscInfo("Nightly test", "No");
  TestReportAddMiscInfo("Test type", "Requirement-Based test");
  TestReportAddMiscInfo("Regression Test", "No");
  TestReportAddMiscInfo("Fault injection method used", "No");
  TestReportAddMiscInfo("Resource usage evaluation", "No");
  TestReportAddMiscInfo("Priority", "No");
  TestReportAddMiscInfo("Safety relevant", "No");
  
  AddRequirementInfo("Requirement under test", "ARCH_SW_ATM_0036");
  AddRequirementInfo("ARCH_SW_ATM_0036", "ATM_KU8_ID_TEST_MOSFET_OPEN_CIRCUIT autotest is inhibited by KU8_MODES_BELTFN_VOLTAG_INHIB.");
  //***************************************************************************************
  
  testCaseComment("Preconditions");
  testStep("STEP", "Bench Initialization");
  RunPreTs();
  
  
    testStep("STEP", "Set a breakpoint in function ATM_runMainFunction() at line 'atm_PlayCyclicTests(castStartupCyclicList);'.");
    debugger_setRelativeFunctionBpAtLine("ATM_runMainFunction", 21);
    
    debugger_reset();
    debugger_run();
  
    testStep("STEP", "Check if CPU is stopped in function ATM_runMainFunction() at line 'atm_PlayCyclicTests(castStartupCyclicList);'.");
    debugger_WaitUntilBPisReached(500);
    
    
    debugger_deleteAllBP();
    
    
    testStep("STEP", "Set a breakpoint in function atm_PlayCyclicTests() at line 'atm_executeAutoTest(u8AutotestID);' under 'if (B_TRUE == atm_isAutoTestEnabled(u8AutotestID))'.");
    debugger_setRelativeFunctionBpAtLine("atm_PlayCyclicTests", 9);
    
    debugger_run();
    
    testStep("STEP", "Check if CPU is stopped in function atm_PlayCyclicTests() at line 'atm_executeAutoTest(u8AutotestID);' under 'if (B_TRUE == atm_isAutoTestEnabled(u8AutotestID))'.");
    debugger_WaitUntilBPisReached(500);
  
  
    debugger_deleteAllBP();

  
    testStep("STEP", "Set a breakpoint in function atm_executeAutoTest() at line 'u8InhibModesIndex = castATMConfig[cu8AutotestID].u8InhibIndex;'.");
    debugger_setBpAtLine("s:\\Components\\Application\\Autoliv\\ATM\\Implementation\\src\\ATM.c", 194);
    
    debugger_run();
    
    testStep("STEP", "Check if CPU is stopped in function atm_executeAutoTest() at line 'u8InhibModesIndex = castATMConfig[cu8AutotestID].u8InhibIndex;'.");
    debugger_WaitUntilBPisReached(500);
  
  
    testCaseComment("Action: ARCH_SW_ATM_0036");
    testStep("STEP", "Evaluate if castATMConfig[cu8AutotestID].u8InhibIndex, with cu8AutotestID == ATM_KU8_ID_TEST_MOSFET_OPEN_CIRCUIT, is equal to KU8_MODES_BELTFN_VOLTAG_INHIB. --> u8InhibIndex == KU8_MODES_BELTFN_VOLTAG_INHIB");
    result = debugger_readGlobalVariable("uint8", "castATMConfig", 0x3D);
    EvalManStepEqual("Expected Test Result", result, 0x02);
    
  
  testCaseComment("Postcondition");
  testStep("STEP", "Return ECU to default values");
  RunPostTs();
}


testcase SW_IT_ATM_inhibit_autotest_08() 
{
  //***********************************Test report header*********************************
  testReportAddMiscInfoBlock("AUTOLsIV ELECTRONICS document");
  TestReportAddMiscInfo("Nightly test", "No");
  TestReportAddMiscInfo("Test type", "Requirement-Based test");
  TestReportAddMiscInfo("Regression Test", "No");
  TestReportAddMiscInfo("Fault injection method used", "No");
  TestReportAddMiscInfo("Resource usage evaluation", "No");
  TestReportAddMiscInfo("Priority", "No");
  TestReportAddMiscInfo("Safety relevant", "No");
  
  AddRequirementInfo("Requirement under test", "ARCH_SW_ATM_0037");
  AddRequirementInfo("ARCH_SW_ATM_0037", "ATM_KU8_ID_TEST_HALL_EFFECT_SENSORS autotest is inhibited by KU8_MODES________VOLTAG_INHIB.");
  //***************************************************************************************
  
  testCaseComment("Preconditions");
  testStep("STEP", "Bench Initialization");
  RunPreTs();
  
  
    testStep("STEP", "Set a breakpoint in function ATM_runMainFunction() at line 'atm_PlayCyclicTests(castStartupCyclicList);'.");
    debugger_setRelativeFunctionBpAtLine("ATM_runMainFunction", 21);
    
    debugger_reset();
    debugger_run();
  
    testStep("STEP", "Check if CPU is stopped in function ATM_runMainFunction() at line 'atm_PlayCyclicTests(castStartupCyclicList);'.");
    debugger_WaitUntilBPisReached(500);
    
    
    debugger_deleteAllBP();
    
    
    testStep("STEP", "Set a breakpoint in function atm_PlayCyclicTests() at line 'atm_executeAutoTest(u8AutotestID);' under 'if (B_TRUE == atm_isAutoTestEnabled(u8AutotestID))'.");
    debugger_setRelativeFunctionBpAtLine("atm_PlayCyclicTests", 9);
    
    debugger_run();
    
    testStep("STEP", "Check if CPU is stopped in function atm_PlayCyclicTests() at line 'atm_executeAutoTest(u8AutotestID);' under 'if (B_TRUE == atm_isAutoTestEnabled(u8AutotestID))'.");
    debugger_WaitUntilBPisReached(500);
  
  
    debugger_deleteAllBP();

  
    testStep("STEP", "Set a breakpoint in function atm_executeAutoTest() at line 'u8InhibModesIndex = castATMConfig[cu8AutotestID].u8InhibIndex;'.");
    debugger_setBpAtLine("s:\\Components\\Application\\Autoliv\\ATM\\Implementation\\src\\ATM.c", 194);
    
    debugger_run();
    
    testStep("STEP", "Check if CPU is stopped in function atm_executeAutoTest() at line 'u8InhibModesIndex = castATMConfig[cu8AutotestID].u8InhibIndex;'.");
    debugger_WaitUntilBPisReached(500);
  
  
    testCaseComment("Action: ARCH_SW_ATM_0037");
    testStep("STEP", "Evaluate if castATMConfig[cu8AutotestID].u8InhibIndex, with cu8AutotestID == ATM_KU8_ID_TEST_HALL_EFFECT_SENSORS, is equal to KU8_MODES________VOLTAG_INHIB. --> u8InhibIndex == KU8_MODES________VOLTAG_INHIB");
    result = debugger_readGlobalVariable("uint8", "castATMConfig", 0x4D);
    EvalManStepEqual("Expected Test Result", result, 0x01);
    
  
  testCaseComment("Postcondition");
  testStep("STEP", "Return ECU to default values");
  RunPostTs();
}



testcase SW_IT_ATM_inhibit_autotest_09() 
{
  //***********************************Test report header*********************************
  testReportAddMiscInfoBlock("AUTOLsIV ELECTRONICS document");
  TestReportAddMiscInfo("Nightly test", "No");
  TestReportAddMiscInfo("Test type", "Requirement-Based test");
  TestReportAddMiscInfo("Regression Test", "No");
  TestReportAddMiscInfo("Fault injection method used", "No");
  TestReportAddMiscInfo("Resource usage evaluation", "No");
  TestReportAddMiscInfo("Priority", "No");
  TestReportAddMiscInfo("Safety relevant", "No");
  
  AddRequirementInfo("Requirement under test", "ARCH_SW_ATM_0038");
  AddRequirementInfo("ARCH_SW_ATM_0038", "ATM_KU8_ID_TEST_MOTOR_CURRENT autotest is inhibited by KU8_MODES________VOLTAG_INHIB.");
  //***************************************************************************************
  
  testCaseComment("Preconditions");
  testStep("STEP", "Bench Initialization");
  RunPreTs();
  
  
    testStep("STEP", "Set a breakpoint in function ATM_runMainFunction() at line 'atm_PlayCyclicTests(castStartupCyclicList);'.");
    debugger_setRelativeFunctionBpAtLine("ATM_runMainFunction", 21);
    
    debugger_reset();
    debugger_run();
  
    testStep("STEP", "Check if CPU is stopped in function ATM_runMainFunction() at line 'atm_PlayCyclicTests(castStartupCyclicList);'.");
    debugger_WaitUntilBPisReached(500);
    
    
    debugger_deleteAllBP();
    
    
    testStep("STEP", "Set a breakpoint in function atm_PlayCyclicTests() at line 'atm_executeAutoTest(u8AutotestID);' under 'if (B_TRUE == atm_isAutoTestEnabled(u8AutotestID))'.");
    debugger_setRelativeFunctionBpAtLine("atm_PlayCyclicTests", 9);
    
    debugger_run();
    
    testStep("STEP", "Check if CPU is stopped in function atm_PlayCyclicTests() at line 'atm_executeAutoTest(u8AutotestID);' under 'if (B_TRUE == atm_isAutoTestEnabled(u8AutotestID))'.");
    debugger_WaitUntilBPisReached(500);
  
  
    debugger_deleteAllBP();

  
    testStep("STEP", "Set a breakpoint in function atm_executeAutoTest() at line 'u8InhibModesIndex = castATMConfig[cu8AutotestID].u8InhibIndex;'.");
    debugger_setBpAtLine("s:\\Components\\Application\\Autoliv\\ATM\\Implementation\\src\\ATM.c", 194);
    
    debugger_run();
    
    testStep("STEP", "Check if CPU is stopped in function atm_executeAutoTest() at line 'u8InhibModesIndex = castATMConfig[cu8AutotestID].u8InhibIndex;'.");
    debugger_WaitUntilBPisReached(500);
  
  
    testCaseComment("Action: ARCH_SW_ATM_0038");
    testStep("STEP", "Evaluate if castATMConfig[cu8AutotestID].u8InhibIndex, with cu8AutotestID == ATM_KU8_ID_TEST_MOTOR_CURRENT, is equal to KU8_MODES________VOLTAG_INHIB. --> u8InhibIndex == KU8_MODES________VOLTAG_INHIB");
    result = debugger_readGlobalVariable("uint8", "castATMConfig", 0x55);
    EvalManStepEqual("Expected Test Result", result, 0x01);
    
  
  testCaseComment("Postcondition");
  testStep("STEP", "Return ECU to default values");
  RunPostTs();
}


testcase SW_IT_ATM_inhibit_autotest_10() 
{
  //***********************************Test report header*********************************
  testReportAddMiscInfoBlock("AUTOLsIV ELECTRONICS document");
  TestReportAddMiscInfo("Nightly test", "No");
  TestReportAddMiscInfo("Test type", "Requirement-Based test");
  TestReportAddMiscInfo("Regression Test", "No");
  TestReportAddMiscInfo("Fault injection method used", "No");
  TestReportAddMiscInfo("Resource usage evaluation", "No");
  TestReportAddMiscInfo("Priority", "No");
  TestReportAddMiscInfo("Safety relevant", "No");
  
  AddRequirementInfo("Requirement under test", "ARCH_SW_ATM_0039");
  AddRequirementInfo("ARCH_SW_ATM_0039", "ATM_KU8_ID_TEST_MOTOR_BLOCKED autotest is inhibited by KU8_MODES________VOLTAG_INHIB.");
  //***************************************************************************************
  
  testCaseComment("Preconditions");
  testStep("STEP", "Bench Initialization");
  RunPreTs();
  
  
    testStep("STEP", "Set a breakpoint in function ATM_runMainFunction() at line 'atm_PlayCyclicTests(castStartupCyclicList);'.");
    debugger_setRelativeFunctionBpAtLine("ATM_runMainFunction", 21);
    
    debugger_reset();
    debugger_run();
  
    testStep("STEP", "Check if CPU is stopped in function ATM_runMainFunction() at line 'atm_PlayCyclicTests(castStartupCyclicList);'.");
    debugger_WaitUntilBPisReached(500);
    
    
    debugger_deleteAllBP();
    
    
    testStep("STEP", "Set a breakpoint in function atm_PlayCyclicTests() at line 'atm_executeAutoTest(u8AutotestID);' under 'if (B_TRUE == atm_isAutoTestEnabled(u8AutotestID))'.");
    debugger_setRelativeFunctionBpAtLine("atm_PlayCyclicTests", 9);
    
    debugger_run();
    
    testStep("STEP", "Check if CPU is stopped in function atm_PlayCyclicTests() at line 'atm_executeAutoTest(u8AutotestID);' under 'if (B_TRUE == atm_isAutoTestEnabled(u8AutotestID))'.");
    debugger_WaitUntilBPisReached(500);
  
  
    debugger_deleteAllBP();

  
    testStep("STEP", "Set a breakpoint in function atm_executeAutoTest() at line 'u8InhibModesIndex = castATMConfig[cu8AutotestID].u8InhibIndex;'.");
    debugger_setBpAtLine("s:\\Components\\Application\\Autoliv\\ATM\\Implementation\\src\\ATM.c", 194);
    
    debugger_run();
    
    testStep("STEP", "Check if CPU is stopped in function atm_executeAutoTest() at line 'u8InhibModesIndex = castATMConfig[cu8AutotestID].u8InhibIndex;'.");
    debugger_WaitUntilBPisReached(500);
  
  
    testCaseComment("Action: ARCH_SW_ATM_0039");
    testStep("STEP", "Evaluate if castATMConfig[cu8AutotestID].u8InhibIndex, with cu8AutotestID == ATM_KU8_ID_TEST_MOTOR_BLOCKED, is equal to KU8_MODES________VOLTAG_INHIB. --> u8InhibIndex == KU8_MODES________VOLTAG_INHIB");
    result = debugger_readGlobalVariable("uint8", "castATMConfig", 0x5D);
    EvalManStepEqual("Expected Test Result", result, 0x01);
    
  
  testCaseComment("Postcondition");
  testStep("STEP", "Return ECU to default values");
  RunPostTs();
}


testcase SW_IT_ATM_inhibit_autotest_11() 
{
  //***********************************Test report header*********************************
  testReportAddMiscInfoBlock("AUTOLsIV ELECTRONICS document");
  TestReportAddMiscInfo("Nightly test", "No");
  TestReportAddMiscInfo("Test type", "Requirement-Based test");
  TestReportAddMiscInfo("Regression Test", "No");
  TestReportAddMiscInfo("Fault injection method used", "No");
  TestReportAddMiscInfo("Resource usage evaluation", "No");
  TestReportAddMiscInfo("Priority", "No");
  TestReportAddMiscInfo("Safety relevant", "No");
  
  AddRequirementInfo("Requirement under test", "ARCH_SW_ATM_0040");
  AddRequirementInfo("ARCH_SW_ATM_0040", "ATM_KU8_ID_TEST_MOTOR_TEMPERATURE autotest is inhibited by KU8_MODES________VOLTAG_INHIB.");
  //***************************************************************************************
  
  testCaseComment("Preconditions");
  testStep("STEP", "Bench Initialization");
  RunPreTs();
  
  
    testStep("STEP", "Set a breakpoint in function ATM_runMainFunction() at line 'atm_PlayCyclicTests(castStartupCyclicList);'.");
    debugger_setRelativeFunctionBpAtLine("ATM_runMainFunction", 21);
    
    debugger_reset();
    debugger_run();
  
    testStep("STEP", "Check if CPU is stopped in function ATM_runMainFunction() at line 'atm_PlayCyclicTests(castStartupCyclicList);'.");
    debugger_WaitUntilBPisReached(500);
    
    
    debugger_deleteAllBP();
    
    
    testStep("STEP", "Set a breakpoint in function atm_PlayCyclicTests() at line 'atm_executeAutoTest(u8AutotestID);' under 'if (B_TRUE == atm_isAutoTestEnabled(u8AutotestID))'.");
    debugger_setRelativeFunctionBpAtLine("atm_PlayCyclicTests", 9);
    
    debugger_run();
    
    testStep("STEP", "Check if CPU is stopped in function atm_PlayCyclicTests() at line 'atm_executeAutoTest(u8AutotestID);' under 'if (B_TRUE == atm_isAutoTestEnabled(u8AutotestID))'.");
    debugger_WaitUntilBPisReached(500);
  
  
    debugger_deleteAllBP();

  
    testStep("STEP", "Set a breakpoint in function atm_executeAutoTest() at line 'u8InhibModesIndex = castATMConfig[cu8AutotestID].u8InhibIndex;'.");
    debugger_setBpAtLine("s:\\Components\\Application\\Autoliv\\ATM\\Implementation\\src\\ATM.c", 194);
    
    debugger_run();
    
    testStep("STEP", "Check if CPU is stopped in function atm_executeAutoTest() at line 'u8InhibModesIndex = castATMConfig[cu8AutotestID].u8InhibIndex;'.");
    debugger_WaitUntilBPisReached(500);
  
  
    testCaseComment("Action: ARCH_SW_ATM_0040");
    testStep("STEP", "Evaluate if castATMConfig[cu8AutotestID].u8InhibIndex, with cu8AutotestID == ATM_KU8_ID_TEST_MOTOR_TEMPERATURE, is equal to KU8_MODES________VOLTAG_INHIB. --> u8InhibIndex == KU8_MODES________VOLTAG_INHIB");
    result = debugger_readGlobalVariable("uint8", "castATMConfig", 0x65);
    EvalManStepEqual("Expected Test Result", 0x01, 0x01);
    
  
  testCaseComment("Postcondition");
  testStep("STEP", "Return ECU to default values");
  RunPostTs();
}


testcase SW_IT_ATM_inhibit_autotest_12() 
{
  //***********************************Test report header*********************************
  testReportAddMiscInfoBlock("AUTOLsIV ELECTRONICS document");
  TestReportAddMiscInfo("Nightly test", "No");
  TestReportAddMiscInfo("Test type", "Requirement-Based test");
  TestReportAddMiscInfo("Regression Test", "No");
  TestReportAddMiscInfo("Fault injection method used", "No");
  TestReportAddMiscInfo("Resource usage evaluation", "No");
  TestReportAddMiscInfo("Priority", "No");
  TestReportAddMiscInfo("Safety relevant", "No");
  
  AddRequirementInfo("Requirement under test", "ARCH_SW_ATM_0041");
  AddRequirementInfo("ARCH_SW_ATM_0041", "ATM_KU8_ID_TEST_MOTOR_SHORT_CIRCUIT  autotest is inhibited by KU8_MODES________________INHIB.");
  //***************************************************************************************
  
  testCaseComment("Preconditions");
  testStep("STEP", "Bench Initialization");
  RunPreTs();
  
  
    testStep("STEP", "Set a breakpoint in function ATM_runMainFunction() at line 'atm_PlayCyclicTests(castStartupCyclicList);'.");
    debugger_setRelativeFunctionBpAtLine("ATM_runMainFunction", 21);
    
    debugger_reset();
    debugger_run();
  
    testStep("STEP", "Check if CPU is stopped in function ATM_runMainFunction() at line 'atm_PlayCyclicTests(castStartupCyclicList);'.");
    debugger_WaitUntilBPisReached(500);
    
    
    debugger_deleteAllBP();
    
    
    testStep("STEP", "Set a breakpoint in function atm_PlayCyclicTests() at line 'atm_executeAutoTest(u8AutotestID);' under 'if (B_TRUE == atm_isAutoTestEnabled(u8AutotestID))'.");
    debugger_setRelativeFunctionBpAtLine("atm_PlayCyclicTests", 9);
    
    debugger_run();
    
    testStep("STEP", "Check if CPU is stopped in function atm_PlayCyclicTests() at line 'atm_executeAutoTest(u8AutotestID);' under 'if (B_TRUE == atm_isAutoTestEnabled(u8AutotestID))'.");
    debugger_WaitUntilBPisReached(500);
  
  
    debugger_deleteAllBP();

  
    testStep("STEP", "Set a breakpoint in function atm_executeAutoTest() at line 'u8InhibModesIndex = castATMConfig[cu8AutotestID].u8InhibIndex;'.");
    debugger_setBpAtLine("s:\\Components\\Application\\Autoliv\\ATM\\Implementation\\src\\ATM.c", 194);
    
    debugger_run();
    
    testStep("STEP", "Check if CPU is stopped in function atm_executeAutoTest() at line 'u8InhibModesIndex = castATMConfig[cu8AutotestID].u8InhibIndex;'.");
    debugger_WaitUntilBPisReached(500);
  
  
    testCaseComment("Action: ARCH_SW_ATM_0041");
    testStep("STEP", "Evaluate if castATMConfig[cu8AutotestID].u8InhibIndex, with cu8AutotestID == ATM_KU8_ID_TEST_MOTOR_SHORT_CIRCUIT, is equal to KU8_MODES________________INHIB. --> u8InhibIndex == KU8_MODES________________INHIB");
    result = debugger_readGlobalVariable("uint8", "castATMConfig", 0x75);
    EvalManStepEqual("Expected Test Result", 0x00, 0x00);
    
  
  testCaseComment("Postcondition");
  testStep("STEP", "Return ECU to default values");
  RunPostTs();
}


testcase SW_IT_ATM_inhibit_autotest_13() 
{
  //***********************************Test report header*********************************
  testReportAddMiscInfoBlock("AUTOLsIV ELECTRONICS document");
  TestReportAddMiscInfo("Nightly test", "No");
  TestReportAddMiscInfo("Test type", "Requirement-Based test");
  TestReportAddMiscInfo("Regression Test", "No");
  TestReportAddMiscInfo("Fault injection method used", "No");
  TestReportAddMiscInfo("Resource usage evaluation", "No");
  TestReportAddMiscInfo("Priority", "No");
  TestReportAddMiscInfo("Safety relevant", "No");
  
  AddRequirementInfo("Requirement under test", "ARCH_SW_ATM_0042");
  AddRequirementInfo("ARCH_SW_ATM_0042", "ATM_KU8_ID_TEST_SENSOR_TEMPERATURE autotest is inhibited by KU8_MODES________________INHIB.");
  //***************************************************************************************
  
  testCaseComment("Preconditions");
  testStep("STEP", "Bench Initialization");
  RunPreTs();
  
  
    testStep("STEP", "Set a breakpoint in function ATM_runMainFunction() at line 'atm_PlayCyclicTests(castStartupCyclicList);'.");
    debugger_setRelativeFunctionBpAtLine("ATM_runMainFunction", 21);
    
    debugger_reset();
    debugger_run();
  
    testStep("STEP", "Check if CPU is stopped in function ATM_runMainFunction() at line 'atm_PlayCyclicTests(castStartupCyclicList);'.");
    debugger_WaitUntilBPisReached(500);
    
    
    debugger_deleteAllBP();
    
    
    testStep("STEP", "Set a breakpoint in function atm_PlayCyclicTests() at line 'atm_executeAutoTest(u8AutotestID);' under 'if (B_TRUE == atm_isAutoTestEnabled(u8AutotestID))'.");
    debugger_setRelativeFunctionBpAtLine("atm_PlayCyclicTests", 9);
    
    debugger_run();
    
    testStep("STEP", "Check if CPU is stopped in function atm_PlayCyclicTests() at line 'atm_executeAutoTest(u8AutotestID);' under 'if (B_TRUE == atm_isAutoTestEnabled(u8AutotestID))'.");
    debugger_WaitUntilBPisReached(500);
  
  
    debugger_deleteAllBP();

  
    testStep("STEP", "Set a breakpoint in function atm_executeAutoTest() at line 'u8InhibModesIndex = castATMConfig[cu8AutotestID].u8InhibIndex;'.");
    debugger_setBpAtLine("s:\\Components\\Application\\Autoliv\\ATM\\Implementation\\src\\ATM.c", 194);
    
    debugger_run();
    
    testStep("STEP", "Check if CPU is stopped in function atm_executeAutoTest() at line 'u8InhibModesIndex = castATMConfig[cu8AutotestID].u8InhibIndex;'.");
    debugger_WaitUntilBPisReached(500);
  
    
    testCaseComment("Action: ARCH_SW_ATM_0042");
    testStep("STEP", "Evaluate if castATMConfig[cu8AutotestID].u8InhibIndex, with cu8AutotestID == ATM_KU8_ID_TEST_SENSOR_TEMPERATURE, is equal to KU8_MODES________________INHIB. --> u8InhibIndex == KU8_MODES________________INHIB");
    result = debugger_readGlobalVariable("uint8", "castATMConfig", 0x6D);
    EvalManStepEqual("Expected Test Result", result, 0x00);
    
  
  testCaseComment("Postcondition");
  testStep("STEP", "Return ECU to default values");
  RunPostTs();
}


testcase SW_IT_ATM_inhibit_autotest_14() 
{
  //***********************************Test report header*********************************
  testReportAddMiscInfoBlock("AUTOLsIV ELECTRONICS document");
  TestReportAddMiscInfo("Nightly test", "No");
  TestReportAddMiscInfo("Test type", "Requirement-Based test");
  TestReportAddMiscInfo("Regression Test", "No");
  TestReportAddMiscInfo("Fault injection method used", "No");
  TestReportAddMiscInfo("Resource usage evaluation", "No");
  TestReportAddMiscInfo("Priority", "No");
  TestReportAddMiscInfo("Safety relevant", "No");
  
  AddRequirementInfo("Requirement under test", "ARCH_SW_ATM_0043");
  AddRequirementInfo("ARCH_SW_ATM_0043", "ATM_KU8_ID_TEST_PWM_ORDER autotest is inhibited by KU8_MODES________VOLTAG_INHIB.");
  //***************************************************************************************
  
  testCaseComment("Preconditions");
  testStep("STEP", "Bench Initialization");
  RunPreTs();
  
  
    testStep("STEP", "Set a breakpoint in function ATM_runMainFunction() at line 'atm_PlayCyclicTests(castStartupCyclicList);'.");
    debugger_setRelativeFunctionBpAtLine("ATM_runMainFunction", 21);
    
    debugger_reset();
    debugger_run();
  
    testStep("STEP", "Check if CPU is stopped in function ATM_runMainFunction() at line 'atm_PlayCyclicTests(castStartupCyclicList);'.");
    debugger_WaitUntilBPisReached(500);
    
    
    debugger_deleteAllBP();
    
    
    testStep("STEP", "Set a breakpoint in function atm_PlayCyclicTests() at line 'atm_executeAutoTest(u8AutotestID);' under 'if (B_TRUE == atm_isAutoTestEnabled(u8AutotestID))'.");
    debugger_setRelativeFunctionBpAtLine("atm_PlayCyclicTests", 9);
    
    debugger_run();
    
    testStep("STEP", "Check if CPU is stopped in function atm_PlayCyclicTests() at line 'atm_executeAutoTest(u8AutotestID);' under 'if (B_TRUE == atm_isAutoTestEnabled(u8AutotestID))'.");
    debugger_WaitUntilBPisReached(500);
  
  
    debugger_deleteAllBP();

  
    testStep("STEP", "Set a breakpoint in function atm_executeAutoTest() at line 'u8InhibModesIndex = castATMConfig[cu8AutotestID].u8InhibIndex;'.");
    debugger_setBpAtLine("s:\\Components\\Application\\Autoliv\\ATM\\Implementation\\src\\ATM.c", 194);
    
    debugger_run();
    
    testStep("STEP", "Check if CPU is stopped in function atm_executeAutoTest() at line 'u8InhibModesIndex = castATMConfig[cu8AutotestID].u8InhibIndex;'.");
    debugger_WaitUntilBPisReached(500);
  
    
    testCaseComment("Action: ARCH_SW_ATM_0043");
    testStep("STEP", "Evaluate if castATMConfig[cu8AutotestID].u8InhibIndex, with cu8AutotestID == ATM_KU8_ID_TEST_PWM_ORDER, is equal to KU8_MODES________VOLTAG_INHIB. --> u8InhibIndex == KU8_MODES________VOLTAG_INHIB");
    result = debugger_readGlobalVariable("uint8", "castATMConfig", 0x7D);
    EvalManStepEqual("Expected Test Result", result, 0x01);
    
  
  testCaseComment("Postcondition");
  testStep("STEP", "Return ECU to default values");
  RunPostTs();
}


testcase SW_IT_ATM_inhibit_autotest_15() 
{
  //***********************************Test report header*********************************
  testReportAddMiscInfoBlock("AUTOLsIV ELECTRONICS document");
  TestReportAddMiscInfo("Nightly test", "No");
  TestReportAddMiscInfo("Test type", "Requirement-Based test");
  TestReportAddMiscInfo("Regression Test", "No");
  TestReportAddMiscInfo("Fault injection method used", "No");
  TestReportAddMiscInfo("Resource usage evaluation", "No");
  TestReportAddMiscInfo("Priority", "No");
  TestReportAddMiscInfo("Safety relevant", "No");
  
  AddRequirementInfo("Requirement under test", "ARCH_SW_ATM_0044");
  AddRequirementInfo("ARCH_SW_ATM_0044", "ATM_KU8_ID_TEST_UNDER_VOLTAGE_POWER autotest is inhibited by KU8_MODES________________INHIB.");
  //***************************************************************************************
  
  testCaseComment("Preconditions");
  testStep("STEP", "Bench Initialization");
  RunPreTs();
  
  
    testStep("STEP", "Set a breakpoint in function ATM_runMainFunction() at line 'atm_PlayCyclicTests(castStartupCyclicList);'.");
    debugger_setRelativeFunctionBpAtLine("ATM_runMainFunction", 21);
    
    debugger_reset();
    debugger_run();
  
    testStep("STEP", "Check if CPU is stopped in function ATM_runMainFunction() at line 'atm_PlayCyclicTests(castStartupCyclicList);'.");
    debugger_WaitUntilBPisReached(500);
    
    
    debugger_deleteAllBP();
    
    
    testStep("STEP", "Set a breakpoint in function atm_PlayCyclicTests() at line 'atm_executeAutoTest(u8AutotestID);' under 'if (B_TRUE == atm_isAutoTestEnabled(u8AutotestID))'.");
    debugger_setRelativeFunctionBpAtLine("atm_PlayCyclicTests", 9);
    
    debugger_run();
    
    testStep("STEP", "Check if CPU is stopped in function atm_PlayCyclicTests() at line 'atm_executeAutoTest(u8AutotestID);' under 'if (B_TRUE == atm_isAutoTestEnabled(u8AutotestID))'.");
    debugger_WaitUntilBPisReached(500);
  
  
    debugger_deleteAllBP();

  
    testStep("STEP", "Set a breakpoint in function atm_executeAutoTest() at line 'u8InhibModesIndex = castATMConfig[cu8AutotestID].u8InhibIndex;'.");
    debugger_setBpAtLine("s:\\Components\\Application\\Autoliv\\ATM\\Implementation\\src\\ATM.c", 194);
    
    debugger_run();
    
    testStep("STEP", "Check if CPU is stopped in function atm_executeAutoTest() at line 'u8InhibModesIndex = castATMConfig[cu8AutotestID].u8InhibIndex;'.");
    debugger_WaitUntilBPisReached(500);
  
    
    testCaseComment("Action: ARCH_SW_ATM_0044");
    testStep("STEP", "Evaluate if castATMConfig[cu8AutotestID].u8InhibIndex, with cu8AutotestID == ATM_KU8_ID_TEST_UNDER_VOLTAGE_POWER, is equal to KU8_MODES________________INHIB. --> u8InhibIndex == KU8_MODES________________INHIB");
    result = debugger_readGlobalVariable("uint8", "castATMConfig", 0x85);
    EvalManStepEqual("Expected Test Result", result, 0x00);
    
  
  testCaseComment("Postcondition");
  testStep("STEP", "Return ECU to default values");
  RunPostTs();
}


testcase SW_IT_ATM_inhibit_autotest_16() 
{
  //***********************************Test report header*********************************
  testReportAddMiscInfoBlock("AUTOLsIV ELECTRONICS document");
  TestReportAddMiscInfo("Nightly test", "No");
  TestReportAddMiscInfo("Test type", "Requirement-Based test");
  TestReportAddMiscInfo("Regression Test", "No");
  TestReportAddMiscInfo("Fault injection method used", "No");
  TestReportAddMiscInfo("Resource usage evaluation", "No");
  TestReportAddMiscInfo("Priority", "No");
  TestReportAddMiscInfo("Safety relevant", "No");
  
  AddRequirementInfo("Requirement under test", "ARCH_SW_ATM_0045");
  AddRequirementInfo("ARCH_SW_ATM_0045", "ATM_KU8_ID_TEST_OVER_VOLTAGE_POWER autotest is inhibited by KU8_MODES________________INHIB.");
  //***************************************************************************************
  
  testCaseComment("Preconditions");
  testStep("STEP", "Bench Initialization");
  RunPreTs();
  
  
    testStep("STEP", "Set a breakpoint in function ATM_runMainFunction() at line 'atm_PlayCyclicTests(castStartupCyclicList);'.");
    debugger_setRelativeFunctionBpAtLine("ATM_runMainFunction", 21);
    
    debugger_reset();
    debugger_run();
  
    testStep("STEP", "Check if CPU is stopped in function ATM_runMainFunction() at line 'atm_PlayCyclicTests(castStartupCyclicList);'.");
    debugger_WaitUntilBPisReached(500);
    
    
    debugger_deleteAllBP();
    
    
    testStep("STEP", "Set a breakpoint in function atm_PlayCyclicTests() at line 'atm_executeAutoTest(u8AutotestID);' under 'if (B_TRUE == atm_isAutoTestEnabled(u8AutotestID))'.");
    debugger_setRelativeFunctionBpAtLine("atm_PlayCyclicTests", 9);
    
    debugger_run();
    
    testStep("STEP", "Check if CPU is stopped in function atm_PlayCyclicTests() at line 'atm_executeAutoTest(u8AutotestID);' under 'if (B_TRUE == atm_isAutoTestEnabled(u8AutotestID))'.");
    debugger_WaitUntilBPisReached(500);
  
  
    debugger_deleteAllBP();

  
    testStep("STEP", "Set a breakpoint in function atm_executeAutoTest() at line 'u8InhibModesIndex = castATMConfig[cu8AutotestID].u8InhibIndex;'.");
    debugger_setBpAtLine("s:\\Components\\Application\\Autoliv\\ATM\\Implementation\\src\\ATM.c", 194);
    
    debugger_run();
    
    testStep("STEP", "Check if CPU is stopped in function atm_executeAutoTest() at line 'u8InhibModesIndex = castATMConfig[cu8AutotestID].u8InhibIndex;'.");
    debugger_WaitUntilBPisReached(500);
  
    
    testCaseComment("Action: ARCH_SW_ATM_0045");
    testStep("STEP", "Evaluate if castATMConfig[cu8AutotestID].u8InhibIndex, with cu8AutotestID == ATM_KU8_ID_TEST_OVER_VOLTAGE_POWER, is equal to KU8_MODES________________INHIB. --> u8InhibIndex == KU8_MODES________________INHIB");
    result = debugger_readGlobalVariable("uint8", "castATMConfig", 0x8D);
    EvalManStepEqual("Expected Test Result", result, 0x00);
    
  
  testCaseComment("Postcondition");
  testStep("STEP", "Return ECU to default values");
  RunPostTs();
}


testcase SW_IT_ATM_inhibit_autotest_17() 
{
  //***********************************Test report header*********************************
  testReportAddMiscInfoBlock("AUTOLsIV ELECTRONICS document");
  TestReportAddMiscInfo("Nightly test", "No");
  TestReportAddMiscInfo("Test type", "Requirement-Based test");
  TestReportAddMiscInfo("Regression Test", "No");
  TestReportAddMiscInfo("Fault injection method used", "No");
  TestReportAddMiscInfo("Resource usage evaluation", "No");
  TestReportAddMiscInfo("Priority", "No");
  TestReportAddMiscInfo("Safety relevant", "No");
  
  AddRequirementInfo("Requirement under test", "ARCH_SW_ATM_0046");
  AddRequirementInfo("ARCH_SW_ATM_0046", "ATM_KU8_ID_TEST_UNDER_VOLTAGE_TENSIONING_POWER autotest is inhibited by KU8_MODES________________INHIB.");
  //***************************************************************************************
  
  testCaseComment("Preconditions");
  testStep("STEP", "Bench Initialization");
  RunPreTs();
  
  
    testStep("STEP", "Set a breakpoint in function ATM_runMainFunction() at line 'atm_PlayCyclicTests(castStartupCyclicList);'.");
    debugger_setRelativeFunctionBpAtLine("ATM_runMainFunction", 21);
    
    debugger_reset();
    debugger_run();
  
    testStep("STEP", "Check if CPU is stopped in function ATM_runMainFunction() at line 'atm_PlayCyclicTests(castStartupCyclicList);'.");
    debugger_WaitUntilBPisReached(500);
    
    
    debugger_deleteAllBP();
    
    
    testStep("STEP", "Set a breakpoint in function atm_PlayCyclicTests() at line 'atm_executeAutoTest(u8AutotestID);' under 'if (B_TRUE == atm_isAutoTestEnabled(u8AutotestID))'.");
    debugger_setRelativeFunctionBpAtLine("atm_PlayCyclicTests", 9);
    
    debugger_run();
    
    testStep("STEP", "Check if CPU is stopped in function atm_PlayCyclicTests() at line 'atm_executeAutoTest(u8AutotestID);' under 'if (B_TRUE == atm_isAutoTestEnabled(u8AutotestID))'.");
    debugger_WaitUntilBPisReached(500);
  
  
    debugger_deleteAllBP();

  
    testStep("STEP", "Set a breakpoint in function atm_executeAutoTest() at line 'u8InhibModesIndex = castATMConfig[cu8AutotestID].u8InhibIndex;'.");
    debugger_setBpAtLine("s:\\Components\\Application\\Autoliv\\ATM\\Implementation\\src\\ATM.c", 194);
    
    debugger_run();
    
    testStep("STEP", "Check if CPU is stopped in function atm_executeAutoTest() at line 'u8InhibModesIndex = castATMConfig[cu8AutotestID].u8InhibIndex;'.");
    debugger_WaitUntilBPisReached(500);
  
    
    testCaseComment("Action: ARCH_SW_ATM_0046");
    testStep("STEP", "Evaluate if castATMConfig[cu8AutotestID].u8InhibIndex, with cu8AutotestID == ATM_KU8_ID_TEST_UNDER_VOLTAGE_TENSIONING_POWER, is equal to KU8_MODES________________INHIB. --> u8InhibIndex == KU8_MODES________________INHIB");
    result = debugger_readGlobalVariable("uint8", "castATMConfig", 0x95);
    EvalManStepEqual("Expected Test Result", result, 0x00);
    
  
  testCaseComment("Postcondition");
  testStep("STEP", "Return ECU to default values");
  RunPostTs();
}


testcase SW_IT_ATM_inhibit_autotest_18() 
{
  //***********************************Test report header*********************************
  testReportAddMiscInfoBlock("AUTOLsIV ELECTRONICS document");
  TestReportAddMiscInfo("Nightly test", "No");
  TestReportAddMiscInfo("Test type", "Requirement-Based test");
  TestReportAddMiscInfo("Regression Test", "No");
  TestReportAddMiscInfo("Fault injection method used", "No");
  TestReportAddMiscInfo("Resource usage evaluation", "No");
  TestReportAddMiscInfo("Priority", "No");
  TestReportAddMiscInfo("Safety relevant", "No");
  
  AddRequirementInfo("Requirement under test", "ARCH_SW_ATM_0047");
  AddRequirementInfo("ARCH_SW_ATM_0047", "ATM_KU8_ID_TEST_OVER_VOLTAGE_TENSIONING_POWER autotest is inhibited by KU8_MODES________________INHIB.");
  //***************************************************************************************
  
  testCaseComment("Preconditions");
  testStep("STEP", "Bench Initialization");
  RunPreTs();
  
  
    testStep("STEP", "Set a breakpoint in function ATM_runMainFunction() at line 'atm_PlayCyclicTests(castStartupCyclicList);'.");
    debugger_setRelativeFunctionBpAtLine("ATM_runMainFunction", 21);
    
    debugger_reset();
    debugger_run();
  
    testStep("STEP", "Check if CPU is stopped in function ATM_runMainFunction() at line 'atm_PlayCyclicTests(castStartupCyclicList);'.");
    debugger_WaitUntilBPisReached(500);
    
    
    debugger_deleteAllBP();
    
    
    testStep("STEP", "Set a breakpoint in function atm_PlayCyclicTests() at line 'atm_executeAutoTest(u8AutotestID);' under 'if (B_TRUE == atm_isAutoTestEnabled(u8AutotestID))'.");
    debugger_setRelativeFunctionBpAtLine("atm_PlayCyclicTests", 9);
    
    debugger_run();
    
    testStep("STEP", "Check if CPU is stopped in function atm_PlayCyclicTests() at line 'atm_executeAutoTest(u8AutotestID);' under 'if (B_TRUE == atm_isAutoTestEnabled(u8AutotestID))'.");
    debugger_WaitUntilBPisReached(500);
  
  
    debugger_deleteAllBP();

  
    testStep("STEP", "Set a breakpoint in function atm_executeAutoTest() at line 'u8InhibModesIndex = castATMConfig[cu8AutotestID].u8InhibIndex;'.");
    debugger_setBpAtLine("s:\\Components\\Application\\Autoliv\\ATM\\Implementation\\src\\ATM.c", 194);
    
    debugger_run();
    
    testStep("STEP", "Check if CPU is stopped in function atm_executeAutoTest() at line 'u8InhibModesIndex = castATMConfig[cu8AutotestID].u8InhibIndex;'.");
    debugger_WaitUntilBPisReached(500);
  
    
    testCaseComment("Action: ARCH_SW_ATM_0047");
    testStep("STEP", "Evaluate if castATMConfig[cu8AutotestID].u8InhibIndex, with cu8AutotestID == ATM_KU8_ID_TEST_OVER_VOLTAGE_TENSIONING_POWER, is equal to KU8_MODES________________INHIB. --> u8InhibIndex == KU8_MODES________________INHIB");
    result = debugger_readGlobalVariable("uint8", "castATMConfig", 0x9D);
    EvalManStepEqual("Expected Test Result", result, 0x00);
    
  
  testCaseComment("Postcondition");
  testStep("STEP", "Return ECU to default values");
  RunPostTs();
}


testcase SW_IT_ATM_inhibit_autotest_19() 
{
  //***********************************Test report header*********************************
  testReportAddMiscInfoBlock("AUTOLsIV ELECTRONICS document");
  TestReportAddMiscInfo("Nightly test", "No");
  TestReportAddMiscInfo("Test type", "Requirement-Based test");
  TestReportAddMiscInfo("Regression Test", "No");
  TestReportAddMiscInfo("Fault injection method used", "No");
  TestReportAddMiscInfo("Resource usage evaluation", "No");
  TestReportAddMiscInfo("Priority", "No");
  TestReportAddMiscInfo("Safety relevant", "No");
  
  AddRequirementInfo("Requirement under test", "ARCH_SW_ATM_0048");
  AddRequirementInfo("ARCH_SW_ATM_0048", "ATM_KU8_ID_EXT_WDG_OUT_OF_ORDER autotest is inhibited by KU8_MODES______________________INHIB.");
  //***************************************************************************************
  
  testCaseComment("Preconditions");
  testStep("STEP", "Bench Initialization");
  RunPreTs();
  
  
    testStep("STEP", "Set a breakpoint in function ATM_runMainFunction() at line 'atm_PlayCyclicTests(castStartupCyclicList);'.");
    debugger_setRelativeFunctionBpAtLine("ATM_runMainFunction", 21);
    
    debugger_reset();
    debugger_run();
  
    testStep("STEP", "Check if CPU is stopped in function ATM_runMainFunction() at line 'atm_PlayCyclicTests(castStartupCyclicList);'.");
    debugger_WaitUntilBPisReached(500);
    
    
    debugger_deleteAllBP();
    
    
    testStep("STEP", "Set a breakpoint in function atm_PlayCyclicTests() at line 'atm_executeAutoTest(u8AutotestID);' under 'if (B_TRUE == atm_isAutoTestEnabled(u8AutotestID))'.");
    debugger_setRelativeFunctionBpAtLine("atm_PlayCyclicTests", 9);
    
    debugger_run();
    
    testStep("STEP", "Check if CPU is stopped in function atm_PlayCyclicTests() at line 'atm_executeAutoTest(u8AutotestID);' under 'if (B_TRUE == atm_isAutoTestEnabled(u8AutotestID))'.");
    debugger_WaitUntilBPisReached(500);
  
  
    debugger_deleteAllBP();

  
    testStep("STEP", "Set a breakpoint in function atm_executeAutoTest() at line 'u8InhibModesIndex = castATMConfig[cu8AutotestID].u8InhibIndex;'.");
    debugger_setBpAtLine("s:\\Components\\Application\\Autoliv\\ATM\\Implementation\\src\\ATM.c", 194);
    
    debugger_run();
    
    testStep("STEP", "Check if CPU is stopped in function atm_executeAutoTest() at line 'u8InhibModesIndex = castATMConfig[cu8AutotestID].u8InhibIndex;'.");
    debugger_WaitUntilBPisReached(500);
  
    
    testCaseComment("Action: ARCH_SW_ATM_0048");
    testStep("STEP", "Evaluate if castATMConfig[cu8AutotestID].u8InhibIndex, with cu8AutotestID == ATM_KU8_ID_EXT_WDG_OUT_OF_ORDER, is equal to KU8_MODES________________INHIB. --> u8InhibIndex == KU8_MODES________________INHIB");
    result = debugger_readGlobalVariable("uint8", "castATMConfig", 0xA5);
    EvalManStepEqual("Expected Test Result", result, 0x00);
    
  
  testCaseComment("Postcondition");
  testStep("STEP", "Return ECU to default values");
  RunPostTs();
}


testcase SW_IT_ATM_inhibit_autotest_20() 
{
  //***********************************Test report header*********************************
  testReportAddMiscInfoBlock("AUTOLsIV ELECTRONICS document");
  TestReportAddMiscInfo("Nightly test", "No");
  TestReportAddMiscInfo("Test type", "Requirement-Based test");
  TestReportAddMiscInfo("Regression Test", "No");
  TestReportAddMiscInfo("Fault injection method used", "No");
  TestReportAddMiscInfo("Resource usage evaluation", "No");
  TestReportAddMiscInfo("Priority", "No");
  TestReportAddMiscInfo("Safety relevant", "No");
  
  AddRequirementInfo("Requirement under test", "ARCH_SW_ATM_0049");
  AddRequirementInfo("ARCH_SW_ATM_0049", "ATM_KU8_ID_RESET_CAUSE autotest is inhibited by KU8_MODES______________________INHIB.");
  //***************************************************************************************
  
  testCaseComment("Preconditions");
  testStep("STEP", "Bench Initialization");
  RunPreTs();
  
  
    testStep("STEP", "Set a breakpoint in function ATM_runMainFunction() at line 'atm_PlayCyclicTests(castStartupCyclicList);'.");
    debugger_setRelativeFunctionBpAtLine("ATM_runMainFunction", 21);
    
    debugger_reset();
    debugger_run();
  
    testStep("STEP", "Check if CPU is stopped in function ATM_runMainFunction() at line 'atm_PlayCyclicTests(castStartupCyclicList);'.");
    debugger_WaitUntilBPisReached(500);
    
    
    debugger_deleteAllBP();
    
    
    testStep("STEP", "Set a breakpoint in function atm_PlayCyclicTests() at line 'atm_executeAutoTest(u8AutotestID);' under 'if (B_TRUE == atm_isAutoTestEnabled(u8AutotestID))'.");
    debugger_setRelativeFunctionBpAtLine("atm_PlayCyclicTests", 9);
    
    debugger_run();
    
    testStep("STEP", "Check if CPU is stopped in function atm_PlayCyclicTests() at line 'atm_executeAutoTest(u8AutotestID);' under 'if (B_TRUE == atm_isAutoTestEnabled(u8AutotestID))'.");
    debugger_WaitUntilBPisReached(500);
  
  
    debugger_deleteAllBP();

  
    testStep("STEP", "Set a breakpoint in function atm_executeAutoTest() at line 'u8InhibModesIndex = castATMConfig[cu8AutotestID].u8InhibIndex;'.");
    debugger_setBpAtLine("s:\\Components\\Application\\Autoliv\\ATM\\Implementation\\src\\ATM.c", 194);
    
    debugger_run();
    
    testStep("STEP", "Check if CPU is stopped in function atm_executeAutoTest() at line 'u8InhibModesIndex = castATMConfig[cu8AutotestID].u8InhibIndex;'.");
    debugger_WaitUntilBPisReached(500);
  
    
    testCaseComment("Action: ARCH_SW_ATM_0049");
    testStep("STEP", "Evaluate if castATMConfig[cu8AutotestID].u8InhibIndex, with cu8AutotestID == ATM_KU8_ID_RESET_CAUSE, is equal to KU8_MODES________________INHIB. --> u8InhibIndex == KU8_MODES________________INHIB");
    result = debugger_readGlobalVariable("uint8", "castATMConfig", 0xDD);
    EvalManStepEqual("Expected Test Result", result, 0x00);
    
  
  testCaseComment("Postcondition");
  testStep("STEP", "Return ECU to default values");
  RunPostTs();
}


testcase SW_IT_ATM_inhibit_autotest_21() 
{
  //***********************************Test report header*********************************
  testReportAddMiscInfoBlock("AUTOLsIV ELECTRONICS document");
  TestReportAddMiscInfo("Nightly test", "No");
  TestReportAddMiscInfo("Test type", "Requirement-Based test");
  TestReportAddMiscInfo("Regression Test", "No");
  TestReportAddMiscInfo("Fault injection method used", "No");
  TestReportAddMiscInfo("Resource usage evaluation", "No");
  TestReportAddMiscInfo("Priority", "No");
  TestReportAddMiscInfo("Safety relevant", "No");
  
  AddRequirementInfo("Requirement under test", "ARCH_SW_ATM_0050");
  AddRequirementInfo("ARCH_SW_ATM_0050", "ATM_KU8_ID_END_OF_LIFE_LOW_FORCE autotest is inhibited by KU8_MODES______________________INHIB.");
  //***************************************************************************************
  
  testCaseComment("Preconditions");
  testStep("STEP", "Bench Initialization");
  RunPreTs();
  
  
    testStep("STEP", "Set a breakpoint in function ATM_runMainFunction() at line 'atm_PlayCyclicTests(castStartupCyclicList);'.");
    debugger_setRelativeFunctionBpAtLine("ATM_runMainFunction", 21);
    
    debugger_reset();
    debugger_run();
  
    testStep("STEP", "Check if CPU is stopped in function ATM_runMainFunction() at line 'atm_PlayCyclicTests(castStartupCyclicList);'.");
    debugger_WaitUntilBPisReached(500);
    
    
    debugger_deleteAllBP();
    
    
    testStep("STEP", "Set a breakpoint in function atm_PlayCyclicTests() at line 'atm_executeAutoTest(u8AutotestID);' under 'if (B_TRUE == atm_isAutoTestEnabled(u8AutotestID))'.");
    debugger_setRelativeFunctionBpAtLine("atm_PlayCyclicTests", 9);
    
    debugger_run();
    
    testStep("STEP", "Check if CPU is stopped in function atm_PlayCyclicTests() at line 'atm_executeAutoTest(u8AutotestID);' under 'if (B_TRUE == atm_isAutoTestEnabled(u8AutotestID))'.");
    debugger_WaitUntilBPisReached(500);
  
  
    debugger_deleteAllBP();

  
    testStep("STEP", "Set a breakpoint in function atm_executeAutoTest() at line 'u8InhibModesIndex = castATMConfig[cu8AutotestID].u8InhibIndex;'.");
    debugger_setBpAtLine("s:\\Components\\Application\\Autoliv\\ATM\\Implementation\\src\\ATM.c", 194);
    
    debugger_run();
    
    testStep("STEP", "Check if CPU is stopped in function atm_executeAutoTest() at line 'u8InhibModesIndex = castATMConfig[cu8AutotestID].u8InhibIndex;'.");
    debugger_WaitUntilBPisReached(500);
  
    
    testCaseComment("Action: ARCH_SW_ATM_0050");
    testStep("STEP", "Evaluate if castATMConfig[cu8AutotestID].u8InhibIndex, with cu8AutotestID == ATM_KU8_ID_END_OF_LIFE_LOW_FORCE, is equal to KU8_MODES________________INHIB. --> u8InhibIndex == KU8_MODES________________INHIB");
    result = debugger_readGlobalVariable("uint8", "castATMConfig", 0xE5);
    EvalManStepEqual("Expected Test Result", result, 0x00);
    
  
  testCaseComment("Postcondition");
  testStep("STEP", "Return ECU to default values");
  RunPostTs();
}


testcase SW_IT_ATM_inhibit_autotest_22() 
{
  //***********************************Test report header*********************************
  testReportAddMiscInfoBlock("AUTOLsIV ELECTRONICS document");
  TestReportAddMiscInfo("Nightly test", "No");
  TestReportAddMiscInfo("Test type", "Requirement-Based test");
  TestReportAddMiscInfo("Regression Test", "No");
  TestReportAddMiscInfo("Fault injection method used", "No");
  TestReportAddMiscInfo("Resource usage evaluation", "No");
  TestReportAddMiscInfo("Priority", "No");
  TestReportAddMiscInfo("Safety relevant", "No");
  
  AddRequirementInfo("Requirement under test", "ARCH_SW_ATM_0051");
  AddRequirementInfo("ARCH_SW_ATM_0051", "ATM_KU8_ID_END_OF_LIFE_HIGH_FORCE autotest is inhibited by KU8_MODES______________________INHIB.");
  //***************************************************************************************
  
  testCaseComment("Preconditions");
  testStep("STEP", "Bench Initialization");
  RunPreTs();
  
  
    testStep("STEP", "Set a breakpoint in function ATM_runMainFunction() at line 'atm_PlayCyclicTests(castStartupCyclicList);'.");
    debugger_setRelativeFunctionBpAtLine("ATM_runMainFunction", 21);
    
    debugger_reset();
    debugger_run();
  
    testStep("STEP", "Check if CPU is stopped in function ATM_runMainFunction() at line 'atm_PlayCyclicTests(castStartupCyclicList);'.");
    debugger_WaitUntilBPisReached(500);
    
    
    debugger_deleteAllBP();
    
    
    testStep("STEP", "Set a breakpoint in function atm_PlayCyclicTests() at line 'atm_executeAutoTest(u8AutotestID);' under 'if (B_TRUE == atm_isAutoTestEnabled(u8AutotestID))'.");
    debugger_setRelativeFunctionBpAtLine("atm_PlayCyclicTests", 9);
    
    debugger_run();
    
    testStep("STEP", "Check if CPU is stopped in function atm_PlayCyclicTests() at line 'atm_executeAutoTest(u8AutotestID);' under 'if (B_TRUE == atm_isAutoTestEnabled(u8AutotestID))'.");
    debugger_WaitUntilBPisReached(500);
  
  
    debugger_deleteAllBP();

  
    testStep("STEP", "Set a breakpoint in function atm_executeAutoTest() at line 'u8InhibModesIndex = castATMConfig[cu8AutotestID].u8InhibIndex;'.");
    debugger_setBpAtLine("s:\\Components\\Application\\Autoliv\\ATM\\Implementation\\src\\ATM.c", 194);
    
    debugger_run();
    
    testStep("STEP", "Check if CPU is stopped in function atm_executeAutoTest() at line 'u8InhibModesIndex = castATMConfig[cu8AutotestID].u8InhibIndex;'.");
    debugger_WaitUntilBPisReached(500);
  
    
    testCaseComment("Action: ARCH_SW_ATM_0051");
    testStep("STEP", "Evaluate if castATMConfig[cu8AutotestID].u8InhibIndex, with cu8AutotestID == ATM_KU8_ID_END_OF_LIFE_HIGH_FORCE, is equal to KU8_MODES________________INHIB. --> u8InhibIndex == KU8_MODES________________INHIB");
    result = debugger_readGlobalVariable("uint8", "castATMConfig", 0xED);
    EvalManStepEqual("Expected Test Result", result, 0x00);
    
  
  testCaseComment("Postcondition");
  testStep("STEP", "Return ECU to default values");
  RunPostTs();
}


testcase SW_IT_ATM_inhibit_autotest_23() 
{
  //***********************************Test report header*********************************
  testReportAddMiscInfoBlock("AUTOLsIV ELECTRONICS document");
  TestReportAddMiscInfo("Nightly test", "No");
  TestReportAddMiscInfo("Test type", "Requirement-Based test");
  TestReportAddMiscInfo("Regression Test", "No");
  TestReportAddMiscInfo("Fault injection method used", "No");
  TestReportAddMiscInfo("Resource usage evaluation", "No");
  TestReportAddMiscInfo("Priority", "No");
  TestReportAddMiscInfo("Safety relevant", "No");
  
  AddRequirementInfo("Requirement under test", "ARCH_SW_ATM_0052");
  AddRequirementInfo("ARCH_SW_ATM_0052", "ATM_KU8_ID_END_OF_LIFE_COMFORT autotest is inhibited by KU8_MODES______________________INHIB.");
  //***************************************************************************************
  
  testCaseComment("Preconditions");
  testStep("STEP", "Bench Initialization");
  RunPreTs();
  
  
    testStep("STEP", "Set a breakpoint in function ATM_runMainFunction() at line 'atm_PlayCyclicTests(castStartupCyclicList);'.");
    debugger_setRelativeFunctionBpAtLine("ATM_runMainFunction", 21);
    
    debugger_reset();
    debugger_run();
  
    testStep("STEP", "Check if CPU is stopped in function ATM_runMainFunction() at line 'atm_PlayCyclicTests(castStartupCyclicList);'.");
    debugger_WaitUntilBPisReached(500);
    
    
    debugger_deleteAllBP();
    
    
    testStep("STEP", "Set a breakpoint in function atm_PlayCyclicTests() at line 'atm_executeAutoTest(u8AutotestID);' under 'if (B_TRUE == atm_isAutoTestEnabled(u8AutotestID))'.");
    debugger_setRelativeFunctionBpAtLine("atm_PlayCyclicTests", 9);
    
    debugger_run();
    
    testStep("STEP", "Check if CPU is stopped in function atm_PlayCyclicTests() at line 'atm_executeAutoTest(u8AutotestID);' under 'if (B_TRUE == atm_isAutoTestEnabled(u8AutotestID))'.");
    debugger_WaitUntilBPisReached(500);
  
  
    debugger_deleteAllBP();

  
    testStep("STEP", "Set a breakpoint in function atm_executeAutoTest() at line 'u8InhibModesIndex = castATMConfig[cu8AutotestID].u8InhibIndex;'.");
    debugger_setBpAtLine("s:\\Components\\Application\\Autoliv\\ATM\\Implementation\\src\\ATM.c", 194);
    
    debugger_run();
    
    testStep("STEP", "Check if CPU is stopped in function atm_executeAutoTest() at line 'u8InhibModesIndex = castATMConfig[cu8AutotestID].u8InhibIndex;'.");
    debugger_WaitUntilBPisReached(500);
  
    
    testCaseComment("Action: ARCH_SW_ATM_0052");
    testStep("STEP", "Evaluate if castATMConfig[cu8AutotestID].u8InhibIndex, with cu8AutotestID == ATM_KU8_ID_END_OF_LIFE_COMFORT, is equal to KU8_MODES________________INHIB. --> u8InhibIndex == KU8_MODES________________INHIB");
    result = debugger_readGlobalVariable("uint8", "castATMConfig", 0xF5);
    EvalManStepEqual("Expected Test Result", result, 0x00);
    
  
  testCaseComment("Postcondition");
  testStep("STEP", "Return ECU to default values");
  RunPostTs();
}



testcase SW_IT_ATM_inhibit_autotest_24() 
{
  //***********************************Test report header*********************************
  testReportAddMiscInfoBlock("AUTOLsIV ELECTRONICS document");
  TestReportAddMiscInfo("Nightly test", "No");
  TestReportAddMiscInfo("Test type", "Requirement-Based test");
  TestReportAddMiscInfo("Regression Test", "No");
  TestReportAddMiscInfo("Fault injection method used", "No");
  TestReportAddMiscInfo("Resource usage evaluation", "No");
  TestReportAddMiscInfo("Priority", "No");
  TestReportAddMiscInfo("Safety relevant", "No");
  
  AddRequirementInfo("Requirement under test", "ARCH_SW_ATM_0053");
  AddRequirementInfo("ARCH_SW_ATM_0053", "ATM_KU8_ID_TIMEOUT_PRESAFE autotest is inhibited by KU8_MODES______________________INHIB.");
  //***************************************************************************************
  
  testCaseComment("Preconditions");
  testStep("STEP", "Bench Initialization");
  RunPreTs();
  
  
    testStep("STEP", "Set a breakpoint in function ATM_runMainFunction() at line 'atm_PlayCyclicTests(castStartupCyclicList);'.");
    debugger_setRelativeFunctionBpAtLine("ATM_runMainFunction", 21);
    
    debugger_reset();
    debugger_run();
  
    testStep("STEP", "Check if CPU is stopped in function ATM_runMainFunction() at line 'atm_PlayCyclicTests(castStartupCyclicList);'.");
    debugger_WaitUntilBPisReached(500);
    
    
    debugger_deleteAllBP();
    
    
    testStep("STEP", "Set a breakpoint in function atm_PlayCyclicTests() at line 'atm_executeAutoTest(u8AutotestID);' under 'if (B_TRUE == atm_isAutoTestEnabled(u8AutotestID))'.");
    debugger_setRelativeFunctionBpAtLine("atm_PlayCyclicTests", 9);
    
    debugger_run();
    
    testStep("STEP", "Check if CPU is stopped in function atm_PlayCyclicTests() at line 'atm_executeAutoTest(u8AutotestID);' under 'if (B_TRUE == atm_isAutoTestEnabled(u8AutotestID))'.");
    debugger_WaitUntilBPisReached(500);
  
  
    debugger_deleteAllBP();

  
    testStep("STEP", "Set a breakpoint in function atm_executeAutoTest() at line 'u8InhibModesIndex = castATMConfig[cu8AutotestID].u8InhibIndex;'.");
    debugger_setBpAtLine("s:\\Components\\Application\\Autoliv\\ATM\\Implementation\\src\\ATM.c", 194);
    
    debugger_run();
    
    testStep("STEP", "Check if CPU is stopped in function atm_executeAutoTest() at line 'u8InhibModesIndex = castATMConfig[cu8AutotestID].u8InhibIndex;'.");
    debugger_WaitUntilBPisReached(500);
  
    
    testCaseComment("Action: ARCH_SW_ATM_0053");
    testStep("STEP", "Evaluate if castATMConfig[cu8AutotestID].u8InhibIndex, with cu8AutotestID == ATM_KU8_ID_TIMEOUT_PRESAFE, is equal to KU8_MODES________________INHIB. --> u8InhibIndex == KU8_MODES________________INHIB");
    result = debugger_readGlobalVariable("uint8", "castATMConfig", 0x10D);
    EvalManStepEqual("Expected Test Result", result, 0x00);
    
  
  testCaseComment("Postcondition");
  testStep("STEP", "Return ECU to default values");
  RunPostTs();
}



testcase SW_IT_ATM_inhibit_autotest_25() 
{
  //***********************************Test report header*********************************
  testReportAddMiscInfoBlock("AUTOLsIV ELECTRONICS document");
  TestReportAddMiscInfo("Nightly test", "No");
  TestReportAddMiscInfo("Test type", "Requirement-Based test");
  TestReportAddMiscInfo("Regression Test", "No");
  TestReportAddMiscInfo("Fault injection method used", "No");
  TestReportAddMiscInfo("Resource usage evaluation", "No");
  TestReportAddMiscInfo("Priority", "No");
  TestReportAddMiscInfo("Safety relevant", "No");
  
  AddRequirementInfo("Requirement under test", "ARCH_SW_ATM_0054");
  AddRequirementInfo("ARCH_SW_ATM_0054", "ATM_KU8_ID_TIMEOUT_BUCKLE autotest is inhibited by KU8_MODES______________________INHIB and KU8_MODES_ENABLE_____IGNITION.");
  //***************************************************************************************
  
  testCaseComment("Preconditions");
  testStep("STEP", "Bench Initialization");
  RunPreTs();
  
  
    testStep("STEP", "Set a breakpoint in function ATM_runMainFunction() at line 'atm_PlayCyclicTests(castStartupCyclicList);'.");
    debugger_setRelativeFunctionBpAtLine("ATM_runMainFunction", 21);
    
    debugger_reset();
    debugger_run();
  
    testStep("STEP", "Check if CPU is stopped in function ATM_runMainFunction() at line 'atm_PlayCyclicTests(castStartupCyclicList);'.");
    debugger_WaitUntilBPisReached(500);
    
    
    debugger_deleteAllBP();
    
    
    testStep("STEP", "Set a breakpoint in function atm_PlayCyclicTests() at line 'atm_executeAutoTest(u8AutotestID);' under 'if (B_TRUE == atm_isAutoTestEnabled(u8AutotestID))'.");
    debugger_setRelativeFunctionBpAtLine("atm_PlayCyclicTests", 9);
    
    debugger_run();
    
    testStep("STEP", "Check if CPU is stopped in function atm_PlayCyclicTests() at line 'atm_executeAutoTest(u8AutotestID);' under 'if (B_TRUE == atm_isAutoTestEnabled(u8AutotestID))'.");
    debugger_WaitUntilBPisReached(500);
  
  
    debugger_deleteAllBP();

  
    testStep("STEP", "Set a breakpoint in function atm_executeAutoTest() at line 'u8InhibModesIndex = castATMConfig[cu8AutotestID].u8InhibIndex;'.");
    debugger_setBpAtLine("s:\\Components\\Application\\Autoliv\\ATM\\Implementation\\src\\ATM.c", 194);
    
    debugger_run();
    
    testStep("STEP", "Check if CPU is stopped in function atm_executeAutoTest() at line 'u8InhibModesIndex = castATMConfig[cu8AutotestID].u8InhibIndex;'.");
    debugger_WaitUntilBPisReached(500);
  
    
    testCaseComment("Action: ARCH_SW_ATM_0054");
    testStep("STEP", "Evaluate if castATMConfig[cu8AutotestID].u8InhibIndex, with cu8AutotestID == ATM_KU8_ID_TIMEOUT_BUCKLE, is equal to KU8_MODES______________________INHIB and KU8_MODES_ENABLE_____IGNITION. --> u8InhibIndex == KU8_MODES______________________INHIB and KU8_MODES_ENABLE_____IGNITION");
    result = debugger_readGlobalVariable("uint8", "castATMConfig", 0x115);
    EvalManStepEqual("Expected Test Result", result, 0x04);
    
  
  testCaseComment("Postcondition");
  testStep("STEP", "Return ECU to default values");
  RunPostTs();
}



testcase SW_IT_ATM_inhibit_autotest_26() 
{
  //***********************************Test report header*********************************
  testReportAddMiscInfoBlock("AUTOLsIV ELECTRONICS document");
  TestReportAddMiscInfo("Nightly test", "No");
  TestReportAddMiscInfo("Test type", "Requirement-Based test");
  TestReportAddMiscInfo("Regression Test", "No");
  TestReportAddMiscInfo("Fault injection method used", "No");
  TestReportAddMiscInfo("Resource usage evaluation", "No");
  TestReportAddMiscInfo("Priority", "No");
  TestReportAddMiscInfo("Safety relevant", "No");
  
  AddRequirementInfo("Requirement under test", "ARCH_SW_ATM_0055");
  AddRequirementInfo("ARCH_SW_ATM_0055", "ATM_KU8_ID_IMPLAUSIBLE_DATA_PRESAFE autotest is inhibited by KU8_MODES______________________INHIB.");
  //***************************************************************************************
  
  testCaseComment("Preconditions");
  testStep("STEP", "Bench Initialization");
  RunPreTs();
  
  
    testStep("STEP", "Set a breakpoint in function ATM_runMainFunction() at line 'atm_PlayCyclicTests(castStartupCyclicList);'.");
    debugger_setRelativeFunctionBpAtLine("ATM_runMainFunction", 21);
    
    debugger_reset();
    debugger_run();
  
    testStep("STEP", "Check if CPU is stopped in function ATM_runMainFunction() at line 'atm_PlayCyclicTests(castStartupCyclicList);'.");
    debugger_WaitUntilBPisReached(500);
    
    
    debugger_deleteAllBP();
    
    
    testStep("STEP", "Set a breakpoint in function atm_PlayCyclicTests() at line 'atm_executeAutoTest(u8AutotestID);' under 'if (B_TRUE == atm_isAutoTestEnabled(u8AutotestID))'.");
    debugger_setRelativeFunctionBpAtLine("atm_PlayCyclicTests", 9);
    
    debugger_run();
    
    testStep("STEP", "Check if CPU is stopped in function atm_PlayCyclicTests() at line 'atm_executeAutoTest(u8AutotestID);' under 'if (B_TRUE == atm_isAutoTestEnabled(u8AutotestID))'.");
    debugger_WaitUntilBPisReached(500);
  
  
    debugger_deleteAllBP();

  
    testStep("STEP", "Set a breakpoint in function atm_executeAutoTest() at line 'u8InhibModesIndex = castATMConfig[cu8AutotestID].u8InhibIndex;'.");
    debugger_setBpAtLine("s:\\Components\\Application\\Autoliv\\ATM\\Implementation\\src\\ATM.c", 194);
    
    debugger_run();
    
    testStep("STEP", "Check if CPU is stopped in function atm_executeAutoTest() at line 'u8InhibModesIndex = castATMConfig[cu8AutotestID].u8InhibIndex;'.");
    debugger_WaitUntilBPisReached(500);
  
    
    testCaseComment("Action: ARCH_SW_ATM_0055");
    testStep("STEP", "Evaluate if castATMConfig[cu8AutotestID].u8InhibIndex, with cu8AutotestID == ATM_KU8_ID_IMPLAUSIBLE_DATA_PRESAFE, is equal to KU8_MODES______________________INHIB. --> u8InhibIndex == KU8_MODES______________________INHIB");
    result = debugger_readGlobalVariable("uint8", "castATMConfig", 0x11F);
    EvalManStepEqual("Expected Test Result", result, 0x00);
    
  
  testCaseComment("Postcondition");
  testStep("STEP", "Return ECU to default values");
  RunPostTs();
}


testcase SW_IT_ATM_inhibit_autotest_27() 
{
  //***********************************Test report header*********************************
  testReportAddMiscInfoBlock("AUTOLsIV ELECTRONICS document");
  TestReportAddMiscInfo("Nightly test", "No");
  TestReportAddMiscInfo("Test type", "Requirement-Based test");
  TestReportAddMiscInfo("Regression Test", "No");
  TestReportAddMiscInfo("Fault injection method used", "No");
  TestReportAddMiscInfo("Resource usage evaluation", "No");
  TestReportAddMiscInfo("Priority", "No");
  TestReportAddMiscInfo("Safety relevant", "No");
  
  AddRequirementInfo("Requirement under test", "ARCH_SW_ATM_0056");
  AddRequirementInfo("ARCH_SW_ATM_0056", "ATM_KU8_ID_IMPLAUSIBLE_DATA_IGNITION autotest is inhibited by KU8_MODES______________________INHIB and KU8_MODES_ENABLE_____IGNITION.");
  //***************************************************************************************
  
  testCaseComment("Preconditions");
  testStep("STEP", "Bench Initialization");
  RunPreTs();
  
  
    testStep("STEP", "Set a breakpoint in function ATM_runMainFunction() at line 'atm_PlayCyclicTests(castStartupCyclicList);'.");
    debugger_setRelativeFunctionBpAtLine("ATM_runMainFunction", 21);
    
    debugger_reset();
    debugger_run();
  
    testStep("STEP", "Check if CPU is stopped in function ATM_runMainFunction() at line 'atm_PlayCyclicTests(castStartupCyclicList);'.");
    debugger_WaitUntilBPisReached(500);
    
    
    debugger_deleteAllBP();
    
    
    testStep("STEP", "Set a breakpoint in function atm_PlayCyclicTests() at line 'atm_executeAutoTest(u8AutotestID);' under 'if (B_TRUE == atm_isAutoTestEnabled(u8AutotestID))'.");
    debugger_setRelativeFunctionBpAtLine("atm_PlayCyclicTests", 9);
    
    debugger_run();
    
    testStep("STEP", "Check if CPU is stopped in function atm_PlayCyclicTests() at line 'atm_executeAutoTest(u8AutotestID);' under 'if (B_TRUE == atm_isAutoTestEnabled(u8AutotestID))'.");
    debugger_WaitUntilBPisReached(500);
  
  
    debugger_deleteAllBP();

  
    testStep("STEP", "Set a breakpoint in function atm_executeAutoTest() at line 'u8InhibModesIndex = castATMConfig[cu8AutotestID].u8InhibIndex;'.");
    debugger_setBpAtLine("s:\\Components\\Application\\Autoliv\\ATM\\Implementation\\src\\ATM.c", 194);
    
    debugger_run();
    
    testStep("STEP", "Check if CPU is stopped in function atm_executeAutoTest() at line 'u8InhibModesIndex = castATMConfig[cu8AutotestID].u8InhibIndex;'.");
    debugger_WaitUntilBPisReached(500);
  
    
    testCaseComment("Action: ARCH_SW_ATM_0056");
    testStep("STEP", "Evaluate if castATMConfig[cu8AutotestID].u8InhibIndex, with cu8AutotestID == ATM_KU8_ID_IMPLAUSIBLE_DATA_IGNITION, is equal to KU8_MODES______________________INHIB and KU8_MODES_ENABLE_____IGNITION. --> u8InhibIndex == KU8_MODES______________________INHIB and KU8_MODES_ENABLE_____IGNITION");
    result = debugger_readGlobalVariable("uint8", "castATMConfig", 0x125);
    EvalManStepEqual("Expected Test Result", result, 0x04);
    
  
  testCaseComment("Postcondition");
  testStep("STEP", "Return ECU to default values");
  RunPostTs();
}


testcase SW_IT_ATM_inhibit_autotest_28() 
{
  //***********************************Test report header*********************************
  testReportAddMiscInfoBlock("AUTOLsIV ELECTRONICS document");
  TestReportAddMiscInfo("Nightly test", "No");
  TestReportAddMiscInfo("Test type", "Requirement-Based test");
  TestReportAddMiscInfo("Regression Test", "No");
  TestReportAddMiscInfo("Fault injection method used", "No");
  TestReportAddMiscInfo("Resource usage evaluation", "No");
  TestReportAddMiscInfo("Priority", "No");
  TestReportAddMiscInfo("Safety relevant", "No");
  
  AddRequirementInfo("Requirement under test", "ARCH_SW_ATM_0057");
  AddRequirementInfo("ARCH_SW_ATM_0057", "ATM_KU8_ID_IMPLAUSIBLE_DATA_BUCKLE autotest is inhibited by KU8_MODES______________________INHIB.");
  //***************************************************************************************
  
  testCaseComment("Preconditions");
  testStep("STEP", "Bench Initialization");
  RunPreTs();
  
  
    testStep("STEP", "Set a breakpoint in function ATM_runMainFunction() at line 'atm_PlayCyclicTests(castStartupCyclicList);'.");
    debugger_setRelativeFunctionBpAtLine("ATM_runMainFunction", 21);
    
    debugger_reset();
    debugger_run();
  
    testStep("STEP", "Check if CPU is stopped in function ATM_runMainFunction() at line 'atm_PlayCyclicTests(castStartupCyclicList);'.");
    debugger_WaitUntilBPisReached(500);
    
    
    debugger_deleteAllBP();
    
    
    testStep("STEP", "Set a breakpoint in function atm_PlayCyclicTests() at line 'atm_executeAutoTest(u8AutotestID);' under 'if (B_TRUE == atm_isAutoTestEnabled(u8AutotestID))'.");
    debugger_setRelativeFunctionBpAtLine("atm_PlayCyclicTests", 9);
    
    debugger_run();
    
    testStep("STEP", "Check if CPU is stopped in function atm_PlayCyclicTests() at line 'atm_executeAutoTest(u8AutotestID);' under 'if (B_TRUE == atm_isAutoTestEnabled(u8AutotestID))'.");
    debugger_WaitUntilBPisReached(500);
  
  
    debugger_deleteAllBP();

  
    testStep("STEP", "Set a breakpoint in function atm_executeAutoTest() at line 'u8InhibModesIndex = castATMConfig[cu8AutotestID].u8InhibIndex;'.");
    debugger_setBpAtLine("s:\\Components\\Application\\Autoliv\\ATM\\Implementation\\src\\ATM.c", 194);
    
    debugger_run();
    
    testStep("STEP", "Check if CPU is stopped in function atm_executeAutoTest() at line 'u8InhibModesIndex = castATMConfig[cu8AutotestID].u8InhibIndex;'.");
    debugger_WaitUntilBPisReached(500);
  
    
    testCaseComment("Action: ARCH_SW_ATM_0057");
    testStep("STEP", "Evaluate if castATMConfig[cu8AutotestID].u8InhibIndex, with cu8AutotestID == ATM_KU8_ID_IMPLAUSIBLE_DATA_BUCKLE, is equal to KU8_MODES______________________INHIB. --> u8InhibIndex == KU8_MODES______________________INHIB");
    result = debugger_readGlobalVariable("uint8", "castATMConfig", 0x12F);
    EvalManStepEqual("Expected Test Result", result, 0x00);
    
  
  testCaseComment("Postcondition");
  testStep("STEP", "Return ECU to default values");
  RunPostTs();
}


testcase SW_IT_ATM_inhibit_autotest_29() 
{
  //***********************************Test report header*********************************
  testReportAddMiscInfoBlock("AUTOLsIV ELECTRONICS document");
  TestReportAddMiscInfo("Nightly test", "No");
  TestReportAddMiscInfo("Test type", "Requirement-Based test");
  TestReportAddMiscInfo("Regression Test", "No");
  TestReportAddMiscInfo("Fault injection method used", "No");
  TestReportAddMiscInfo("Resource usage evaluation", "No");
  TestReportAddMiscInfo("Priority", "No");
  TestReportAddMiscInfo("Safety relevant", "No");
  
  AddRequirementInfo("Requirement under test", "ARCH_SW_ATM_0058");
  AddRequirementInfo("ARCH_SW_ATM_0058", "ATM_KU8_ID_END_OF_LIFE_MAX_FORCE autotest is inhibited by KU8_MODES______________________INHIB.");
  //***************************************************************************************
  
  testCaseComment("Preconditions");
  testStep("STEP", "Bench Initialization");
  RunPreTs();
  
  
    testStep("STEP", "Set a breakpoint in function ATM_runMainFunction() at line 'atm_PlayCyclicTests(castStartupCyclicList);'.");
    debugger_setRelativeFunctionBpAtLine("ATM_runMainFunction", 21);
    
    debugger_reset();
    debugger_run();
  
    testStep("STEP", "Check if CPU is stopped in function ATM_runMainFunction() at line 'atm_PlayCyclicTests(castStartupCyclicList);'.");
    debugger_WaitUntilBPisReached(500);
    
    
    debugger_deleteAllBP();
    
    
    testStep("STEP", "Set a breakpoint in function atm_PlayCyclicTests() at line 'atm_executeAutoTest(u8AutotestID);' under 'if (B_TRUE == atm_isAutoTestEnabled(u8AutotestID))'.");
    debugger_setRelativeFunctionBpAtLine("atm_PlayCyclicTests", 9);
    
    debugger_run();
    
    testStep("STEP", "Check if CPU is stopped in function atm_PlayCyclicTests() at line 'atm_executeAutoTest(u8AutotestID);' under 'if (B_TRUE == atm_isAutoTestEnabled(u8AutotestID))'.");
    debugger_WaitUntilBPisReached(500);
  
  
    debugger_deleteAllBP();

  
    testStep("STEP", "Set a breakpoint in function atm_executeAutoTest() at line 'u8InhibModesIndex = castATMConfig[cu8AutotestID].u8InhibIndex;'.");
    debugger_setBpAtLine("s:\\Components\\Application\\Autoliv\\ATM\\Implementation\\src\\ATM.c", 194);
    
    debugger_run();
    
    testStep("STEP", "Check if CPU is stopped in function atm_executeAutoTest() at line 'u8InhibModesIndex = castATMConfig[cu8AutotestID].u8InhibIndex;'.");
    debugger_WaitUntilBPisReached(500);
  
    
    testCaseComment("Action: ARCH_SW_ATM_0058");
    testStep("STEP", "Evaluate if castATMConfig[cu8AutotestID].u8InhibIndex, with cu8AutotestID == ATM_KU8_ID_END_OF_LIFE_MAX_FORCE, is equal to KU8_MODES______________________INHIB. --> u8InhibIndex == KU8_MODES______________________INHIB");
    result = debugger_readGlobalVariable("uint8", "castATMConfig", 0xFD);
    EvalManStepEqual("Expected Test Result", result, 0x00);
    
  
  testCaseComment("Postcondition");
  testStep("STEP", "Return ECU to default values");
  RunPostTs();
}


testcase SW_IT_ATM_inhibit_autotest_30() 
{
  //***********************************Test report header*********************************
  testReportAddMiscInfoBlock("AUTOLsIV ELECTRONICS document");
  TestReportAddMiscInfo("Nightly test", "No");
  TestReportAddMiscInfo("Test type", "Requirement-Based test");
  TestReportAddMiscInfo("Regression Test", "No");
  TestReportAddMiscInfo("Fault injection method used", "No");
  TestReportAddMiscInfo("Resource usage evaluation", "No");
  TestReportAddMiscInfo("Priority", "No");
  TestReportAddMiscInfo("Safety relevant", "No");
  
  AddRequirementInfo("Requirement under test", "ARCH_SW_ATM_0059");
  AddRequirementInfo("ARCH_SW_ATM_0059", "ATM_KU8_ID_TIMEOUT_IGNITION autotest is inhibited by KU8_MODES______________________INHIB.");
  //***************************************************************************************
  
  testCaseComment("Preconditions");
  testStep("STEP", "Bench Initialization");
  RunPreTs();
  
  
    testStep("STEP", "Set a breakpoint in function ATM_runMainFunction() at line 'atm_PlayCyclicTests(castStartupCyclicList);'.");
    debugger_setRelativeFunctionBpAtLine("ATM_runMainFunction", 21);
    
    debugger_reset();
    debugger_run();
  
    testStep("STEP", "Check if CPU is stopped in function ATM_runMainFunction() at line 'atm_PlayCyclicTests(castStartupCyclicList);'.");
    debugger_WaitUntilBPisReached(500);
    
    
    debugger_deleteAllBP();
    
    
    testStep("STEP", "Set a breakpoint in function atm_PlayCyclicTests() at line 'atm_executeAutoTest(u8AutotestID);' under 'if (B_TRUE == atm_isAutoTestEnabled(u8AutotestID))'.");
    debugger_setRelativeFunctionBpAtLine("atm_PlayCyclicTests", 9);
    
    debugger_run();
    
    testStep("STEP", "Check if CPU is stopped in function atm_PlayCyclicTests() at line 'atm_executeAutoTest(u8AutotestID);' under 'if (B_TRUE == atm_isAutoTestEnabled(u8AutotestID))'.");
    debugger_WaitUntilBPisReached(500);
  
  
    debugger_deleteAllBP();

  
    testStep("STEP", "Set a breakpoint in function atm_executeAutoTest() at line 'u8InhibModesIndex = castATMConfig[cu8AutotestID].u8InhibIndex;'.");
    debugger_setBpAtLine("s:\\Components\\Application\\Autoliv\\ATM\\Implementation\\src\\ATM.c", 194);
    
    debugger_run();
    
    testStep("STEP", "Check if CPU is stopped in function atm_executeAutoTest() at line 'u8InhibModesIndex = castATMConfig[cu8AutotestID].u8InhibIndex;'.");
    debugger_WaitUntilBPisReached(500);
  
    
    testCaseComment("Action: ARCH_SW_ATM_0059");
    testStep("STEP", "Evaluate if castATMConfig[cu8AutotestID].u8InhibIndex, with cu8AutotestID == ATM_KU8_ID_TIMEOUT_IGNITION, is equal to KU8_MODES______________________INHIB. --> u8InhibIndex == KU8_MODES______________________INHIB");
    result = debugger_readGlobalVariable("uint8", "castATMConfig", 0x145);
    EvalManStepEqual("Expected Test Result", result, 0x00);
    
  
  testCaseComment("Postcondition");
  testStep("STEP", "Return ECU to default values");
  RunPostTs();
}


testcase SW_IT_ATM_inhibit_autotest_31() 
{
  //***********************************Test report header*********************************
  testReportAddMiscInfoBlock("AUTOLsIV ELECTRONICS document");
  TestReportAddMiscInfo("Nightly test", "No");
  TestReportAddMiscInfo("Test type", "Requirement-Based test");
  TestReportAddMiscInfo("Regression Test", "No");
  TestReportAddMiscInfo("Fault injection method used", "No");
  TestReportAddMiscInfo("Resource usage evaluation", "No");
  TestReportAddMiscInfo("Priority", "No");
  TestReportAddMiscInfo("Safety relevant", "No");
  
  AddRequirementInfo("Requirement under test", "ARCH_SW_ATM_0060");
  AddRequirementInfo("ARCH_SW_ATM_0060", "ATM_KU8_ID_TIMEOUT_POWERTRAIN autotest is inhibited by KU8_MODES______________________INHIB.");
  //***************************************************************************************
  
  testCaseComment("Preconditions");
  testStep("STEP", "Bench Initialization");
  RunPreTs();
  
  
    testStep("STEP", "Set a breakpoint in function ATM_runMainFunction() at line 'atm_PlayCyclicTests(castStartupCyclicList);'.");
    debugger_setRelativeFunctionBpAtLine("ATM_runMainFunction", 21);
    
    debugger_reset();
    debugger_run();
  
    testStep("STEP", "Check if CPU is stopped in function ATM_runMainFunction() at line 'atm_PlayCyclicTests(castStartupCyclicList);'.");
    debugger_WaitUntilBPisReached(500);
    
    
    debugger_deleteAllBP();
    
    
    testStep("STEP", "Set a breakpoint in function atm_PlayCyclicTests() at line 'atm_executeAutoTest(u8AutotestID);' under 'if (B_TRUE == atm_isAutoTestEnabled(u8AutotestID))'.");
    debugger_setRelativeFunctionBpAtLine("atm_PlayCyclicTests", 9);
    
    debugger_run();
    
    testStep("STEP", "Check if CPU is stopped in function atm_PlayCyclicTests() at line 'atm_executeAutoTest(u8AutotestID);' under 'if (B_TRUE == atm_isAutoTestEnabled(u8AutotestID))'.");
    debugger_WaitUntilBPisReached(500);
  
  
    debugger_deleteAllBP();

  
    testStep("STEP", "Set a breakpoint in function atm_executeAutoTest() at line 'u8InhibModesIndex = castATMConfig[cu8AutotestID].u8InhibIndex;'.");
    debugger_setBpAtLine("s:\\Components\\Application\\Autoliv\\ATM\\Implementation\\src\\ATM.c", 194);
    
    debugger_run();
    
    testStep("STEP", "Check if CPU is stopped in function atm_executeAutoTest() at line 'u8InhibModesIndex = castATMConfig[cu8AutotestID].u8InhibIndex;'.");
    debugger_WaitUntilBPisReached(500);
  
    
    testCaseComment("Action: ARCH_SW_ATM_0060");
    testStep("STEP", "Evaluate if castATMConfig[cu8AutotestID].u8InhibIndex, with cu8AutotestID == ATM_KU8_ID_TIMEOUT_POWERTRAIN, is equal to KU8_MODES______________________INHIB. --> u8InhibIndex == KU8_MODES______________________INHIB");
    result = debugger_readGlobalVariable("uint8", "castATMConfig", 0x15F);
    EvalManStepEqual("Expected Test Result", result, 0x00);
    
  
  testCaseComment("Postcondition");
  testStep("STEP", "Return ECU to default values");
  RunPostTs();
}


testcase SW_IT_ATM_inhibit_autotest_32() 
{
  //***********************************Test report header*********************************
  testReportAddMiscInfoBlock("AUTOLsIV ELECTRONICS document");
  TestReportAddMiscInfo("Nightly test", "No");
  TestReportAddMiscInfo("Test type", "Requirement-Based test");
  TestReportAddMiscInfo("Regression Test", "No");
  TestReportAddMiscInfo("Fault injection method used", "No");
  TestReportAddMiscInfo("Resource usage evaluation", "No");
  TestReportAddMiscInfo("Priority", "No");
  TestReportAddMiscInfo("Safety relevant", "No");
  
  AddRequirementInfo("Requirement under test", "ARCH_SW_ATM_0061");
  AddRequirementInfo("ARCH_SW_ATM_0061", "ATM_KU8_ID_IMPLAUSIBLE_DATA_POWERTRAIN autotest is inhibited by KU8_MODES______________________INHIB.");
  //***************************************************************************************
  
  testCaseComment("Preconditions");
  testStep("STEP", "Bench Initialization");
  RunPreTs();
  
  
    testStep("STEP", "Set a breakpoint in function ATM_runMainFunction() at line 'atm_PlayCyclicTests(castStartupCyclicList);'.");
    debugger_setRelativeFunctionBpAtLine("ATM_runMainFunction", 21);
    
    debugger_reset();
    debugger_run();
  
    testStep("STEP", "Check if CPU is stopped in function ATM_runMainFunction() at line 'atm_PlayCyclicTests(castStartupCyclicList);'.");
    debugger_WaitUntilBPisReached(500);
    
    
    debugger_deleteAllBP();
    
    
    testStep("STEP", "Set a breakpoint in function atm_PlayCyclicTests() at line 'atm_executeAutoTest(u8AutotestID);' under 'if (B_TRUE == atm_isAutoTestEnabled(u8AutotestID))'.");
    debugger_setRelativeFunctionBpAtLine("atm_PlayCyclicTests", 9);
    
    debugger_run();
    
    testStep("STEP", "Check if CPU is stopped in function atm_PlayCyclicTests() at line 'atm_executeAutoTest(u8AutotestID);' under 'if (B_TRUE == atm_isAutoTestEnabled(u8AutotestID))'.");
    debugger_WaitUntilBPisReached(500);
  
  
    debugger_deleteAllBP();

  
    testStep("STEP", "Set a breakpoint in function atm_executeAutoTest() at line 'u8InhibModesIndex = castATMConfig[cu8AutotestID].u8InhibIndex;'.");
    debugger_setBpAtLine("s:\\Components\\Application\\Autoliv\\ATM\\Implementation\\src\\ATM.c", 194);
    
    debugger_run();
    
    testStep("STEP", "Check if CPU is stopped in function atm_executeAutoTest() at line 'u8InhibModesIndex = castATMConfig[cu8AutotestID].u8InhibIndex;'.");
    debugger_WaitUntilBPisReached(500);
  
    
    testCaseComment("Action: ARCH_SW_ATM_0061");
    testStep("STEP", "Evaluate if castATMConfig[cu8AutotestID].u8InhibIndex, with cu8AutotestID == ATM_KU8_ID_IMPLAUSIBLE_DATA_POWERTRAIN, is equal to KU8_MODES______________________INHIB. --> u8InhibIndex == KU8_MODES______________________INHIB");
    result = debugger_readGlobalVariable("uint8", "castATMConfig", 0x155);
    EvalManStepEqual("Expected Test Result", 0x00, 0x00);
    
  
  testCaseComment("Postcondition");
  testStep("STEP", "Return ECU to default values");
  RunPostTs();
}


testcase SW_IT_ATM_inhibit_autotest_33() 
{
  //***********************************Test report header*********************************
  testReportAddMiscInfoBlock("AUTOLsIV ELECTRONICS document");
  TestReportAddMiscInfo("Nightly test", "No");
  TestReportAddMiscInfo("Test type", "Requirement-Based test");
  TestReportAddMiscInfo("Regression Test", "No");
  TestReportAddMiscInfo("Fault injection method used", "No");
  TestReportAddMiscInfo("Resource usage evaluation", "No");
  TestReportAddMiscInfo("Priority", "No");
  TestReportAddMiscInfo("Safety relevant", "No");
  
  AddRequirementInfo("Requirement under test", "ARCH_SW_ATM_0062");
  AddRequirementInfo("ARCH_SW_ATM_0062", "ATM_KU8_ID_IMPLAUSIBLE_DATA_ORC autotest is inhibited by KU8_MODES______________________INHIB.");
  //***************************************************************************************
  
  testCaseComment("Preconditions");
  testStep("STEP", "Bench Initialization");
  RunPreTs();
  
  
    testStep("STEP", "Set a breakpoint in function ATM_runMainFunction() at line 'atm_PlayCyclicTests(castStartupCyclicList);'.");
    debugger_setRelativeFunctionBpAtLine("ATM_runMainFunction", 21);
    
    debugger_reset();
    debugger_run();
  
    testStep("STEP", "Check if CPU is stopped in function ATM_runMainFunction() at line 'atm_PlayCyclicTests(castStartupCyclicList);'.");
    debugger_WaitUntilBPisReached(500);
    
    
    debugger_deleteAllBP();
    
    
    testStep("STEP", "Set a breakpoint in function atm_PlayCyclicTests() at line 'atm_executeAutoTest(u8AutotestID);' under 'if (B_TRUE == atm_isAutoTestEnabled(u8AutotestID))'.");
    debugger_setRelativeFunctionBpAtLine("atm_PlayCyclicTests", 9);
    
    debugger_run();
    
    testStep("STEP", "Check if CPU is stopped in function atm_PlayCyclicTests() at line 'atm_executeAutoTest(u8AutotestID);' under 'if (B_TRUE == atm_isAutoTestEnabled(u8AutotestID))'.");
    debugger_WaitUntilBPisReached(500);
  
  
    debugger_deleteAllBP();

  
    testStep("STEP", "Set a breakpoint in function atm_executeAutoTest() at line 'u8InhibModesIndex = castATMConfig[cu8AutotestID].u8InhibIndex;'.");
    debugger_setBpAtLine("s:\\Components\\Application\\Autoliv\\ATM\\Implementation\\src\\ATM.c", 194);
    
    debugger_run();
    
    testStep("STEP", "Check if CPU is stopped in function atm_executeAutoTest() at line 'u8InhibModesIndex = castATMConfig[cu8AutotestID].u8InhibIndex;'.");
    debugger_WaitUntilBPisReached(500);
  
    
    testCaseComment("Action: ARCH_SW_ATM_0062");
    testStep("STEP", "Evaluate if castATMConfig[cu8AutotestID].u8InhibIndex, with cu8AutotestID == ATM_KU8_ID_IMPLAUSIBLE_DATA_ORC, is equal to KU8_MODES______________________INHIB. --> u8InhibIndex == KU8_MODES______________________INHIB");
    result = debugger_readGlobalVariable("uint8", "castATMConfig", 0x14F);
    EvalManStepEqual("Expected Test Result", result, 0x00);
    
  
  testCaseComment("Postcondition");
  testStep("STEP", "Return ECU to default values");
  RunPostTs();
}


testcase SW_IT_ATM_inhibit_autotest_34() 
{
  //***********************************Test report header*********************************
  testReportAddMiscInfoBlock("AUTOLsIV ELECTRONICS document");
  TestReportAddMiscInfo("Nightly test", "No");
  TestReportAddMiscInfo("Test type", "Requirement-Based test");
  TestReportAddMiscInfo("Regression Test", "No");
  TestReportAddMiscInfo("Fault injection method used", "No");
  TestReportAddMiscInfo("Resource usage evaluation", "No");
  TestReportAddMiscInfo("Priority", "No");
  TestReportAddMiscInfo("Safety relevant", "No");
  
  AddRequirementInfo("Requirement under test", "ARCH_SW_ATM_0063");
  AddRequirementInfo("ARCH_SW_ATM_0063", "ATM_KU8_ID_TIMEOUT_BELT_HAND_OVER_LEFT autotest is inhibited by KU8_MODES______________________INHIB.");
  //***************************************************************************************
  
  testCaseComment("Preconditions");
  testStep("STEP", "Bench Initialization");
  RunPreTs();
  
  
    testStep("STEP", "Set a breakpoint in function ATM_runMainFunction() at line 'atm_PlayCyclicTests(castStartupCyclicList);'.");
    debugger_setRelativeFunctionBpAtLine("ATM_runMainFunction", 21);
    
    debugger_reset();
    debugger_run();
  
    testStep("STEP", "Check if CPU is stopped in function ATM_runMainFunction() at line 'atm_PlayCyclicTests(castStartupCyclicList);'.");
    debugger_WaitUntilBPisReached(500);
    
    
    debugger_deleteAllBP();
    
    
    testStep("STEP", "Set a breakpoint in function atm_PlayCyclicTests() at line 'atm_executeAutoTest(u8AutotestID);' under 'if (B_TRUE == atm_isAutoTestEnabled(u8AutotestID))'.");
    debugger_setRelativeFunctionBpAtLine("atm_PlayCyclicTests", 9);
    
    debugger_run();
    
    testStep("STEP", "Check if CPU is stopped in function atm_PlayCyclicTests() at line 'atm_executeAutoTest(u8AutotestID);' under 'if (B_TRUE == atm_isAutoTestEnabled(u8AutotestID))'.");
    debugger_WaitUntilBPisReached(500);
  
  
    debugger_deleteAllBP();

  
    testStep("STEP", "Set a breakpoint in function atm_executeAutoTest() at line 'u8InhibModesIndex = castATMConfig[cu8AutotestID].u8InhibIndex;'.");
    debugger_setBpAtLine("s:\\Components\\Application\\Autoliv\\ATM\\Implementation\\src\\ATM.c", 194);
    
    debugger_run();
    
    testStep("STEP", "Check if CPU is stopped in function atm_executeAutoTest() at line 'u8InhibModesIndex = castATMConfig[cu8AutotestID].u8InhibIndex;'.");
    debugger_WaitUntilBPisReached(500);
  
    
    testCaseComment("Action: ARCH_SW_ATM_0063");
    testStep("STEP", "Evaluate if castATMConfig[cu8AutotestID].u8InhibIndex, with cu8AutotestID == ATM_KU8_ID_TIMEOUT_BELT_HAND_OVER_LEFT, is equal to KU8_MODES______________________INHIB. --> u8InhibIndex == KU8_MODES______________________INHIB");
    result = debugger_readGlobalVariable("uint8", "castATMConfig", 0x13F);
    EvalManStepEqual("Expected Test Result", result, 0x00);
    
  
  testCaseComment("Postcondition");
  testStep("STEP", "Return ECU to default values");
  RunPostTs();
}


testcase SW_IT_ATM_inhibit_autotest_35() 
{
  //***********************************Test report header*********************************
  testReportAddMiscInfoBlock("AUTOLsIV ELECTRONICS document");
  TestReportAddMiscInfo("Nightly test", "No");
  TestReportAddMiscInfo("Test type", "Requirement-Based test");
  TestReportAddMiscInfo("Regression Test", "No");
  TestReportAddMiscInfo("Fault injection method used", "No");
  TestReportAddMiscInfo("Resource usage evaluation", "No");
  TestReportAddMiscInfo("Priority", "No");
  TestReportAddMiscInfo("Safety relevant", "No");
  
  AddRequirementInfo("Requirement under test", "ARCH_SW_ATM_0064");
  AddRequirementInfo("ARCH_SW_ATM_0064", "ATM_KU8_ID_TIMEOUT_BELT_HAND_OVER_RIGHT autotest is inhibited by KU8_MODES______________________INHIB and KU8_MODES_ENABLE_CodingRBTMFR.");
  //***************************************************************************************
  
  testCaseComment("Preconditions");
  testStep("STEP", "Bench Initialization");
  RunPreTs();
  
  
    testStep("STEP", "Set a breakpoint in function ATM_runMainFunction() at line 'atm_PlayCyclicTests(castStartupCyclicList);'.");
    debugger_setRelativeFunctionBpAtLine("ATM_runMainFunction", 21);
    
    debugger_reset();
    debugger_run();
  
    testStep("STEP", "Check if CPU is stopped in function ATM_runMainFunction() at line 'atm_PlayCyclicTests(castStartupCyclicList);'.");
    debugger_WaitUntilBPisReached(500);
    
    
    debugger_deleteAllBP();
    
    
    testStep("STEP", "Set a breakpoint in function atm_PlayCyclicTests() at line 'atm_executeAutoTest(u8AutotestID);' under 'if (B_TRUE == atm_isAutoTestEnabled(u8AutotestID))'.");
    debugger_setRelativeFunctionBpAtLine("atm_PlayCyclicTests", 9);
    
    debugger_run();
    
    testStep("STEP", "Check if CPU is stopped in function atm_PlayCyclicTests() at line 'atm_executeAutoTest(u8AutotestID);' under 'if (B_TRUE == atm_isAutoTestEnabled(u8AutotestID))'.");
    debugger_WaitUntilBPisReached(500);
  
  
    debugger_deleteAllBP();

  
    testStep("STEP", "Set a breakpoint in function atm_executeAutoTest() at line 'u8InhibModesIndex = castATMConfig[cu8AutotestID].u8InhibIndex;'.");
    debugger_setBpAtLine("s:\\Components\\Application\\Autoliv\\ATM\\Implementation\\src\\ATM.c", 194);
    
    debugger_run();
    
    testStep("STEP", "Check if CPU is stopped in function atm_executeAutoTest() at line 'u8InhibModesIndex = castATMConfig[cu8AutotestID].u8InhibIndex;'.");
    debugger_WaitUntilBPisReached(500);
  
    
    testCaseComment("Action: ARCH_SW_ATM_0064");
    testStep("STEP", "Evaluate if castATMConfig[cu8AutotestID].u8InhibIndex, with cu8AutotestID == ATM_KU8_ID_TIMEOUT_BELT_HAND_OVER_RIGHT, is equal to KU8_MODES______________________INHIB and KU8_MODES_ENABLE_CodingRBTMFR. --> u8InhibIndex == KU8_MODES______________________INHIB and KU8_MODES_ENABLE_CodingRBTMFR");
    result = debugger_readGlobalVariable("uint8", "castATMConfig", 0x135);
    EvalManStepEqual("Expected Test Result", result, 0x07);
    
  
  testCaseComment("Postcondition");
  testStep("STEP", "Return ECU to default values");
  RunPostTs();
}



testcase SW_IT_ATM_inhibit_autotest_36() 
{
  //***********************************Test report header*********************************
  testReportAddMiscInfoBlock("AUTOLsIV ELECTRONICS document");
  TestReportAddMiscInfo("Nightly test", "No");
  TestReportAddMiscInfo("Test type", "Requirement-Based test");
  TestReportAddMiscInfo("Regression Test", "No");
  TestReportAddMiscInfo("Fault injection method used", "No");
  TestReportAddMiscInfo("Resource usage evaluation", "No");
  TestReportAddMiscInfo("Priority", "No");
  TestReportAddMiscInfo("Safety relevant", "No");
  
  AddRequirementInfo("Requirement under test", "ARCH_SW_ATM_0065");
  AddRequirementInfo("ARCH_SW_ATM_0065", "ATM_KU8_ID_TIMEOUT_API_INTERFACE autotest is inhibited by KU8_MODES______________________INHIB.");
  //***************************************************************************************
  
  testCaseComment("Preconditions");
  testStep("STEP", "Bench Initialization");
  RunPreTs();
  
  
    testStep("STEP", "Set a breakpoint in function ATM_runMainFunction() at line 'atm_PlayCyclicTests(castStartupCyclicList);'.");
    debugger_setRelativeFunctionBpAtLine("ATM_runMainFunction", 21);
    
    debugger_reset();
    debugger_run();
  
    testStep("STEP", "Check if CPU is stopped in function ATM_runMainFunction() at line 'atm_PlayCyclicTests(castStartupCyclicList);'.");
    debugger_WaitUntilBPisReached(500);
    
    
    debugger_deleteAllBP();
    
    
    testStep("STEP", "Set a breakpoint in function atm_PlayCyclicTests() at line 'atm_executeAutoTest(u8AutotestID);' under 'if (B_TRUE == atm_isAutoTestEnabled(u8AutotestID))'.");
    debugger_setRelativeFunctionBpAtLine("atm_PlayCyclicTests", 9);
    
    debugger_run();
    
    testStep("STEP", "Check if CPU is stopped in function atm_PlayCyclicTests() at line 'atm_executeAutoTest(u8AutotestID);' under 'if (B_TRUE == atm_isAutoTestEnabled(u8AutotestID))'.");
    debugger_WaitUntilBPisReached(500);
  
  
    debugger_deleteAllBP();

  
    testStep("STEP", "Set a breakpoint in function atm_executeAutoTest() at line 'u8InhibModesIndex = castATMConfig[cu8AutotestID].u8InhibIndex;'.");
    debugger_setBpAtLine("s:\\Components\\Application\\Autoliv\\ATM\\Implementation\\src\\ATM.c", 194);
    
    debugger_run();
    
    testStep("STEP", "Check if CPU is stopped in function atm_executeAutoTest() at line 'u8InhibModesIndex = castATMConfig[cu8AutotestID].u8InhibIndex;'.");
    debugger_WaitUntilBPisReached(500);
  
    
    testCaseComment("Action: ARCH_SW_ATM_0065");
    testStep("STEP", "Evaluate if castATMConfig[cu8AutotestID].u8InhibIndex, with cu8AutotestID == ATM_KU8_ID_TIMEOUT_API_INTERFACE, is equal to KU8_MODES______________________INHIB. --> u8InhibIndex == KU8_MODES______________________INHIB");
    result = debugger_readGlobalVariable("uint8", "castATMConfig", 0x175);
    EvalManStepEqual("Expected Test Result", result, 0x00);
  
  
  testCaseComment("Postcondition");
  testStep("STEP", "Return ECU to default values");
  RunPostTs();
}


testcase SW_IT_ATM_inhibit_autotest_37() 
{
  //***********************************Test report header*********************************
  testReportAddMiscInfoBlock("AUTOLsIV ELECTRONICS document");
  TestReportAddMiscInfo("Nightly test", "No");
  TestReportAddMiscInfo("Test type", "Requirement-Based test");
  TestReportAddMiscInfo("Regression Test", "No");
  TestReportAddMiscInfo("Fault injection method used", "No");
  TestReportAddMiscInfo("Resource usage evaluation", "No");
  TestReportAddMiscInfo("Priority", "No");
  TestReportAddMiscInfo("Safety relevant", "No");
  
  AddRequirementInfo("Requirement under test", "ARCH_SW_ATM_0066");
  AddRequirementInfo("ARCH_SW_ATM_0066", "ATM_KU8_ID_OVERVOLTAGE_SYSTEM autotest is inhibited by KU8_MODES______________________INHIB.");
  //***************************************************************************************
  
  testCaseComment("Preconditions");
  testStep("STEP", "Bench Initialization");
  RunPreTs();
  
  
    testStep("STEP", "Set a breakpoint in function ATM_runMainFunction() at line 'atm_PlayCyclicTests(castStartupCyclicList);'.");
    debugger_setRelativeFunctionBpAtLine("ATM_runMainFunction", 21);
    
    debugger_reset();
    debugger_run();
  
    testStep("STEP", "Check if CPU is stopped in function ATM_runMainFunction() at line 'atm_PlayCyclicTests(castStartupCyclicList);'.");
    debugger_WaitUntilBPisReached(500);
    
    
    debugger_deleteAllBP();
    
    
    testStep("STEP", "Set a breakpoint in function atm_PlayCyclicTests() at line 'atm_executeAutoTest(u8AutotestID);' under 'if (B_TRUE == atm_isAutoTestEnabled(u8AutotestID))'.");
    debugger_setRelativeFunctionBpAtLine("atm_PlayCyclicTests", 9);
    
    debugger_run();
    
    testStep("STEP", "Check if CPU is stopped in function atm_PlayCyclicTests() at line 'atm_executeAutoTest(u8AutotestID);' under 'if (B_TRUE == atm_isAutoTestEnabled(u8AutotestID))'.");
    debugger_WaitUntilBPisReached(500);
  
  
    debugger_deleteAllBP();

  
    testStep("STEP", "Set a breakpoint in function atm_executeAutoTest() at line 'u8InhibModesIndex = castATMConfig[cu8AutotestID].u8InhibIndex;'.");
    debugger_setBpAtLine("s:\\Components\\Application\\Autoliv\\ATM\\Implementation\\src\\ATM.c", 194);
    
    debugger_run();
    
    testStep("STEP", "Check if CPU is stopped in function atm_executeAutoTest() at line 'u8InhibModesIndex = castATMConfig[cu8AutotestID].u8InhibIndex;'.");
    debugger_WaitUntilBPisReached(500);
  
    
    testCaseComment("Action: ARCH_SW_ATM_0066");
    testStep("STEP", "Evaluate if castATMConfig[cu8AutotestID].u8InhibIndex, with cu8AutotestID == ATM_KU8_ID_OVERVOLTAGE_SYSTEM, is equal to KU8_MODES______________________INHIB. --> u8InhibIndex == KU8_MODES______________________INHIB");
    result = debugger_readGlobalVariable("uint8", "castATMConfig", 0x165);
    EvalManStepEqual("Expected Test Result", result, 0x00);
    
  
  testCaseComment("Postcondition");
  testStep("STEP", "Return ECU to default values");
  RunPostTs();
}



testcase SW_IT_ATM_inhibit_autotest_38() 
{
  //***********************************Test report header*********************************
  testReportAddMiscInfoBlock("AUTOLsIV ELECTRONICS document");
  TestReportAddMiscInfo("Nightly test", "No");
  TestReportAddMiscInfo("Test type", "Requirement-Based test");
  TestReportAddMiscInfo("Regression Test", "No");
  TestReportAddMiscInfo("Fault injection method used", "No");
  TestReportAddMiscInfo("Resource usage evaluation", "No");
  TestReportAddMiscInfo("Priority", "No");
  TestReportAddMiscInfo("Safety relevant", "No");
  
  AddRequirementInfo("Requirement under test", "ARCH_SW_ATM_0067");
  AddRequirementInfo("ARCH_SW_ATM_0067", "ATM_KU8_ID_UNDERVOLTAGE_SYSTEM autotest is inhibited by KU8_MODES______________________INHIB.");
  //***************************************************************************************
  
  testCaseComment("Preconditions");
  testStep("STEP", "Bench Initialization");
  RunPreTs();
  
  
    testStep("STEP", "Set a breakpoint in function ATM_runMainFunction() at line 'atm_PlayCyclicTests(castStartupCyclicList);'.");
    debugger_setRelativeFunctionBpAtLine("ATM_runMainFunction", 21);
    
    debugger_reset();
    debugger_run();
  
    testStep("STEP", "Check if CPU is stopped in function ATM_runMainFunction() at line 'atm_PlayCyclicTests(castStartupCyclicList);'.");
    debugger_WaitUntilBPisReached(500);
    
    
    debugger_deleteAllBP();
    
    
    testStep("STEP", "Set a breakpoint in function atm_PlayCyclicTests() at line 'atm_executeAutoTest(u8AutotestID);' under 'if (B_TRUE == atm_isAutoTestEnabled(u8AutotestID))'.");
    debugger_setRelativeFunctionBpAtLine("atm_PlayCyclicTests", 9);
    
    debugger_run();
    
    testStep("STEP", "Check if CPU is stopped in function atm_PlayCyclicTests() at line 'atm_executeAutoTest(u8AutotestID);' under 'if (B_TRUE == atm_isAutoTestEnabled(u8AutotestID))'.");
    debugger_WaitUntilBPisReached(500);
  
  
    debugger_deleteAllBP();

  
    testStep("STEP", "Set a breakpoint in function atm_executeAutoTest() at line 'u8InhibModesIndex = castATMConfig[cu8AutotestID].u8InhibIndex;'.");
    debugger_setBpAtLine("s:\\Components\\Application\\Autoliv\\ATM\\Implementation\\src\\ATM.c", 194);
    
    debugger_run();
    
    testStep("STEP", "Check if CPU is stopped in function atm_executeAutoTest() at line 'u8InhibModesIndex = castATMConfig[cu8AutotestID].u8InhibIndex;'.");
    debugger_WaitUntilBPisReached(500);
  
    
    testCaseComment("Action: ARCH_SW_ATM_0067");
    testStep("STEP", "Evaluate if castATMConfig[cu8AutotestID].u8InhibIndex, with cu8AutotestID == ATM_KU8_ID_UNDERVOLTAGE_SYSTEM, is equal to KU8_MODES______________________INHIB. --> u8InhibIndex == KU8_MODES______________________INHIB");
    result = debugger_readGlobalVariable("uint8", "castATMConfig", 0x16F);
    EvalManStepEqual("Expected Test Result", result, 0x00);
    
  
  testCaseComment("Postcondition");
  testStep("STEP", "Return ECU to default values");
  RunPostTs();
}


testcase SW_IT_ATM_inhibit_autotest_39() 
{
  //***********************************Test report header*********************************
  testReportAddMiscInfoBlock("AUTOLsIV ELECTRONICS document");
  TestReportAddMiscInfo("Nightly test", "No");
  TestReportAddMiscInfo("Test type", "Requirement-Based test");
  TestReportAddMiscInfo("Regression Test", "No");
  TestReportAddMiscInfo("Fault injection method used", "No");
  TestReportAddMiscInfo("Resource usage evaluation", "No");
  TestReportAddMiscInfo("Priority", "No");
  TestReportAddMiscInfo("Safety relevant", "No");
  
  AddRequirementInfo("Requirement under test", "ARCH_SW_ATM_0068");
  AddRequirementInfo("ARCH_SW_ATM_0068", "ATM_KU8_ID_TIMEOUT_API autotest is inhibited by KU8_MODES______________________INHIB.");
  //***************************************************************************************
  
  testCaseComment("Preconditions");
  testStep("STEP", "Bench Initialization");
  RunPreTs();
  
  
    testStep("STEP", "Set a breakpoint in function ATM_runMainFunction() at line 'atm_PlayCyclicTests(castStartupCyclicList);'.");
    debugger_setRelativeFunctionBpAtLine("ATM_runMainFunction", 21);
    
    debugger_reset();
    debugger_run();
  
    testStep("STEP", "Check if CPU is stopped in function ATM_runMainFunction() at line 'atm_PlayCyclicTests(castStartupCyclicList);'.");
    debugger_WaitUntilBPisReached(500);
    
    
    debugger_deleteAllBP();
    
    
    testStep("STEP", "Set a breakpoint in function atm_PlayCyclicTests() at line 'atm_executeAutoTest(u8AutotestID);' under 'if (B_TRUE == atm_isAutoTestEnabled(u8AutotestID))'.");
    debugger_setRelativeFunctionBpAtLine("atm_PlayCyclicTests", 9);
    
    debugger_run();
    
    testStep("STEP", "Check if CPU is stopped in function atm_PlayCyclicTests() at line 'atm_executeAutoTest(u8AutotestID);' under 'if (B_TRUE == atm_isAutoTestEnabled(u8AutotestID))'.");
    debugger_WaitUntilBPisReached(500);
  
  
    debugger_deleteAllBP();

  
    testStep("STEP", "Set a breakpoint in function atm_executeAutoTest() at line 'u8InhibModesIndex = castATMConfig[cu8AutotestID].u8InhibIndex;'.");
    debugger_setBpAtLine("s:\\Components\\Application\\Autoliv\\ATM\\Implementation\\src\\ATM.c", 194);
    
    debugger_run();
    
    testStep("STEP", "Check if CPU is stopped in function atm_executeAutoTest() at line 'u8InhibModesIndex = castATMConfig[cu8AutotestID].u8InhibIndex;'.");
    debugger_WaitUntilBPisReached(500);
  
    
    testCaseComment("Action: ARCH_SW_ATM_0068");
    testStep("STEP", "Evaluate if castATMConfig[cu8AutotestID].u8InhibIndex, with cu8AutotestID == ATM_KU8_ID_TIMEOUT_API, is equal to KU8_MODES______________________INHIB. --> u8InhibIndex == KU8_MODES______________________INHIB");
    result = debugger_readGlobalVariable("uint8", "castATMConfig", 0x175);
    EvalManStepEqual("Expected Test Result", result, 0x00);
    
  
  testCaseComment("Postcondition");
  testStep("STEP", "Return ECU to default values");
  RunPostTs();
}



testcase SW_IT_ATM_inhibit_autotest_40() 
{
  //***********************************Test report header*********************************
  testReportAddMiscInfoBlock("AUTOLsIV ELECTRONICS document");
  TestReportAddMiscInfo("Nightly test", "No");
  TestReportAddMiscInfo("Test type", "Requirement-Based test");
  TestReportAddMiscInfo("Regression Test", "No");
  TestReportAddMiscInfo("Fault injection method used", "No");
  TestReportAddMiscInfo("Resource usage evaluation", "No");
  TestReportAddMiscInfo("Priority", "No");
  TestReportAddMiscInfo("Safety relevant", "No");
  
  AddRequirementInfo("Requirement under test", "ARCH_SW_ATM_0069");
  AddRequirementInfo("ARCH_SW_ATM_0069", "ATM_KU8_ID_IMPLAUSIBLE_DATA_POWERTRAIN_DRV autotest is inhibited by KU8_MODES______________________INHIB.");
  //***************************************************************************************
  
  testCaseComment("Preconditions");
  testStep("STEP", "Bench Initialization");
  RunPreTs();
  
  
    testStep("STEP", "Set a breakpoint in function ATM_runMainFunction() at line 'atm_PlayCyclicTests(castStartupCyclicList);'.");
    debugger_setRelativeFunctionBpAtLine("ATM_runMainFunction", 21);
    
    debugger_reset();
    debugger_run();
  
    testStep("STEP", "Check if CPU is stopped in function ATM_runMainFunction() at line 'atm_PlayCyclicTests(castStartupCyclicList);'.");
    debugger_WaitUntilBPisReached(500);
    
    
    debugger_deleteAllBP();
    
    
    testStep("STEP", "Set a breakpoint in function atm_PlayCyclicTests() at line 'atm_executeAutoTest(u8AutotestID);' under 'if (B_TRUE == atm_isAutoTestEnabled(u8AutotestID))'.");
    debugger_setRelativeFunctionBpAtLine("atm_PlayCyclicTests", 9);
    
    debugger_run();
    
    testStep("STEP", "Check if CPU is stopped in function atm_PlayCyclicTests() at line 'atm_executeAutoTest(u8AutotestID);' under 'if (B_TRUE == atm_isAutoTestEnabled(u8AutotestID))'.");
    debugger_WaitUntilBPisReached(500);
  
  
    debugger_deleteAllBP();

  
    testStep("STEP", "Set a breakpoint in function atm_executeAutoTest() at line 'u8InhibModesIndex = castATMConfig[cu8AutotestID].u8InhibIndex;'.");
    debugger_setBpAtLine("s:\\Components\\Application\\Autoliv\\ATM\\Implementation\\src\\ATM.c", 194);
    
    debugger_run();
    
    testStep("STEP", "Check if CPU is stopped in function atm_executeAutoTest() at line 'u8InhibModesIndex = castATMConfig[cu8AutotestID].u8InhibIndex;'.");
    debugger_WaitUntilBPisReached(500);
  
    
    testCaseComment("Action: ARCH_SW_ATM_0069");
    testStep("STEP", "Evaluate if castATMConfig[cu8AutotestID].u8InhibIndex, with cu8AutotestID == ATM_KU8_ID_IMPLAUSIBLE_DATA_POWERTRAIN_DRV, is equal to KU8_MODES______________________INHIB. --> u8InhibIndex == KU8_MODES______________________INHIB");
    result = debugger_readGlobalVariable("uint8", "castATMConfig", 0x17F);
    EvalManStepEqual("Expected Test Result", result, 0x00);
    
  
  testCaseComment("Postcondition");
  testStep("STEP", "Return ECU to default values");
  RunPostTs();
}


testcase SW_IT_ATM_inhibit_autotest_41() 
{
  //***********************************Test report header*********************************
  testReportAddMiscInfoBlock("AUTOLsIV ELECTRONICS document");
  TestReportAddMiscInfo("Nightly test", "No");
  TestReportAddMiscInfo("Test type", "Requirement-Based test");
  TestReportAddMiscInfo("Regression Test", "No");
  TestReportAddMiscInfo("Fault injection method used", "No");
  TestReportAddMiscInfo("Resource usage evaluation", "No");
  TestReportAddMiscInfo("Priority", "No");
  TestReportAddMiscInfo("Safety relevant", "No");
  
  AddRequirementInfo("Requirement under test", "ARCH_SW_ATM_0070");
  AddRequirementInfo("ARCH_SW_ATM_0070", "ATM_KU8_ID_TIMEOUT_ODOSPEEDOMETER autotest is inhibited by KU8_MODES______________________INHIB.");
  //***************************************************************************************
  
  testCaseComment("Preconditions");
  testStep("STEP", "Bench Initialization");
  RunPreTs();
  
  
    testStep("STEP", "Set a breakpoint in function ATM_runMainFunction() at line 'atm_PlayCyclicTests(castStartupCyclicList);'.");
    debugger_setRelativeFunctionBpAtLine("ATM_runMainFunction", 21);
    
    debugger_reset();
    debugger_run();
  
    testStep("STEP", "Check if CPU is stopped in function ATM_runMainFunction() at line 'atm_PlayCyclicTests(castStartupCyclicList);'.");
    debugger_WaitUntilBPisReached(500);
    
    
    debugger_deleteAllBP();
    
    
    testStep("STEP", "Set a breakpoint in function atm_PlayCyclicTests() at line 'atm_executeAutoTest(u8AutotestID);' under 'if (B_TRUE == atm_isAutoTestEnabled(u8AutotestID))'.");
    debugger_setRelativeFunctionBpAtLine("atm_PlayCyclicTests", 9);
    
    debugger_run();
    
    testStep("STEP", "Check if CPU is stopped in function atm_PlayCyclicTests() at line 'atm_executeAutoTest(u8AutotestID);' under 'if (B_TRUE == atm_isAutoTestEnabled(u8AutotestID))'.");
    debugger_WaitUntilBPisReached(500);
  
  
    debugger_deleteAllBP();

  
    testStep("STEP", "Set a breakpoint in function atm_executeAutoTest() at line 'u8InhibModesIndex = castATMConfig[cu8AutotestID].u8InhibIndex;'.");
    debugger_setBpAtLine("s:\\Components\\Application\\Autoliv\\ATM\\Implementation\\src\\ATM.c", 194);
    
    debugger_run();
    
    testStep("STEP", "Check if CPU is stopped in function atm_executeAutoTest() at line 'u8InhibModesIndex = castATMConfig[cu8AutotestID].u8InhibIndex;'.");
    debugger_WaitUntilBPisReached(500);
  
    
    testCaseComment("Action: ARCH_SW_ATM_0070");
    testStep("STEP", "Evaluate if castATMConfig[cu8AutotestID].u8InhibIndex, with cu8AutotestID == ATM_KU8_ID_TIMEOUT_ODOSPEEDOMETER, is equal to KU8_MODES______________________INHIB. --> u8InhibIndex == KU8_MODES______________________INHIB");
    result = debugger_readGlobalVariable("uint8", "castATMConfig", 0x185);
    EvalManStepEqual("Expected Test Result", result, 0x00);
    
  
  testCaseComment("Postcondition");
  testStep("STEP", "Return ECU to default values");
  RunPostTs();
}


testcase SW_IT_ATM_inhibit_autotest_42() 
{
  //***********************************Test report header*********************************
  testReportAddMiscInfoBlock("AUTOLsIV ELECTRONICS document");
  TestReportAddMiscInfo("Nightly test", "No");
  TestReportAddMiscInfo("Test type", "Requirement-Based test");
  TestReportAddMiscInfo("Regression Test", "No");
  TestReportAddMiscInfo("Fault injection method used", "No");
  TestReportAddMiscInfo("Resource usage evaluation", "No");
  TestReportAddMiscInfo("Priority", "No");
  TestReportAddMiscInfo("Safety relevant", "No");
  
  AddRequirementInfo("Requirement under test", "ARCH_SW_ATM_0071");
  AddRequirementInfo("ARCH_SW_ATM_0071", "ATM_KU8_ID_IMPLAUSIBLE_DATA_API autotest is inhibited by KU8_MODES______________________INHIB.");
  //***************************************************************************************
  
  testCaseComment("Preconditions");
  testStep("STEP", "Bench Initialization");
  RunPreTs();
  
  
    testStep("STEP", "Set a breakpoint in function ATM_runMainFunction() at line 'atm_PlayCyclicTests(castStartupCyclicList);'.");
    debugger_setRelativeFunctionBpAtLine("ATM_runMainFunction", 21);
    
    debugger_reset();
    debugger_run();
  
    testStep("STEP", "Check if CPU is stopped in function ATM_runMainFunction() at line 'atm_PlayCyclicTests(castStartupCyclicList);'.");
    debugger_WaitUntilBPisReached(500);
    
    
    debugger_deleteAllBP();
    
    
    testStep("STEP", "Set a breakpoint in function atm_PlayCyclicTests() at line 'atm_executeAutoTest(u8AutotestID);' under 'if (B_TRUE == atm_isAutoTestEnabled(u8AutotestID))'.");
    debugger_setRelativeFunctionBpAtLine("atm_PlayCyclicTests", 9);
    
    debugger_run();
    
    testStep("STEP", "Check if CPU is stopped in function atm_PlayCyclicTests() at line 'atm_executeAutoTest(u8AutotestID);' under 'if (B_TRUE == atm_isAutoTestEnabled(u8AutotestID))'.");
    debugger_WaitUntilBPisReached(500);
  
  
    debugger_deleteAllBP();

  
    testStep("STEP", "Set a breakpoint in function atm_executeAutoTest() at line 'u8InhibModesIndex = castATMConfig[cu8AutotestID].u8InhibIndex;'.");
    debugger_setBpAtLine("s:\\Components\\Application\\Autoliv\\ATM\\Implementation\\src\\ATM.c", 194);
    
    debugger_run();
    
    testStep("STEP", "Check if CPU is stopped in function atm_executeAutoTest() at line 'u8InhibModesIndex = castATMConfig[cu8AutotestID].u8InhibIndex;'.");
    debugger_WaitUntilBPisReached(500);
  
    
    testCaseComment("Action: ARCH_SW_ATM_0071");
    testStep("STEP", "Evaluate if castATMConfig[cu8AutotestID].u8InhibIndex, with cu8AutotestID == ATM_KU8_ID_IMPLAUSIBLE_DATA_API, is equal to KU8_MODES______________________INHIB. --> u8InhibIndex == KU8_MODES______________________INHIB");
    result = debugger_readGlobalVariable("uint8", "castATMConfig", 0x18F);
    EvalManStepEqual("Expected Test Result", result, 0x00);
    
  
  testCaseComment("Postcondition");
  testStep("STEP", "Return ECU to default values");
  RunPostTs();
}


testcase SW_IT_ATM_inhibit_autotest_43() 
{
  //***********************************Test report header*********************************
  testReportAddMiscInfoBlock("AUTOLsIV ELECTRONICS document");
  TestReportAddMiscInfo("Nightly test", "No");
  TestReportAddMiscInfo("Test type", "Requirement-Based test");
  TestReportAddMiscInfo("Regression Test", "No");
  TestReportAddMiscInfo("Fault injection method used", "No");
  TestReportAddMiscInfo("Resource usage evaluation", "No");
  TestReportAddMiscInfo("Priority", "No");
  TestReportAddMiscInfo("Safety relevant", "No");
  
  AddRequirementInfo("Requirement under test", "ARCH_SW_ATM_0072");
  AddRequirementInfo("ARCH_SW_ATM_0072", "ATM_KU8_ID_VARIANT_CODING autotest is inhibited by KU8_MODES______________________INHIB.");
  //***************************************************************************************
  
  testCaseComment("Preconditions");
  testStep("STEP", "Bench Initialization");
  RunPreTs();
  
  
    testStep("STEP", "Set a breakpoint in function ATM_runMainFunction() at line 'atm_PlayCyclicTests(castStartupCyclicList);'.");
    debugger_setRelativeFunctionBpAtLine("ATM_runMainFunction", 21);
    
    debugger_reset();
    debugger_run();
  
    testStep("STEP", "Check if CPU is stopped in function ATM_runMainFunction() at line 'atm_PlayCyclicTests(castStartupCyclicList);'.");
    debugger_WaitUntilBPisReached(500);
    
    
    debugger_deleteAllBP();
    
    
    testStep("STEP", "Set a breakpoint in function atm_PlayCyclicTests() at line 'atm_executeAutoTest(u8AutotestID);' under 'if (B_TRUE == atm_isAutoTestEnabled(u8AutotestID))'.");
    debugger_setRelativeFunctionBpAtLine("atm_PlayCyclicTests", 9);
    
    debugger_run();
    
    testStep("STEP", "Check if CPU is stopped in function atm_PlayCyclicTests() at line 'atm_executeAutoTest(u8AutotestID);' under 'if (B_TRUE == atm_isAutoTestEnabled(u8AutotestID))'.");
    debugger_WaitUntilBPisReached(500);
  
  
    debugger_deleteAllBP();

  
    testStep("STEP", "Set a breakpoint in function atm_executeAutoTest() at line 'u8InhibModesIndex = castATMConfig[cu8AutotestID].u8InhibIndex;'.");
    debugger_setBpAtLine("s:\\Components\\Application\\Autoliv\\ATM\\Implementation\\src\\ATM.c", 194);
    
    debugger_run();
    
    testStep("STEP", "Check if CPU is stopped in function atm_executeAutoTest() at line 'u8InhibModesIndex = castATMConfig[cu8AutotestID].u8InhibIndex;'.");
    debugger_WaitUntilBPisReached(500);
  
    
    testCaseComment("Action: ARCH_SW_ATM_0072");
    testStep("STEP", "Evaluate if castATMConfig[cu8AutotestID].u8InhibIndex, with cu8AutotestID == ATM_KU8_ID_VARIANT_CODING, is equal to KU8_MODES______________________INHIB. --> u8InhibIndex == KU8_MODES______________________INHIB");
    result = debugger_readGlobalVariable("uint8", "castATMConfig", 0x1A5);
    EvalManStepEqual("Expected Test Result", result, 0x00);
    
  
  testCaseComment("Postcondition");
  testStep("STEP", "Return ECU to default values");
  RunPostTs();
}


testcase SW_IT_ATM_inhibit_autotest_44() 
{
  //***********************************Test report header*********************************
  testReportAddMiscInfoBlock("AUTOLsIV ELECTRONICS document");
  TestReportAddMiscInfo("Nightly test", "No");
  TestReportAddMiscInfo("Test type", "Requirement-Based test");
  TestReportAddMiscInfo("Regression Test", "No");
  TestReportAddMiscInfo("Fault injection method used", "No");
  TestReportAddMiscInfo("Resource usage evaluation", "No");
  TestReportAddMiscInfo("Priority", "No");
  TestReportAddMiscInfo("Safety relevant", "No");
  
  AddRequirementInfo("Requirement under test", "ARCH_SW_ATM_0073");
  AddRequirementInfo("ARCH_SW_ATM_0073", "ATM_KU8_ID_TIMEOUT_BELT_ADJ autotest is inhibited by KU8_MODES______________________INHIB.");
  //***************************************************************************************
  
  testCaseComment("Preconditions");
  testStep("STEP", "Bench Initialization");
  RunPreTs();
  
  
    testStep("STEP", "Set a breakpoint in function ATM_runMainFunction() at line 'atm_PlayCyclicTests(castStartupCyclicList);'.");
    debugger_setRelativeFunctionBpAtLine("ATM_runMainFunction", 21);
    
    debugger_reset();
    debugger_run();
  
    testStep("STEP", "Check if CPU is stopped in function ATM_runMainFunction() at line 'atm_PlayCyclicTests(castStartupCyclicList);'.");
    debugger_WaitUntilBPisReached(500);
    
    
    debugger_deleteAllBP();
    
    
    testStep("STEP", "Set a breakpoint in function atm_PlayCyclicTests() at line 'atm_executeAutoTest(u8AutotestID);' under 'if (B_TRUE == atm_isAutoTestEnabled(u8AutotestID))'.");
    debugger_setRelativeFunctionBpAtLine("atm_PlayCyclicTests", 9);
    
    debugger_run();
    
    testStep("STEP", "Check if CPU is stopped in function atm_PlayCyclicTests() at line 'atm_executeAutoTest(u8AutotestID);' under 'if (B_TRUE == atm_isAutoTestEnabled(u8AutotestID))'.");
    debugger_WaitUntilBPisReached(500);
  
  
    debugger_deleteAllBP();

  
    testStep("STEP", "Set a breakpoint in function atm_executeAutoTest() at line 'u8InhibModesIndex = castATMConfig[cu8AutotestID].u8InhibIndex;'.");
    debugger_setBpAtLine("s:\\Components\\Application\\Autoliv\\ATM\\Implementation\\src\\ATM.c", 194);
    
    debugger_run();
    
    testStep("STEP", "Check if CPU is stopped in function atm_executeAutoTest() at line 'u8InhibModesIndex = castATMConfig[cu8AutotestID].u8InhibIndex;'.");
    debugger_WaitUntilBPisReached(500);
  
    
    testCaseComment("Action: ARCH_SW_ATM_0073");
    testStep("STEP", "Evaluate if castATMConfig[cu8AutotestID].u8InhibIndex, with cu8AutotestID == ATM_KU8_ID_TIMEOUT_BELT_ADJ, is equal to KU8_MODES______________________INHIB. --> u8InhibIndex == KU8_MODES______________________INHIB");
    result = debugger_readGlobalVariable("uint8", "castATMConfig", 0x19F);
    EvalManStepEqual("Expected Test Result", result, 0x00);
    
  
  testCaseComment("Postcondition");
  testStep("STEP", "Return ECU to default values");
  RunPostTs();
}


testcase SW_IT_ATM_inhibit_autotest_45() 
{
  //***********************************Test report header*********************************
  testReportAddMiscInfoBlock("AUTOLsIV ELECTRONICS document");
  TestReportAddMiscInfo("Nightly test", "No");
  TestReportAddMiscInfo("Test type", "Requirement-Based test");
  TestReportAddMiscInfo("Regression Test", "No");
  TestReportAddMiscInfo("Fault injection method used", "No");
  TestReportAddMiscInfo("Resource usage evaluation", "No");
  TestReportAddMiscInfo("Priority", "No");
  TestReportAddMiscInfo("Safety relevant", "No");
  
  AddRequirementInfo("Requirement under test", "ARCH_SW_ATM_0074");
  AddRequirementInfo("ARCH_SW_ATM_0074", "ATM_KU8_ID_SPI_ERROR autotest is inhibited by KU8_MODES________________INHIB.");
  //***************************************************************************************
  
  testCaseComment("Preconditions");
  testStep("STEP", "Bench Initialization");
  RunPreTs();
  
  
    testStep("STEP", "Set a breakpoint in function ATM_runMainFunction() at line 'atm_PlayCyclicTests(castStartupCyclicList);'.");
    debugger_setRelativeFunctionBpAtLine("ATM_runMainFunction", 21);
    
    debugger_reset();
    debugger_run();
  
    testStep("STEP", "Check if CPU is stopped in function ATM_runMainFunction() at line 'atm_PlayCyclicTests(castStartupCyclicList);'.");
    debugger_WaitUntilBPisReached(500);
    
    
    debugger_deleteAllBP();
    
    
    testStep("STEP", "Set a breakpoint in function atm_PlayCyclicTests() at line 'atm_executeAutoTest(u8AutotestID);' under 'if (B_TRUE == atm_isAutoTestEnabled(u8AutotestID))'.");
    debugger_setRelativeFunctionBpAtLine("atm_PlayCyclicTests", 9);
    
    debugger_run();
    
    testStep("STEP", "Check if CPU is stopped in function atm_PlayCyclicTests() at line 'atm_executeAutoTest(u8AutotestID);' under 'if (B_TRUE == atm_isAutoTestEnabled(u8AutotestID))'.");
    debugger_WaitUntilBPisReached(500);
  
  
    debugger_deleteAllBP();

  
    testStep("STEP", "Set a breakpoint in function atm_executeAutoTest() at line 'u8InhibModesIndex = castATMConfig[cu8AutotestID].u8InhibIndex;'.");
    debugger_setBpAtLine("s:\\Components\\Application\\Autoliv\\ATM\\Implementation\\src\\ATM.c", 194);
    
    debugger_run();
    
    testStep("STEP", "Check if CPU is stopped in function atm_executeAutoTest() at line 'u8InhibModesIndex = castATMConfig[cu8AutotestID].u8InhibIndex;'.");
    debugger_WaitUntilBPisReached(500);
  
    
    testCaseComment("Action: ARCH_SW_ATM_0074");
    testStep("STEP", "Evaluate if castATMConfig[cu8AutotestID].u8InhibIndex, with cu8AutotestID == ATM_KU8_ID_SPI_ERROR, is equal to KU8_MODES______________________INHIB. --> u8InhibIndex == KU8_MODES______________________INHIB");
    result = debugger_readGlobalVariable("uint8", "castATMConfig", 0x45);
    EvalManStepEqual("Expected Test Result", result, 0x00);
    
  
  testCaseComment("Postcondition");
  testStep("STEP", "Return ECU to default values");
  RunPostTs();
}



testcase SW_IT_ATM_runCheckModeStatus_01()
{
  //***********************************Test report header*********************************
  testReportAddMiscInfoBlock("AUTOLIV ELECTRONICS document");
  TestReportAddMiscInfo("Nightly test", "No");
  TestReportAddMiscInfo("Test type", "Requirement-Based test");
  TestReportAddMiscInfo("Regression Test", "No");
  TestReportAddMiscInfo("Fault injection method used", "No");
  TestReportAddMiscInfo("Resource usage evaluation", "No");
  TestReportAddMiscInfo("Priority", "No");
  TestReportAddMiscInfo("Safety relevant", "No");
  
  AddRequirementInfo("Requirement under test", "ARCH_SW_ATM_0021");
  AddRequirementInfo("ARCH_SW_ATM_0021", "MMG_runCheckModeStatus shall be called to check if all conditions are fulfilled to execute the test.");
  //***************************************************************************************
  
  testCaseComment("Preconditions");
  testStep("STEP", "Bench Initialization");
  RunPreTs();


    debugger_reset();  
  
    testStep("STEP", "Set a breakpoint in ATM_runMainFunction() at line 'atm_PlayCyclicTests(castRunningCyclicList);'.");
    debugger_setRelativeFunctionBpAtLine("ATM_runMainFunction", 29);

    debugger_run();
  
    testCaseComment("Action: ARCH_SW_ATM_0021");
    testStep("STEP", "Check if CPU stopped in ATM_runMainFunction() at line 'atm_PlayCyclicTests(castRunningCyclicList);'. --> CPU is Stopped");
    debugger_WaitUntilBPisReached(500);
    

    debugger_deleteAllBP();
    
    
    testStep("STEP", "Set a breakpoint in function atm_PlayCyclicTests() at line 'atm_executeAutoTest(u8AutotestID);' under 'if (B_TRUE == atm_isAutoTestEnabled(u8AutotestID))' and press run.");
    debugger_setRelativeFunctionBpAtLine("atm_PlayCyclicTests", 9);

    debugger_run();
    
    testStep("STEP", "Check if CPU stopped in function atm_PlayCyclicTests() at line 'atm_executeAutoTest(u8AutotestID);' under 'if (B_TRUE == atm_isAutoTestEnabled(u8AutotestID))'. --> CPU is Stopped");
    debugger_WaitUntilBPisReached(500);
      

    debugger_deleteAllBP();
    
    
    testStep("STEP", "Set a breakpoint in function atm_executeAutoTest() at line 'Rte_Call_pclModeManagement_CheckModeStatus(cau32InhibitingModes[u8InhibModesIndex], &u8InhibitingContextStatus);' and press run.");
    debugger_setBpAtLine("s:\\Components\\Application\\Autoliv\\ATM\\Implementation\\src\\ATM.c", 197);

    debugger_run();
    
    testStep("STEP", "Check if CPU stopped in function atm_executeAutoTest() at line 'Rte_Call_pclModeManagement_CheckModeStatus(cau32InhibitingModes[u8InhibModesIndex], &u8InhibitingContextStatus);'. --> CPU is Stopped");
    debugger_WaitUntilBPisReached(500);
  
  
    debugger_deleteAllBP();
    
  
    testStep("STEP", "Step over at line Rte_Call_pclModeManagement_CheckModeStatus(cau32InhibitingModes[u8InhibModesIndex], &u8InhibitingContextStatus);.");
    debugger_stepIn();
  
    
    testStep("STEP", "Set a breakpoint in function MMG_runCheckModeStatus() at line 'if(B_TRUE == MMG_b8MMGHAsBeenInitialized)'.");
    debugger_setRelativeFunctionBpAtLine("MMG_runCheckModeStatus", 0);
  
    debugger_run();
    
    testCaseComment("Action: ARCH_SW_ATM_0021");
    testStep("STEP", "Check if CPU stopped in function MMG_runCheckModeStatus() at line 'if(B_TRUE == MMG_b8MMGHAsBeenInitialized)'. --> CPU is Stopped");
    debugger_WaitUntilBPisReached(500);
      
  
  testCaseComment("Postcondition");
  testStep("STEP", "Return ECU to default values");
  RunPostTs();
}


testcase SW_IT_ATM_RunResetCause_01()
{
  //***********************************Test report header*********************************
  testReportAddMiscInfoBlock("AUTOLIV ELECTRONICS document");
  TestReportAddMiscInfo("Nightly test", "No");
  TestReportAddMiscInfo("Test type", "Requirement-Based test");
  TestReportAddMiscInfo("Regression Test", "No");
  TestReportAddMiscInfo("Fault injection method used", "No");
  TestReportAddMiscInfo("Resource usage evaluation", "No");
  TestReportAddMiscInfo("Priority", "No");
  TestReportAddMiscInfo("Safety relevant", "No");
  
  AddRequirementInfo("Requirement under test", "ARCH_SW_ATM_0106");
  AddRequirementInfo("ARCH_SW_ATM_0106", "ATM_runMainFunction shall call the RCM_Autotest_RunResetCause function.");
  //***************************************************************************************
  
  testCaseComment("Preconditions");
  testStep("STEP", "Bench Initialization");
  RunPreTs();
  

    testStep("STEP", "Set a breakpoint in ATM_runMainFunction() at line 'atm_PlayCyclicTests(castRunningCyclicList);'.");
    debugger_setRelativeFunctionBpAtLine("ATM_runMainFunction", 29);

    debugger_reset();
    debugger_run();
  
    testCaseComment("Action: ARCH_SW_ATM_0106");
    testStep("STEP", "Check if CPU stopped in ATM_runMainFunction() at line 'atm_PlayCyclicTests(castRunningCyclicList);'. --> CPU is Stopped");
    debugger_WaitUntilBPisReached(500);
    
  
    debugger_deleteAllBP();
  
  
    testStep("STEP", "Set a breakpoint in atm_PlayCyclicTests() at line 'if (B_TRUE == atm_isAutoTestEnabled(u8AutotestID))' to step in atm_executeAutoTest()..");
    debugger_setRelativeFunctionBpAtLine("atm_PlayCyclicTests", 9);
    
    debugger_run();
  
    testStep("STEP", "Check if CPU stopped in atm_PlayCyclicTests() at line 'if (B_TRUE == atm_isAutoTestEnabled(u8AutotestID))' to step in atm_executeAutoTest(). --> CPU is Stopped");
    debugger_WaitUntilBPisReached(500);
  
    
    testStep("STEP", "Step in function atm_executeAutoTest(). --> Stepped in function atm_executeAutoTest");
    debugger_stepIn();
  
    testStep("STEP", "Check if CPU stopped in function atm_executeAutoTest(). --> CPU is Stopped");
    debugger_WaitUntilBPisReached(500);  
  

    debugger_deleteAllBP();
    
  
    testStep("STEP", "Set a breakpoint in function RCM_cbk_RunResetCause_Autotest() at line 'Rte_Call_pclRunResetCause_AutotestCallback(&u8TestResult);'.");
    debugger_setRelativeFunctionBpAtLine("RCM_cbk_RunResetCause_Autotest", 4);
    
    debugger_reset();
    debugger_run();
    
    testCaseComment("Action: ARCH_SW_ATM_0106");
    testStep("STEP", "Check if CPU stopped in function RCM_cbk_RunResetCause_Autotest() at line 'Rte_Call_pclRunResetCause_AutotestCallback(&u8TestResult);'. --> CPU is Stopped");
    debugger_WaitUntilBPisReached(500);    
  
  
    debugger_deleteAllBP();
    
  
    testStep("STEP", "Set a breakpoint in function RCM_Autotest_RunResetCause().");
    debugger_setRelativeFunctionBpAtLine("RCM_Autotest_RunResetCause", 0);

    debugger_run();
    
    testCaseComment("Action: ARCH_SW_ATM_0106");
    testStep("STEP", "Check if CPU stopped  in function RCM_Autotest_RunResetCause(). --> CPU is Stopped");
    debugger_WaitUntilBPisReached(500);

  
  testCaseComment("Postcondition");
  testStep("STEP", "Return ECU to default values");
  RunPostTs();
}


testcase SW_IT_ATM_CheckProductEndOfLifeMaxForce_01()
{
  //***********************************Test report header*********************************
  testReportAddMiscInfoBlock("AUTOLIV ELECTRONICS document");
  TestReportAddMiscInfo("Nightly test", "No");
  TestReportAddMiscInfo("Test type", "Requirement-Based test");
  TestReportAddMiscInfo("Regression Test", "No");
  TestReportAddMiscInfo("Fault injection method used", "No");
  TestReportAddMiscInfo("Resource usage evaluation", "No");
  TestReportAddMiscInfo("Priority", "No");
  TestReportAddMiscInfo("Safety relevant", "No");
  
  AddRequirementInfo("Requirement under test", "ARCH_SW_ATM_0110, ARCH_SW_ATM_0234");
  AddRequirementInfo("ARCH_SW_ATM_0110", "ATM_runMainFunction shall call the EOL_Autotest_CheckProductEndOfLifeMaxForce function.");
  AddRequirementInfo("ARCH_SW_ATM_0234", "ATM_runMainFunction shall call the EOL_cbk_CheckProductEndOfLifeMaxForce function.");
  //***************************************************************************************
  
  testCaseComment("Preconditions");
  testStep("STEP", "Bench Initialization");
  RunPreTs();


    testStep("STEP", "Set a breakpoint in ATM_runMainFunction() at line 'atm_PlayCyclicTests(castRunningCyclicList);'.");
    debugger_setRelativeFunctionBpAtLine("ATM_runMainFunction", 29);
  
    debugger_reset();
    debugger_run();
  
    testCaseComment("Action: ARCH_SW_ATM_0110");
    testStep("STEP", "Check if CPU stopped in ATM_runMainFunction() at line 'atm_PlayCyclicTests(castRunningCyclicList);'. --> CPU is Stopped");
    debugger_WaitUntilBPisReached(500);
    
    
    debugger_deleteAllBP();
    
    
    testStep("STEP", "Set a breakpoint in function atm_PlayCyclicTests() at line 'atm_executeAutoTest(u8AutotestID);' under 'if (B_TRUE == atm_isAutoTestEnabled(u8AutotestID))' and press run.");
    debugger_setRelativeFunctionBpAtLine("atm_PlayCyclicTests", 9);

    debugger_run();
    
    testStep("STEP", "Check if CPU stopped in function atm_PlayCyclicTests() at line 'atm_executeAutoTest(u8AutotestID);' under 'if (B_TRUE == atm_isAutoTestEnabled(u8AutotestID))'. --> CPU is Stopped");
    debugger_WaitUntilBPisReached(500);
  
  
    debugger_deleteAllBP();
  
  
    testStep("STEP", "Set a breakpoint in function atm_executeAutoTest() at line 'u8InhibModesIndex = castATMConfig[cu8AutotestID].u8InhibIndex;'.");
    debugger_setBpAtLine("s:\\Components\\Application\\Autoliv\\ATM\\Implementation\\src\\ATM.c", 194);
    
    debugger_run();
    
    testStep("STEP", "Check if CPU stopped in function atm_executeAutoTest() at line 'u8InhibModesIndex = castATMConfig[cu8AutotestID].u8InhibIndex;'. --> CPU is Stopped");
    debugger_WaitUntilBPisReached(500);
    

    debugger_deleteAllBP();    

    
    testStep("STEP", "Set a breakpoint in EOL_cbk_CheckProductEndOfLifeMaxForce().");
    debugger_setRelativeFunctionBpAtLine("EOL_cbk_CheckProductEndOfLifeMaxForce", 0); 
    
    debugger_run();
    
    testCaseComment("Action: ARCH_SW_ATM_0234");
    testStep("STEP", "Check if CPU stopped at EOL_cbk_CheckProductEndOfLifeMaxForce()*. --> CPU is Stopped");
    debugger_WaitUntilBPisReached(500);
    
  
    debugger_deleteAllBP();
  
  
    testStep("STEP", "Set a breakpoint in EOL_Autotest_CheckProductEndOfLifeMaxForce().");
    debugger_setRelativeFunctionBpAtLine("EOL_Autotest_CheckProductEndOfLifeMaxForce", 0);
    
    debugger_run();
    
    testCaseComment("Action: ARCH_SW_ATM_0110");
    testStep("STEP", "Check if CPU stopped at EOL_Autotest_CheckProductEndOfLifeMaxForce()*. --> CPU is Stopped");
    debugger_isCPUStoppedAtFunction("EOL_Autotest_CheckProductEndOfLifeMaxForce");

  
  testCaseComment("Postcondition");
  testStep("STEP", "Return ECU to default values");
  RunPostTs();
}


testcase SW_IT_ATM_CheckHighSideSwRegulation_01()
{
  //***********************************Test report header*********************************
  testReportAddMiscInfoBlock("AUTOLIV ELECTRONICS document");
  TestReportAddMiscInfo("Nightly test", "No");
  TestReportAddMiscInfo("Test type", "Requirement-Based test");
  TestReportAddMiscInfo("Regression Test", "No");
  TestReportAddMiscInfo("Fault injection method used", "No");
  TestReportAddMiscInfo("Resource usage evaluation", "No");
  TestReportAddMiscInfo("Priority", "No");
  TestReportAddMiscInfo("Safety relevant", "No");
  
  AddRequirementInfo("Requirement under test", "ARCH_SW_ATM_0114");
  AddRequirementInfo("ARCH_SW_ATM_0114", "ATM_runMainFunction shall call the PAL_Autotest_CheckHighSideSwRegulation function.");
  //***************************************************************************************
  
  testCaseComment("Preconditions");
  testStep("STEP", "Bench Initialization");
  RunPreTs();

    
    testStep("STEP", "Set a breakpoint in ATM_runMainFunction() at line 'atm_PlayCyclicTests(castRunningCyclicList);'.");
    debugger_setRelativeFunctionBpAtLine("ATM_runMainFunction", 29);
  
    debugger_reset();
    debugger_run();
  
    testCaseComment("Action: ARCH_SW_ATM_0114");
    testStep("STEP", "Check if CPU stopped in ATM_runMainFunction() at line 'atm_PlayCyclicTests(castRunningCyclicList);'. --> CPU is Stopped");
    debugger_WaitUntilBPisReached(500);
    
    
    debugger_deleteAllBP();
    
    
    testStep("STEP", "Set a breakpoint in function atm_PlayCyclicTests() at line 'atm_executeAutoTest(u8AutotestID);' under 'if (B_TRUE == atm_isAutoTestEnabled(u8AutotestID))' and press run.");
    debugger_setRelativeFunctionBpAtLine("atm_PlayCyclicTests", 9);

    debugger_run();
    
    testStep("STEP", "Check if CPU stopped in function atm_PlayCyclicTests() at line 'atm_executeAutoTest(u8AutotestID);' under 'if (B_TRUE == atm_isAutoTestEnabled(u8AutotestID))'. --> CPU is Stopped");
    debugger_WaitUntilBPisReached(500);
  
  
    debugger_deleteAllBP();
  
  
    testStep("STEP", "Set a breakpoint in function atm_executeAutoTest() at line 'u8InhibModesIndex = castATMConfig[cu8AutotestID].u8InhibIndex;'.");
    debugger_setBpAtLine("s:\\Components\\Application\\Autoliv\\ATM\\Implementation\\src\\ATM.c", 194);
    
    debugger_run();
    
    testStep("STEP", "Check if CPU stopped in function atm_executeAutoTest() at line 'u8InhibModesIndex = castATMConfig[cu8AutotestID].u8InhibIndex;'. --> CPU is Stopped");
    debugger_WaitUntilBPisReached(500);
    
  
    debugger_deleteAllBP();
  
  
    testStep("STEP", "Set a breakpoint in PAL_Autotest_CheckHighSideSwRegulation().");
    debugger_setRelativeFunctionBpAtLine("PAL_Autotest_CheckHighSideSwRegulation", 0);
    
    debugger_run();
    
    testCaseComment("Action: ARCH_SW_ATM_0114");
    testStep("STEP", "Check if CPU stopped at PAL_Autotest_CheckHighSideSwRegulation()*. --> CPU is Stopped");
    debugger_WaitUntilBPisReached(500);
  
  
  testCaseComment("Postcondition");
  testStep("STEP", "Return ECU to default values");
  RunPostTs();
}


testcase SW_IT_ATM_CheckCommandConsistency_01()
{
  //***********************************Test report header*********************************
  testReportAddMiscInfoBlock("AUTOLIV ELECTRONICS document");
  TestReportAddMiscInfo("Nightly test", "No");
  TestReportAddMiscInfo("Test type", "Requirement-Based test");
  TestReportAddMiscInfo("Regression Test", "No");
  TestReportAddMiscInfo("Fault injection method used", "No");
  TestReportAddMiscInfo("Resource usage evaluation", "No");
  TestReportAddMiscInfo("Priority", "No");
  TestReportAddMiscInfo("Safety relevant", "No");
  
  AddRequirementInfo("Requirement under test", "ARCH_SW_ATM_0115, ARCH_SW_ATM_0205");
  AddRequirementInfo("ARCH_SW_ATM_0115", "ATM_runMainFunction shall call the PAL_Autotest_CheckCommandConsistency function.");
  AddRequirementInfo("ARCH_SW_ATM_0205", "ATM_runMainFunction shall call the PAL_Autotest_CheckCommandConsistency function.");
  //***************************************************************************************
  
  testCaseComment("Preconditions");
  testStep("STEP", "Bench Initialization");
  RunPreTs();


    testStep("STEP", "Set a breakpoint in ATM_runMainFunction() at line 'atm_PlayCyclicTests(castRunningCyclicList);'.");
    debugger_setRelativeFunctionBpAtLine("ATM_runMainFunction", 29);
  
    debugger_reset();
    debugger_run();
  
    testCaseComment("Action: ARCH_SW_ATM_0115");
    testStep("STEP", "Check if CPU stopped in ATM_runMainFunction() at line 'atm_PlayCyclicTests(castRunningCyclicList);'. --> CPU is Stopped");
    debugger_WaitUntilBPisReached(500);
    
    
    debugger_deleteAllBP();
    
    
    testStep("STEP", "Set a breakpoint in function atm_PlayCyclicTests() at line 'atm_executeAutoTest(u8AutotestID);' under 'if (B_TRUE == atm_isAutoTestEnabled(u8AutotestID))' and press run.");
    debugger_setRelativeFunctionBpAtLine("atm_PlayCyclicTests", 9);

    debugger_run();
    
    testStep("STEP", "Check if CPU stopped in function atm_PlayCyclicTests() at line 'atm_executeAutoTest(u8AutotestID);' under 'if (B_TRUE == atm_isAutoTestEnabled(u8AutotestID))'. --> CPU is Stopped");
    debugger_WaitUntilBPisReached(500);
  
  
    debugger_deleteAllBP();
  
  
    testStep("STEP", "Set a breakpoint in function atm_executeAutoTest() at line 'u8InhibModesIndex = castATMConfig[cu8AutotestID].u8InhibIndex;'.");
    debugger_setBpAtLine("s:\\Components\\Application\\Autoliv\\ATM\\Implementation\\src\\ATM.c", 194);
    
    debugger_run();
    
    testStep("STEP", "Check if CPU stopped in function atm_executeAutoTest() at line 'u8InhibModesIndex = castATMConfig[cu8AutotestID].u8InhibIndex;'. --> CPU is Stopped");
    debugger_WaitUntilBPisReached(500);
    
  
    debugger_deleteAllBP();
  
  
    testStep("STEP", "Set a breakpoint in PAL_Autotest_CheckCommandConsistency().");
    debugger_setRelativeFunctionBpAtLine("PAL_Autotest_CheckCommandConsistency", 0); 

    debugger_run();
    
    testCaseComment("Action: ARCH_SW_ATM_0115, ARCH_SW_ATM_0205");
    testStep("STEP", "Check if CPU stopped at PAL_Autotest_CheckCommandConsistency()*. --> CPU is Stopped");
    debugger_WaitUntilBPisReached(500);
  
  
  testCaseComment("Postcondition");
  testStep("STEP", "Return ECU to default values");
  RunPostTs();
}


testcase SW_IT_ATM_CheckMosfetLowSC_01()
{
  //***********************************Test report header*********************************
  testReportAddMiscInfoBlock("AUTOLIV ELECTRONICS document");
  TestReportAddMiscInfo("Nightly test", "No");
  TestReportAddMiscInfo("Test type", "Requirement-Based test");
  TestReportAddMiscInfo("Regression Test", "No");
  TestReportAddMiscInfo("Fault injection method used", "No");
  TestReportAddMiscInfo("Resource usage evaluation", "No");
  TestReportAddMiscInfo("Priority", "No");
  TestReportAddMiscInfo("Safety relevant", "No");
  
  AddRequirementInfo("Requirement under test", "ARCH_SW_ATM_0117, ARCH_SW_ATM_0207");
  AddRequirementInfo("ARCH_SW_ATM_0117", "ATM_runMainFunction shall call the PAL_Autotest_CheckMosfetLowSC function.");
  AddRequirementInfo("ARCH_SW_ATM_0207", "ATM_runMainFunction shall call the PAL_cbk_CheckMosfetLowSC function.");
  //***************************************************************************************
  
  testCaseComment("Preconditions");
  testStep("STEP", "Bench Initialization");
  RunPreTs();

    
    testStep("STEP", "Set a breakpoint in ATM_runMainFunction() at line 'atm_PlayCyclicTests(castRunningCyclicList);'.");
    debugger_setRelativeFunctionBpAtLine("ATM_runMainFunction", 29);
  
    debugger_reset();
    debugger_run();
  
    testCaseComment("Action: ARCH_SW_ATM_0117");
    testStep("STEP", "Check if CPU stopped in ATM_runMainFunction() at line 'atm_PlayCyclicTests(castRunningCyclicList);'. --> CPU is Stopped");
    debugger_WaitUntilBPisReached(500);
    
    
    debugger_deleteAllBP();
    
    
    testStep("STEP", "Set a breakpoint in function atm_PlayCyclicTests() at line 'atm_executeAutoTest(u8AutotestID);' under 'if (B_TRUE == atm_isAutoTestEnabled(u8AutotestID))' and press run.");
    debugger_setRelativeFunctionBpAtLine("atm_PlayCyclicTests", 9);

    debugger_run();
    
    testStep("STEP", "Check if CPU stopped in function atm_PlayCyclicTests() at line 'atm_executeAutoTest(u8AutotestID);' under 'if (B_TRUE == atm_isAutoTestEnabled(u8AutotestID))'. --> CPU is Stopped");
    debugger_WaitUntilBPisReached(500);
  
  
    debugger_deleteAllBP();
  
  
    testStep("STEP", "Set a breakpoint in function atm_executeAutoTest() at line 'u8InhibModesIndex = castATMConfig[cu8AutotestID].u8InhibIndex;'.");
    debugger_setBpAtLine("s:\\Components\\Application\\Autoliv\\ATM\\Implementation\\src\\ATM.c", 194);
    
    debugger_run();
    
    testStep("STEP", "Check if CPU stopped in function atm_executeAutoTest() at line 'u8InhibModesIndex = castATMConfig[cu8AutotestID].u8InhibIndex;'. --> CPU is Stopped");
    debugger_WaitUntilBPisReached(500);
    
  
    debugger_deleteAllBP();
  
     
    testStep("STEP", "Set a breakpoint in PAL_cbk_CheckMosfetLowSC().");
    debugger_setRelativeFunctionBpAtLine("PAL_cbk_CheckMosfetLowSC", 0); 
    
    debugger_run();
    
    testCaseComment("Action: ARCH_SW_ATM_0207");
    testStep("STEP", "Check if CPU stopped at PAL_cbk_CheckMosfetLowSC()*. --> CPU is Stopped");
    debugger_WaitUntilBPisReached(500);
    
  
    debugger_deleteAllBP();
  
  
    testStep("STEP", "Set a breakpoint in PAL_Autotest_CheckMosfetLowSC().");
    debugger_setRelativeFunctionBpAtLine("PAL_Autotest_CheckMosfetLowSC", 0);
  
    debugger_run();
    
    testCaseComment("Action: ARCH_SW_ATM_0117");
    testStep("STEP", "Check if CPU stopped at PAL_Autotest_CheckMosfetLowSC()*. --> CPU is Stopped");
    debugger_WaitUntilBPisReached(500);

  
  testCaseComment("Postcondition");
  testStep("STEP", "Return ECU to default values");
  RunPostTs();
}


testcase SW_IT_ATM_CheckMotorConnection_01()
{
  //***********************************Test report header*********************************
  testReportAddMiscInfoBlock("AUTOLIV ELECTRONICS document");
  TestReportAddMiscInfo("Nightly test", "No");
  TestReportAddMiscInfo("Test type", "Requirement-Based test");
  TestReportAddMiscInfo("Regression Test", "No");
  TestReportAddMiscInfo("Fault injection method used", "No");
  TestReportAddMiscInfo("Resource usage evaluation", "No");
  TestReportAddMiscInfo("Priority", "No");
  TestReportAddMiscInfo("Safety relevant", "No");
  
  AddRequirementInfo("Requirement under test", "ARCH_SW_ATM_0118, ARCH_SW_ATM_0208");
  AddRequirementInfo("ARCH_SW_ATM_0118", "ATM_runMainFunction shall call the PAL_Autotest_CheckMotorConnection function.");
  AddRequirementInfo("ARCH_SW_ATM_0208", "ATM_runMainFunction shall call the PAL_cbk_CheckMotorConnection function.");
  //***************************************************************************************
  
  testCaseComment("Preconditions");
  testStep("STEP", "Bench Initialization");
  RunPreTs();

   
    testStep("STEP", "Set a breakpoint in ATM_runMainFunction() at line 'atm_PlayCyclicTests(castRunningCyclicList);'.");
    debugger_setRelativeFunctionBpAtLine("ATM_runMainFunction", 29);
  
    debugger_reset();
    debugger_run();
  
    testCaseComment("Action: ARCH_SW_ATM_0118");
    testStep("STEP", "Check if CPU stopped in ATM_runMainFunction() at line 'atm_PlayCyclicTests(castRunningCyclicList);'. --> CPU is Stopped");
    debugger_WaitUntilBPisReached(500);
    
    
    debugger_deleteAllBP();
    
    
    testStep("STEP", "Set a breakpoint in function atm_PlayCyclicTests() at line 'atm_executeAutoTest(u8AutotestID);' under 'if (B_TRUE == atm_isAutoTestEnabled(u8AutotestID))' and press run.");
    debugger_setRelativeFunctionBpAtLine("atm_PlayCyclicTests", 9);

    debugger_run();
    
    testStep("STEP", "Check if CPU stopped in function atm_PlayCyclicTests() at line 'atm_executeAutoTest(u8AutotestID);' under 'if (B_TRUE == atm_isAutoTestEnabled(u8AutotestID))'. --> CPU is Stopped");
    debugger_WaitUntilBPisReached(500);
  
  
    debugger_deleteAllBP();
  
  
    testStep("STEP", "Set a breakpoint in function atm_executeAutoTest() at line 'u8InhibModesIndex = castATMConfig[cu8AutotestID].u8InhibIndex;'.");
    debugger_setBpAtLine("s:\\Components\\Application\\Autoliv\\ATM\\Implementation\\src\\ATM.c", 194);
    
    debugger_run();
    
    testStep("STEP", "Check if CPU stopped in function atm_executeAutoTest() at line 'u8InhibModesIndex = castATMConfig[cu8AutotestID].u8InhibIndex;'. --> CPU is Stopped");
    debugger_WaitUntilBPisReached(500);
    
  
    debugger_deleteAllBP();
  
     
    testStep("STEP", "Set a breakpoint in PAL_cbk_CheckMotorConnection().");
    debugger_setRelativeFunctionBpAtLine("PAL_cbk_CheckMotorConnection", 0); 

    debugger_run();
    
    testCaseComment("Action: ARCH_SW_ATM_0208");
    testStep("STEP", "Check if CPU stopped at PAL_cbk_CheckMotorConnection()*. --> CPU is Stopped");
    debugger_WaitUntilBPisReached(500);
    
  
    debugger_deleteAllBP();
  
    
    testStep("STEP", "Set a breakpoint in PAL_Autotest_CheckMotorConnection().");
    debugger_setRelativeFunctionBpAtLine("PAL_Autotest_CheckMotorConnection", 0);
  
    debugger_run();
    
    testCaseComment("Action: ARCH_SW_ATM_0118");
    testStep("STEP", "Check if CPU stopped at PAL_Autotest_CheckMotorConnection()*. --> CPU is Stopped");
    debugger_WaitUntilBPisReached(500);

  
  testCaseComment("Postcondition");
  testStep("STEP", "Return ECU to default values");
  RunPostTs();
}


testcase SW_IT_ATM_CheckHWSelfProtection_01()
{
  //***********************************Test report header*********************************
  testReportAddMiscInfoBlock("AUTOLIV ELECTRONICS document");
  TestReportAddMiscInfo("Nightly test", "No");
  TestReportAddMiscInfo("Test type", "Requirement-Based test");
  TestReportAddMiscInfo("Regression Test", "No");
  TestReportAddMiscInfo("Fault injection method used", "No");
  TestReportAddMiscInfo("Resource usage evaluation", "No");
  TestReportAddMiscInfo("Priority", "No");
  TestReportAddMiscInfo("Safety relevant", "No");
  
  AddRequirementInfo("Requirement under test", "ARCH_SW_ATM_0119, ARCH_SW_ATM_0209");
  AddRequirementInfo("ARCH_SW_ATM_0119", "ATM_runMainFunction shall call the PAL_Autotest_CheckHWSelfProtection function.");
  AddRequirementInfo("ARCH_SW_ATM_0209", "ATM_runMainFunction shall call the PAL_cbk_CheckHWSelfProtection function.");
  //***************************************************************************************
  
  testCaseComment("Preconditions");
  testStep("STEP", "Bench Initialization");
  RunPreTs();


    testStep("STEP", "Set a breakpoint in ATM_runMainFunction() at line 'atm_PlayCyclicTests(castRunningCyclicList);'.");
    debugger_setRelativeFunctionBpAtLine("ATM_runMainFunction", 29);
  
    debugger_reset();
    debugger_run();
  
    testCaseComment("Action: ARCH_SW_ATM_0119");
    testStep("STEP", "Check if CPU stopped in ATM_runMainFunction() at line 'atm_PlayCyclicTests(castRunningCyclicList);'. --> CPU is Stopped");
    debugger_WaitUntilBPisReached(500);
    
    
    debugger_deleteAllBP();
    
    
    testStep("STEP", "Set a breakpoint in function atm_PlayCyclicTests() at line 'atm_executeAutoTest(u8AutotestID);' under 'if (B_TRUE == atm_isAutoTestEnabled(u8AutotestID))' and press run.");
    debugger_setRelativeFunctionBpAtLine("atm_PlayCyclicTests", 9);

    debugger_run();
    
    testStep("STEP", "Check if CPU stopped in function atm_PlayCyclicTests() at line 'atm_executeAutoTest(u8AutotestID);' under 'if (B_TRUE == atm_isAutoTestEnabled(u8AutotestID))'. --> CPU is Stopped");
    debugger_WaitUntilBPisReached(500);
  
  
    debugger_deleteAllBP();
  
  
    testStep("STEP", "Set a breakpoint in function atm_executeAutoTest() at line 'u8InhibModesIndex = castATMConfig[cu8AutotestID].u8InhibIndex;'.");
    debugger_setBpAtLine("s:\\Components\\Application\\Autoliv\\ATM\\Implementation\\src\\ATM.c", 194);
    
    debugger_run();
    
    testStep("STEP", "Check if CPU stopped in function atm_executeAutoTest() at line 'u8InhibModesIndex = castATMConfig[cu8AutotestID].u8InhibIndex;'. --> CPU is Stopped");
    debugger_WaitUntilBPisReached(500);
    
  
    debugger_deleteAllBP();  
  
     
    testStep("STEP", "Set a breakpoint in PAL_cbk_CheckHWSelfProtection().");
    debugger_setRelativeFunctionBpAtLine("PAL_cbk_CheckHWSelfProtection", 0);
  
    debugger_run();
    
    testCaseComment("Action: ARCH_SW_ATM_0209");
    testStep("STEP", "Check if CPU stopped at PAL_cbk_CheckHWSelfProtection()*. --> CPU is Stopped");
    debugger_WaitUntilBPisReached(500);
    
  
    debugger_deleteAllBP();
  
    
    testStep("STEP", "Set a breakpoint in PAL_Autotest_CheckHWSelfProtection().");
    debugger_setRelativeFunctionBpAtLine("PAL_Autotest_CheckHWSelfProtection", 0);
    
    debugger_run();
    
    testCaseComment("Action: ARCH_SW_ATM_0119");
    testStep("STEP", "Check if CPU stopped at PAL_Autotest_CheckHWSelfProtection()*. --> CPU is Stopped");
    debugger_WaitUntilBPisReached(500);

  
  testCaseComment("Postcondition");
  testStep("STEP", "Return ECU to default values");
  RunPostTs();
}



testcase SW_IT_ATM_CheckPowerSupplyUV_01()
{
  //***********************************Test report header*********************************
  testReportAddMiscInfoBlock("AUTOLIV ELECTRONICS document");
  TestReportAddMiscInfo("Nightly test", "No");
  TestReportAddMiscInfo("Test type", "Requirement-Based test");
  TestReportAddMiscInfo("Regression Test", "No");
  TestReportAddMiscInfo("Fault injection method used", "No");
  TestReportAddMiscInfo("Resource usage evaluation", "No");
  TestReportAddMiscInfo("Priority", "No");
  TestReportAddMiscInfo("Safety relevant", "No");
  
  AddRequirementInfo("Requirement under test", "ARCH_SW_ATM_0150, ARCH_SW_ATM_0214");
  AddRequirementInfo("ARCH_SW_ATM_0150", "ATM_runMainFunction shall call the PMP_Autotest_CheckPowerSupplyUV function.");
  AddRequirementInfo("ARCH_SW_ATM_0214", "ATM_runMainFunction shall call the PMP_cbk_CheckPowerSupplyUV function.");
  //***************************************************************************************
  
  testCaseComment("Preconditions");
  testStep("STEP", "Bench Initialization");
  RunPreTs();
  

    testStep("STEP", "Set a breakpoint in ATM_runMainFunction() at line 'atm_PlayCyclicTests(castRunningCyclicList);'.");
    debugger_setRelativeFunctionBpAtLine("ATM_runMainFunction", 29);
  
    debugger_reset();
    debugger_run();
  
    testCaseComment("Action: ARCH_SW_ATM_0150");
    testStep("STEP", "Check if CPU stopped in ATM_runMainFunction() at line 'atm_PlayCyclicTests(castRunningCyclicList);'. --> CPU is Stopped");
    debugger_WaitUntilBPisReached(500);
    
    
    debugger_deleteAllBP();
    
    
    testStep("STEP", "Set a breakpoint in function atm_PlayCyclicTests() at line 'atm_executeAutoTest(u8AutotestID);' under 'if (B_TRUE == atm_isAutoTestEnabled(u8AutotestID))' and press run.");
    debugger_setRelativeFunctionBpAtLine("atm_PlayCyclicTests", 9);

    debugger_run();
    
    testStep("STEP", "Check if CPU stopped in function atm_PlayCyclicTests() at line 'atm_executeAutoTest(u8AutotestID);' under 'if (B_TRUE == atm_isAutoTestEnabled(u8AutotestID))'. --> CPU is Stopped");
    debugger_WaitUntilBPisReached(500);
  
  
    debugger_deleteAllBP();
  
  
    testStep("STEP", "Set a breakpoint in function atm_executeAutoTest() at line 'u8InhibModesIndex = castATMConfig[cu8AutotestID].u8InhibIndex;'.");
    debugger_setBpAtLine("s:\\Components\\Application\\Autoliv\\ATM\\Implementation\\src\\ATM.c", 194);
    
    debugger_run();
    
    testStep("STEP", "Check if CPU stopped in function atm_executeAutoTest() at line 'u8InhibModesIndex = castATMConfig[cu8AutotestID].u8InhibIndex;'. --> CPU is Stopped");
    debugger_WaitUntilBPisReached(500);
    

    debugger_deleteAllBP();    
  
     
    testStep("STEP", "Set a breakpoint in function PMP_cbk_CheckPowerSupplyUV().");
    debugger_setRelativeFunctionBpAtLine("PMP_cbk_CheckPowerSupplyUV", 0); 
    
    debugger_run();
    
    testCaseComment("Action: ARCH_SW_ATM_0214");
    testStep("STEP", "Check if CPU stopped in function PMP_cbk_CheckPowerSupplyUV()*. --> CPU is Stopped");
    debugger_WaitUntilBPisReached(500);
    
  
    debugger_deleteAllBP();   
  
    
    testStep("STEP", "Set a breakpoint in PMP_Autotest_CheckPowerSupplyUV().");
    debugger_setRelativeFunctionBpAtLine("PMP_Autotest_CheckPowerSupplyUV", 0);

    debugger_run();
    
    testCaseComment("Action: ARCH_SW_ATM_0150");
    testStep("STEP", "Check if CPU stopped at PMP_Autotest_CheckPowerSupplyUV()*. --> CPU is Stopped");
    debugger_WaitUntilBPisReached(500);
  
  
  testCaseComment("Postcondition");
  testStep("STEP", "Return ECU to default values");
  RunPostTs();
}


testcase SW_IT_ATM_CheckPowerSupplyOV_01()
{
  //***********************************Test report header*********************************
  testReportAddMiscInfoBlock("AUTOLIV ELECTRONICS document");
  TestReportAddMiscInfo("Nightly test", "No");
  TestReportAddMiscInfo("Test type", "Requirement-Based test");
  TestReportAddMiscInfo("Regression Test", "No");
  TestReportAddMiscInfo("Fault injection method used", "No");
  TestReportAddMiscInfo("Resource usage evaluation", "No");
  TestReportAddMiscInfo("Priority", "No");
  TestReportAddMiscInfo("Safety relevant", "No");
  
  AddRequirementInfo("Requirement under test", "ARCH_SW_ATM_0151, ARCH_SW_ATM_0215");
  AddRequirementInfo("ARCH_SW_ATM_0151", "ATM_runMainFunction shall call the PMP_Autotest_CheckPowerSupplyOV function.");
  AddRequirementInfo("ARCH_SW_ATM_0215", "ATM_runMainFunction shall call the PMP_cbk_CheckPowerSupplyOV function.");
  //***************************************************************************************
  
  testCaseComment("Preconditions");
  testStep("STEP", "Bench Initialization");
  RunPreTs();
    

    testStep("STEP", "Set a breakpoint in ATM_runMainFunction() at line 'atm_PlayCyclicTests(castRunningCyclicList);'.");
    debugger_setRelativeFunctionBpAtLine("ATM_runMainFunction", 29);
  
    debugger_reset();
    debugger_run();
  
    testCaseComment("Action: ARCH_SW_ATM_0151");
    testStep("STEP", "Check if CPU stopped in ATM_runMainFunction() at line 'atm_PlayCyclicTests(castRunningCyclicList);'. --> CPU is Stopped");
    debugger_WaitUntilBPisReached(500);
    
    
    debugger_deleteAllBP();
    
    
    testStep("STEP", "Set a breakpoint in function atm_PlayCyclicTests() at line 'atm_executeAutoTest(u8AutotestID);' under 'if (B_TRUE == atm_isAutoTestEnabled(u8AutotestID))' and press run.");
    debugger_setRelativeFunctionBpAtLine("atm_PlayCyclicTests", 9);

    debugger_run();
    
    testStep("STEP", "Check if CPU stopped in function atm_PlayCyclicTests() at line 'atm_executeAutoTest(u8AutotestID);' under 'if (B_TRUE == atm_isAutoTestEnabled(u8AutotestID))'. --> CPU is Stopped");
    debugger_WaitUntilBPisReached(500);
  
  
    debugger_deleteAllBP();
  
  
    testStep("STEP", "Set a breakpoint in function atm_executeAutoTest() at line 'u8InhibModesIndex = castATMConfig[cu8AutotestID].u8InhibIndex;'.");
    debugger_setBpAtLine("s:\\Components\\Application\\Autoliv\\ATM\\Implementation\\src\\ATM.c", 194);
    
    debugger_run();
    
    testStep("STEP", "Check if CPU stopped in function atm_executeAutoTest() at line 'u8InhibModesIndex = castATMConfig[cu8AutotestID].u8InhibIndex;'. --> CPU is Stopped");
    debugger_WaitUntilBPisReached(500);
    

    debugger_deleteAllBP();    
  
     
    testStep("STEP", "Set a breakpoint in PMP_cbk_CheckPowerSupplyOV().");
    debugger_setRelativeFunctionBpAtLine("PMP_cbk_CheckPowerSupplyOV", 0); 
    
    debugger_run();
    
    testCaseComment("Action: ARCH_SW_ATM_0215");
    testStep("STEP", "Check if CPU stopped at PMP_cbk_CheckPowerSupplyOV()*. --> CPU is Stopped");
    debugger_WaitUntilBPisReached(500);
    
  
    debugger_deleteAllBP();
  
    
    testStep("STEP", "Set a breakpoint in PMP_Autotest_CheckPowerSupplyOV().");
    debugger_setRelativeFunctionBpAtLine("PMP_Autotest_CheckPowerSupplyOV", 0);
    
    debugger_run();
    
    testCaseComment("Action: ARCH_SW_ATM_0151");
    testStep("STEP", "Check if CPU stopped at PMP_Autotest_CheckPowerSupplyOV()*. --> CPU is Stopped"); 
    debugger_WaitUntilBPisReached(500);

  
  testCaseComment("Postcondition");
  testStep("STEP", "Return ECU to default values");
  RunPostTs();
}


testcase SW_IT_ATM_CheckPowerSupplyUVDuringActivation_01()
{
  //***********************************Test report header*********************************
  testReportAddMiscInfoBlock("AUTOLIV ELECTRONICS document");
  TestReportAddMiscInfo("Nightly test", "No");
  TestReportAddMiscInfo("Test type", "Requirement-Based test");
  TestReportAddMiscInfo("Regression Test", "No");
  TestReportAddMiscInfo("Fault injection method used", "No");
  TestReportAddMiscInfo("Resource usage evaluation", "No");
  TestReportAddMiscInfo("Priority", "No");
  TestReportAddMiscInfo("Safety relevant", "No");
  
  AddRequirementInfo("Requirement under test", "ARCH_SW_ATM_0202");
  AddRequirementInfo("ARCH_SW_ATM_0202", "ATM_runMainFunction shall call the PMP_Autotest_CheckPowerSupplyUVDuringActivation function.");
  //***************************************************************************************
  
  testCaseComment("Preconditions");
  testStep("STEP", "Bench Initialization");
  RunPreTs();
    

    testStep("STEP", "Set a breakpoint in ATM_runMainFunction() at line 'atm_PlayCyclicTests(castRunningCyclicList);'.");
    debugger_setRelativeFunctionBpAtLine("ATM_runMainFunction", 29);
  
    debugger_reset();
    debugger_run();
  
    testCaseComment("Action: ARCH_SW_ATM_0202");
    testStep("STEP", "Check if CPU stopped in ATM_runMainFunction() at line 'atm_PlayCyclicTests(castRunningCyclicList);'. --> CPU is Stopped");
    debugger_WaitUntilBPisReached(500);
    
    
    debugger_deleteAllBP();
    
    
    testStep("STEP", "Set a breakpoint in function atm_PlayCyclicTests() at line 'atm_executeAutoTest(u8AutotestID);' under 'if (B_TRUE == atm_isAutoTestEnabled(u8AutotestID))' and press run.");
    debugger_setRelativeFunctionBpAtLine("atm_PlayCyclicTests", 9);

    debugger_run();
    
    testStep("STEP", "Check if CPU stopped in function atm_PlayCyclicTests() at line 'atm_executeAutoTest(u8AutotestID);' under 'if (B_TRUE == atm_isAutoTestEnabled(u8AutotestID))'. --> CPU is Stopped");
    debugger_WaitUntilBPisReached(500);
  
  
    debugger_deleteAllBP();
  
  
    testStep("STEP", "Set a breakpoint in function atm_executeAutoTest() at line 'u8InhibModesIndex = castATMConfig[cu8AutotestID].u8InhibIndex;'.");
    debugger_setBpAtLine("s:\\Components\\Application\\Autoliv\\ATM\\Implementation\\src\\ATM.c", 194);
    
    debugger_run();
    
    testStep("STEP", "Check if CPU stopped in function atm_executeAutoTest() at line 'u8InhibModesIndex = castATMConfig[cu8AutotestID].u8InhibIndex;'. --> CPU is Stopped");
    debugger_WaitUntilBPisReached(500);
    
  
    debugger_deleteAllBP();
  
    
    testStep("STEP", "Set a breakpoint in PMP_Autotest_CheckPowerSupplyUVDuringActivation().");
    debugger_setRelativeFunctionBpAtLine("PMP_Autotest_CheckPowerSupplyUVDuringActivation", 0);

    debugger_run();
    
    testCaseComment("Action: ARCH_SW_ATM_0202");
    testStep("STEP", "Check if CPU stopped at PMP_Autotest_CheckPowerSupplyUVDuringActivation()*. --> CPU is Stopped");
    debugger_WaitUntilBPisReached(500);

  
  testCaseComment("Postcondition");
  testStep("STEP", "Return ECU to default values");
  RunPostTs();
}


testcase SW_IT_ATM_CheckPowerSupplyOVDuringActivation_01()
{
  //***********************************Test report header*********************************
  testReportAddMiscInfoBlock("AUTOLIV ELECTRONICS document");
  TestReportAddMiscInfo("Nightly test", "No");
  TestReportAddMiscInfo("Test type", "Requirement-Based test");
  TestReportAddMiscInfo("Regression Test", "No");
  TestReportAddMiscInfo("Fault injection method used", "No");
  TestReportAddMiscInfo("Resource usage evaluation", "No");
  TestReportAddMiscInfo("Priority", "No");
  TestReportAddMiscInfo("Safety relevant", "No");
  
  AddRequirementInfo("Requirement under test", "ARCH_SW_ATM_0203");
  AddRequirementInfo("ARCH_SW_ATM_0203", "ATM_runMainFunction shall call the PMP_Autotest_CheckPowerSupplyOVDuringActivation function.");
  //***************************************************************************************
  
  testCaseComment("Preconditions");
  testStep("STEP", "Bench Initialization");
  RunPreTs();
    

    testStep("STEP", "Set a breakpoint in ATM_runMainFunction() at line 'atm_PlayCyclicTests(castRunningCyclicList);'.");
    debugger_setRelativeFunctionBpAtLine("ATM_runMainFunction", 29);
  
    debugger_reset();
    debugger_run();
  
    testCaseComment("Action: ARCH_SW_ATM_0203");
    testStep("STEP", "Check if CPU stopped in ATM_runMainFunction() at line 'atm_PlayCyclicTests(castRunningCyclicList);'. --> CPU is Stopped");
    debugger_WaitUntilBPisReached(500);
    
    
    debugger_deleteAllBP();
    
    
    testStep("STEP", "Set a breakpoint in function atm_PlayCyclicTests() at line 'atm_executeAutoTest(u8AutotestID);' under 'if (B_TRUE == atm_isAutoTestEnabled(u8AutotestID))' and press run.");
    debugger_setRelativeFunctionBpAtLine("atm_PlayCyclicTests", 9);

    debugger_run();
    
    testStep("STEP", "Check if CPU stopped in function atm_PlayCyclicTests() at line 'atm_executeAutoTest(u8AutotestID);' under 'if (B_TRUE == atm_isAutoTestEnabled(u8AutotestID))'. --> CPU is Stopped");
    debugger_WaitUntilBPisReached(500);
  
  
    debugger_deleteAllBP();
  
  
    testStep("STEP", "Set a breakpoint in function atm_executeAutoTest() at line 'u8InhibModesIndex = castATMConfig[cu8AutotestID].u8InhibIndex;'.");
    debugger_setBpAtLine("s:\\Components\\Application\\Autoliv\\ATM\\Implementation\\src\\ATM.c", 194);
    
    debugger_run();
    
    testStep("STEP", "Check if CPU stopped in function atm_executeAutoTest() at line 'u8InhibModesIndex = castATMConfig[cu8AutotestID].u8InhibIndex;'. --> CPU is Stopped");
    debugger_WaitUntilBPisReached(500);
    
  
    debugger_deleteAllBP();
  
    
    testStep("STEP", "Set a breakpoint in PMP_Autotest_CheckPowerSupplyOVDuringActivation().");
    debugger_setRelativeFunctionBpAtLine("PMP_Autotest_CheckPowerSupplyOVDuringActivation", 0);

    debugger_run();
    
    testCaseComment("Action: ARCH_SW_ATM_0203");
    testStep("STEP", "Check if CPU stopped at PMP_Autotest_CheckPowerSupplyOVDuringActivation()*. --> CPU is Stopped");
    debugger_WaitUntilBPisReached(500);
  
  
  testCaseComment("Postcondition");
  testStep("STEP", "Return ECU to default values");
  RunPostTs();
}


testcase SW_IT_ATM_CheckImplausibleData_Powertrain_Drv_01()
{
  //***********************************Test report header*********************************
  testReportAddMiscInfoBlock("AUTOLIV ELECTRONICS document");
  TestReportAddMiscInfo("Nightly test", "No");
  TestReportAddMiscInfo("Test type", "Requirement-Based test");
  TestReportAddMiscInfo("Regression Test", "No");
  TestReportAddMiscInfo("Fault injection method used", "No");
  TestReportAddMiscInfo("Resource usage evaluation", "No");
  TestReportAddMiscInfo("Priority", "No");
  TestReportAddMiscInfo("Safety relevant", "No");
  
  AddRequirementInfo("Requirement under test", "ARCH_SW_ATM_0235");
  AddRequirementInfo("ARCH_SW_ATM_0235", "ATM_runMainFunction shall call the CIL_Autotest_CheckImplausibleData_Powertrain_Drv function.");
  //***************************************************************************************
  
  testCaseComment("Preconditions");
  testStep("STEP", "Bench Initialization");
  RunPreTs();
    

    testStep("STEP", "Set a breakpoint in ATM_runMainFunction() at line 'atm_PlayCyclicTests(castRunningCyclicList);'.");
    debugger_setRelativeFunctionBpAtLine("ATM_runMainFunction", 29);
  
    debugger_reset();
    debugger_run();
  
    testCaseComment("Action: ARCH_SW_ATM_0235");
    testStep("STEP", "Check if CPU stopped in ATM_runMainFunction() at line 'atm_PlayCyclicTests(castRunningCyclicList);'. --> CPU is Stopped");
    debugger_WaitUntilBPisReached(500);
    
    
    debugger_deleteAllBP();
    
    
    testStep("STEP", "Set a breakpoint in function atm_PlayCyclicTests() at line 'atm_executeAutoTest(u8AutotestID);' under 'if (B_TRUE == atm_isAutoTestEnabled(u8AutotestID))' and press run.");
    debugger_setRelativeFunctionBpAtLine("atm_PlayCyclicTests", 9);

    debugger_run();
    
    testStep("STEP", "Check if CPU stopped in function atm_PlayCyclicTests() at line 'atm_executeAutoTest(u8AutotestID);' under 'if (B_TRUE == atm_isAutoTestEnabled(u8AutotestID))'. --> CPU is Stopped");
    debugger_WaitUntilBPisReached(500);
  
  
    debugger_deleteAllBP();
  
  
    testStep("STEP", "Set a breakpoint in function atm_executeAutoTest() at line 'u8InhibModesIndex = castATMConfig[cu8AutotestID].u8InhibIndex;'.");
    debugger_setBpAtLine("s:\\Components\\Application\\Autoliv\\ATM\\Implementation\\src\\ATM.c", 194);
    
    debugger_run();
    
    testStep("STEP", "Check if CPU stopped in function atm_executeAutoTest() at line 'u8InhibModesIndex = castATMConfig[cu8AutotestID].u8InhibIndex;'. --> CPU is Stopped");
    debugger_WaitUntilBPisReached(500);
    
  
    debugger_deleteAllBP();
  
    
    testStep("STEP", "Set a breakpoint in  function CIL_Autotest_CheckImplausibleData_PowertrainDrv().");
    debugger_setRelativeFunctionBpAtLine("CIL_Autotest_CheckImplausibleData_PowertrainDrv", 0);
    
    debugger_run();
    
    testCaseComment("Action: ARCH_SW_ATM_0235");
    testStep("STEP", "Check if CPU stopped in function CIL_Autotest_CheckImplausibleData_PowertrainDrv(). --> CPU is Stopped");
    debugger_WaitUntilBPisReached(500);

  
  testCaseComment("Postcondition");
  testStep("STEP", "Return ECU to default values");
  RunPostTs();
}


testcase SW_IT_ATM_CheckTimeoutError_OdoSpeedometer_01()
{
  //***********************************Test report header*********************************
  testReportAddMiscInfoBlock("AUTOLIV ELECTRONICS document");
  TestReportAddMiscInfo("Nightly test", "No");
  TestReportAddMiscInfo("Test type", "Requirement-Based test");
  TestReportAddMiscInfo("Regression Test", "No");
  TestReportAddMiscInfo("Fault injection method used", "No");
  TestReportAddMiscInfo("Resource usage evaluation", "No");
  TestReportAddMiscInfo("Priority", "No");
  TestReportAddMiscInfo("Safety relevant", "No");
  
  AddRequirementInfo("Requirement under test", "ARCH_SW_ATM_0236");
  AddRequirementInfo("ARCH_SW_ATM_0236", "ATM_runMainFunction shall call the CIL_Autotest_CheckTimeout_Odospeedometer function.");
  //***************************************************************************************
  
  testCaseComment("Preconditions");
  testStep("STEP", "Bench Initialization");
  RunPreTs();
    

    testStep("STEP", "Set a breakpoint in ATM_runMainFunction() at line 'atm_PlayCyclicTests(castRunningCyclicList);'.");
    debugger_setRelativeFunctionBpAtLine("ATM_runMainFunction", 29);
  
    debugger_reset();
    debugger_run();
  
    testCaseComment("Action: ARCH_SW_ATM_0236");
    testStep("STEP", "Check if CPU stopped in ATM_runMainFunction() at line 'atm_PlayCyclicTests(castRunningCyclicList);'. --> CPU is Stopped");
    debugger_WaitUntilBPisReached(500);
    
    
    debugger_deleteAllBP();
    
    
    testStep("STEP", "Set a breakpoint in function atm_PlayCyclicTests() at line 'atm_executeAutoTest(u8AutotestID);' under 'if (B_TRUE == atm_isAutoTestEnabled(u8AutotestID))' and press run.");
    debugger_setRelativeFunctionBpAtLine("atm_PlayCyclicTests", 9);

    debugger_run();
    
    testStep("STEP", "Check if CPU stopped in function atm_PlayCyclicTests() at line 'atm_executeAutoTest(u8AutotestID);' under 'if (B_TRUE == atm_isAutoTestEnabled(u8AutotestID))'. --> CPU is Stopped");
    debugger_WaitUntilBPisReached(500);
  
  
    debugger_deleteAllBP();
  
  
    testStep("STEP", "Set a breakpoint in function atm_executeAutoTest() at line 'u8InhibModesIndex = castATMConfig[cu8AutotestID].u8InhibIndex;'.");
    debugger_setBpAtLine("s:\\Components\\Application\\Autoliv\\ATM\\Implementation\\src\\ATM.c", 194);
    
    debugger_run();
    
    testStep("STEP", "Check if CPU stopped in function atm_executeAutoTest() at line 'u8InhibModesIndex = castATMConfig[cu8AutotestID].u8InhibIndex;'. --> CPU is Stopped");
    debugger_WaitUntilBPisReached(500);
    
  
    debugger_deleteAllBP();   
  
    
    testStep("STEP", "Set a breakpoint in function CIL_Autotest_CheckTimeoutError_OdoSpeedometer().");
    debugger_setRelativeFunctionBpAtLine("CIL_Autotest_CheckTimeoutError_OdoSpeedometer", 0);
    
    debugger_run();
    
    testCaseComment("Action: ARCH_SW_ATM_0236");
    testStep("STEP", "Check if CPU stopped in function CIL_Autotest_CheckTimeoutError_OdoSpeedometer(). --> CPU is Stopped");
    debugger_WaitUntilBPisReached(500);

  
  testCaseComment("Postcondition");
  testStep("STEP", "Return ECU to default values");
  RunPostTs();
}


testcase SW_IT_ATM_CheckCommandConsistency_02()
{
  //***********************************Test report header*********************************
  testReportAddMiscInfoBlock("AUTOLIV ELECTRONICS document");
  TestReportAddMiscInfo("Nightly test", "No");
  TestReportAddMiscInfo("Test type", "Requirement-Based test");
  TestReportAddMiscInfo("Regression Test", "No");
  TestReportAddMiscInfo("Fault injection method used", "No");
  TestReportAddMiscInfo("Resource usage evaluation", "No");
  TestReportAddMiscInfo("Priority", "No");
  TestReportAddMiscInfo("Safety relevant", "No");
  
  AddRequirementInfo("Requirement under test", "ARCH_SW_ATM_0205");
  AddRequirementInfo("ARCH_SW_ATM_0205", "ATM_runMainFunction shall call the PAL_Autotest_CheckCommandConsistency function.");
  //***************************************************************************************
  
  testCaseComment("Preconditions");
  testStep("STEP", "Bench Initialization");
  RunPreTs();
    

    testStep("STEP", "Set a breakpoint in ATM_runMainFunction() at line 'atm_PlayCyclicTests(castRunningCyclicList);'.");
    debugger_setRelativeFunctionBpAtLine("ATM_runMainFunction", 29);
  
    debugger_reset();
    debugger_run();
  
    testCaseComment("Action: ARCH_SW_ATM_0205");
    testStep("STEP", "Check if CPU stopped in ATM_runMainFunction() at line 'atm_PlayCyclicTests(castRunningCyclicList);'. --> CPU is Stopped");
    debugger_WaitUntilBPisReached(500);
    
    
    debugger_deleteAllBP();
    
    
    testStep("STEP", "Set a breakpoint in function atm_PlayCyclicTests() at line 'atm_executeAutoTest(u8AutotestID);' under 'if (B_TRUE == atm_isAutoTestEnabled(u8AutotestID))' and press run.");
    debugger_setRelativeFunctionBpAtLine("atm_PlayCyclicTests", 9);

    debugger_run();
    
    testStep("STEP", "Check if CPU stopped in function atm_PlayCyclicTests() at line 'atm_executeAutoTest(u8AutotestID);' under 'if (B_TRUE == atm_isAutoTestEnabled(u8AutotestID))'. --> CPU is Stopped");
    debugger_WaitUntilBPisReached(500);
  
  
    debugger_deleteAllBP();
  
  
    testStep("STEP", "Set a breakpoint in function atm_executeAutoTest() at line 'u8InhibModesIndex = castATMConfig[cu8AutotestID].u8InhibIndex;'.");
    debugger_setBpAtLine("s:\\Components\\Application\\Autoliv\\ATM\\Implementation\\src\\ATM.c", 194);
    
    debugger_run();
    
    testStep("STEP", "Check if CPU stopped in function atm_executeAutoTest() at line 'u8InhibModesIndex = castATMConfig[cu8AutotestID].u8InhibIndex;'. --> CPU is Stopped");
    debugger_WaitUntilBPisReached(500);
    
  
    debugger_deleteAllBP();   
  
      
    testStep("STEP", "Set a breakpoint in PAL_Autotest_CheckCommandConsistency().");
    debugger_setRelativeFunctionBpAtLine("PAL_Autotest_CheckCommandConsistency", 0);

    debugger_run();
    
    testCaseComment("Action: ARCH_SW_ATM_0205");
    testStep("STEP", "Check if CPU stopped at PAL_Autotest_CheckCommandConsistency()*. --> CPU is Stopped");
    debugger_WaitUntilBPisReached(500);

  
  testCaseComment("Postcondition");
  testStep("STEP", "Return ECU to default values");
  RunPostTs();
}


testcase SW_IT_ATM_CheckMosfetHighSC_04()
{
  //***********************************Test report header*********************************
  testReportAddMiscInfoBlock("AUTOLIV ELECTRONICS document");
  TestReportAddMiscInfo("Nightly test", "No");
  TestReportAddMiscInfo("Test type", "Requirement-Based test");
  TestReportAddMiscInfo("Regression Test", "No");
  TestReportAddMiscInfo("Fault injection method used", "No");
  TestReportAddMiscInfo("Resource usage evaluation", "No");
  TestReportAddMiscInfo("Priority", "No");
  TestReportAddMiscInfo("Safety relevant", "No");
  
  AddRequirementInfo("Requirement under test", "ARCH_SW_ATM_0206");
  AddRequirementInfo("ARCH_SW_ATM_0206", "ATM_runMainFunction shall call the PAL_cbk_CheckMosfetHighSC function.");
  //***************************************************************************************
  
  testCaseComment("Preconditions");
  testStep("STEP", "Bench Initialization");
  RunPreTs();
 

    testStep("STEP", "Set a breakpoint in ATM_runMainFunction() at line 'atm_PlayCyclicTests(castRunningCyclicList);'.");
    debugger_setRelativeFunctionBpAtLine("ATM_runMainFunction", 29);
  
    debugger_reset();
    debugger_run();
  
    testCaseComment("Action: ARCH_SW_ATM_0206");
    testStep("STEP", "Check if CPU stopped in ATM_runMainFunction() at line 'atm_PlayCyclicTests(castRunningCyclicList);'. --> CPU is Stopped");
    debugger_WaitUntilBPisReached(500);
    
    
    debugger_deleteAllBP();
    
    
    testStep("STEP", "Set a breakpoint in function atm_PlayCyclicTests() at line 'atm_executeAutoTest(u8AutotestID);' under 'if (B_TRUE == atm_isAutoTestEnabled(u8AutotestID))' and press run.");
    debugger_setRelativeFunctionBpAtLine("atm_PlayCyclicTests", 9);

    debugger_run();
    
    testStep("STEP", "Check if CPU stopped in function atm_PlayCyclicTests() at line 'atm_executeAutoTest(u8AutotestID);' under 'if (B_TRUE == atm_isAutoTestEnabled(u8AutotestID))'. --> CPU is Stopped");
    debugger_WaitUntilBPisReached(500);
  
  
    debugger_deleteAllBP();
  
  
    testStep("STEP", "Set a breakpoint in function atm_executeAutoTest() at line 'u8InhibModesIndex = castATMConfig[cu8AutotestID].u8InhibIndex;'.");
    debugger_setBpAtLine("s:\\Components\\Application\\Autoliv\\ATM\\Implementation\\src\\ATM.c", 194);
    
    debugger_run();
    
    testStep("STEP", "Check if CPU stopped in function atm_executeAutoTest() at line 'u8InhibModesIndex = castATMConfig[cu8AutotestID].u8InhibIndex;'. --> CPU is Stopped");
    debugger_WaitUntilBPisReached(500);
    
  
    debugger_deleteAllBP();    
  
      
    testStep("STEP", "Set a breakpoint in PAL_cbk_CheckMosfetHighSC().");
    debugger_setRelativeFunctionBpAtLine("PAL_cbk_CheckMosfetHighSC", 0); 
    
    debugger_reset();
    debugger_run();
    
    testCaseComment("Action: ARCH_SW_ATM_0206");
    testStep("STEP", "Check if CPU stopped at PAL_cbk_CheckMosfetHighSC()*. --> CPU is Stopped");
    debugger_WaitUntilBPisReached(500);

  
  testCaseComment("Postcondition");
  testStep("STEP", "Return ECU to default values");
  RunPostTs();
}


testcase SW_IT_ATM_CheckMotorDisengagement_02()
{
  //***********************************Test report header*********************************
  testReportAddMiscInfoBlock("AUTOLIV ELECTRONICS document");
  TestReportAddMiscInfo("Nightly test", "No");
  TestReportAddMiscInfo("Test type", "Requirement-Based test");
  TestReportAddMiscInfo("Regression Test", "No");
  TestReportAddMiscInfo("Fault injection method used", "No");
  TestReportAddMiscInfo("Resource usage evaluation", "No");
  TestReportAddMiscInfo("Priority", "No");
  TestReportAddMiscInfo("Safety relevant", "No");
  
  AddRequirementInfo("Requirement under test", "ARCH_SW_ATM_0210");
  AddRequirementInfo("ARCH_SW_ATM_0210", "ATM_runMainFunction shall call the PAL_cbk_CheckMotorDisengagement function.");
  //***************************************************************************************
  
  testCaseComment("Preconditions");
  testStep("STEP", "Bench Initialization");
  RunPreTs();
  

    testStep("STEP", "Set a breakpoint in ATM_runMainFunction() at line 'atm_PlayCyclicTests(castRunningCyclicList);'.");
    debugger_setRelativeFunctionBpAtLine("ATM_runMainFunction", 29);
  
    debugger_reset();
    debugger_run();
  
    testCaseComment("Action: ARCH_SW_ATM_0210");
    testStep("STEP", "Check if CPU stopped in ATM_runMainFunction() at line 'atm_PlayCyclicTests(castRunningCyclicList);'. --> CPU is Stopped");
    debugger_WaitUntilBPisReached(500);
    
    
    debugger_deleteAllBP();
    
    
    testStep("STEP", "Set a breakpoint in function atm_PlayCyclicTests() at line 'atm_executeAutoTest(u8AutotestID);' under 'if (B_TRUE == atm_isAutoTestEnabled(u8AutotestID))' and press run.");
    debugger_setRelativeFunctionBpAtLine("atm_PlayCyclicTests", 9);

    debugger_run();
    
    testStep("STEP", "Check if CPU stopped in function atm_PlayCyclicTests() at line 'atm_executeAutoTest(u8AutotestID);' under 'if (B_TRUE == atm_isAutoTestEnabled(u8AutotestID))'. --> CPU is Stopped");
    debugger_WaitUntilBPisReached(500);
  
  
    debugger_deleteAllBP();
  
  
    testStep("STEP", "Set a breakpoint in function atm_executeAutoTest() at line 'u8InhibModesIndex = castATMConfig[cu8AutotestID].u8InhibIndex;'.");
    debugger_setBpAtLine("s:\\Components\\Application\\Autoliv\\ATM\\Implementation\\src\\ATM.c", 194);
    
    debugger_run();
    
    testStep("STEP", "Check if CPU stopped in function atm_executeAutoTest() at line 'u8InhibModesIndex = castATMConfig[cu8AutotestID].u8InhibIndex;'. --> CPU is Stopped");
    debugger_WaitUntilBPisReached(500);
    
  
    debugger_deleteAllBP();    
  
     
    testStep("STEP", "Set a breakpoint in PAL_cbk_CheckMotorDisengagement().");
    debugger_setRelativeFunctionBpAtLine("PAL_cbk_CheckMotorDisengagement", 0);
  
    debugger_run();
    
    testCaseComment("Action: ARCH_SW_ATM_0210");
    testStep("STEP", "Check if CPU stopped at PAL_cbk_CheckMotorDisengagement()*. --> CPU is Stopped");
    debugger_WaitUntilBPisReached(500);

  
  testCaseComment("Postcondition");
  testStep("STEP", "Return ECU to default values");
  RunPostTs();
}


testcase SW_IT_ATM_CheckHallEffectSensor_02()
{
  //***********************************Test report header*********************************
  testReportAddMiscInfoBlock("AUTOLIV ELECTRONICS document");
  TestReportAddMiscInfo("Nightly test", "No");
  TestReportAddMiscInfo("Test type", "Requirement-Based test");
  TestReportAddMiscInfo("Regression Test", "No");
  TestReportAddMiscInfo("Fault injection method used", "No");
  TestReportAddMiscInfo("Resource usage evaluation", "No");
  TestReportAddMiscInfo("Priority", "No");
  TestReportAddMiscInfo("Safety relevant", "No");
  
  AddRequirementInfo("Requirement under test", "ARCH_SW_ATM_0211");
  AddRequirementInfo("ARCH_SW_ATM_0211", "ATM_runMainFunction shall call the BMM_cbk_CheckHallEffectSensor function.");
  //***************************************************************************************
  
  testCaseComment("Preconditions");
  testStep("STEP", "Bench Initialization");
  RunPreTs();
    

    testStep("STEP", "Set a breakpoint in ATM_runMainFunction() at line 'atm_PlayCyclicTests(castRunningCyclicList);'.");
    debugger_setRelativeFunctionBpAtLine("ATM_runMainFunction", 29);
  
    debugger_reset();
    debugger_run();
  
    testCaseComment("Action: ARCH_SW_ATM_0211");
    testStep("STEP", "Check if CPU stopped in ATM_runMainFunction() at line 'atm_PlayCyclicTests(castRunningCyclicList);'. --> CPU is Stopped");
    debugger_WaitUntilBPisReached(500);
    
    
    debugger_deleteAllBP();
    
    
    testStep("STEP", "Set a breakpoint in function atm_PlayCyclicTests() at line 'atm_executeAutoTest(u8AutotestID);' under 'if (B_TRUE == atm_isAutoTestEnabled(u8AutotestID))' and press run.");
    debugger_setRelativeFunctionBpAtLine("atm_PlayCyclicTests", 9);

    debugger_run();
    
    testStep("STEP", "Check if CPU stopped in function atm_PlayCyclicTests() at line 'atm_executeAutoTest(u8AutotestID);' under 'if (B_TRUE == atm_isAutoTestEnabled(u8AutotestID))'. --> CPU is Stopped");
    debugger_WaitUntilBPisReached(500);
  
  
    debugger_deleteAllBP();
  
  
    testStep("STEP", "Set a breakpoint in function atm_executeAutoTest() at line 'u8InhibModesIndex = castATMConfig[cu8AutotestID].u8InhibIndex;'.");
    debugger_setBpAtLine("s:\\Components\\Application\\Autoliv\\ATM\\Implementation\\src\\ATM.c", 194);
    
    debugger_run();
    
    testStep("STEP", "Check if CPU stopped in function atm_executeAutoTest() at line 'u8InhibModesIndex = castATMConfig[cu8AutotestID].u8InhibIndex;'. --> CPU is Stopped");
    debugger_WaitUntilBPisReached(500);
    
  
    debugger_deleteAllBP();    
  
     
    testStep("STEP", "Set a breakpoint in BMM_cbk_CheckHallEffectSensor().");
    debugger_setRelativeFunctionBpAtLine("BMM_cbk_CheckHallEffectSensor", 0);
  
    debugger_run();
    
    testCaseComment("Action: ARCH_SW_ATM_0211");
    testStep("STEP", "Check if CPU stopped at BMM_cbk_CheckHallEffectSensor(). --> CPU is Stopped");
    debugger_WaitUntilBPisReached(500);

  
  testCaseComment("Postcondition");
  testStep("STEP", "Return ECU to default values");
  RunPostTs();
}


testcase SW_IT_ATM_CheckMotorCurrent_02()
{
  //***********************************Test report header*********************************
  testReportAddMiscInfoBlock("AUTOLIV ELECTRONICS document");
  TestReportAddMiscInfo("Nightly test", "No");
  TestReportAddMiscInfo("Test type", "Requirement-Based test");
  TestReportAddMiscInfo("Regression Test", "No");
  TestReportAddMiscInfo("Fault injection method used", "No");
  TestReportAddMiscInfo("Resource usage evaluation", "No");
  TestReportAddMiscInfo("Priority", "No");
  TestReportAddMiscInfo("Safety relevant", "No");
  
  AddRequirementInfo("Requirement under test", "ARCH_SW_ATM_0212");
  AddRequirementInfo("ARCH_SW_ATM_0212", "ATM_runMainFunction shall call the PAL_cbk_CheckMotorCurrent function.");
  //***************************************************************************************
  
  testCaseComment("Preconditions");
  testStep("STEP", "Bench Initialization");
  RunPreTs();
    

    testStep("STEP", "Set a breakpoint in ATM_runMainFunction() at line 'atm_PlayCyclicTests(castRunningCyclicList);'.");
    debugger_setRelativeFunctionBpAtLine("ATM_runMainFunction", 29);
  
    debugger_reset();
    debugger_run();
  
    testCaseComment("Action: ARCH_SW_ATM_0212");
    testStep("STEP", "Check if CPU stopped in ATM_runMainFunction() at line 'atm_PlayCyclicTests(castRunningCyclicList);'. --> CPU is Stopped");
    debugger_WaitUntilBPisReached(500);
    
    
    debugger_deleteAllBP();
    
    
    testStep("STEP", "Set a breakpoint in function atm_PlayCyclicTests() at line 'atm_executeAutoTest(u8AutotestID);' under 'if (B_TRUE == atm_isAutoTestEnabled(u8AutotestID))' and press run.");
    debugger_setRelativeFunctionBpAtLine("atm_PlayCyclicTests", 9);

    debugger_run();
    
    testStep("STEP", "Check if CPU stopped in function atm_PlayCyclicTests() at line 'atm_executeAutoTest(u8AutotestID);' under 'if (B_TRUE == atm_isAutoTestEnabled(u8AutotestID))'. --> CPU is Stopped");
    debugger_WaitUntilBPisReached(500);
  
  
    debugger_deleteAllBP();
  
  
    testStep("STEP", "Set a breakpoint in function atm_executeAutoTest() at line 'u8InhibModesIndex = castATMConfig[cu8AutotestID].u8InhibIndex;'.");
    debugger_setBpAtLine("s:\\Components\\Application\\Autoliv\\ATM\\Implementation\\src\\ATM.c", 194);
    
    debugger_run();
    
    testStep("STEP", "Check if CPU stopped in function atm_executeAutoTest() at line 'u8InhibModesIndex = castATMConfig[cu8AutotestID].u8InhibIndex;'. --> CPU is Stopped");
    debugger_WaitUntilBPisReached(500);
    
  
    debugger_deleteAllBP();
  
     
    testStep("STEP", "Set a breakpoint in function PAL_cbk_CheckMotorCurrent().");
    debugger_setRelativeFunctionBpAtLine("PAL_cbk_CheckMotorCurrent", 0);
  
    debugger_run();
    
    testCaseComment("Action: ARCH_SW_ATM_0212");
    testStep("STEP", "Check if CPU stopped in function PAL_cbk_CheckMotorCurrent(). --> CPU is Stopped");
    debugger_WaitUntilBPisReached(500);

  
  testCaseComment("Postcondition");
  testStep("STEP", "Return ECU to default values");
  RunPostTs();
}


testcase SW_IT_ATM_CheckImplausibledataAPI_01()
{
  //***********************************Test report header*********************************
  testReportAddMiscInfoBlock("AUTOLIV ELECTRONICS document");
  TestReportAddMiscInfo("Nightly test", "No");
  TestReportAddMiscInfo("Test type", "Requirement-Based test");
  TestReportAddMiscInfo("Regression Test", "No");
  TestReportAddMiscInfo("Fault injection method used", "No");
  TestReportAddMiscInfo("Resource usage evaluation", "No");
  TestReportAddMiscInfo("Priority", "No");
  TestReportAddMiscInfo("Safety relevant", "No");
  
  AddRequirementInfo("Requirement under test", "ARCH_SW_ATM_0237");
  AddRequirementInfo("ARCH_SW_ATM_0237", "ATM_runMainFunction shall call the CIL_Autotest_CheckImplausibledataAPI function. .");
  //***************************************************************************************
  
  testCaseComment("Preconditions");
  testStep("STEP", "Bench Initialization");
  RunPreTs();
     

    testStep("STEP", "Set a breakpoint in ATM_runMainFunction() at line 'atm_PlayCyclicTests(castRunningCyclicList);'.");
    debugger_setRelativeFunctionBpAtLine("ATM_runMainFunction", 29);
  
    debugger_reset();
    debugger_run();
  
    testCaseComment("Action: ARCH_SW_ATM_0237");
    testStep("STEP", "Check if CPU stopped in ATM_runMainFunction() at line 'atm_PlayCyclicTests(castRunningCyclicList);'. --> CPU is Stopped");
    debugger_WaitUntilBPisReached(500);
    
    
    debugger_deleteAllBP();
    
    
    testStep("STEP", "Set a breakpoint in function atm_PlayCyclicTests() at line 'atm_executeAutoTest(u8AutotestID);' under 'if (B_TRUE == atm_isAutoTestEnabled(u8AutotestID))' and press run.");
    debugger_setRelativeFunctionBpAtLine("atm_PlayCyclicTests", 9);

    debugger_run();
    
    testStep("STEP", "Check if CPU stopped in function atm_PlayCyclicTests() at line 'atm_executeAutoTest(u8AutotestID);' under 'if (B_TRUE == atm_isAutoTestEnabled(u8AutotestID))'. --> CPU is Stopped");
    debugger_WaitUntilBPisReached(500);
  
  
    debugger_deleteAllBP();
  
  
    testStep("STEP", "Set a breakpoint in function atm_executeAutoTest() at line 'u8InhibModesIndex = castATMConfig[cu8AutotestID].u8InhibIndex;'.");
    debugger_setBpAtLine("s:\\Components\\Application\\Autoliv\\ATM\\Implementation\\src\\ATM.c", 194);
    
    debugger_run();
    
    testStep("STEP", "Check if CPU stopped in function atm_executeAutoTest() at line 'u8InhibModesIndex = castATMConfig[cu8AutotestID].u8InhibIndex;'. --> CPU is Stopped");
    debugger_WaitUntilBPisReached(500);
    
  
    debugger_deleteAllBP();
  
     
    testStep("STEP", "Set a breakpoint in function CIL_Autotest_CheckImplausibleData_API().");
    debugger_setRelativeFunctionBpAtLine("CIL_Autotest_CheckImplausibleData_API", 0); 

    debugger_run();
    
    testCaseComment("Action: ARCH_SW_ATM_0237");
    testStep("STEP", "Check if CPU stopped in function CIL_Autotest_CheckImplausibleData_API(). --> CPU is Stopped");
    debugger_WaitUntilBPisReached(500);

  
  testCaseComment("Postcondition");
  testStep("STEP", "Return ECU to default values");
  RunPostTs();
}


testcase SW_IT_ATM_Presafe_CheckTimeoutError_01()
{
  //***********************************Test report header*********************************
  testReportAddMiscInfoBlock("AUTOLIV ELECTRONICS document");
  TestReportAddMiscInfo("Nightly test", "No");
  TestReportAddMiscInfo("Test type", "Requirement-Based test");
  TestReportAddMiscInfo("Regression Test", "No");
  TestReportAddMiscInfo("Fault injection method used", "No");
  TestReportAddMiscInfo("Resource usage evaluation", "No");
  TestReportAddMiscInfo("Priority", "No");
  TestReportAddMiscInfo("Safety relevant", "No");
  
  AddRequirementInfo("Requirement under test", "ARCH_SW_ATM_0222");
  AddRequirementInfo("ARCH_SW_ATM_0222", "ATM_runMainFunction shall call the CIL_Autotest_Presafe_CheckTimeoutError function.");
  //***************************************************************************************
  
  testCaseComment("Preconditions");
  testStep("STEP", "Bench Initialization");
  RunPreTs();
     

    testStep("STEP", "Set a breakpoint in ATM_runMainFunction() at line 'atm_PlayCyclicTests(castRunningCyclicList);'.");
    debugger_setRelativeFunctionBpAtLine("ATM_runMainFunction", 29);
  
    debugger_reset();
    debugger_run();
  
    testCaseComment("Action: ARCH_SW_ATM_0222");
    testStep("STEP", "Check if CPU stopped in ATM_runMainFunction() at line 'atm_PlayCyclicTests(castRunningCyclicList);'. --> CPU is Stopped");
    debugger_WaitUntilBPisReached(500);
    
    
    debugger_deleteAllBP();
    
    
    testStep("STEP", "Set a breakpoint in function atm_PlayCyclicTests() at line 'atm_executeAutoTest(u8AutotestID);' under 'if (B_TRUE == atm_isAutoTestEnabled(u8AutotestID))' and press run.");
    debugger_setRelativeFunctionBpAtLine("atm_PlayCyclicTests", 9);

    debugger_run();
    
    testStep("STEP", "Check if CPU stopped in function atm_PlayCyclicTests() at line 'atm_executeAutoTest(u8AutotestID);' under 'if (B_TRUE == atm_isAutoTestEnabled(u8AutotestID))'. --> CPU is Stopped");
    debugger_WaitUntilBPisReached(500);
  
  
    debugger_deleteAllBP();
  
  
    testStep("STEP", "Set a breakpoint in function atm_executeAutoTest() at line 'u8InhibModesIndex = castATMConfig[cu8AutotestID].u8InhibIndex;'.");
    debugger_setBpAtLine("s:\\Components\\Application\\Autoliv\\ATM\\Implementation\\src\\ATM.c", 194);
    
    debugger_run();
    
    testStep("STEP", "Check if CPU stopped in function atm_executeAutoTest() at line 'u8InhibModesIndex = castATMConfig[cu8AutotestID].u8InhibIndex;'. --> CPU is Stopped");
    debugger_WaitUntilBPisReached(500);
    
  
    debugger_deleteAllBP();
  
     
    testStep("STEP", "Set a breakpoint in CIL_Autotest_Presafe_CheckTimeoutError().");
    debugger_setRelativeFunctionBpAtLine("CIL_Autotest_Presafe_CheckTimeoutError", 0); 
    
    debugger_run();
    
    testCaseComment("Action: ARCH_SW_ATM_0222");
    testStep("STEP", "Check if CPU stopped at CIL_Autotest_Presafe_CheckTimeoutError()*. --> CPU is Stopped");
    debugger_WaitUntilBPisReached(500);
  
  
  testCaseComment("Postcondition");
  testStep("STEP", "Return ECU to default values");
  RunPostTs();
}


testcase SW_IT_ATM_Buckle_CheckTimeoutError_01()
{
  //***********************************Test report header*********************************
  testReportAddMiscInfoBlock("AUTOLIV ELECTRONICS document");
  TestReportAddMiscInfo("Nightly test", "No");
  TestReportAddMiscInfo("Test type", "Requirement-Based test");
  TestReportAddMiscInfo("Regression Test", "No");
  TestReportAddMiscInfo("Fault injection method used", "No");
  TestReportAddMiscInfo("Resource usage evaluation", "No");
  TestReportAddMiscInfo("Priority", "No");
  TestReportAddMiscInfo("Safety relevant", "No");
  
  AddRequirementInfo("Requirement under test", "ARCH_SW_ATM_0223");
  AddRequirementInfo("ARCH_SW_ATM_0223", "ATM_runMainFunction shall call the CIL_Autotest_Buckle_CheckTimeoutError function.");
  //***************************************************************************************
  
  testCaseComment("Preconditions");
  testStep("STEP", "Bench Initialization");
  RunPreTs();
  
    
    testStep("STEP", "Set a breakpoint in ATM_runMainFunction() at line 'atm_PlayCyclicTests(castRunningCyclicList);'.");
    debugger_setRelativeFunctionBpAtLine("ATM_runMainFunction", 29);
  
    debugger_reset();
    debugger_run();
  
    testCaseComment("Action: ARCH_SW_ATM_0223");
    testStep("STEP", "Check if CPU stopped in ATM_runMainFunction() at line 'atm_PlayCyclicTests(castRunningCyclicList);'. --> CPU is Stopped");
    debugger_WaitUntilBPisReached(500);
    
    
    debugger_deleteAllBP();
    
    
    testStep("STEP", "Set a breakpoint in function atm_PlayCyclicTests() at line 'atm_executeAutoTest(u8AutotestID);' under 'if (B_TRUE == atm_isAutoTestEnabled(u8AutotestID))' and press run.");
    debugger_setRelativeFunctionBpAtLine("atm_PlayCyclicTests", 9);

    debugger_run();
    
    testStep("STEP", "Check if CPU stopped in function atm_PlayCyclicTests() at line 'atm_executeAutoTest(u8AutotestID);' under 'if (B_TRUE == atm_isAutoTestEnabled(u8AutotestID))'. --> CPU is Stopped");
    debugger_WaitUntilBPisReached(500);
  
  
    debugger_deleteAllBP();
  
  
    testStep("STEP", "Set a breakpoint in function atm_executeAutoTest() at line 'u8InhibModesIndex = castATMConfig[cu8AutotestID].u8InhibIndex;'.");
    debugger_setBpAtLine("s:\\Components\\Application\\Autoliv\\ATM\\Implementation\\src\\ATM.c", 194);
    
    debugger_run();
    
    testStep("STEP", "Check if CPU stopped in function atm_executeAutoTest() at line 'u8InhibModesIndex = castATMConfig[cu8AutotestID].u8InhibIndex;'. --> CPU is Stopped");
    debugger_WaitUntilBPisReached(500);
    
  
    debugger_deleteAllBP(); 
  
  
    testStep("STEP", "Set a breakpoint in function CIL_Autotest_Buckle_CheckTimeoutError().");
    debugger_setRelativeFunctionBpAtLine("CIL_Autotest_Buckle_CheckTimeoutError", 0); 
    
    debugger_run();
    
    testCaseComment("Action: ARCH_SW_ATM_0223");
    testStep("STEP", "Check if CPU stopped in function CIL_Autotest_Buckle_CheckTimeoutError()*. --> CPU is Stopped");
    debugger_WaitUntilBPisReached(500);

  
  testCaseComment("Postcondition");
  testStep("STEP", "Return ECU to default values");
  RunPostTs();
}


testcase SW_IT_ATM_CheckImplausibleData_Presafe_01()
{
  //***********************************Test report header*********************************
  testReportAddMiscInfoBlock("AUTOLIV ELECTRONICS document");
  TestReportAddMiscInfo("Nightly test", "No");
  TestReportAddMiscInfo("Test type", "Requirement-Based test");
  TestReportAddMiscInfo("Regression Test", "No");
  TestReportAddMiscInfo("Fault injection method used", "No");
  TestReportAddMiscInfo("Resource usage evaluation", "No");
  TestReportAddMiscInfo("Priority", "No");
  TestReportAddMiscInfo("Safety relevant", "No");
  
  AddRequirementInfo("Requirement under test", "ARCH_SW_ATM_0224");
  AddRequirementInfo("ARCH_SW_ATM_0224", "ATM_runMainFunction shall call the CIL_Autotest_CheckImplausibleData_Presafe function.");
  //***************************************************************************************
  
  testCaseComment("Preconditions");
  testStep("STEP", "Bench Initialization");
  RunPreTs();
    

    testStep("STEP", "Set a breakpoint in ATM_runMainFunction() at line 'atm_PlayCyclicTests(castRunningCyclicList);'.");
    debugger_setRelativeFunctionBpAtLine("ATM_runMainFunction", 29);
  
    debugger_reset();
    debugger_run();
  
    testCaseComment("Action: ARCH_SW_ATM_0224");
    testStep("STEP", "Check if CPU stopped in ATM_runMainFunction() at line 'atm_PlayCyclicTests(castRunningCyclicList);'. --> CPU is Stopped");
    debugger_WaitUntilBPisReached(500);
    
    
    debugger_deleteAllBP();
    
    
    testStep("STEP", "Set a breakpoint in function atm_PlayCyclicTests() at line 'atm_executeAutoTest(u8AutotestID);' under 'if (B_TRUE == atm_isAutoTestEnabled(u8AutotestID))' and press run.");
    debugger_setRelativeFunctionBpAtLine("atm_PlayCyclicTests", 9);

    debugger_run();
    
    testStep("STEP", "Check if CPU stopped in function atm_PlayCyclicTests() at line 'atm_executeAutoTest(u8AutotestID);' under 'if (B_TRUE == atm_isAutoTestEnabled(u8AutotestID))'. --> CPU is Stopped");
    debugger_WaitUntilBPisReached(500);
  
  
    debugger_deleteAllBP();
  
  
    testStep("STEP", "Set a breakpoint in function atm_executeAutoTest() at line 'u8InhibModesIndex = castATMConfig[cu8AutotestID].u8InhibIndex;'.");
    debugger_setBpAtLine("s:\\Components\\Application\\Autoliv\\ATM\\Implementation\\src\\ATM.c", 194);
    
    debugger_run();
    
    testStep("STEP", "Check if CPU stopped in function atm_executeAutoTest() at line 'u8InhibModesIndex = castATMConfig[cu8AutotestID].u8InhibIndex;'. --> CPU is Stopped");
    debugger_WaitUntilBPisReached(500);
    
  
    debugger_deleteAllBP(); 

    
    testStep("STEP", "Set a breakpoint in function CIL_Autotest_CheckImplausibleData_Presafe().");
    debugger_setRelativeFunctionBpAtLine("CIL_Autotest_CheckImplausibleData_Presafe", 0); 
    
    testStep("", "Run the debugger.");
    debugger_run();
    
    testCaseComment("Action: ARCH_SW_ATM_0224");
    testStep("STEP", "Check if CPU stopped in function CIL_Autotest_CheckImplausibleData_Presafe(). --> CPU is Stopped");
    debugger_WaitUntilBPisReached(500);

  
  testCaseComment("Postcondition");
  testStep("STEP", "Return ECU to default values");
  RunPostTs();
}


testcase SW_IT_ATM_CheckImplausibleData_Ignition_01()
{
  //***********************************Test report header*********************************
  testReportAddMiscInfoBlock("AUTOLIV ELECTRONICS document");
  TestReportAddMiscInfo("Nightly test", "No");
  TestReportAddMiscInfo("Test type", "Requirement-Based test");
  TestReportAddMiscInfo("Regression Test", "No");
  TestReportAddMiscInfo("Fault injection method used", "No");
  TestReportAddMiscInfo("Resource usage evaluation", "No");
  TestReportAddMiscInfo("Priority", "No");
  TestReportAddMiscInfo("Safety relevant", "No");
  
  AddRequirementInfo("Requirement under test", "ARCH_SW_ATM_0225");
  AddRequirementInfo("ARCH_SW_ATM_0225", "ATM_runMainFunction shall call the CIL_Autotest_CheckImplausibleData_Ignition function.");
  //***************************************************************************************
  
  testCaseComment("Preconditions");
  testStep("STEP", "Bench Initialization");
  RunPreTs();
      

    testStep("STEP", "Set a breakpoint in ATM_runMainFunction() at line 'atm_PlayCyclicTests(castRunningCyclicList);'.");
    debugger_setRelativeFunctionBpAtLine("ATM_runMainFunction", 29);
  
    debugger_reset();
    debugger_run();
  
    testCaseComment("Action: ARCH_SW_ATM_0225");
    testStep("STEP", "Check if CPU stopped in ATM_runMainFunction() at line 'atm_PlayCyclicTests(castRunningCyclicList);'. --> CPU is Stopped");
    debugger_WaitUntilBPisReached(500);
    
    
    debugger_deleteAllBP();
    
    
    testStep("STEP", "Set a breakpoint in function atm_PlayCyclicTests() at line 'atm_executeAutoTest(u8AutotestID);' under 'if (B_TRUE == atm_isAutoTestEnabled(u8AutotestID))' and press run.");
    debugger_setRelativeFunctionBpAtLine("atm_PlayCyclicTests", 9);

    debugger_run();
    
    testStep("STEP", "Check if CPU stopped in function atm_PlayCyclicTests() at line 'atm_executeAutoTest(u8AutotestID);' under 'if (B_TRUE == atm_isAutoTestEnabled(u8AutotestID))'. --> CPU is Stopped");
    debugger_WaitUntilBPisReached(500);
  
  
    debugger_deleteAllBP();
  
  
    testStep("STEP", "Set a breakpoint in function atm_executeAutoTest() at line 'u8InhibModesIndex = castATMConfig[cu8AutotestID].u8InhibIndex;'.");
    debugger_setBpAtLine("s:\\Components\\Application\\Autoliv\\ATM\\Implementation\\src\\ATM.c", 194);
    
    debugger_run();
    
    testStep("STEP", "Check if CPU stopped in function atm_executeAutoTest() at line 'u8InhibModesIndex = castATMConfig[cu8AutotestID].u8InhibIndex;'. --> CPU is Stopped");
    debugger_WaitUntilBPisReached(500);
    
  
    debugger_deleteAllBP();  

    
    testStep("STEP", "Set a breakpoint in function CIL_Autotest_CheckImplausibleData_Ignition().");
    debugger_setRelativeFunctionBpAtLine("CIL_Autotest_CheckImplausibleData_Ignition", 0); 
    
    debugger_run();
    
    testCaseComment("Action: ARCH_SW_ATM_0225");
    testStep("STEP", "Check if CPU stopped in function CIL_Autotest_CheckImplausibleData_Ignition()*. --> CPU is Stopped");
    debugger_WaitUntilBPisReached(500);

  
  testCaseComment("Postcondition");
  testStep("STEP", "Return ECU to default values");
  RunPostTs();
}


testcase SW_IT_ATM_CheckImplausibleData_Buckle_01()
{
  //***********************************Test report header*********************************
  testReportAddMiscInfoBlock("AUTOLIV ELECTRONICS document");
  TestReportAddMiscInfo("Nightly test", "No");
  TestReportAddMiscInfo("Test type", "Requirement-Based test");
  TestReportAddMiscInfo("Regression Test", "No");
  TestReportAddMiscInfo("Fault injection method used", "No");
  TestReportAddMiscInfo("Resource usage evaluation", "No");
  TestReportAddMiscInfo("Priority", "No");
  TestReportAddMiscInfo("Safety relevant", "No");
  
  AddRequirementInfo("Requirement under test", "ARCH_SW_ATM_0226");
  AddRequirementInfo("ARCH_SW_ATM_0226", "ATM_runMainFunction shall call the CIL_Autotest_CheckImplausibleData_Buckle function.");
  //***************************************************************************************
  
  testCaseComment("Preconditions");
  testStep("STEP", "Bench Initialization");
  RunPreTs();
       

    testStep("STEP", "Set a breakpoint in ATM_runMainFunction() at line 'atm_PlayCyclicTests(castRunningCyclicList);'.");
    debugger_setRelativeFunctionBpAtLine("ATM_runMainFunction", 29);
  
    debugger_reset();
    debugger_run();
  
    testCaseComment("Action: ARCH_SW_ATM_0226");
    testStep("STEP", "Check if CPU stopped in ATM_runMainFunction() at line 'atm_PlayCyclicTests(castRunningCyclicList);'. --> CPU is Stopped");
    debugger_WaitUntilBPisReached(500);
    
    
    debugger_deleteAllBP();
    
    
    testStep("STEP", "Set a breakpoint in function atm_PlayCyclicTests() at line 'atm_executeAutoTest(u8AutotestID);' under 'if (B_TRUE == atm_isAutoTestEnabled(u8AutotestID))' and press run.");
    debugger_setRelativeFunctionBpAtLine("atm_PlayCyclicTests", 9);

    debugger_run();
    
    testStep("STEP", "Check if CPU stopped in function atm_PlayCyclicTests() at line 'atm_executeAutoTest(u8AutotestID);' under 'if (B_TRUE == atm_isAutoTestEnabled(u8AutotestID))'. --> CPU is Stopped");
    debugger_WaitUntilBPisReached(500);
  
  
    debugger_deleteAllBP();
  
  
    testStep("STEP", "Set a breakpoint in function atm_executeAutoTest() at line 'u8InhibModesIndex = castATMConfig[cu8AutotestID].u8InhibIndex;'.");
    debugger_setBpAtLine("s:\\Components\\Application\\Autoliv\\ATM\\Implementation\\src\\ATM.c", 194);
    
    debugger_run();
    
    testStep("STEP", "Check if CPU stopped in function atm_executeAutoTest() at line 'u8InhibModesIndex = castATMConfig[cu8AutotestID].u8InhibIndex;'. --> CPU is Stopped");
    debugger_WaitUntilBPisReached(500);
    
  
    debugger_deleteAllBP();      

    
    testStep("STEP", "Set a breakpoint in function CIL_Autotest_CheckImplausibleData_Buckle().");
    debugger_setRelativeFunctionBpAtLine("CIL_Autotest_CheckImplausibleData_Buckle", 0); 

    debugger_run();
    
    testCaseComment("Action: ARCH_SW_ATM_0226");
    testStep("STEP", "Check if CPU stopped in function CIL_Autotest_CheckImplausibleData_Buckle(). --> CPU is Stopped");
    debugger_WaitUntilBPisReached(500);

  
  testCaseComment("Postcondition");
  testStep("STEP", "Return ECU to default values");
  RunPostTs();
}


testcase SW_IT_ATM_CheckTimeoutError_Powertrain_01()
{
  //***********************************Test report header*********************************
  testReportAddMiscInfoBlock("AUTOLIV ELECTRONICS document");
  TestReportAddMiscInfo("Nightly test", "No");
  TestReportAddMiscInfo("Test type", "Requirement-Based test");
  TestReportAddMiscInfo("Regression Test", "No");
  TestReportAddMiscInfo("Fault injection method used", "No");
  TestReportAddMiscInfo("Resource usage evaluation", "No");
  TestReportAddMiscInfo("Priority", "No");
  TestReportAddMiscInfo("Safety relevant", "No");
  
  AddRequirementInfo("Requirement under test", "ARCH_SW_ATM_0227");
  AddRequirementInfo("ARCH_SW_ATM_0227", "ATM_runMainFunction shall call the CIL_Autotest_CheckTimeoutError_Powertrain function.");
  //***************************************************************************************
  
  testCaseComment("Preconditions");
  testStep("STEP", "Bench Initialization");
  RunPreTs();
         

    testStep("STEP", "Set a breakpoint in ATM_runMainFunction() at line 'atm_PlayCyclicTests(castRunningCyclicList);'.");
    debugger_setRelativeFunctionBpAtLine("ATM_runMainFunction", 29);
  
    debugger_reset();
    debugger_run();
  
    testCaseComment("Action: ARCH_SW_ATM_0227");
    testStep("STEP", "Check if CPU stopped in ATM_runMainFunction() at line 'atm_PlayCyclicTests(castRunningCyclicList);'. --> CPU is Stopped");
    debugger_WaitUntilBPisReached(500);
    
    
    debugger_deleteAllBP();
    
    
    testStep("STEP", "Set a breakpoint in function atm_PlayCyclicTests() at line 'atm_executeAutoTest(u8AutotestID);' under 'if (B_TRUE == atm_isAutoTestEnabled(u8AutotestID))' and press run.");
    debugger_setRelativeFunctionBpAtLine("atm_PlayCyclicTests", 9);

    debugger_run();
    
    testStep("STEP", "Check if CPU stopped in function atm_PlayCyclicTests() at line 'atm_executeAutoTest(u8AutotestID);' under 'if (B_TRUE == atm_isAutoTestEnabled(u8AutotestID))'. --> CPU is Stopped");
    debugger_WaitUntilBPisReached(500);
  
  
    debugger_deleteAllBP();
  
  
    testStep("STEP", "Set a breakpoint in function atm_executeAutoTest() at line 'u8InhibModesIndex = castATMConfig[cu8AutotestID].u8InhibIndex;'.");
    debugger_setBpAtLine("s:\\Components\\Application\\Autoliv\\ATM\\Implementation\\src\\ATM.c", 194);
    
    debugger_run();
    
    testStep("STEP", "Check if CPU stopped in function atm_executeAutoTest() at line 'u8InhibModesIndex = castATMConfig[cu8AutotestID].u8InhibIndex;'. --> CPU is Stopped");
    debugger_WaitUntilBPisReached(500);
    
  
    debugger_deleteAllBP();        

    
    testStep("STEP", "Set a breakpoint in function CIL_Autotest_CheckTimeoutError_Powertrain().");
    debugger_setRelativeFunctionBpAtLine("CIL_Autotest_CheckTimeoutError_Powertrain", 0); 

    debugger_run();
    
    testCaseComment("Action: ARCH_SW_ATM_0227");
    testStep("STEP", "Check if CPU stopped in function CIL_Autotest_CheckTimeoutError_Powertrain(). --> CPU is Stopped");
    debugger_WaitUntilBPisReached(500);
  
  
  testCaseComment("Postcondition");
  testStep("STEP", "Return ECU to default values");
  RunPostTs();
}


testcase SW_IT_ATM_CheckTimeoutError_Ignition_01()
{
  //***********************************Test report header*********************************
  testReportAddMiscInfoBlock("AUTOLIV ELECTRONICS document");
  TestReportAddMiscInfo("Nightly test", "No");
  TestReportAddMiscInfo("Test type", "Requirement-Based test");
  TestReportAddMiscInfo("Regression Test", "No");
  TestReportAddMiscInfo("Fault injection method used", "No");
  TestReportAddMiscInfo("Resource usage evaluation", "No");
  TestReportAddMiscInfo("Priority", "No");
  TestReportAddMiscInfo("Safety relevant", "No");
  
  AddRequirementInfo("Requirement under test", "ARCH_SW_ATM_0228");
  AddRequirementInfo("ARCH_SW_ATM_0228", "ATM_runMainFunction shall call the CIL_Autotest_CheckTimeoutError_Ignition function.");
  //***************************************************************************************
  
  testCaseComment("Preconditions");
  testStep("STEP", "Bench Initialization");
  RunPreTs();
          

    testStep("STEP", "Set a breakpoint in ATM_runMainFunction() at line 'atm_PlayCyclicTests(castRunningCyclicList);'.");
    debugger_setRelativeFunctionBpAtLine("ATM_runMainFunction", 29);
  
    debugger_reset();
    debugger_run();
  
    testCaseComment("Action: ARCH_SW_ATM_0228");
    testStep("STEP", "Check if CPU stopped in ATM_runMainFunction() at line 'atm_PlayCyclicTests(castRunningCyclicList);'. --> CPU is Stopped");
    debugger_WaitUntilBPisReached(500);
    
    
    debugger_deleteAllBP();
    
    
    testStep("STEP", "Set a breakpoint in function atm_PlayCyclicTests() at line 'atm_executeAutoTest(u8AutotestID);' under 'if (B_TRUE == atm_isAutoTestEnabled(u8AutotestID))' and press run.");
    debugger_setRelativeFunctionBpAtLine("atm_PlayCyclicTests", 9);

    debugger_run();
    
    testStep("STEP", "Check if CPU stopped in function atm_PlayCyclicTests() at line 'atm_executeAutoTest(u8AutotestID);' under 'if (B_TRUE == atm_isAutoTestEnabled(u8AutotestID))'. --> CPU is Stopped");
    debugger_WaitUntilBPisReached(500);
  
  
    debugger_deleteAllBP();
  
  
    testStep("STEP", "Set a breakpoint in function atm_executeAutoTest() at line 'u8InhibModesIndex = castATMConfig[cu8AutotestID].u8InhibIndex;'.");
    debugger_setBpAtLine("s:\\Components\\Application\\Autoliv\\ATM\\Implementation\\src\\ATM.c", 194);
    
    debugger_run();
    
    testStep("STEP", "Check if CPU stopped in function atm_executeAutoTest() at line 'u8InhibModesIndex = castATMConfig[cu8AutotestID].u8InhibIndex;'. --> CPU is Stopped");
    debugger_WaitUntilBPisReached(500);
    
  
    debugger_deleteAllBP(); 

    
    testStep("STEP", "Set a breakpoint in function CIL_Autotest_CheckTimeoutError_Ignition().");
    debugger_setRelativeFunctionBpAtLine("CIL_Autotest_CheckTimeoutError_Ignition", 0);
    
    debugger_run();
    
    testCaseComment("Action: ARCH_SW_ATM_0228");
    testStep("STEP", "Check if CPU stopped in function CIL_Autotest_CheckTimeoutError_Ignition(). --> CPU is Stopped");
    debugger_WaitUntilBPisReached(500);
  
  
  testCaseComment("Postcondition");
  testStep("STEP", "Return ECU to default values");
  RunPostTs();
}


testcase SW_IT_ATM_CheckImplausibleData_Powertrain_01()
{
  //***********************************Test report header*********************************
  testReportAddMiscInfoBlock("AUTOLIV ELECTRONICS document");
  TestReportAddMiscInfo("Nightly test", "No");
  TestReportAddMiscInfo("Test type", "Requirement-Based test");
  TestReportAddMiscInfo("Regression Test", "No");
  TestReportAddMiscInfo("Fault injection method used", "No");
  TestReportAddMiscInfo("Resource usage evaluation", "No");
  TestReportAddMiscInfo("Priority", "No");
  TestReportAddMiscInfo("Safety relevant", "No");
  
  AddRequirementInfo("Requirement under test", "ARCH_SW_ATM_0229");
  AddRequirementInfo("ARCH_SW_ATM_0229", "ATM_runMainFunction shall call the CIL_Autotest_CheckImplausibleData_Powertrain function");
  //***************************************************************************************
  
  testCaseComment("Preconditions");
  testStep("STEP", "Bench Initialization");
  RunPreTs();
  

    testStep("STEP", "Set a breakpoint in ATM_runMainFunction() at line 'atm_PlayCyclicTests(castRunningCyclicList);'.");
    debugger_setRelativeFunctionBpAtLine("ATM_runMainFunction", 29);
  
    debugger_reset();
    debugger_run();
  
    testCaseComment("Action: ARCH_SW_ATM_0229");
    testStep("STEP", "Check if CPU stopped in ATM_runMainFunction() at line 'atm_PlayCyclicTests(castRunningCyclicList);'. --> CPU is Stopped");
    debugger_WaitUntilBPisReached(500);
    
    
    debugger_deleteAllBP();
    
    
    testStep("STEP", "Set a breakpoint in function atm_PlayCyclicTests() at line 'atm_executeAutoTest(u8AutotestID);' under 'if (B_TRUE == atm_isAutoTestEnabled(u8AutotestID))' and press run.");
    debugger_setRelativeFunctionBpAtLine("atm_PlayCyclicTests", 9);

    debugger_run();
    
    testStep("STEP", "Check if CPU stopped in function atm_PlayCyclicTests() at line 'atm_executeAutoTest(u8AutotestID);' under 'if (B_TRUE == atm_isAutoTestEnabled(u8AutotestID))'. --> CPU is Stopped");
    debugger_WaitUntilBPisReached(500);
  
  
    debugger_deleteAllBP();
  
  
    testStep("STEP", "Set a breakpoint in function atm_executeAutoTest() at line 'u8InhibModesIndex = castATMConfig[cu8AutotestID].u8InhibIndex;'.");
    debugger_setBpAtLine("s:\\Components\\Application\\Autoliv\\ATM\\Implementation\\src\\ATM.c", 194);
    
    debugger_run();
    
    testStep("STEP", "Check if CPU stopped in function atm_executeAutoTest() at line 'u8InhibModesIndex = castATMConfig[cu8AutotestID].u8InhibIndex;'. --> CPU is Stopped");
    debugger_WaitUntilBPisReached(500);
    
  
    debugger_deleteAllBP();

    
    testStep("STEP", "Set a breakpoint in function CIL_Autotest_CheckImplausibleData_PowertrainRdy().");
    debugger_setRelativeFunctionBpAtLine("CIL_Autotest_CheckImplausibleData_PowertrainRdy", 0); 
    
    debugger_run();
    
    testCaseComment("Action: ARCH_SW_ATM_0229");
    testStep("STEP", "Check if CPU stopped in function CIL_Autotest_CheckImplausibleData_PowertrainRdy(). --> CPU is Stopped");
    debugger_WaitUntilBPisReached(500);
  
  
  testCaseComment("Postcondition");
  testStep("STEP", "Return ECU to default values");
  RunPostTs();
}


testcase SW_IT_ATM_CheckImplausibleData_ORC_01()
{
  //***********************************Test report header*********************************
  testReportAddMiscInfoBlock("AUTOLIV ELECTRONICS document");
  TestReportAddMiscInfo("Nightly test", "No");
  TestReportAddMiscInfo("Test type", "Requirement-Based test");
  TestReportAddMiscInfo("Regression Test", "No");
  TestReportAddMiscInfo("Fault injection method used", "No");
  TestReportAddMiscInfo("Resource usage evaluation", "No");
  TestReportAddMiscInfo("Priority", "No");
  TestReportAddMiscInfo("Safety relevant", "No");
  
  AddRequirementInfo("Requirement under test", "ARCH_SW_ATM_0230");
  AddRequirementInfo("ARCH_SW_ATM_0230", "ATM_runMainFunction shall call the CIL_Autotest_CheckImplausibleData_ORC function.");
  //***************************************************************************************
  
  testCaseComment("Preconditions");
  testStep("STEP", "Bench Initialization");
  RunPreTs();
    

    testStep("STEP", "Set a breakpoint in ATM_runMainFunction() at line 'atm_PlayCyclicTests(castRunningCyclicList);'.");
    debugger_setRelativeFunctionBpAtLine("ATM_runMainFunction", 29);
  
    debugger_reset();
    debugger_run();
  
    testCaseComment("Action: ARCH_SW_ATM_0230");
    testStep("STEP", "Check if CPU stopped in ATM_runMainFunction() at line 'atm_PlayCyclicTests(castRunningCyclicList);'. --> CPU is Stopped");
    debugger_WaitUntilBPisReached(500);
    
    
    debugger_deleteAllBP();
    
    
    testStep("STEP", "Set a breakpoint in function atm_PlayCyclicTests() at line 'atm_executeAutoTest(u8AutotestID);' under 'if (B_TRUE == atm_isAutoTestEnabled(u8AutotestID))' and press run.");
    debugger_setRelativeFunctionBpAtLine("atm_PlayCyclicTests", 9);

    debugger_run();
    
    testStep("STEP", "Check if CPU stopped in function atm_PlayCyclicTests() at line 'atm_executeAutoTest(u8AutotestID);' under 'if (B_TRUE == atm_isAutoTestEnabled(u8AutotestID))'. --> CPU is Stopped");
    debugger_WaitUntilBPisReached(500);
  
  
    debugger_deleteAllBP();
  
  
    testStep("STEP", "Set a breakpoint in function atm_executeAutoTest() at line 'u8InhibModesIndex = castATMConfig[cu8AutotestID].u8InhibIndex;'.");
    debugger_setBpAtLine("s:\\Components\\Application\\Autoliv\\ATM\\Implementation\\src\\ATM.c", 194);
    
    debugger_run();
    
    testStep("STEP", "Check if CPU stopped in function atm_executeAutoTest() at line 'u8InhibModesIndex = castATMConfig[cu8AutotestID].u8InhibIndex;'. --> CPU is Stopped");
    debugger_WaitUntilBPisReached(500);
    
  
    debugger_deleteAllBP();   

    
    testStep("STEP", "Set a breakpoint in function CIL_Autotest_CheckImplausibleData_ORC().");
    debugger_setRelativeFunctionBpAtLine("CIL_Autotest_CheckImplausibleData_ORC", 0); 
    
    debugger_run();
    
    testCaseComment("Action: ARCH_SW_ATM_0230");
    testStep("STEP", "Check if CPU stopped in function CIL_Autotest_CheckImplausibleData_ORC()*. --> CPU is Stopped");
    debugger_WaitUntilBPisReached(500);
  
  
  testCaseComment("Postcondition");
  testStep("STEP", "Return ECU to default values");
  RunPostTs();
}


testcase SW_IT_ATM_CheckTimeoutError_Belthandover_L_01()
{
  //***********************************Test report header*********************************
  testReportAddMiscInfoBlock("AUTOLIV ELECTRONICS document");
  TestReportAddMiscInfo("Nightly test", "No");
  TestReportAddMiscInfo("Test type", "Requirement-Based test");
  TestReportAddMiscInfo("Regression Test", "No");
  TestReportAddMiscInfo("Fault injection method used", "No");
  TestReportAddMiscInfo("Resource usage evaluation", "No");
  TestReportAddMiscInfo("Priority", "No");
  TestReportAddMiscInfo("Safety relevant", "No");
  
  AddRequirementInfo("Requirement under test", "ARCH_SW_ATM_0231");
  AddRequirementInfo("ARCH_SW_ATM_0231", "ATM_runMainFunction shall call the CIL_Autotest_CheckTimeoutError_Belthandover_L function.");
  //***************************************************************************************
  
  testCaseComment("Preconditions");
  testStep("STEP", "Bench Initialization");
  RunPreTs();
  

    testStep("STEP", "Set a breakpoint in ATM_runMainFunction() at line 'atm_PlayCyclicTests(castRunningCyclicList);'.");
    debugger_setRelativeFunctionBpAtLine("ATM_runMainFunction", 29);
  
    debugger_reset();
    debugger_run();
  
    testCaseComment("Action: ARCH_SW_ATM_0231");
    testStep("STEP", "Check if CPU stopped in ATM_runMainFunction() at line 'atm_PlayCyclicTests(castRunningCyclicList);'. --> CPU is Stopped");
    debugger_WaitUntilBPisReached(500);
    
    
    debugger_deleteAllBP();
    
    
    testStep("STEP", "Set a breakpoint in function atm_PlayCyclicTests() at line 'atm_executeAutoTest(u8AutotestID);' under 'if (B_TRUE == atm_isAutoTestEnabled(u8AutotestID))' and press run.");
    debugger_setRelativeFunctionBpAtLine("atm_PlayCyclicTests", 9);

    debugger_run();
    
    testStep("STEP", "Check if CPU stopped in function atm_PlayCyclicTests() at line 'atm_executeAutoTest(u8AutotestID);' under 'if (B_TRUE == atm_isAutoTestEnabled(u8AutotestID))'. --> CPU is Stopped");
    debugger_WaitUntilBPisReached(500);
  
  
    debugger_deleteAllBP();
  
  
    testStep("STEP", "Set a breakpoint in function atm_executeAutoTest() at line 'u8InhibModesIndex = castATMConfig[cu8AutotestID].u8InhibIndex;'.");
    debugger_setBpAtLine("s:\\Components\\Application\\Autoliv\\ATM\\Implementation\\src\\ATM.c", 194);
    
    debugger_run();
    
    testStep("STEP", "Check if CPU stopped in function atm_executeAutoTest() at line 'u8InhibModesIndex = castATMConfig[cu8AutotestID].u8InhibIndex;'. --> CPU is Stopped");
    debugger_WaitUntilBPisReached(500);
    
  
    debugger_deleteAllBP();  

    
    testStep("STEP", "Set a breakpoint in function CIL_Autotest_CheckTimeoutError_BelthandoverL().");
    debugger_setRelativeFunctionBpAtLine("CIL_Autotest_CheckTimeoutError_BelthandoverL", 0); 
    
    debugger_run();
    
    testCaseComment("Action: ARCH_SW_ATM_0231");
    testStep("STEP", "Check if CPU stopped in function CIL_Autotest_CheckTimeoutError_BelthandoverL(). --> CPU is Stopped");
    debugger_WaitUntilBPisReached(500);

  
  testCaseComment("Postcondition");
  testStep("STEP", "Return ECU to default values");
  RunPostTs();
}


testcase SW_IT_ATM_CheckTimeoutError_Belthandover_R_01()
{
  //***********************************Test report header*********************************
  testReportAddMiscInfoBlock("AUTOLIV ELECTRONICS document");
  TestReportAddMiscInfo("Nightly test", "No");
  TestReportAddMiscInfo("Test type", "Requirement-Based test");
  TestReportAddMiscInfo("Regression Test", "No");
  TestReportAddMiscInfo("Fault injection method used", "No");
  TestReportAddMiscInfo("Resource usage evaluation", "No");
  TestReportAddMiscInfo("Priority", "No");
  TestReportAddMiscInfo("Safety relevant", "No");
  
  AddRequirementInfo("Requirement under test", "ARCH_SW_ATM_0232");
  AddRequirementInfo("ARCH_SW_ATM_0232", "ATM_runMainFunction shall call the CIL_Autotest_CheckTimeoutError_Belthandover_R function.");
  //***************************************************************************************
  
  testCaseComment("Preconditions");
  testStep("STEP", "Bench Initialization");
  RunPreTs();
  

    testStep("STEP", "Set a breakpoint in ATM_runMainFunction() at line 'atm_PlayCyclicTests(castRunningCyclicList);'.");
    debugger_setRelativeFunctionBpAtLine("ATM_runMainFunction", 29);
  
    debugger_reset();
    debugger_run();
  
    testCaseComment("Action: ARCH_SW_ATM_0232");
    testStep("STEP", "Check if CPU stopped in ATM_runMainFunction() at line 'atm_PlayCyclicTests(castRunningCyclicList);'. --> CPU is Stopped");
    debugger_WaitUntilBPisReached(500);
    
    
    debugger_deleteAllBP();
    
    
    testStep("STEP", "Set a breakpoint in function atm_PlayCyclicTests() at line 'atm_executeAutoTest(u8AutotestID);' under 'if (B_TRUE == atm_isAutoTestEnabled(u8AutotestID))' and press run.");
    debugger_setRelativeFunctionBpAtLine("atm_PlayCyclicTests", 9);

    debugger_run();
    
    testStep("STEP", "Check if CPU stopped in function atm_PlayCyclicTests() at line 'atm_executeAutoTest(u8AutotestID);' under 'if (B_TRUE == atm_isAutoTestEnabled(u8AutotestID))'. --> CPU is Stopped");
    debugger_WaitUntilBPisReached(500);
  
  
    debugger_deleteAllBP();
  
  
    testStep("STEP", "Set a breakpoint in function atm_executeAutoTest() at line 'u8InhibModesIndex = castATMConfig[cu8AutotestID].u8InhibIndex;'.");
    debugger_setBpAtLine("s:\\Components\\Application\\Autoliv\\ATM\\Implementation\\src\\ATM.c", 194);
    
    debugger_run();
    
    testStep("STEP", "Check if CPU stopped in function atm_executeAutoTest() at line 'u8InhibModesIndex = castATMConfig[cu8AutotestID].u8InhibIndex;'. --> CPU is Stopped");
    debugger_WaitUntilBPisReached(500);
    
  
    debugger_deleteAllBP();   

    
    testStep("STEP", "Set a breakpoint in CIL_Autotest_CheckTimeoutError_BelthandoverR().");
    debugger_setRelativeFunctionBpAtLine("CIL_Autotest_CheckTimeoutError_BelthandoverR", 0); 
    
    testStep("", "Run the debugger.");
    debugger_run();
    
    testCaseComment("Action: ARCH_SW_ATM_0232");
    testStep("STEP", "Check if CPU stopped at CIL_Autotest_CheckTimeoutError_BelthandoverR()*. --> CPU is Stopped");
    debugger_WaitUntilBPisReached(500);
  
  
  testCaseComment("Postcondition");
  testStep("STEP", "Return ECU to default values");
  RunPostTs();
}


testcase SW_IT_ATM_CheckTimeoutError_API_01()
{
  //***********************************Test report header*********************************
  testReportAddMiscInfoBlock("AUTOLIV ELECTRONICS document");
  TestReportAddMiscInfo("Nightly test", "No");
  TestReportAddMiscInfo("Test type", "Requirement-Based test");
  TestReportAddMiscInfo("Regression Test", "No");
  TestReportAddMiscInfo("Fault injection method used", "No");
  TestReportAddMiscInfo("Resource usage evaluation", "No");
  TestReportAddMiscInfo("Priority", "No");
  TestReportAddMiscInfo("Safety relevant", "No");
  
  AddRequirementInfo("Requirement under test", "ARCH_SW_ATM_0233");
  AddRequirementInfo("ARCH_SW_ATM_0233", "ATM_runMainFunction shall call the CIL_Autotest_CheckTimeoutError_API function.");
  //***************************************************************************************
  
  testCaseComment("Preconditions");
  testStep("STEP", "Bench Initialization");
  RunPreTs();
    

    testStep("STEP", "Set a breakpoint in ATM_runMainFunction() at line 'atm_PlayCyclicTests(castRunningCyclicList);'.");
    debugger_setRelativeFunctionBpAtLine("ATM_runMainFunction", 29);
  
    debugger_reset();
    debugger_run();
  
    testCaseComment("Action: ARCH_SW_ATM_0233");
    testStep("STEP", "Check if CPU stopped in ATM_runMainFunction() at line 'atm_PlayCyclicTests(castRunningCyclicList);'. --> CPU is Stopped");
    debugger_WaitUntilBPisReached(500);
    
    
    debugger_deleteAllBP();
    
    
    testStep("STEP", "Set a breakpoint in function atm_PlayCyclicTests() at line 'atm_executeAutoTest(u8AutotestID);' under 'if (B_TRUE == atm_isAutoTestEnabled(u8AutotestID))' and press run.");
    debugger_setRelativeFunctionBpAtLine("atm_PlayCyclicTests", 9);

    debugger_run();
    
    testStep("STEP", "Check if CPU stopped in function atm_PlayCyclicTests() at line 'atm_executeAutoTest(u8AutotestID);' under 'if (B_TRUE == atm_isAutoTestEnabled(u8AutotestID))'. --> CPU is Stopped");
    debugger_WaitUntilBPisReached(500);
  
  
    debugger_deleteAllBP();
  
  
    testStep("STEP", "Set a breakpoint in function atm_executeAutoTest() at line 'u8InhibModesIndex = castATMConfig[cu8AutotestID].u8InhibIndex;'.");
    debugger_setBpAtLine("s:\\Components\\Application\\Autoliv\\ATM\\Implementation\\src\\ATM.c", 194);
    
    debugger_run();
    
    testStep("STEP", "Check if CPU stopped in function atm_executeAutoTest() at line 'u8InhibModesIndex = castATMConfig[cu8AutotestID].u8InhibIndex;'. --> CPU is Stopped");
    debugger_WaitUntilBPisReached(500);
    
  
    debugger_deleteAllBP();   

    
    testStep("STEP", "Set a breakpoint in function CIL_Autotest_CheckTimeoutError_API().");
    debugger_setRelativeFunctionBpAtLine("CIL_Autotest_CheckTimeoutError_API", 0); 

    debugger_run();
    
    testCaseComment("Action: ARCH_SW_ATM_0233");
    testStep("STEP", "Check if CPU stopped in function CIL_Autotest_CheckTimeoutError_API(). --> CPU is Stopped");
    debugger_WaitUntilBPisReached(500);
  
  
  testCaseComment("Postcondition");
  testStep("STEP", "Return ECU to default values");
  RunPostTs();
}


testcase SW_IT_ATM_CheckMotorPowerOrder_01()
{
  //***********************************Test report header*********************************
  testReportAddMiscInfoBlock("AUTOLIV ELECTRONICS document");
  TestReportAddMiscInfo("Nightly test", "No");
  TestReportAddMiscInfo("Test type", "Requirement-Based test");
  TestReportAddMiscInfo("Regression Test", "No");
  TestReportAddMiscInfo("Fault injection method used", "No");
  TestReportAddMiscInfo("Resource usage evaluation", "No");
  TestReportAddMiscInfo("Priority", "No");
  TestReportAddMiscInfo("Safety relevant", "No");
  
  AddRequirementInfo("Requirement under test", "ARCH_SW_ATM_0216");
  AddRequirementInfo("ARCH_SW_ATM_0216", "ATM_runMainFunction shall call the PAL_cbk_CheckMotorPowerOrder function.");
  //***************************************************************************************
  
  testCaseComment("Preconditions");
  testStep("STEP", "Bench Initialization");
  RunPreTs();
      

    testStep("STEP", "Set a breakpoint in ATM_runMainFunction() at line 'atm_PlayCyclicTests(castRunningCyclicList);'.");
    debugger_setRelativeFunctionBpAtLine("ATM_runMainFunction", 29);
  
    debugger_reset();
    debugger_run();
  
    testCaseComment("Action: ARCH_SW_ATM_0216");
    testStep("STEP", "Check if CPU stopped in ATM_runMainFunction() at line 'atm_PlayCyclicTests(castRunningCyclicList);'. --> CPU is Stopped");
    debugger_WaitUntilBPisReached(500);
    
    
    debugger_deleteAllBP();
    
    
    testStep("STEP", "Set a breakpoint in function atm_PlayCyclicTests() at line 'atm_executeAutoTest(u8AutotestID);' under 'if (B_TRUE == atm_isAutoTestEnabled(u8AutotestID))' and press run.");
    debugger_setRelativeFunctionBpAtLine("atm_PlayCyclicTests", 9);

    debugger_run();
    
    testStep("STEP", "Check if CPU stopped in function atm_PlayCyclicTests() at line 'atm_executeAutoTest(u8AutotestID);' under 'if (B_TRUE == atm_isAutoTestEnabled(u8AutotestID))'. --> CPU is Stopped");
    debugger_WaitUntilBPisReached(500);
  
  
    debugger_deleteAllBP();
  
  
    testStep("STEP", "Set a breakpoint in function atm_executeAutoTest() at line 'u8InhibModesIndex = castATMConfig[cu8AutotestID].u8InhibIndex;'.");
    debugger_setBpAtLine("s:\\Components\\Application\\Autoliv\\ATM\\Implementation\\src\\ATM.c", 194);
    
    debugger_run();
    
    testStep("STEP", "Check if CPU stopped in function atm_executeAutoTest() at line 'u8InhibModesIndex = castATMConfig[cu8AutotestID].u8InhibIndex;'. --> CPU is Stopped");
    debugger_WaitUntilBPisReached(500);
    
  
    debugger_deleteAllBP();     

    
    testStep("STEP", "Set a breakpoint in function PAL_cbk_CheckMotorPowerOrder().");
    debugger_setRelativeFunctionBpAtLine("PAL_cbk_CheckMotorPowerOrder", 0); 
    
    debugger_reset();
    debugger_run();
    
    testCaseComment("Action: ARCH_SW_ATM_0216");
    testStep("STEP", "Check if CPU stopped in function PAL_cbk_CheckMotorPowerOrder()*. --> CPU is Stopped");
    debugger_WaitUntilBPisReached(500);

  
  testCaseComment("Postcondition");
  testStep("STEP", "Return ECU to default values");
  RunPostTs();
}


testcase SW_IT_ATM_CheckTemperatureSensor_01()
{
  //***********************************Test report header*********************************
  testReportAddMiscInfoBlock("AUTOLIV ELECTRONICS document");
  TestReportAddMiscInfo("Nightly test", "No");
  TestReportAddMiscInfo("Test type", "Requirement-Based test");
  TestReportAddMiscInfo("Regression Test", "No");
  TestReportAddMiscInfo("Fault injection method used", "No");
  TestReportAddMiscInfo("Resource usage evaluation", "No");
  TestReportAddMiscInfo("Priority", "No");
  TestReportAddMiscInfo("Safety relevant", "No");
  
  AddRequirementInfo("Requirement under test", "ARCH_SW_ATM_0217");
  AddRequirementInfo("ARCH_SW_ATM_0217", "ATM_runMainFunction shall call the PMP_cbk_CheckTemperatureSensor function.");
  //***************************************************************************************
  
  testCaseComment("Preconditions");
  testStep("STEP", "Bench Initialization");
  RunPreTs();
        

    testStep("STEP", "Set a breakpoint in ATM_runMainFunction() at line 'atm_PlayCyclicTests(castRunningCyclicList);'.");
    debugger_setRelativeFunctionBpAtLine("ATM_runMainFunction", 29);
  
    debugger_reset();
    debugger_run();
  
    testCaseComment("Action: ARCH_SW_ATM_0217");
    testStep("STEP", "Check if CPU stopped in ATM_runMainFunction() at line 'atm_PlayCyclicTests(castRunningCyclicList);'. --> CPU is Stopped");
    debugger_WaitUntilBPisReached(500);
    
    
    debugger_deleteAllBP();
    
    
    testStep("STEP", "Set a breakpoint in function atm_PlayCyclicTests() at line 'atm_executeAutoTest(u8AutotestID);' under 'if (B_TRUE == atm_isAutoTestEnabled(u8AutotestID))' and press run.");
    debugger_setRelativeFunctionBpAtLine("atm_PlayCyclicTests", 9);

    debugger_run();
    
    testStep("STEP", "Check if CPU stopped in function atm_PlayCyclicTests() at line 'atm_executeAutoTest(u8AutotestID);' under 'if (B_TRUE == atm_isAutoTestEnabled(u8AutotestID))'. --> CPU is Stopped");
    debugger_WaitUntilBPisReached(500);
  
  
    debugger_deleteAllBP();
  
  
    testStep("STEP", "Set a breakpoint in function atm_executeAutoTest() at line 'u8InhibModesIndex = castATMConfig[cu8AutotestID].u8InhibIndex;'.");
    debugger_setBpAtLine("s:\\Components\\Application\\Autoliv\\ATM\\Implementation\\src\\ATM.c", 194);
    
    debugger_run();
    
    testStep("STEP", "Check if CPU stopped in function atm_executeAutoTest() at line 'u8InhibModesIndex = castATMConfig[cu8AutotestID].u8InhibIndex;'. --> CPU is Stopped");
    debugger_WaitUntilBPisReached(500);
    
  
    debugger_deleteAllBP();  

    
    testStep("STEP", "Set a breakpoint in function PMP_cbk_CheckTemperatureSensor().");
    debugger_setBpAtLine("s:\\Components\\Application\\Autoliv\\ATM\\Implementation\\src\\ATM_cfg.c", 505);
    
    debugger_run();
    testWaitForTimeoutSilent(500);
    
    testCaseComment("Action: ARCH_SW_ATM_0217");
    testStep("STEP", "Check if CPU stopped in function PMP_cbk_CheckTemperatureSensor(). --> CPU is Stopped");
    debugger_WaitUntilBPisReached(500);
  
  
  testCaseComment("Postcondition");
  testStep("STEP", "Return ECU to default values");
  RunPostTs();
}


testcase SW_IT_ATM_CheckMotorSC_01()
{
  //***********************************Test report header*********************************
  testReportAddMiscInfoBlock("AUTOLIV ELECTRONICS document");
  TestReportAddMiscInfo("Nightly test", "No");
  TestReportAddMiscInfo("Test type", "Requirement-Based test");
  TestReportAddMiscInfo("Regression Test", "No");
  TestReportAddMiscInfo("Fault injection method used", "No");
  TestReportAddMiscInfo("Resource usage evaluation", "No");
  TestReportAddMiscInfo("Priority", "No");
  TestReportAddMiscInfo("Safety relevant", "No");
  
  AddRequirementInfo("Requirement under test", "ARCH_SW_ATM_0220");
  AddRequirementInfo("ARCH_SW_ATM_0220", "ATM_runMainFunction shall call the PAL_cbk_CheckMotorSC function.");
  //***************************************************************************************
  
  testCaseComment("Preconditions");
  testStep("STEP", "Bench Initialization");
  RunPreTs();
    

    testStep("STEP", "Set a breakpoint in ATM_runMainFunction() at line 'atm_PlayCyclicTests(castRunningCyclicList);'.");
    debugger_setRelativeFunctionBpAtLine("ATM_runMainFunction", 29);
  
    debugger_reset();
    debugger_run();
  
    testCaseComment("Action: ARCH_SW_ATM_0220");
    testStep("STEP", "Check if CPU stopped in ATM_runMainFunction() at line 'atm_PlayCyclicTests(castRunningCyclicList);'. --> CPU is Stopped");
    debugger_WaitUntilBPisReached(500);
    
    
    debugger_deleteAllBP();
    
    
    testStep("STEP", "Set a breakpoint in function atm_PlayCyclicTests() at line 'atm_executeAutoTest(u8AutotestID);' under 'if (B_TRUE == atm_isAutoTestEnabled(u8AutotestID))' and press run.");
    debugger_setRelativeFunctionBpAtLine("atm_PlayCyclicTests", 9);

    debugger_run();
    
    testStep("STEP", "Check if CPU stopped in function atm_PlayCyclicTests() at line 'atm_executeAutoTest(u8AutotestID);' under 'if (B_TRUE == atm_isAutoTestEnabled(u8AutotestID))'. --> CPU is Stopped");
    debugger_WaitUntilBPisReached(500);
  
  
    debugger_deleteAllBP();
  
  
    testStep("STEP", "Set a breakpoint in function atm_executeAutoTest() at line 'u8InhibModesIndex = castATMConfig[cu8AutotestID].u8InhibIndex;'.");
    debugger_setBpAtLine("s:\\Components\\Application\\Autoliv\\ATM\\Implementation\\src\\ATM.c", 194);
    
    debugger_run();
    
    testStep("STEP", "Check if CPU stopped in function atm_executeAutoTest() at line 'u8InhibModesIndex = castATMConfig[cu8AutotestID].u8InhibIndex;'. --> CPU is Stopped");
    debugger_WaitUntilBPisReached(500);
    
  
    debugger_deleteAllBP();      

    
    testStep("STEP", "Set a breakpoint in function PAL_cbk_CheckMotorSC().");
    debugger_setRelativeFunctionBpAtLine("PAL_cbk_CheckMotorSC", 0);
  
    debugger_run();
    
    testCaseComment("Action: ARCH_SW_ATM_0220");
    testStep("STEP", "Check if CPU stopped in function PAL_cbk_CheckMotorSC(). --> CPU is Stopped");
    debugger_WaitUntilBPisReached(500);

  
  testCaseComment("Postcondition");
  testStep("STEP", "Return ECU to default values");
  RunPostTs();
}


testcase SW_IT_ATM_CheckMotorThermalProctection_01()
{
  //***********************************Test report header*********************************
  testReportAddMiscInfoBlock("AUTOLIV ELECTRONICS document");
  TestReportAddMiscInfo("Nightly test", "No");
  TestReportAddMiscInfo("Test type", "Requirement-Based test");
  TestReportAddMiscInfo("Regression Test", "No");
  TestReportAddMiscInfo("Fault injection method used", "No");
  TestReportAddMiscInfo("Resource usage evaluation", "No");
  TestReportAddMiscInfo("Priority", "No");
  TestReportAddMiscInfo("Safety relevant", "No");
  
  AddRequirementInfo("Requirement under test", "ARCH_SW_ATM_0221");
  AddRequirementInfo("ARCH_SW_ATM_0221", "ATM_runMainFunction shall call the PAL_cbk_CheckMotorThermalProctection function.");
  //***************************************************************************************
  
  testCaseComment("Preconditions");
  testStep("STEP", "Bench Initialization");
  RunPreTs();
      

    testStep("STEP", "Set a breakpoint in ATM_runMainFunction() at line 'atm_PlayCyclicTests(castRunningCyclicList);'.");
    debugger_setRelativeFunctionBpAtLine("ATM_runMainFunction", 29);
  
    debugger_reset();
    debugger_run();
  
    testCaseComment("Action: ARCH_SW_ATM_0221");
    testStep("STEP", "Check if CPU stopped in ATM_runMainFunction() at line 'atm_PlayCyclicTests(castRunningCyclicList);'. --> CPU is Stopped");
    debugger_WaitUntilBPisReached(500);
    
    
    debugger_deleteAllBP();
    
    
    testStep("STEP", "Set a breakpoint in function atm_PlayCyclicTests() at line 'atm_executeAutoTest(u8AutotestID);' under 'if (B_TRUE == atm_isAutoTestEnabled(u8AutotestID))' and press run.");
    debugger_setRelativeFunctionBpAtLine("atm_PlayCyclicTests", 9);

    debugger_run();
    
    testStep("STEP", "Check if CPU stopped in function atm_PlayCyclicTests() at line 'atm_executeAutoTest(u8AutotestID);' under 'if (B_TRUE == atm_isAutoTestEnabled(u8AutotestID))'. --> CPU is Stopped");
    debugger_WaitUntilBPisReached(500);
  
  
    debugger_deleteAllBP();
  
  
    testStep("STEP", "Set a breakpoint in function atm_executeAutoTest() at line 'u8InhibModesIndex = castATMConfig[cu8AutotestID].u8InhibIndex;'.");
    debugger_setBpAtLine("s:\\Components\\Application\\Autoliv\\ATM\\Implementation\\src\\ATM.c", 194);
    
    debugger_run();
    
    testStep("STEP", "Check if CPU stopped in function atm_executeAutoTest() at line 'u8InhibModesIndex = castATMConfig[cu8AutotestID].u8InhibIndex;'. --> CPU is Stopped");
    debugger_WaitUntilBPisReached(500);
    
  
    debugger_deleteAllBP();

    
    testStep("STEP", "Set a breakpoint in function PAL_cbk_CheckMotorThermalProctection().");
    debugger_setRelativeFunctionBpAtLine("PAL_cbk_CheckMotorThermalProctection", 0); 
    
    debugger_run();
    
    testCaseComment("Action: ARCH_SW_ATM_0221");
    testStep("STEP", "Check if CPU stopped in function PAL_cbk_CheckMotorThermalProctection()*. --> CPU is Stopped");
    debugger_WaitUntilBPisReached(500);
  
  
  testCaseComment("Postcondition");
  testStep("STEP", "Return ECU to default values");
  RunPostTs();
}


testcase SW_IT_ATM_runMainFunction_02()
{
  //***********************************Test report header*********************************
  testReportAddMiscInfoBlock("AUTOLIV ELECTRONICS document");
  TestReportAddMiscInfo("Nightly test", "No");
  TestReportAddMiscInfo("Test type", "Requirement-Based test");
  TestReportAddMiscInfo("Regression Test", "No");
  TestReportAddMiscInfo("Fault injection method used", "No");
  TestReportAddMiscInfo("Resource usage evaluation", "No");
  TestReportAddMiscInfo("Priority", "No");
  TestReportAddMiscInfo("Safety relevant", "No");
  
  AddRequirementInfo("Requirement under test", "ARCH_SW_ATM_0260");
  AddRequirementInfo("ARCH_SW_ATM_0260", "Verify if an auto-test cannot be executed ATM_runMainFunction shall set the status of the tests to “NOT DECIDED”.");
  //***************************************************************************************
  
  testCaseComment("Preconditions");
  testStep("STEP", "Bench Initialization");
  RunPreTs();
 

    testStep("STEP", "Set a breakpoint in ATM_runMainFunction() at line 'atm_PlayCyclicTests(castRunningCyclicList);'.");
    debugger_setRelativeFunctionBpAtLine("ATM_runMainFunction", 29);
  
    debugger_reset();
    debugger_run();
  
    testCaseComment("Action: ARCH_SW_ATM_0260");
    testStep("STEP", "Check if CPU stopped in ATM_runMainFunction() at line 'atm_PlayCyclicTests(castRunningCyclicList);'. --> CPU is Stopped");
    debugger_WaitUntilBPisReached(500);
    
    
    debugger_deleteAllBP();
    
    
    testStep("STEP", "Set a breakpoint in function atm_PlayCyclicTests() at line 'atm_executeAutoTest(u8AutotestID);' under 'if (B_TRUE == atm_isAutoTestEnabled(u8AutotestID))' and press run.");
    debugger_setRelativeFunctionBpAtLine("atm_PlayCyclicTests", 9);

    debugger_run();
    
    testStep("STEP", "Check if CPU stopped in function atm_PlayCyclicTests() at line 'atm_executeAutoTest(u8AutotestID);' under 'if (B_TRUE == atm_isAutoTestEnabled(u8AutotestID))'. --> CPU is Stopped");
    debugger_WaitUntilBPisReached(500);
  
  
    debugger_deleteAllBP();
  
  
    testStep("STEP", "Set a breakpoint in function atm_executeAutoTest() at line 'u8InhibModesIndex = castATMConfig[cu8AutotestID].u8InhibIndex;'.");
    debugger_setBpAtLine("s:\\Components\\Application\\Autoliv\\ATM\\Implementation\\src\\ATM.c", 194);
    
    debugger_run();
    
    testStep("STEP", "Check if CPU stopped in function atm_executeAutoTest() at line 'u8InhibModesIndex = castATMConfig[cu8AutotestID].u8InhibIndex;'. --> CPU is Stopped");
    debugger_WaitUntilBPisReached(500);
    
  
    debugger_deleteAllBP();  


    testStep("STEP", "Set a breakpoint in function atm_executeAutoTest() at line 'atm_au8AtStatuses[cu8AutotestID] =  KU8_ATM_TEST_NOT_DECIDED;'. --> BP set.");
    debugger_setBpAtLine("s:\\Components\\Application\\Autoliv\\ATM\\Implementation\\src\\ATM.c", 209);
    
    debugger_run();
  
    testCaseComment("Action: ARCH_SW_ATM_0260");
    testStep("STEP", "Check if CPU stopped in function atm_executeAutoTest() at line 'atm_au8AtStatuses[cu8AutotestID] =  KU8_ATM_TEST_NOT_DECIDED;'. --> CPU is Stopped");
    debugger_WaitUntilBPisReached(500);
  
    
    testCaseComment("Action: ARCH_SW_ATM_0260");
    testStep("STEP", "Evaluate if atm_au8AtStatuses[cu8AutotestID] =  KU8_ATM_TEST_NOT_DECIDED;. --> 0x4.");
    result = debugger_readGlobalVariable("uint8", "atm_au8AtStatuses,,app.elf", 0);
    EvalManStepEqual("Expected Test Result",  result, 4); 
  
  
  testCaseComment("Postcondition");
  testStep("STEP", "Return ECU to default values");
  RunPostTs();
}


testcase SW_IT_ATM_CheckVariantCoding_01()
{
  //***********************************Test report header*********************************
  testReportAddMiscInfoBlock("AUTOLIV ELECTRONICS document");
  TestReportAddMiscInfo("Nightly test", "No");
  TestReportAddMiscInfo("Test type", "Requirement-Based test");
  TestReportAddMiscInfo("Regression Test", "No");
  TestReportAddMiscInfo("Fault injection method used", "No");
  TestReportAddMiscInfo("Resource usage evaluation", "No");
  TestReportAddMiscInfo("Priority", "No");
  TestReportAddMiscInfo("Safety relevant", "No");
  
  AddRequirementInfo("Requirement under test", "ARCH_SW_ATM_0238");
  AddRequirementInfo("ARCH_SW_ATM_0238", "ATM_runMainFunction shall call the CIL_Autotest_CheckVariantCoding function. .");
  //***************************************************************************************
  
  testCaseComment("Preconditions");
  testStep("STEP", "Bench Initialization");
  RunPreTs();


    testStep("STEP", "Set a breakpoint in ATM_runMainFunction() at line 'atm_PlayCyclicTests(castRunningCyclicList);'.");
    debugger_setRelativeFunctionBpAtLine("ATM_runMainFunction", 29);
  
    debugger_reset();
    debugger_run();
  
    testCaseComment("Action: ARCH_SW_ATM_0238");
    testStep("STEP", "Check if CPU stopped in ATM_runMainFunction() at line 'atm_PlayCyclicTests(castRunningCyclicList);'. --> CPU is Stopped");
    debugger_WaitUntilBPisReached(500);
    
    
    debugger_deleteAllBP();
    
    
    testStep("STEP", "Set a breakpoint in function atm_PlayCyclicTests() at line 'atm_executeAutoTest(u8AutotestID);' under 'if (B_TRUE == atm_isAutoTestEnabled(u8AutotestID))' and press run.");
    debugger_setRelativeFunctionBpAtLine("atm_PlayCyclicTests", 9);

    debugger_run();
    
    testStep("STEP", "Check if CPU stopped in function atm_PlayCyclicTests() at line 'atm_executeAutoTest(u8AutotestID);' under 'if (B_TRUE == atm_isAutoTestEnabled(u8AutotestID))'. --> CPU is Stopped");
    debugger_WaitUntilBPisReached(500);
  
  
    debugger_deleteAllBP();
  
  
    testStep("STEP", "Set a breakpoint in function atm_executeAutoTest() at line 'u8InhibModesIndex = castATMConfig[cu8AutotestID].u8InhibIndex;'.");
    debugger_setBpAtLine("s:\\Components\\Application\\Autoliv\\ATM\\Implementation\\src\\ATM.c", 194);
    
    debugger_run();
    
    testStep("STEP", "Check if CPU stopped in function atm_executeAutoTest() at line 'u8InhibModesIndex = castATMConfig[cu8AutotestID].u8InhibIndex;'. --> CPU is Stopped");
    debugger_WaitUntilBPisReached(500);
    
  
    debugger_deleteAllBP();
    
    testStep("STEP", "Set a breakpoint in function CIL_Autotest_CheckVariantCoding().");
    debugger_setRelativeFunctionBpAtLine("CIL_Autotest_CheckVariantCoding", 0);

    debugger_run();
    
    testCaseComment("Action: ARCH_SW_ATM_0238");
    testStep("STEP", "Check if CPU stopped in function CIL_Autotest_CheckVariantCoding(). --> CPU is Stopped");
    debugger_WaitUntilBPisReached(500);

  
  testCaseComment("Postcondition");
  testStep("STEP", "Return ECU to default values");
  RunPostTs();
}

