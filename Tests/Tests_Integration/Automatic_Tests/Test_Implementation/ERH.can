/*@!Encoding:1252*/
/*------------------------------------------------------------------------------
                                IMPORT LIBRARY
 ------------------------------------------------------------------------------*/
/* To include all the libraries used by the .capl script. */
/* WARNING: Some things such as diagnostic functions are different from project
to project, change those according to your project requirements */
includes
{
  #include "..\Includes\SW_Modules\SW_Modules_Project\Project_Includes_Configuration.cin"
}


/*------------------------------------------------------------------------------
                                    GLOBALS
 ------------------------------------------------------------------------------*/
/* To declare the constants used throurough the entire module, and global variables */
variables
{
  int64 debugger_variable = 0;
  int64 debuggerResultVariable = 0;
  int64 debuggerResultVariableToCompare = 0;
  int64 debuggerResultVariableToCompare1 = 0;
  int64 debuggerResultVariableToCompare2 = 0;
  byte bWriteStepsLibraryRequest[3] = {0x2E, 0xFD, 0x2A};
  diagRequest RBTMFL174.FaultMem_ClearGroup reqFaultMem_ClearGroup;
  
  char buffer[256];
  long result;
  int index;
  int ERH_KU8_NUMBER_OF_AEC = 53;
  int ERH_KU8_UNDEFINED_AEC = 0x19;
  int KU8_ZERO  = 0;
  int KU16_ZERO = 0;
  int KU16_ONE  = 1;
  int KU32_ZERO = 0;
  
  char erh_au16AecCounter[54][64] = {
    "ERH_KU8_ADC_AEC_CFG",
    "ERH_KU8_HIGH_SIDE_SWITCH_AEC_CFG1",                     
    "ERH_KU8_ENABLE_OUT_OF_ORDER_AEC_CFG",                    
    "ERH_KU8_MOSFET_HIGH_SC_AEC_CFG",                 
    "ERH_KU8_MOSFET_LOW_SC_AEC_CFG",
    "ERH_KU8_MOTOR_DISCONNECTED_AEC_CFG",
    "ERH_KU8_HW_SELF_PROTECTION_AEC_CFG",
    "ERH_KU8_MOSFET_OC_AEC_CFG",
    "ERH_KU8_SPI_ERROR_AEC_CFG",
    "ERH_KU8_HALL_SENSOR_AEC_CFG",
    "ERH_KU8_MOTOR_CURRENT_AEC_CFG",
    "ERH_KU8_MOTOR_BLOCKED_AEC_CFG",
    "ERH_KU8_SW_SELF_PROTECTION_AEC_CFG",
    "ERH_KU8_TEMPERATURE_SENSOR_FAILURE_AEC_CFG",
    "ERH_KU8_MOTOR_IN_SC_AEC_CFG",
    "ERH_KU8_MOTOR_ORDER_AEC_CFG",
    "ERH_KU8_UVO_POWER_AEC_CFG",
    "ERH_KU8_OVO_POWER_AEC_CFG",
    "ERH_KU8_UVO_TENSIONING_POWER_AEC_CFG",
    "ERH_KU8_OVO_TENSIONING_POWER_AEC_CFG",
    "ERH_KU8_EXT_WDG_OUT_OF_ORDER_AEC_CFG",
    "ERH_KU8_UNDEFINED_AEC_CFG",
    "ERH_KU8_UNDEFINED_AEC_CFG",
    "ERH_KU8_UNDEFINED_AEC_CFG",
    "ERH_KU8_UNDEFINED_AEC_CFG",
    "ERH_KU8_UNDEFINED_AEC_CFG",
    "ERH_KU8_CAN_BUS_OFF_AEC_CFG",
    "ERH_KU8_WARM_RESET_AEC_CFG",
    "ERH_KU8_END_OF_LIFE_LOW_AEC_CFG",
    "ERH_KU8_END_OF_LIFE_HIGH_AEC_CFG",
    "ERH_KU8_END_OF_LIFE_COMFORT_AEC_CFG",
    "ERH_KU8_END_OF_LIFE_MAX_FORCE_AEC_CFG",
    "ERH_KU8_UNDEFINED_AEC_CFG",
    "ERH_KU8_TIMEOUT_PRESAFE_AEC_CFG",
    "ERH_KU8_TIMEOUT_BUCKLE_AEC_CFG",
    "ERH_KU8_IMPLAUSIBLE_DATA_PRESAFE_AEC_CFG",
    "ERH_KU8_IMPLAUSIBLE_DATA_IGNITION_AEC_CFG",
    "ERH_KU8_IMPLAUSIBLE_DATA_BUCKLE_AEC_CFG",
    "ERH_KU8_TIMEOUT_BLTHD_R_AEC_CFG",
    "ERH_KU8_TIMEOUT_BLTHD_L_AEC_CFG",
    "ERH_KU8_TIMEOUT_IGNITION_AEC_CFG",
    "ERH_KU8_IMPLAUSIBLE_DATA_ORC_AEC_CFG",
    "ERH_KU8_IMPLAUSIBLE_DATA_POWERTRAIN_RDY_AEC_CFG",
    "ERH_KU8_TIMEOUT_POWERTRAIN_AEC_CFG",
    "ERH_KU8_STEERING_CONFIG_AEC_CFG",
    "ERH_KU8_SYSTEM_OV_AEC_CFG",
    "ERH_KU8_SYSTEM_UV_AEC_CFG",
    "ERH_KU8_TIMEOUT_API",
    "ERH_KU8_IMPLAUSIBLE_DATA_POWERTRAIN_DRV_AEC_CFG",
    "ERH_KU8_TIMEOUT_ODOSPEEDOMETER_AEC_CFG",
    "ERH_KU8_IMPLAUSIBLE_DATA_API_AEC_CFG",
    "ERH_KU8_VARIANT_CODING_AEC_CFG",
    "ERH_KU8_TIMEOUT_BELT_ADJ_AEC_CFG"   
  };
}

/*------------------------------------------------------------------------------
                                REPORT INFO
 ------------------------------------------------------------------------------*/
testcase InitTestModule()
{
  ConfigureTestModuleInformation(CGA);
  
  strncpy(cLogPath, "S:\\Tools\\CANoe\\Config\\DAIMLER_MMA_INTEGRATION\\Logs\\",  elcount(cLogPath));
}



testcase SW_IT_ERH_ResetAllAECStatus_02()
{
  //***********************************Test report header*********************************
  testReportAddMiscInfoBlock("AUTOLIV ELECTRONICS document");
  TestReportAddMiscInfo("Nightly test", "No");
  TestReportAddMiscInfo("Test type", "Requirement-Based test");
  TestReportAddMiscInfo("Regression Test", "No");
  TestReportAddMiscInfo("Fault injection method used", "No");
  TestReportAddMiscInfo("Resource usage evaluation", "No");
  TestReportAddMiscInfo("Priority", "No");
  TestReportAddMiscInfo("Safety relevant", "No");
  
  AddRequirementInfo("Requirement under test", "ARCH_SW_ERH_0074, ARCH_SW_ERH_0075, ARCH_SW_ERH_0076, ARCH_SW_ERH_0077");
  AddRequirementInfo("ARCH_SW_ERH_0074", "The erh_CheckAecId function shall be called to check the validity of all AEC identifiers and to get the counter index and the status array of each AEC.");
  AddRequirementInfo("ARCH_SW_ERH_0075", "The NvM_SetRamBlockStatus interface shall be called to notify NVM that AEC status block shall be stored in NVM by the next call of NvM_WriteAll function.");
  AddRequirementInfo("ARCH_SW_ERH_0076", "NvM_WriteBlock shall be called to copy the data of the RAM block to its corresponding NVM block.");
  AddRequirementInfo("ARCH_SW_ERH_0077", "Rte_Write_psrAECsBlockStatus_b8NVMBlockStatus shall be called to write the updated AECs block in NVM.");
  //***************************************************************************************

  testCaseComment("Preconditions");
  testStep("STEP", "Bench Initialization");
  RunPreTs();
  
  
    testStep("STEP", "Set a breakpoint in function ERH_ResetAllAECStatus() at line '(void) erh_CheckAecId(u8AECIndex, &u8OutputIndex, &stAecData);'.");
    debugger_setRelativeFunctionBpAtLine("ERH_ResetAllAECStatus", 22);
  
    debugger_reset();
    debugger_run();
    
    testStep("STEP", "Send diagnostic request 14 FF FF FF.");
    diagSendRequest(reqFaultMem_ClearGroup);
    testWaitForTimeoutSilent(500);
  
    testStep("STEP", "Check if CPU stopped in function ERH_ResetAllAECStatus() at line '(void) erh_CheckAecId(u8AECIndex, &u8OutputIndex, &stAecData);'. --> CPU stopped at BP");
    debugger_waitUntilBPisReached(500);
  
  
    debugger_deleteAllBP();
  
  
    testStep("STEP", "Set a breakpoint in function ERH_ResetAllAECStatus() at line 'Rte_Call_pclNvmServicesAecBlock_GetErrorStatus(&u8NvmBlockStatus);'.");
    debugger_setRelativeFunctionBpAtLine("ERH_ResetAllAECStatus", 4);
  
    debugger_run();
    
    testCaseComment("Action: ARCH_SW_ERH_0074");
    testStep("STEP", "Check if CPU stopped in function erh_CheckAecId() at line 'if ((ERH_KU8_UNDEFINED_AEC_CFG < cu8AecId)'. --> CPU stopped at BP");
    debugger_waitUntilBPisReached(500);
  
  
    debugger_deleteAllBP();
  
  
    testStep("STEP", "Set a breakpoint in function ERH_ResetAllAECStatus() at line 'Rte_Call_pclNvmServicesAecBlock_GetErrorStatus(&u8NvmBlockStatus);'.");
    debugger_setRelativeFunctionBpAtLine("ERH_ResetAllAECStatus", 61);
  
    debugger_run();
    
    testCaseComment("Action: ARCH_SW_ERH_0075");
    testStep("STEP", "Check if CPU stopped in function ERH_ResetAllAECStatus() at line 'Rte_Call_pclNvmServicesAecBlock_GetErrorStatus(&u8NvmBlockStatus);'. --> CPU stopped at BP");
    debugger_waitUntilBPisReached(500);
  
  
    debugger_deleteAllBP();
  
  
    testStep("STEP", "Set a breakpoint in function ERH_ResetAllAECStatus() at line 'Result = Rte_Call_pclNvmServicesAecBlock_WriteBlock(&NVP_BLOCK_ID_AEC_STATUS_RamBlockData);'.");
    debugger_setRelativeFunctionBpAtLine("ERH_ResetAllAECStatus", 61);
  
    debugger_run();
    
    testCaseComment("Action: ARCH_SW_ERH_0076, ARCH_SW_ERH_0077");
    testStep("STEP", "Check if CPU stopped in function ERH_ResetAllAECStatus() at line 'Result = Rte_Call_pclNvmServicesAecBlock_WriteBlock(&NVP_BLOCK_ID_AEC_STATUS_RamBlockData);'. --> CPU stopped at BP");
    debugger_waitUntilBPisReached(500);
  
  
  testCaseComment("Postcondition");
  testStep("STEP", "Return ECU to default values");
  RunPostTs();
}



testcase SW_IT_ERH_cyclic_01()
{
  //***********************************Test report header*********************************
  testReportAddMiscInfoBlock("AUTOLIV ELECTRONICS document");
  TestReportAddMiscInfo("Nightly test", "No");
  TestReportAddMiscInfo("Test type", "Requirement-Based test");
  TestReportAddMiscInfo("Regression Test", "No");
  TestReportAddMiscInfo("Fault injection method used", "No");
  TestReportAddMiscInfo("Resource usage evaluation", "No");
  TestReportAddMiscInfo("Priority", "No");
  TestReportAddMiscInfo("Safety relevant", "No");
  
  AddRequirementInfo("Requirement under test", "ARCH_SW_ERH_0111, ARCH_SW_ERH_0112, ARCH_SW_ERH_0113, ARCH_SW_ERH_0114, ARCH_SW_ERH_0115, ARCH_SW_ERH_0116, ARCH_SW_ERH_0117, ARCH_SW_ERH_0118, ARCH_SW_ERH_0119, ARCH_SW_ERH_0120, ARCH_SW_ERH_0121");
  AddRequirementInfo("ARCH_SW_ERH_0111", "Read Rte_Read_isrSupBatStatus_b8SupBatStatus to get status in order to manage storage conditions.");
  AddRequirementInfo("ARCH_SW_ERH_0112", "Read Rte_Call_pcsGetComMStatus_GetCurrentComMode to get status in order to manage storage conditions.");
  AddRequirementInfo("ARCH_SW_ERH_0113", "Read Rte_Read_prrEngStartStatus_b8EngStartStatus to get status in order to manage storage conditions.");
  AddRequirementInfo("ARCH_SW_ERH_0114", "Read Rte_Read_prrProdModeStatus_b8TriggerProdModeStatus to get status in order to manage storage conditions.");
  AddRequirementInfo("ARCH_SW_ERH_0115", "Read Rte_Read_prrTransportationModeStatus_b8TransportationModeStatus to get status in order to manage storage conditions.");
  AddRequirementInfo("ARCH_SW_ERH_0116", "Read Rte_Call_pcsAutotestServices_GetTestResult to get status in order to manage storage conditions.");
  AddRequirementInfo("ARCH_SW_ERH_0117", "Read Rte_Read_prrIgnitionStatus_b8TriggerIgnitionStatusEnableStorageConditionto get status in order to manage storage conditions.");
  AddRequirementInfo("ARCH_SW_ERH_0118", "Read Rte_Read_prrIgnitionStatus_b8TriggerIgnitionStatusto get status in order to manage ignition power cycle.");
  AddRequirementInfo("ARCH_SW_ERH_0119", "Dem_SetStorageCondition is called to send information to DEM to manage storage conditions for DTCs");
  AddRequirementInfo("ARCH_SW_ERH_0120", "Dem_GetEventUdsStatus is called in order to check DTC status for DIA external tester present.");
  AddRequirementInfo("ARCH_SW_ERH_0121", "Write Rte_Write_ERH_AC_ErrorHandler_psrDTCConfirmed_b8DTCConfirmed  for DIA external tester present.");
  //***************************************************************************************

  testCaseComment("Preconditions");
  testStep("STEP", "Bench Initialization");
  RunPreTs();
  
  
    testStep("STEP", "Set a breakpoint in function ERH_cyclic() at line '(void)Rte_Read_isrSupBatStatus_b8SupBatStatus(&u8SupBatStatus);'.");
    debugger_setRelativeFunctionBpAtLine("ERH_cyclic", 25);
       
    debugger_reset();
    debugger_run();
    
    testCaseComment("Action: ARCH_SW_ERH_0111");
    testStep("STEP", "Check if CPU stopped in function ERH_cyclic() at line '(void)Rte_Read_isrSupBatStatus_b8SupBatStatus(&u8SupBatStatus);'.--> CPU stopped at BP");
    debugger_waitUntilBPisReached(1000);
  
  
    debugger_deleteAllBP();
  
  
    testStep("STEP", "Set a breakpoint in function ERH_cyclic() at line '(void)Rte_Call_pcsGetComMStatus_GetCurrentComMode(&ComM_Status);'.");
    debugger_setRelativeFunctionBpAtLine("ERH_cyclic", 28);

    debugger_run();
    
    testCaseComment("Action: ARCH_SW_ERH_0112");
    testStep("STEP", "Check if CPU stopped in function ERH_cyclic() at line '(void)Rte_Call_pcsGetComMStatus_GetCurrentComMode(&ComM_Status);'.--> CPU stopped at BP");
    debugger_waitUntilBPisReached(1000);
  
  
    debugger_deleteAllBP();
  
  
    testStep("STEP", "Set a breakpoint in function ERH_cyclic() at line '(void)Rte_Read_prrEngStartStatus_b8EngStartStatus(&u8EngStartStatus);'.");
    debugger_setRelativeFunctionBpAtLine("ERH_cyclic", 31);

    debugger_run();
    
    testCaseComment("Action: ARCH_SW_ERH_0113");
    testStep("STEP", "Check if CPU stopped in function ERH_cyclic() at line '(void)Rte_Read_prrEngStartStatus_b8EngStartStatus(&u8EngStartStatus);'.--> CPU stopped at BP");
    debugger_waitUntilBPisReached(1000);
  
  
    debugger_deleteAllBP();
  
  
    testStep("STEP", "Set a breakpoint in function ERH_cyclic() at line '(void)Rte_Read_prrProdModeStatus_b8TriggerProdModeStatus(&u8ProductionMode);'.");
    debugger_setRelativeFunctionBpAtLine("ERH_cyclic", 34);

    debugger_run();
    
    testCaseComment("Action: ARCH_SW_ERH_0114");
    testStep("STEP", "Check if CPU stopped in function ERH_cyclic() at line '(void)Rte_Read_prrProdModeStatus_b8TriggerProdModeStatus(&u8ProductionMode);'.--> CPU stopped at BP");
    debugger_waitUntilBPisReached(1000);
  
  
    debugger_deleteAllBP();
  
  
    testStep("STEP", "Set a breakpoint in function ERH_cyclic() at line '(void)Rte_Read_prrTransportationModeStatus_b8TransportationModeStatus(&u8TransportationMode);'.");
    debugger_setRelativeFunctionBpAtLine("ERH_cyclic", 37);

    debugger_run();
    
    testCaseComment("Action: ARCH_SW_ERH_0115");
    testStep("STEP", "Check if CPU stopped in function ERH_cyclic() at line '(void)Rte_Read_prrTransportationModeStatus_b8TransportationModeStatus(&u8TransportationMode);'.--> CPU stopped at BP");
    debugger_waitUntilBPisReached(1000);
  
  
    debugger_deleteAllBP();
  
  
    testStep("STEP", "Set a breakpoint in function ERH_cyclic() at line '(void)Rte_Call_pcsAutotestServices_GetTestResult(ATM_KU8_ID_SYSTEM_OV, &u8AutotestResultSOV);'.");
    debugger_setRelativeFunctionBpAtLine("ERH_cyclic", 40);

    debugger_run();
    
    testCaseComment("Action: ARCH_SW_ERH_0116");
    testStep("STEP", "Check if CPU stopped in function ERH_cyclic() at line '(void)Rte_Call_pcsAutotestServices_GetTestResult(ATM_KU8_ID_SYSTEM_OV, &u8AutotestResultSOV);'.--> CPU stopped at BP");
    debugger_waitUntilBPisReached(1000);
  
  
    debugger_deleteAllBP();
  
  
    testStep("STEP", "Set a breakpoint in function ERH_cyclic() at line '(void)Rte_Read_prrIgnitionStatus_b8TriggerIgnitionStatusEnableStorageCondition(&u8IgnitionStatusStorage);'.");
    debugger_setRelativeFunctionBpAtLine("ERH_cyclic", 48);

    debugger_run();
    
    testCaseComment("Action: ARCH_SW_ERH_0117");
    testStep("STEP", "Check if CPU stopped in function ERH_cyclic() at line '(void)Rte_Read_prrIgnitionStatus_b8TriggerIgnitionStatusEnableStorageCondition(&u8IgnitionStatusStorage);'.--> CPU stopped at BP");
    debugger_waitUntilBPisReached(1000);
  
  
    debugger_deleteAllBP();
  
  
    testStep("STEP", "Set a breakpoint in function ERH_cyclic() at line '(void)Rte_Read_prrIgnitionStatus_b8TriggerIgnitionStatus(&u8IgnitionStatus);'.");
    debugger_setRelativeFunctionBpAtLine("ERH_cyclic", 54);

    debugger_run();
    
    testCaseComment("Action: ARCH_SW_ERH_0118");
    testStep("STEP", "Check if CPU stopped in function ERH_cyclic() at line '(void)Rte_Read_prrIgnitionStatus_b8TriggerIgnitionStatus(&u8IgnitionStatus);'.--> CPU stopped at BP");
    debugger_waitUntilBPisReached(1000);
  
  
    debugger_deleteAllBP();
  
  
    testStep("STEP", "Set a breakpoint in function ERH_cyclic() at line '(void)Rte_Call_pclStorageConditionSC1_SetStorageCondition(BOOL_ERH_SET_STORAGE_CONDITION);'.");
    debugger_setRelativeFunctionBpAtLine("ERH_cyclic", 84);

    debugger_run();
    
    testCaseComment("Action: ARCH_SW_ERH_0119");
    testStep("STEP", "Check if CPU stopped in function ERH_cyclic() at line '(void)Rte_Call_pclStorageConditionSC1_SetStorageCondition(BOOL_ERH_SET_STORAGE_CONDITION);'.--> CPU stopped at BP");
    debugger_waitUntilBPisReached(1000);
  
  
    debugger_deleteAllBP();
  
  
    testStep("STEP", "Set a breakpoint in function ERH_cyclic() at line '(void)Dem_GetEventUdsStatus(EventId, &EventStatusByte);'.");
    debugger_setRelativeFunctionBpAtLine("ERH_cyclic", 282);

    debugger_run();
    
    testCaseComment("Action: ARCH_SW_ERH_0120");
    testStep("STEP", "Check if CPU stopped in function ERH_cyclic() at line '(void)Dem_GetEventUdsStatus(EventId, &EventStatusByte);;'.--> CPU stopped at BP");
    debugger_waitUntilBPisReached(1000);
  
  
    debugger_deleteAllBP();
  
  
    testStep("STEP", "Set a breakpoint in function ERH_cyclic() at line '(void)Rte_Write_ERH_AC_ErrorHandler_psrDTCConfirmed_b8DTCConfirmed(B_FALSE);'.");
    debugger_setRelativeFunctionBpAtLine("ERH_cyclic", 289);

    debugger_run();
    
    testCaseComment("Action: ARCH_SW_ERH_0121");
    testStep("STEP", "Check if CPU stopped in function ERH_cyclic() at line '(void)Rte_Write_ERH_AC_ErrorHandler_psrDTCConfirmed_b8DTCConfirmed(B_FALSE);'.--> CPU stopped at BP");
    debugger_waitUntilBPisReached(1000);
  
  
  testCaseComment("Postcondition");
  testStep("STEP", "Return ECU to default values");
  RunPostTs();
}


testcase SW_IT_ERH_DemOperationCycle_01()
{
  //***********************************Test report header*********************************
  testReportAddMiscInfoBlock("AUTOLIV ELECTRONICS document");
  TestReportAddMiscInfo("Nightly test", "No");
  TestReportAddMiscInfo("Test type", "Requirement-Based test");
  TestReportAddMiscInfo("Regression Test", "No");
  TestReportAddMiscInfo("Fault injection method used", "No");
  TestReportAddMiscInfo("Resource usage evaluation", "No");
  TestReportAddMiscInfo("Priority", "No");
  TestReportAddMiscInfo("Safety relevant", "No");
  
  AddRequirementInfo("Requirement under test", "ARCH_SW_ERH_0100, ARCH_SW_ERH_0110");
  AddRequirementInfo("ARCH_SW_ERH_0100", "DemConf_DemOperationCycle_PowerCycle and Dem_SetEnableCondition called to enable conditions for error handler mechanism.");
  AddRequirementInfo("ARCH_SW_ERH_0110", "DemConf_DemOperationCycle_IgnitionCycle is called to enable Ignition cycle, when Ignition status is TRUE, otherwise DemConf_DemOperationCycle_IgnitionCycle is called to end DEM ignition status.");
 //***************************************************************************************

  testCaseComment("Preconditions");
  testStep("STEP", "Bench Initialization");
  RunPreTs();
  
  
    testStep("STEP", "Set a breakpoint in function ERH_Init() at line '(void)Dem_SetOperationCycleState(DemConf_DemOperationCycle_PowerCycle, DEM_CYCLE_STATE_START);'.");
    debugger_setRelativeFunctionBpAtLine("ERH_Init", 59);
       
    debugger_reset();
    debugger_run();
    
    testCaseComment("Action: ARCH_SW_ERH_0100");
    testStep("STEP", "Check if CPU stopped in function ERH_Init() at line '(void)Dem_SetOperationCycleState(DemConf_DemOperationCycle_PowerCycle, DEM_CYCLE_STATE_START);'.--> CPU stopped at BP");
    debugger_waitUntilBPisReached(1000);
  
  
    debugger_deleteAllBP();
  
  
    testStep("STEP", "Set a breakpoint in function ERH_cyclic() at line '(void)Dem_SetOperationCycleState(DemConf_DemOperationCycle_IgnitionCycle, DEM_CYCLE_STATE_END);'.");
    debugger_setRelativeFunctionBpAtLine("ERH_cyclic", 77);

    debugger_run();
    
    testCaseComment("Action: ARCH_SW_ERH_0110");
    testStep("STEP", "Check if CPU stopped in function ERH_cyclic() at line '(void)Dem_SetOperationCycleState(DemConf_DemOperationCycle_IgnitionCycle, DEM_CYCLE_STATE_END);'.--> CPU stopped at BP");
    debugger_waitUntilBPisReached(1000);
  
  
  testCaseComment("Postcondition");
  testStep("STEP", "Return ECU to default values");
  RunPostTs();
}


testcase SW_IT_ERH_DebounceCounter_01()
{
  //***********************************Test report header*********************************
  testReportAddMiscInfoBlock("AUTOLIV ELECTRONICS document");
  TestReportAddMiscInfo("Nightly test", "No");
  TestReportAddMiscInfo("Test type", "Requirement-Based test");
  TestReportAddMiscInfo("Regression Test", "No");
  TestReportAddMiscInfo("Fault injection method used", "No");
  TestReportAddMiscInfo("Resource usage evaluation", "No");
  TestReportAddMiscInfo("Priority", "No");
  TestReportAddMiscInfo("Safety relevant", "No");
  
  AddRequirementInfo("Requirement under test", "ARCH_SW_ERH_0156");
  AddRequirementInfo("ARCH_SW_ERH_0156", "A debounce timer of 5s shall be applicable for the following storage condition groups if all the SCs are fulfiled: Power Distribution, Network Communication without Clam 15 and Network Communication.");
 //***************************************************************************************

  testCaseComment("Preconditions");
  testStep("STEP", "Bench Initialization");
  RunPreTs();
  
  
    testStep("STEP", "Set a breakpoint in function ERH_cyclic() at line 'if(KU16_ERH_TIMER_TRESHOLD > ERH_u16DebounceCounter_NetworkComunication)'.");
    debugger_setRelativeFunctionBpAtLine("ERH_cyclic", 206);
       
    debugger_reset();
    debugger_run();
    
    testCaseComment("Action: ARCH_SW_ERH_0156");
    testStep("STEP", "Check if CPU stopped in function ERH_cyclic() at line 'if(KU16_ERH_TIMER_TRESHOLD > ERH_u16DebounceCounter_NetworkComunication)'.--> CPU stopped at BP");
    debugger_waitUntilBPisReached(1000);
  
  
    debugger_deleteAllBP();
  
  
    testStep("STEP", "Set a breakpoint in function ERH_cyclic() at line 'if(KU16_ERH_TIMER_TRESHOLD > ERH_u16DebounceCounter_NetworkComunication15)'.");
    debugger_setRelativeFunctionBpAtLine("ERH_cyclic", 231);

    debugger_run();
    
    testCaseComment("Action: ARCH_SW_ERH_0156");
    testStep("STEP", "Check if CPU stopped in function ERH_cyclic() at line 'if(KU16_ERH_TIMER_TRESHOLD > ERH_u16DebounceCounter_NetworkComunication15)'.--> CPU stopped at BP");
    debugger_waitUntilBPisReached(1000);
  
  
    debugger_deleteAllBP();
  
  
    testStep("STEP", "Set a breakpoint in function ERH_cyclic() at line 'if(KU16_ERH_TIMER_TRESHOLD > ERH_u16DebounceCounter_PowerDistribution)'.");
    debugger_setRelativeFunctionBpAtLine("ERH_cyclic", 256);

    debugger_run();
    
    testCaseComment("Action: ARCH_SW_ERH_0156");
    testStep("STEP", "Check if CPU stopped in function ERH_cyclic() at line 'if(KU16_ERH_TIMER_TRESHOLD > ERH_u16DebounceCounter_PowerDistribution)'.--> CPU stopped at BP");
    debugger_waitUntilBPisReached(1000);
  
  
  testCaseComment("Postcondition");
  testStep("STEP", "Return ECU to default values");
  RunPostTs();
}


testcase SW_IT_ERH_SetAecEvent_02()
{
  //***********************************Test report header*********************************
  testReportAddMiscInfoBlock("AUTOLIV ELECTRONICS document");
  TestReportAddMiscInfo("Nightly test", "No");
  TestReportAddMiscInfo("Test type", "Requirement-Based test");
  TestReportAddMiscInfo("Regression Test", "No");
  TestReportAddMiscInfo("Fault injection method used", "No");
  TestReportAddMiscInfo("Resource usage evaluation", "No");
  TestReportAddMiscInfo("Priority", "No");
  TestReportAddMiscInfo("Safety relevant", "No");
  
  AddRequirementInfo("Requirement under test", "ARCH_SW_ERH_0096, ARCH_SW_ERH_0097, ARCH_SW_ERH_0098, ARCH_SW_ERH_0099, ARCH_SW_ERH_0150");
  AddRequirementInfo("ARCH_SW_ERH_0096", "For the following AECs ECU level storage condition shall be applicable: ERH_KU8_ENABLE_OUT_OF_ORDER_AEC_CFG, ERH_KU8_MOSFET_HIGH_SC_AEC_CFG, ERH_KU8_MOSFET_LOW_SC_AEC_CFG, ERH_KU8_MOTOR_DISCONNECTED_AEC_CFG, ERH_KU8_HALL_SENSOR_AEC_CFG, ERH_KU8_TEMPERATURE_SENSOR_FAILURE_AEC_CFG, ERH_KU8_EXT_WDG_OUT_OF_ORDER_AEC_CFG, ERH_KU8_HW_SELF_PROTECTION_AEC_CFG, ERH_KU8_SW_SELF_PROTECTION_AEC_CFG, ERH_KU8_END_OF_LIFE_COMFORT_AEC_CFG, ERH_KU8_END_OF_LIFE_LOW_AEC_CFG, ERH_KU8_END_OF_LIFE_HIGH_AEC_CFG, ERH_KU8_END_OF_LIFE_MAX_FORCE_AEC_CFG, ERH_KU8_STEERING_CONFIG_AEC_CFG, ERH_KU8_VARIANT_CODING_AEC_CFG.");
  AddRequirementInfo("ARCH_SW_ERH_0097", "For the following AECs Network Communication storage condition shall be applicable: ERH_KU8_TIMEOUT_PRESAFE_AEC_CFG, ERH_KU8_TIMEOUT_BUCKLE_AEC_CFG, ERH_KU8_IMPLAUSIBLE_DATA_PRESAFE_AEC_CFG, ERH_KU8_IMPLAUSIBLE_DATA_IGNITION_AEC_CFG, ERH_KU8_IMPLAUSIBLE_DATA_BUCKLE_AEC_CFGERH_KU8_IMPLAUSIBLE_DATA_ORC_AEC_CFG, ERH_KU8_IMPLAUSIBLE_DATA_POWERTRAIN_RDY_AEC_CFG, ERH_KU8_IMPLAUSIBLE_DATA_POWERTRAIN_DRV_AEC_CFG, ERH_KU8_TIMEOUT_BLTHD_R_AEC_CFG, ERH_KU8_TIMEOUT_BLTHD_L_AEC_CFG, ERH_KU8_TIMEOUT_POWERTRAIN_AEC_CFG, ERH_KU8_TIMEOUT_ODOSPEEDOMETER_AEC_CFG, ERH_KU8_IMPLAUSIBLE_DATA_API_AEC_CFG, ERH_KU8_TIMEOUT_BELT_ADJ_AEC_CFG, ERH_KU8_TIMEOUT_API.");
  AddRequirementInfo("ARCH_SW_ERH_0098", "For the following AECs Network Communication without Clam 15 storage condition shall be applicable: ERH_KU8_TIMEOUT_IGNITION_AEC_CFG.");
  AddRequirementInfo("ARCH_SW_ERH_0099", "For the following AECs Power Distribution storage condition shall be applicable: ERH_KU8_OVO_POWER_AEC_CFG, ERH_KU8_UVO_POWER_AEC_CFG, ERH_KU8_UVO_TENSIONING_POWER_AEC_CFG, ERH_KU8_OVO_TENSIONING_POWER_AEC_CFG, ERH_KU8_SYSTEM_OV_AEC_CFG, ERH_KU8_SYSTEM_UV_AEC_CFG.");
  AddRequirementInfo("ARCH_SW_ERH_0150", "The following AECs shall not have any storage condition applicable: ERH_KU8_SPI_ERROR_AEC_CFG, ERH_KU8_HIGH_SIDE_SWITCH_AEC_CFG, ERH_KU8_MOSFET_OC_AEC_CFG, ERH_KU8_WARM_RESET_AEC_CFG, ERH_KU8_MOTOR_CURRENT_AEC_CFG, ERH_KU8_MOTOR_BLOCKED_AEC_CFG, ERH_KU8_MOTOR_ORDER_AEC_CFG, ERH_KU8_MOTOR_IN_SC_AEC_CFG.");
  AddRequirementInfo("ARCH_SW_ERH_0151", "ECU level shall include the folowing storage conditions: •	SC1: Control DTC settings•	SC3: Local Voltage (KL30 input)•	SC11: Vehicle Startup.");
  AddRequirementInfo("ARCH_SW_ERH_0152", "Network Communication shall include the folowing storage conditions: •	SC1: Control DTC settings •	SC2: Ignition Status •	SC4: System Voltage •	SC5: Transportation mode •	SC8: Communication Status •	SC10: De-bounce Timer network •	SC11: Vehicle Startup •	SC12: production mode.");
  AddRequirementInfo("ARCH_SW_ERH_0153", "Network Communication - Timeout monitoring without Clamp 15 shall include the folowing storage conditions: •	SC1: Control DTC settings •	SC4: System Voltage •	SC5: Transportation mode •	SC8: Communication Status •	SC10: De-bounce Timer Network w/o KL15 •	SC11: Vehicle Startup •	SC12: production mode.");
  AddRequirementInfo("ARCH_SW_ERH_0154", "Power Distribution shall include the folowing storage conditions: •	SC1: Control DTC settings •	SC2: Ignition Status •	SC5: Transportation mode •	SC10: De-bounce Timer Power •	SC11: Vehicle Startup •	SC12: production mode.");
  //***************************************************************************************

  testCaseComment("Preconditions");
  testStep("STEP", "Bench Initialization");
  RunPreTs();
  
    
    debugger_reset();
    debugger_run();
  
    $PN14_TransMd_Stat_ST3.raw64             = I_C02_TRANSMD_STAT_OFF;                         
    $PN14_ProdMd_Stat_ST3.raw64              = I_C03_PN14_PRODMD_STAT_ST3_OFF;                 
    $PT4_PTCoor_EngStartPN14_Stat_ST3.raw64  = I_C03_ENGSTARTPN14_STAT_NO_COMBUSTIONSTART_RQ; 
  
  
    testStep("STEP", "Set a breakpoint in function ERH_runSetAecEvent() at line 'if ((ERH_u16StorageConditionStatus & KU16_ERH_MASK_ECU_LEVEL) == KU16_ERH_MASK_ECU_LEVEL)'.");
    debugger_setRelativeFunctionBpAtLine("ERH_runSetAecEvent", 45);
    
    testCaseComment("Action: ARCH_SW_ERH_0096, ARCH_SW_ERH_0151");
    testStep("STEP", "Check if CPU stopped in function ERH_runSetAecEvent() at line 'if ((ERH_u16StorageConditionStatus & KU16_ERH_MASK_ECU_LEVEL) == KU16_ERH_MASK_ECU_LEVEL)'.--> CPU stopped at BP");
    debugger_waitUntilBPisReached(1000);
  
  
    debugger_deleteAllBP();
  
  
    testStep("STEP", "Set a breakpoint in function ERH_runSetAecEvent() at line 'erh_ManageAECCommand(u8Command, u8Index, &stAecData);' under 'if ((ERH_u16StorageConditionStatus & KU16_ERH_MASK_ECU_LEVEL) == KU16_ERH_MASK_ECU_LEVEL)'.");
    debugger_setRelativeFunctionBpAtLine("ERH_runSetAecEvent", 53);
    
    debugger_run();

    testCaseComment("Action: ARCH_SW_ERH_0096, ARCH_SW_ERH_0151");
    testStep("STEP", "Check if CPU stopped in function ERH_runSetAecEvent() at line 'erh_ManageAECCommand(u8Command, u8Index, &stAecData);' under 'if ((ERH_u16StorageConditionStatus & KU16_ERH_MASK_ECU_LEVEL) == KU16_ERH_MASK_ECU_LEVEL)'.--> CPU stopped at BP");
    debugger_waitUntilBPisReached(1000);
    
  
    debugger_deleteAllBP();
  
  
    testStep("STEP", "Set a breakpoint in function ERH_runSetAecEvent() at line 'if ((ERH_u16StorageConditionStatus & KU16_ERH_MASK_POWER_DISTRIBUTION) == KU16_ERH_MASK_POWER_DISTRIBUTION)'.");
    debugger_setRelativeFunctionBpAtLine("ERH_runSetAecEvent", 45);
    
    debugger_run();

    testCaseComment("Action: ARCH_SW_ERH_0099, ARCH_SW_ERH_0154");
    testStep("STEP", "Check if CPU stopped in function ERH_runSetAecEvent() at line 'if ((ERH_u16StorageConditionStatus & KU16_ERH_MASK_POWER_DISTRIBUTION) == KU16_ERH_MASK_POWER_DISTRIBUTION)'.--> CPU stopped at BP");
    debugger_waitUntilBPisReached(1000);
  
  
    debugger_deleteAllBP();
  
  
    testStep("STEP", "Set a breakpoint in function ERH_runSetAecEvent() at line 'erh_ManageAECCommand(u8Command, u8Index, &stAecData);' under 'if ((ERH_u16StorageConditionStatus & KU16_ERH_MASK_POWER_DISTRIBUTION) == KU16_ERH_MASK_POWER_DISTRIBUTION)'.");
    debugger_setRelativeFunctionBpAtLine("ERH_runSetAecEvent", 53);
    
    debugger_run();

    testCaseComment("Action: ARCH_SW_ERH_0099, ARCH_SW_ERH_0154");
    testStep("STEP", "Check if CPU stopped in function ERH_runSetAecEvent() at line 'erh_ManageAECCommand(u8Command, u8Index, &stAecData);' under 'if ((ERH_u16StorageConditionStatus & KU16_ERH_MASK_POWER_DISTRIBUTION) == KU16_ERH_MASK_POWER_DISTRIBUTION)'.--> CPU stopped at BP");
    debugger_waitUntilBPisReached(1000);
  
  
    debugger_deleteAllBP();
  
  
    testStep("STEP", "Set a breakpoint in function ERH_runSetAecEvent() at line 'if( KU16_ERH_MASK_NETWORK_COM == (ERH_u16StorageConditionStatus & KU16_ERH_MASK_NETWORK_COM))'.");
    debugger_setRelativeFunctionBpAtLine("ERH_runSetAecEvent", 45);
    
    debugger_run();

    testCaseComment("Action: ARCH_SW_ERH_0097, ARCH_SW_ERH_0152");
    testStep("STEP", "Check if CPU stopped in function ERH_runSetAecEvent() at line 'if( KU16_ERH_MASK_NETWORK_COM == (ERH_u16StorageConditionStatus & KU16_ERH_MASK_NETWORK_COM))'.--> CPU stopped at BP");
    debugger_waitUntilBPisReached(1000);
  
  
    debugger_deleteAllBP();
  
  
    testStep("STEP", "Set a breakpoint in function ERH_runSetAecEvent() at line 'erh_ManageAECCommand(u8Command, u8Index, &stAecData);' under 'if( KU16_ERH_MASK_NETWORK_COM == (ERH_u16StorageConditionStatus & KU16_ERH_MASK_NETWORK_COM))'.");
    debugger_setRelativeFunctionBpAtLine("ERH_runSetAecEvent", 53);
    
    debugger_run();

    testCaseComment("Action: ARCH_SW_ERH_0097, ARCH_SW_ERH_0152");
    testStep("STEP", "Check if CPU stopped in function ERH_runSetAecEvent() at line 'erh_ManageAECCommand(u8Command, u8Index, &stAecData);' under 'if( KU16_ERH_MASK_NETWORK_COM == (ERH_u16StorageConditionStatus & KU16_ERH_MASK_NETWORK_COM))'.--> CPU stopped at BP");
    debugger_waitUntilBPisReached(1000);
  
  
    debugger_deleteAllBP();
  
  
    testStep("STEP", "Set a breakpoint in function ERH_runSetAecEvent() at line '((ERH_u16StorageConditionStatus & KU16_ERH_MASK_NETWORK_COM15) == KU16_ERH_MASK_NETWORK_COM15))'.");
    debugger_setRelativeFunctionBpAtLine("ERH_runSetAecEvent", 45);
    
    debugger_run();

    testCaseComment("Action: ARCH_SW_ERH_0098, ARCH_SW_ERH_0153");
    testStep("STEP", "Check if CPU stopped in function ERH_runSetAecEvent() at line '((ERH_u16StorageConditionStatus & KU16_ERH_MASK_NETWORK_COM15) == KU16_ERH_MASK_NETWORK_COM15))'.--> CPU stopped at BP");
    debugger_waitUntilBPisReached(1000);
  
  
    debugger_deleteAllBP();
  
  
    testStep("STEP", "Set a breakpoint in function ERH_runSetAecEvent() at line 'erh_ManageAECCommand(u8Command, u8Index, &stAecData);' under '((ERH_u16StorageConditionStatus & KU16_ERH_MASK_NETWORK_COM15) == KU16_ERH_MASK_NETWORK_COM15))'.");
    debugger_setRelativeFunctionBpAtLine("ERH_runSetAecEvent", 53);
    
    debugger_run();

    testCaseComment("Action: ARCH_SW_ERH_0098, ARCH_SW_ERH_0153");
    testStep("STEP", "Check if CPU stopped in function ERH_runSetAecEvent() at line 'erh_ManageAECCommand(u8Command, u8Index, &stAecData);' under '((ERH_u16StorageConditionStatus & KU16_ERH_MASK_NETWORK_COM15) == KU16_ERH_MASK_NETWORK_COM15))'.--> CPU stopped at BP");
    debugger_waitUntilBPisReached(1000);
  
  
    debugger_deleteAllBP();
  
  
    testStep("STEP", "Set a breakpoint in function ERH_runSetAecEvent() at line 'if( KU16_ERH_MASK_CONTROL_DTC == (uint16)(ERH_u16StorageConditionStatus & KU16_ERH_MASK_CONTROL_DTC) )'.");
    debugger_setRelativeFunctionBpAtLine("ERH_runSetAecEvent", 45);
    
    debugger_run();

    testCaseComment("Action: ARCH_SW_ERH_0150");
    testStep("STEP", "Check if CPU stopped in function ERH_runSetAecEvent() at line 'if( KU16_ERH_MASK_CONTROL_DTC == (uint16)(ERH_u16StorageConditionStatus & KU16_ERH_MASK_CONTROL_DTC) ))'.--> CPU stopped at BP");
    debugger_waitUntilBPisReached(1000);
  
  
    debugger_deleteAllBP();
  
  
    testStep("STEP", "Set a breakpoint in function ERH_runSetAecEvent() at line 'erh_ManageAECCommand(u8Command, u8Index, &stAecData);' under 'if( KU16_ERH_MASK_CONTROL_DTC == (uint16)(ERH_u16StorageConditionStatus & KU16_ERH_MASK_CONTROL_DTC) )'.");
    debugger_setRelativeFunctionBpAtLine("ERH_runSetAecEvent", 53);
    
    debugger_run();

    testCaseComment("Action: ARCH_SW_ERH_0150");
    testStep("STEP", "Check if CPU stopped in function ERH_runSetAecEvent() at line 'erh_ManageAECCommand(u8Command, u8Index, &stAecData);' under 'if( KU16_ERH_MASK_CONTROL_DTC == (uint16)(ERH_u16StorageConditionStatus & KU16_ERH_MASK_CONTROL_DTC) )'.--> CPU stopped at BP");
    debugger_waitUntilBPisReached(1000);
  
  
  testCaseComment("Postcondition");
  testStep("STEP", "Return ECU to default values");
  RunPostTs();
}


testcase SW_IT_ERH_IgnitionCycle_01()
{
  //***********************************Test report header*********************************
  testReportAddMiscInfoBlock("AUTOLIV ELECTRONICS document");
  TestReportAddMiscInfo("Nightly test", "No");
  TestReportAddMiscInfo("Test type", "Requirement-Based test");
  TestReportAddMiscInfo("Regression Test", "No");
  TestReportAddMiscInfo("Fault injection method used", "No");
  TestReportAddMiscInfo("Resource usage evaluation", "No");
  TestReportAddMiscInfo("Priority", "No");
  TestReportAddMiscInfo("Safety relevant", "No");
  
  AddRequirementInfo("Requirement under test", "ARCH_SW_ERH_0093, ARCH_SW_ERH_0094, ARCH_SW_ERH_0095");
  AddRequirementInfo("ARCH_SW_ERH_0093", "The ERH component shall be able to manage a 10s delay in order to enable the start of a DEM Ignition Cycle.");
  AddRequirementInfo("ARCH_SW_ERH_0094", "Transition from  'Ignition off' to 'Ignition on' shall start the delay timer. Status of Ignition signal is get through RTE(Rte_Read_ERH_AC_ErrorHandler_prrIgnitionStatus_b8TriggerIgnitionStatus) interface from CIL module.");
  AddRequirementInfo("ARCH_SW_ERH_0095", "Transition from  'Ignition off' to 'Ignition on' shall start the delay timer. Status of Ignition signal is get through RTE(Rte_Read_ERH_AC_ErrorHandler_prrIgnitionStatus_b8TriggerIgnitionStatus) interface from CIL module.");
 //***************************************************************************************

  testCaseComment("Preconditions");
  testStep("STEP", "Bench Initialization");
  RunPreTs();
  
  
    testStep("STEP", "Set a breakpoint in function CIL_runCANToAppli() at line 'Rte_Write_psrIgnitionStatus_b8TriggerIgnitionStatusEnableStorageCondition(KU8_TRUE);'.");
    debugger_setRelativeFunctionBpAtLine("CIL_runCANToAppli", 28);
       
    debugger_reset();
    debugger_run();
    
    testCaseComment("Action: ARCH_SW_ERH_0094, ARCH_SW_ERH_0095");
    testStep("STEP", "Check if CPU stopped in function CIL_runCANToAppli() at line 'Rte_Write_psrIgnitionStatus_b8TriggerIgnitionStatusEnableStorageCondition(KU8_TRUE);'.--> CPU stopped at BP");
    debugger_waitUntilBPisReached(1000);
  
  
    debugger_deleteAllBP();
  
  
    testStep("STEP", "Set a breakpoint in function ERH_cyclic() at line '(void)Rte_Read_prrIgnitionStatus_b8TriggerIgnitionStatus(&u8IgnitionStatus);'.");
    debugger_setRelativeFunctionBpAtLine("ERH_cyclic", 52);
       
    debugger_run();
    
    testCaseComment("Action: ARCH_SW_ERH_0093, ARCH_SW_ERH_0094, ARCH_SW_ERH_0095");
    testStep("STEP", "Check if CPU stopped in function ERH_cyclic() at line '(void)Rte_Read_prrIgnitionStatus_b8TriggerIgnitionStatus(&u8IgnitionStatus);'.--> CPU stopped at BP");
    debugger_waitUntilBPisReached(1000);
  
    testStep("STEP", "Set a variable Rte_CIL_psrIgnitionStatus_b8TriggerIgnitionStatus to KU8_TRUE'.");
    debugger_writeGlobalVariable("uint8", "Rte_CIL_psrIgnitionStatus_b8TriggerIgnitionStatus,,app.elf", 0, 0xAA);
  
  
    debugger_deleteAllBP();
  
  
    testStep("STEP", "Set a breakpoint in function ERH_cyclic() at line 'erh_u16DebounceCounter++;'.");
    debugger_setRelativeFunctionBpAtLine("ERH_cyclic", 60);
    
    debugger_run();

    testStep("STEP", "Check if CPU stopped in function ERH_cyclic() at line 'erh_u16DebounceCounter++;'.--> CPU stopped at BP");
    debugger_waitUntilBPisReached(1000);
  
    
    debugger_deleteAllBP();
  
  
    testStep("STEP", "Set a breakpoint in function ERH_cyclic() at line '(void)Dem_SetOperationCycleState(DemConf_DemOperationCycle_IgnitionCycle, DEM_CYCLE_STATE_START);'.");
    debugger_setRelativeFunctionBpAtLine("ERH_cyclic", 62);
    
    debugger_run();

    testCaseComment("Action: ARCH_SW_ERH_0093, ARCH_SW_ERH_0094, ARCH_SW_ERH_0095");
    testStep("STEP", "Check if CPU stopped in function ERH_cyclic() at line '(void)Dem_SetOperationCycleState(DemConf_DemOperationCycle_IgnitionCycle, DEM_CYCLE_STATE_START);'.--> CPU stopped at BP");
    debugger_waitUntilBPisReached(1000);
  
  
  testCaseComment("Postcondition");
  testStep("STEP", "Return ECU to default values");
  RunPostTs();
}


testcase SW_IT_ERH_HW_SELF_PROTECTION_01()
{
  //***********************************Test report header*********************************
  testReportAddMiscInfoBlock("AUTOLIV ELECTRONICS document");
  TestReportAddMiscInfo("Nightly test", "No");
  TestReportAddMiscInfo("Test type", "Requirement-Based test");
  TestReportAddMiscInfo("Regression Test", "No");
  TestReportAddMiscInfo("Fault injection method used", "No");
  TestReportAddMiscInfo("Resource usage evaluation", "No");
  TestReportAddMiscInfo("Priority", "No");
  TestReportAddMiscInfo("Safety relevant", "No");
  
  AddRequirementInfo("Requirement under test", "ARCH_SW_ERH_0001, ARCH_SW_ERH_0006, ARCH_SW_ERH_0018");
  AddRequirementInfo("ARCH_SW_ERH_0001", "The AEC ERH_KU8_HW_SELF_PROTECTION_AEC_CFG shall be defined as a Counter based AEC, with the following parameters: qualification time: 1200ms; deskill time: 60000ms; associated group: KU32_AEC_GROUP_MASK_SELF_PROTECTION;");
  AddRequirementInfo("ARCH_SW_ERH_0006", "The AEC ERH_KU8_HW_SELF_PROTECTION_AEC_CFG shall be defined as a Counter based AEC, with the following parameters: qualification count: 1; deskill count: 1; associated group: KU32_AEC_GROUP_MASK_SELF_PROTECTION;");
  AddRequirementInfo("ARCH_SW_ERH_0018", "The AEC ERH_KU8_HIGH_SIDE_SWITCH_AEC_CFG shall be defined as a Counter based AEC, with the following parameters:- qualification time: instantaneously;- deskill time: 1 (shall be deskilled even after reset to recheck the fault situation);- associated group: KU32_AEC_GROUP_MASK_HARDWARE");
 //***************************************************************************************

  testCaseComment("Preconditions");
  testStep("STEP", "Bench Initialization");
  RunPreTs();
  
  
    testStep("STEP", "Set a breakpoint in function ERH_Init() at line 'erh_au16AecCounter[u8Index] = KU16_ZERO;'.");
    debugger_setRelativeFunctionBpAtLine("ERH_Init", 19);
       
    debugger_reset();
    debugger_run();
    
    testStep("STEP", "Check if CPU stopped in function ERH_Init() at line 'erh_au16AecCounter[u8Index] = KU16_ZERO;'.");
    debugger_waitUntilBPisReached(500);
  
    
    debugger_deleteAllBP();
  
  
    testStep("STEP", "Set a breakpoint in ERH_Init() at the end of the function.");
    debugger_setRelativeFunctionBpAtLine("ERH_Init", 65);
    
    debugger_run();
    testWaitForTimeoutSilent(500);

    testCaseComment("Action: ARCH_SW_ERH_0001, ARCH_SW_ERH_0006, ARCH_SW_ERH_0018");
    testStep("STEP", "Evaluate if erh_au16AecCounter[u8Index], where u8Index is ATM_KU8_ID_TEST_DRIVER_SELF_PROTECTION, is equal to KU16_ZERO. --> erh_au16AecCounter[u8Index] == KU16_ZERO");
    result = debugger_readGlobalVariable("uint16", "erh_au16AecCounter,,app.elf", 0x06);
    EvalManStepEqual("Expected test result", result, KU16_ZERO);
 
    
    debugger_deleteAllBP();
    debugger_reset();
  
        
    testStep("STEP", "Set a breakpoint in function PAL_Autotest_CheckHWSelfProtection() at line '*pu8TestResult = pal_u8ResultOfAutoTest;'.");
    debugger_setRelativeFunctionBpAtLine("PAL_Autotest_CheckHWSelfProtection", 37);
    
    debugger_run();
    
    testStep("STEP", "Check if CPU stopped in function PAL_Autotest_CheckHWSelfProtection() at line '*pu8TestResult = pal_u8ResultOfAutoTest;'.");
    debugger_waitUntilBPisReached(500);
  
    
    testStep("STEP", "Set variable *pu8TestResult to KU8_ATM_TEST_NOK.");
    debugger_writeLocalVariable("*pu8TestResult", 0x02);
    testWaitForTimeoutSilent(1000);


    debugger_deleteAllBP();
  
            
    testStep("STEP", "Set a breakpoint in function erh_ManageFailedCounterEvent() at line 'erh_au16AecCounter[cu8Index] += KU16_ONE;'.");
    debugger_setRelativeFunctionBpAtLine("erh_ManageFailedCounterEvent", 30);
    
    debugger_run();
    
    testStep("STEP", "Check if CPU stopped in function erh_ManageFailedCounterEvent() at line 'erh_au16AecCounter[cu8Index] += KU16_ONE;'.");
    debugger_waitUntilBPisReached(500);
  
    debugger_stepOver();
    
    testCaseComment("Action: ARCH_SW_ERH_0001, ARCH_SW_ERH_0006, ARCH_SW_ERH_0018");
    testStep("STEP", "Evaluate if erh_au16AecCounter[u8Index], where u8Index is ATM_KU8_ID_TEST_DRIVER_SELF_PROTECTION, is equal to KU16_ONE. --> erh_au16AecCounter[u8Index] == KU16_ONE");
    result = debugger_readGlobalVariable("uint16", "erh_au16AecCounter,,app.elf", 0x06);
    EvalManStepEqual("Expected test result",  result, KU16_ONE);
  
  
  testCaseComment("Postcondition");
  testStep("STEP", "Return ECU to default values");
  RunPostTs();
}



testcase SW_IT_ERH_SPI_ERROR_01()
{
  //***********************************Test report header*********************************
  testReportAddMiscInfoBlock("AUTOLIV ELECTRONICS document");
  TestReportAddMiscInfo("Nightly test", "No");
  TestReportAddMiscInfo("Test type", "Requirement-Based test");
  TestReportAddMiscInfo("Regression Test", "No");
  TestReportAddMiscInfo("Fault injection method used", "No");
  TestReportAddMiscInfo("Resource usage evaluation", "No");
  TestReportAddMiscInfo("Priority", "No");
  TestReportAddMiscInfo("Safety relevant", "No");
  
  AddRequirementInfo("Requirement under test", "ARCH_SW_ERH_0157");
  AddRequirementInfo("ARCH_SW_ERH_0157", "The ERH_KU8_SPI_ERROR_AEC_CFG should have the following properties: ? Qualification Count =1; ? Deskill Count = 1;.");
  //***************************************************************************************

  testCaseComment("Preconditions");
  testStep("STEP", "Bench Initialization");
  RunPreTs();
  
  
    testStep("STEP", "Set a breakpoint in function ERH_Init() at line 'erh_au16AecCounter[u8Index] = KU16_ZERO;'.");
    debugger_setRelativeFunctionBpAtLine("ERH_Init", 19);
       
    debugger_reset();
    debugger_run();
    
    testStep("STEP", "Check if CPU stopped in function ERH_Init() at line 'erh_au16AecCounter[u8Index] = KU16_ZERO;'.");
    debugger_waitUntilBPisReached(500);
  
    
    debugger_deleteAllBP();
  
  
    testStep("STEP", "Set a breakpoint in ERH_Init() at the end of the function.");
    debugger_setRelativeFunctionBpAtLine("ERH_Init", 65);
    
    debugger_run();
    testWaitForTimeoutSilent(500);

    testCaseComment("Action: ARCH_SW_ERH_0157");
    testStep("STEP", "Evaluate if erh_au16AecCounter[u8Index], where u8Index is ATM_KU8_ID_SPI_ERROR, is equal to KU16_ZERO. --> erh_au16AecCounter[u8Index] == KU16_ZERO");
    result = debugger_readGlobalVariable("uint16", "erh_au16AecCounter,,app.elf", 0x08);
    EvalManStepEqual("Expected test result", result, KU16_ZERO);
 
    
    debugger_deleteAllBP();
    debugger_reset();
  
        
    testStep("STEP", "Set a breakpoint in function SBC_ServiceAutotest_GetTestResult() at line '*pu8TestResult = pal_u8ResultOfAutoTest;'.");
    debugger_setRelativeFunctionBpAtLine("SBC_ServiceAutotest_GetTestResult", 1);
    
    debugger_run();
    
    testStep("STEP", "Check if CPU stopped in function SBC_ServiceAutotest_GetTestResult() at line '*pu8TestResult = pal_u8ResultOfAutoTest;'.");
    debugger_waitUntilBPisReached(10000);
  
    
    testStep("STEP", "Set variable *pu8TestResult to KU8_ATM_TEST_NOK.");
    debugger_writeLocalVariable("*pu8TestResult", 0x02);
    testWaitForTimeoutSilent(2000);


    debugger_deleteAllBP();
  
            
    testStep("STEP", "Set a breakpoint in function erh_ManageFailedCounterEvent() at line 'erh_au16AecCounter[cu8Index] += KU16_ONE;'.");
    debugger_setRelativeFunctionBpAtLine("erh_ManageFailedCounterEvent", 30);
    
    debugger_run();
    
    testCaseComment("Action: ARCH_SW_ERH_0157");
    testStep("STEP", "Check if CPU stopped in function erh_ManageFailedCounterEvent() at line 'erh_au16AecCounter[cu8Index] += KU16_ONE;'.");
    debugger_waitUntilBPisReached(500);
  
    debugger_stepOver();
    
    testCaseComment("Action: ARCH_SW_ERH_0157");
    testStep("STEP", "Evaluate if erh_au16AecCounter[u8Index], where u8Index is ATM_KU8_ID_SPI_ERROR, is equal to KU16_ONE. --> erh_au16AecCounter[u8Index] == KU16_ONE");
    result = debugger_readGlobalVariable("uint16", "erh_au16AecCounter,,app.elf", 0x08);
    EvalManStepEqual("Expected test result",  result, KU16_ONE);
  
  
  testCaseComment("Postcondition");
  testStep("STEP", "Return ECU to default values");
  RunPostTs();
}


testcase SW_IT_ERH_MOTOR_DISCONNECTED_01()
{
  //***********************************Test report header*********************************
  testReportAddMiscInfoBlock("AUTOLIV ELECTRONICS document");
  TestReportAddMiscInfo("Nightly test", "No");
  TestReportAddMiscInfo("Test type", "Requirement-Based test");
  TestReportAddMiscInfo("Regression Test", "No");
  TestReportAddMiscInfo("Fault injection method used", "No");
  TestReportAddMiscInfo("Resource usage evaluation", "No");
  TestReportAddMiscInfo("Priority", "No");
  TestReportAddMiscInfo("Safety relevant", "No");
  
  AddRequirementInfo("Requirement under test", "ARCH_SW_ERH_0004");
  AddRequirementInfo("ARCH_SW_ERH_0004", "The AEC ERH_KU8_MOTOR_DISCONNECTED_AEC_CFG shall be defined as a Counter based AEC, with the following parameters:- qualification count: 50;- deskill count: 1;- associated group: KU32_AEC_GROUP_MASK_MOTOR");
  //***************************************************************************************

  testCaseComment("Preconditions");
  testStep("STEP", "Bench Initialization");
  RunPreTs();
  
  
    testStep("STEP", "Set a breakpoint in function ERH_Init() at line 'erh_au16AecCounter[u8Index] = KU16_ZERO;'.");
    debugger_setRelativeFunctionBpAtLine("ERH_Init", 19);
       
    debugger_reset();
    debugger_run();
    
    testStep("STEP", "Check if CPU stopped in function ERH_Init() at line 'erh_au16AecCounter[u8Index] = KU16_ZERO;'.");
    debugger_waitUntilBPisReached(500);
  
    
    debugger_deleteAllBP();
  
  
    testStep("STEP", "Set a breakpoint in ERH_Init() at the end of the function.");
    debugger_setRelativeFunctionBpAtLine("ERH_Init", 65);
    
    debugger_run();
    testWaitForTimeoutSilent(500);

    testCaseComment("Action: ARCH_SW_ERH_0004");
    testStep("STEP", "Evaluate if erh_au16AecCounter[u8Index], where u8Index is ATM_KU8_ID_TEST_MOTOR_DISCONNECTION, is equal to KU16_ZERO. --> erh_au16AecCounter[u8Index] == KU16_ZERO");
    result = debugger_readGlobalVariable("uint16", "erh_au16AecCounter,,app.elf", 0x05);
    EvalManStepEqual("Expected test result", result, KU16_ZERO);
 
    
    debugger_deleteAllBP();
    debugger_reset();
  
        
    testStep("STEP", "Set a breakpoint in function PAL_Autotest_CheckMotorConnection() at line '*pu8TestResult = pal_u8ResultOfAutoTest;'.");
    debugger_setRelativeFunctionBpAtLine("PAL_Autotest_CheckMotorConnection", 98);
    
    debugger_run();
    
    testStep("STEP", "Check if CPU stopped in function PAL_Autotest_CheckMotorConnection() at line '*pu8TestResult = pal_u8ResultOfAutoTest;'.");
    debugger_waitUntilBPisReached(10000);
  
    
    testStep("STEP", "Set variable *pu8TestResult to KU8_ATM_TEST_NOK.");
    debugger_writeLocalVariable("*pu8TestResult", 0x02);
    testWaitForTimeoutSilent(2000);


    debugger_deleteAllBP();
  
            
    testStep("STEP", "Set a breakpoint in function erh_ManageFailedCounterEvent() at line 'erh_au16AecCounter[cu8Index] += KU16_ONE;'.");
    debugger_setRelativeFunctionBpAtLine("erh_ManageFailedCounterEvent", 30);
    
    debugger_run();
    
    testCaseComment("Action: ARCH_SW_ERH_0004");
    testStep("STEP", "Check if CPU stopped in function erh_ManageFailedCounterEvent() at line 'erh_au16AecCounter[cu8Index] += KU16_ONE;'.");
    debugger_waitUntilBPisReached(500);
  
    debugger_stepOver();
    
    testCaseComment("Action: ARCH_SW_ERH_0004");
    testStep("STEP", "Evaluate if erh_au16AecCounter[u8Index], where u8Index is ATM_KU8_ID_TEST_MOTOR_DISCONNECTION, is equal to KU16_ONE. --> erh_au16AecCounter[u8Index] == KU16_ONE");
    result = debugger_readGlobalVariable("uint16", "erh_au16AecCounter,,app.elf", 0x05);
    EvalManStepEqual("Expected test result",  result, KU16_ONE);
  
  
  testCaseComment("Postcondition");
  testStep("STEP", "Return ECU to default values");
  RunPostTs();
}



testcase SW_IT_ERH_OVO_POWER_01()
{
  //***********************************Test report header*********************************
  testReportAddMiscInfoBlock("AUTOLIV ELECTRONICS document");
  TestReportAddMiscInfo("Nightly test", "No");
  TestReportAddMiscInfo("Test type", "Requirement-Based test");
  TestReportAddMiscInfo("Regression Test", "No");
  TestReportAddMiscInfo("Fault injection method used", "No");
  TestReportAddMiscInfo("Resource usage evaluation", "No");
  TestReportAddMiscInfo("Priority", "No");
  TestReportAddMiscInfo("Safety relevant", "No");
  
  AddRequirementInfo("Requirement under test", "ARCH_SW_ERH_0008");
  AddRequirementInfo("ARCH_SW_ERH_0008", "The AEC ERH_KU8_OVO_POWER_AEC_CFG shall be defined as a Counter based AEC, with the following parameters:- qualification time: 150s;- deskill time:  15s;- associated group: KU32_AEC_GROUP_MASK_OVER_VO");
  //***************************************************************************************

  testCaseComment("Preconditions");
  testStep("STEP", "Bench Initialization");
  RunPreTs();
  
  
    testStep("STEP", "Set a breakpoint in function ERH_Init() at line 'erh_au16AecCounter[u8Index] = KU16_ZERO;'.");
    debugger_setRelativeFunctionBpAtLine("ERH_Init", 19);
       
    debugger_reset();
    debugger_run();
    
    testStep("STEP", "Check if CPU stopped in function ERH_Init() at line 'erh_au16AecCounter[u8Index] = KU16_ZERO;'.");
    debugger_waitUntilBPisReached(500);
  
    
    debugger_deleteAllBP();
  
  
    testStep("STEP", "Set a breakpoint in ERH_Init() at the end of the function.");
    debugger_setRelativeFunctionBpAtLine("ERH_Init", 65);
    
    debugger_run();
    testWaitForTimeoutSilent(500);

    testCaseComment("Action: ARCH_SW_ERH_0008");
    testStep("STEP", "Evaluate if erh_au16AecCounter[u8Index], where u8Index is ATM_KU8_ID_TEST_OVER_VOLTAGE_POWER, is equal to KU16_ZERO. --> erh_au16AecCounter[u8Index] == KU16_ZERO");
    result = debugger_readGlobalVariable("uint16", "erh_au16AecCounter,,app.elf", 0x11);
    EvalManStepEqual("Expected test result", result, KU16_ZERO);
 
    
    debugger_deleteAllBP();
    debugger_reset();
    debugger_run();
  
    
    SetVoltage(17);
    testWaitForTimeoutSilent(3000);
  
    testStep("STEP", "Set a breakpoint in function PMP_Autotest_CheckPowerSupplyOV() at line '*pu8TestResult = pal_u8ResultOfAutoTest;'.");
    debugger_setRelativeFunctionBpAtLine("PMP_Autotest_CheckPowerSupplyOV", 71);
    
    debugger_run();
    
    testStep("STEP", "Check if CPU stopped in function PMP_Autotest_CheckPowerSupplyOV() at line '*pu8TestResult = pal_u8ResultOfAutoTest;'.");
    debugger_waitUntilBPisReached(5000);
  
    
    testStep("STEP", "Check if variable *pu8TestResult is KU8_ATM_TEST_NOK.");
    result = debugger_readGlobalVariable("uint16", "erh_au16AecCounter,,app.elf", 0x11);
    EvalManStepEqual("Expected test result", result, 0x02);


    debugger_deleteAllBP();
  
            
    testStep("STEP", "Set a breakpoint in function erh_ManageFailedCounterEvent() at line 'erh_au16AecCounter[cu8Index] += KU16_ONE;'.");
    debugger_setRelativeFunctionBpAtLine("erh_ManageFailedCounterEvent", 60);
    
    debugger_run();
    
    testStep("STEP", "Check if CPU stopped in function erh_ManageFailedCounterEvent() at line 'erh_au16AecCounter[cu8Index] += KU16_ONE;'.");
    debugger_waitUntilBPisReached(5000);
  
    debugger_stepOver();
    
    testCaseComment("Action: ARCH_SW_ERH_0008");
    testStep("STEP", "Evaluate if erh_au16AecCounter[u8Index], where u8Index is ATM_KU8_ID_TEST_OVER_VOLTAGE_POWER, is equal to KU16_ONE. --> erh_au16AecCounter[u8Index] == KU16_ONE");
    result = debugger_readGlobalVariable("uint16", "erh_au16AecCounter,,app.elf", 0x11);
    EvalManStepEqual("Expected test result", result, KU16_ONE);
    
    SetVoltage(13);
  
  testCaseComment("Postcondition");
  testStep("STEP", "Return ECU to default values");
  RunPostTs();
}



testcase SW_IT_ERH_UVO_POWER_01()
{
  //***********************************Test report header*********************************
  testReportAddMiscInfoBlock("AUTOLIV ELECTRONICS document");
  TestReportAddMiscInfo("Nightly test", "No");
  TestReportAddMiscInfo("Test type", "Requirement-Based test");
  TestReportAddMiscInfo("Regression Test", "No");
  TestReportAddMiscInfo("Fault injection method used", "No");
  TestReportAddMiscInfo("Resource usage evaluation", "No");
  TestReportAddMiscInfo("Priority", "No");
  TestReportAddMiscInfo("Safety relevant", "No");
  
  AddRequirementInfo("Requirement under test", "ARCH_SW_ERH_0010");
  AddRequirementInfo("ARCH_SW_ERH_0010", "The AEC ERH_KU8_UVO_POWER_AEC_CFG  shall be defined as a Counter based AEC, with the following parameters:- qualification time: 15s;- deskill time: 150s;- associated group: KU32_AEC_GROUP_MASK_UNDER_VO;");
  //***************************************************************************************

  testCaseComment("Preconditions");
  testStep("STEP", "Bench Initialization");
  RunPreTs();
  
  
    testStep("STEP", "Set a breakpoint in function ERH_Init() at line 'erh_au16AecCounter[u8Index] = KU16_ZERO;'.");
    debugger_setRelativeFunctionBpAtLine("ERH_Init", 19);
       
    debugger_reset();
    debugger_run();
    
    testStep("STEP", "Check if CPU stopped in function ERH_Init() at line 'erh_au16AecCounter[u8Index] = KU16_ZERO;'.");
    debugger_waitUntilBPisReached(500);
  
    
    debugger_deleteAllBP();
  
  
    testStep("STEP", "Set a breakpoint in ERH_Init() at the end of the function.");
    debugger_setRelativeFunctionBpAtLine("ERH_Init", 65);
    
    debugger_run();
    testWaitForTimeoutSilent(500);

    testCaseComment("Action: ARCH_SW_ERH_0010");
    testStep("STEP", "Evaluate if erh_au16AecCounter[u8Index], where u8Index is ATM_KU8_ID_TEST_UNDER_VOLTAGE_POWER, is equal to KU16_ZERO. --> erh_au16AecCounter[u8Index] == KU16_ZERO");
    result = debugger_readGlobalVariable("uint16", "erh_au16AecCounter,,app.elf", 0x10);
    EvalManStepEqual("Expected test result", result, KU16_ZERO);
 
    
    debugger_deleteAllBP();
    debugger_reset();
  
  
    SetVoltage(7);
    testWaitForTimeoutSilent(3000);
        
  
    testStep("STEP", "Set a breakpoint in function PMP_cbk_CheckPowerSupplyUV() at line '*pu8TestResult = pal_u8ResultOfAutoTest;'.");
    debugger_setRelativeFunctionBpAtLine("PMP_cbk_CheckPowerSupplyUV", 71);
    
    debugger_run();
    
    testStep("STEP", "Check if CPU stopped in function PMP_cbk_CheckPowerSupplyUV() at line '*pu8TestResult = pal_u8ResultOfAutoTest;'.");
    debugger_waitUntilBPisReached(500);
  
    
    testStep("STEP", "Check if variable *pu8TestResult is KU8_ATM_TEST_NOK.");
    result = debugger_readGlobalVariable("uint16", "erh_au16AecCounter,,app.elf", 0x10);
    EvalManStepEqual("Expected test result", result, 0x02);


    debugger_deleteAllBP();
  
            
    testStep("STEP", "Set a breakpoint in function erh_ManageFailedCounterEvent() at line 'erh_au16AecCounter[cu8Index] += KU16_ONE;'.");
    debugger_setRelativeFunctionBpAtLine("erh_ManageFailedCounterEvent", 60);
    
    debugger_run();
    
    testStep("STEP", "Check if CPU stopped in function erh_ManageFailedCounterEvent() at line 'erh_au16AecCounter[cu8Index] += KU16_ONE;'.");
    debugger_waitUntilBPisReached(500);
  
    debugger_stepOver();
    
    testCaseComment("Action: ARCH_SW_ERH_0010");
    testStep("STEP", "Evaluate if erh_au16AecCounter[u8Index], where u8Index is ATM_KU8_ID_TEST_UNDER_VOLTAGE_POWER, is equal to KU16_ONE. --> erh_au16AecCounter[u8Index] == KU16_ONE");
    result = debugger_readGlobalVariable("uint16", "erh_au16AecCounter,,app.elf", 0x10);
    EvalManStepEqual("Expected test result", result, KU16_ONE);
  
  
    SetVoltage(13);
  
  testCaseComment("Postcondition");
  testStep("STEP", "Return ECU to default values");
  RunPostTs();
}


testcase SW_IT_ERH_UVO_TENSIONING_POWER_01()
{
  //***********************************Test report header*********************************
  testReportAddMiscInfoBlock("AUTOLIV ELECTRONICS document");
  TestReportAddMiscInfo("Nightly test", "No");
  TestReportAddMiscInfo("Test type", "Requirement-Based test");
  TestReportAddMiscInfo("Regression Test", "No");
  TestReportAddMiscInfo("Fault injection method used", "No");
  TestReportAddMiscInfo("Resource usage evaluation", "No");
  TestReportAddMiscInfo("Priority", "No");
  TestReportAddMiscInfo("Safety relevant", "No");
  
  AddRequirementInfo("Requirement under test", "ARCH_SW_ERH_0012, ARCH_SW_ERH_0014");
  AddRequirementInfo("ARCH_SW_ERH_0012", "The AEC ERH_KU8_UVO_TENSIONING_POWER_AEC_CFG shall be defined as a Counter based AEC, with the following parameters:- qualification time: 30ms;- deskill time: 30ms;- associated group: KU32_AEC_GROUP_MASK_UNDER_VO_TENS");
  AddRequirementInfo("ARCH_SW_ERH_0014", "The AEC ERH_KU8_UVO_TENSIONING_POWER_AEC_CFG shall be defined as a Counter based AEC, with the following parameters:- qualification time: 30ms;- deskill time: 30ms;- associated group: KU32_AEC_GROUP_MASK_OVER_VO_TENS");
 //***************************************************************************************

  testCaseComment("Preconditions");
  testStep("STEP", "Bench Initialization");
  RunPreTs();
  
  
    testStep("STEP", "Set a breakpoint in function ERH_Init() at line 'erh_au16AecCounter[u8Index] = KU16_ZERO;'.");
    debugger_setRelativeFunctionBpAtLine("ERH_Init", 19);
       
    debugger_reset();
    debugger_run();
    
    testStep("STEP", "Check if CPU stopped in function ERH_Init() at line 'erh_au16AecCounter[u8Index] = KU16_ZERO;'.");
    debugger_waitUntilBPisReached(500);
  
    
    debugger_deleteAllBP();
  
  
    testStep("STEP", "Set a breakpoint in ERH_Init() at the end of the function.");
    debugger_setRelativeFunctionBpAtLine("ERH_Init", 65);
    
    debugger_run();
    testWaitForTimeoutSilent(500);

    testCaseComment("Action: ARCH_SW_ERH_0012, ARCH_SW_ERH_0014");
    testStep("STEP", "Evaluate if erh_au16AecCounter[u8Index], where u8Index is ATM_KU8_ID_TEST_UNDER_VOLTAGE_TENSIONING_POWER, is equal to KU16_ZERO. --> erh_au16AecCounter[u8Index] == KU16_ZERO");
    result = debugger_readGlobalVariable("uint16", "erh_au16AecCounter,,app.elf", 0x12);
    EvalManStepEqual("Expected test result", result, KU16_ZERO);
 
    
    debugger_deleteAllBP();
    debugger_reset();
  
        
    testStep("STEP", "Set a breakpoint in function PMP_Autotest_CheckPowerSupplyUVDuringActivation() at line '*pu8TestResult = pal_u8ResultOfAutoTest;'.");
    debugger_setRelativeFunctionBpAtLine("PMP_Autotest_CheckPowerSupplyUVDuringActivation", 129);
    
    debugger_run();
    
    testStep("STEP", "Check if CPU stopped in function PMP_Autotest_CheckPowerSupplyUVDuringActivation() at line '*pu8TestResult = pal_u8ResultOfAutoTest;'.");
    debugger_waitUntilBPisReached(5000);
  
    
    testStep("STEP", "Set variable *pu8TestResult to KU8_ATM_TEST_NOK.");
    debugger_writeLocalVariable("*pu8TestResult", 0x02);
    testWaitForTimeoutSilent(2000);


    debugger_deleteAllBP();
  
            
    testStep("STEP", "Set a breakpoint in function erh_ManageFailedCounterEvent() at line 'erh_au16AecCounter[cu8Index] += KU16_ONE;'.");
    debugger_setRelativeFunctionBpAtLine("erh_ManageFailedCounterEvent", 60);
    
    debugger_run();
    
    testStep("STEP", "Check if CPU stopped in function erh_ManageFailedCounterEvent() at line 'erh_au16AecCounter[cu8Index] += KU16_ONE;'.");
    debugger_waitUntilBPisReached(500);
  
    debugger_stepOver();
    
    testCaseComment("Action: ARCH_SW_ERH_0012, ARCH_SW_ERH_0014");
    testStep("STEP", "Evaluate if erh_au16AecCounter[u8Index], where u8Index is ATM_KU8_ID_TEST_UNDER_VOLTAGE_TENSIONING_POWER, is equal to KU16_ONE. --> erh_au16AecCounter[u8Index] == KU16_ONE");
    result = debugger_readGlobalVariable("uint16", "erh_au16AecCounter,,app.elf", 0x12);
    EvalManStepEqual("Expected test result", KU16_ONE, KU16_ONE);
  
  
  testCaseComment("Postcondition");
  testStep("STEP", "Return ECU to default values");
  RunPostTs();
}


testcase SW_IT_ERH_PWM_ORDER_01()
{
  //***********************************Test report header*********************************
  testReportAddMiscInfoBlock("AUTOLIV ELECTRONICS document");
  TestReportAddMiscInfo("Nightly test", "No");
  TestReportAddMiscInfo("Test type", "Requirement-Based test");
  TestReportAddMiscInfo("Regression Test", "No");
  TestReportAddMiscInfo("Fault injection method used", "No");
  TestReportAddMiscInfo("Resource usage evaluation", "No");
  TestReportAddMiscInfo("Priority", "No");
  TestReportAddMiscInfo("Safety relevant", "No");
  
  AddRequirementInfo("Requirement under test", "ARCH_SW_ERH_0016");
  AddRequirementInfo("ARCH_SW_ERH_0016", "The AEC ERH_KU8_PWM_ORDER_AEC_CFG shall be defined as a Counter based AEC, with the following parameters:- qualification time: instantaneously;- deskill time: instantaneously;- associated group: KU32_AEC_GROUP_MASK_MOTOR");
 //***************************************************************************************

  testCaseComment("Preconditions");
  testStep("STEP", "Bench Initialization");
  RunPreTs();
  
  
    testStep("STEP", "Set a breakpoint in function ERH_Init() at line 'erh_au16AecCounter[u8Index] = KU16_ZERO;'.");
    debugger_setRelativeFunctionBpAtLine("ERH_Init", 19);
       
    debugger_reset();
    debugger_run();
    
    testStep("STEP", "Check if CPU stopped in function ERH_Init() at line 'erh_au16AecCounter[u8Index] = KU16_ZERO;'.");
    debugger_waitUntilBPisReached(500);
  
    
    debugger_deleteAllBP();
  
  
    testStep("STEP", "Set a breakpoint in ERH_Init() at the end of the function.");
    debugger_setRelativeFunctionBpAtLine("ERH_Init", 65);
    
    debugger_run();
    testWaitForTimeoutSilent(500);

    testCaseComment("Action: ARCH_SW_ERH_0016");
    testStep("STEP", "Evaluate if erh_au16AecCounter[u8Index], where u8Index is ATM_KU8_ID_TEST_PWM_ORDER, is equal to KU16_ZERO. --> erh_au16AecCounter[u8Index] == KU16_ZERO");
    result = debugger_readGlobalVariable("uint16", "erh_au16AecCounter,,app.elf", 0x0F);
    EvalManStepEqual("Expected test result", result, KU16_ZERO);
 
    
    debugger_deleteAllBP();
    debugger_reset();
  
        
    testStep("STEP", "Set a breakpoint in function PAL_Autotest_CheckMotorPowerOrder() at line '*pu8TestResult = pal_u8ResultOfAutoTest;'.");
    debugger_setRelativeFunctionBpAtLine("PAL_Autotest_CheckMotorPowerOrder", 141);
    
    debugger_run();
    
    testStep("STEP", "Check if CPU stopped in function PAL_Autotest_CheckMotorPowerOrder() at line '*pu8TestResult = pal_u8ResultOfAutoTest;'.");
    debugger_waitUntilBPisReached(10000);
  
    
    testStep("STEP", "Set variable *pu8TestResult to KU8_ATM_TEST_NOK.");
    debugger_writeLocalVariable("*pu8TestResult", 0x02);
    testWaitForTimeoutSilent(2000);


    debugger_deleteAllBP();
  
            
    testStep("STEP", "Set a breakpoint in function erh_ManageFailedCounterEvent() at line 'erh_au16AecCounter[cu8Index] += KU16_ONE;'.");
    debugger_setRelativeFunctionBpAtLine("erh_ManageFailedCounterEvent", 60);
    
    debugger_run();
    
    testStep("STEP", "Check if CPU stopped in function erh_ManageFailedCounterEvent() at line 'erh_au16AecCounter[cu8Index] += KU16_ONE;'.");
    debugger_waitUntilBPisReached(500);
  
    debugger_stepOver();
    
    testCaseComment("Action: ARCH_SW_ERH_0016");
    testStep("STEP", "Evaluate if erh_au16AecCounter[u8Index], where u8Index is ATM_KU8_ID_TEST_PWM_ORDER, is equal to KU16_ONE. --> erh_au16AecCounter[u8Index] == KU16_ONE");
    result = debugger_readGlobalVariable("uint16", "erh_au16AecCounter,,app.elf", 0x0F);
    EvalManStepEqual("Expected test result",  result, KU16_ONE);
  
  
  testCaseComment("Postcondition");
  testStep("STEP", "Return ECU to default values");
  RunPostTs();
}


testcase SW_IT_ERH_MOSFET_HIGH_SC_01()
{
  //***********************************Test report header*********************************
  testReportAddMiscInfoBlock("AUTOLIV ELECTRONICS document");
  TestReportAddMiscInfo("Nightly test", "No");
  TestReportAddMiscInfo("Test type", "Requirement-Based test");
  TestReportAddMiscInfo("Regression Test", "No");
  TestReportAddMiscInfo("Fault injection method used", "No");
  TestReportAddMiscInfo("Resource usage evaluation", "No");
  TestReportAddMiscInfo("Priority", "No");
  TestReportAddMiscInfo("Safety relevant", "No");
  
  AddRequirementInfo("Requirement under test", "ARCH_SW_ERH_0019");
  AddRequirementInfo("ARCH_SW_ERH_0019", "The ERH_KU8_MOSFET_HIGH_SC_AEC_CFG should have the following properties:? Qualification Count = 50; ? Qualification_time = Qualification_count * Autotest_Periodicity = 5000ms;? Deskill Count = 100; ? Deskill_time = Deskill_count * Autotest_Periodicity = 10000ms SC';- associated group: KU32_AEC_GROUP_MASK_HARDWARE.");
 //***************************************************************************************

  testCaseComment("Preconditions");
  testStep("STEP", "Bench Initialization");
  RunPreTs();
  
  
    testStep("STEP", "Set a breakpoint in function ERH_Init() at line 'erh_au16AecCounter[u8Index] = KU16_ZERO;'.");
    debugger_setRelativeFunctionBpAtLine("ERH_Init", 19);
       
    debugger_reset();
    debugger_run();
    
    testStep("STEP", "Check if CPU stopped in function ERH_Init() at line 'erh_au16AecCounter[u8Index] = KU16_ZERO;'.");
    debugger_waitUntilBPisReached(500);
  
    
    debugger_deleteAllBP();
  
  
    testStep("STEP", "Set a breakpoint in ERH_Init() at the end of the function.");
    debugger_setRelativeFunctionBpAtLine("ERH_Init", 65);
    
    debugger_run();
    testWaitForTimeoutSilent(500);

    testCaseComment("Action: ARCH_SW_ERH_0019");
    testStep("STEP", "Evaluate if erh_au16AecCounter[u8Index], where u8Index is ATM_KU8_ID_TEST_MOSFET_HIGH_SHORT_CIRCUIT, is equal to KU16_ZERO. --> erh_au16AecCounter[u8Index] == KU16_ZERO");
    result = debugger_readGlobalVariable("uint16", "erh_au16AecCounter,,app.elf", 0x03);
    EvalManStepEqual("Expected test result", result, KU16_ZERO);
 
    
    debugger_deleteAllBP();
    debugger_reset();
  
        
    testStep("STEP", "Set a breakpoint in function PAL_Autotest_CheckMosfetHighSC() at line '*pu8TestResult = pal_u8ResultOfAutoTest;'.");
    debugger_setRelativeFunctionBpAtLine("PAL_Autotest_CheckMosfetHighSC", 101);
    
    debugger_run();
    
    testStep("STEP", "Check if CPU stopped in function PAL_Autotest_CheckMosfetHighSC() at line '*pu8TestResult = pal_u8ResultOfAutoTest;'.");
    debugger_waitUntilBPisReached(10000);
  
    
    testStep("STEP", "Set variable *pu8TestResult to KU8_ATM_TEST_NOK.");
    debugger_writeLocalVariable("*pu8TestResult", 0x02);
    testWaitForTimeoutSilent(2000);


    debugger_deleteAllBP();
  
            
    testStep("STEP", "Set a breakpoint in function erh_ManageFailedCounterEvent() at line 'erh_au16AecCounter[cu8Index] += KU16_ONE;'.");
    debugger_setRelativeFunctionBpAtLine("erh_ManageFailedCounterEvent", 60);
    
    debugger_run();
    
    testStep("STEP", "Check if CPU stopped in function erh_ManageFailedCounterEvent() at line 'erh_au16AecCounter[cu8Index] += KU16_ONE;'.");
    debugger_waitUntilBPisReached(500);
  
    debugger_stepOver();
    
    testCaseComment("Action: ARCH_SW_ERH_0019");
    testStep("STEP", "Evaluate if erh_au16AecCounter[u8Index], where u8Index is ATM_KU8_ID_TEST_MOSFET_HIGH_SHORT_CIRCUIT, is equal to KU16_ONE. --> erh_au16AecCounter[u8Index] == KU16_ONE");
    result = debugger_readGlobalVariable("uint16", "erh_au16AecCounter,,app.elf", 0x03);
    EvalManStepEqual("Expected test result",  result, KU16_ONE);
  
  
  testCaseComment("Postcondition");
  testStep("STEP", "Return ECU to default values");
  RunPostTs();
}



testcase SW_IT_ERH_MOSFET_LOW_SC_01()
{
  //***********************************Test report header*********************************
  testReportAddMiscInfoBlock("AUTOLIV ELECTRONICS document");
  TestReportAddMiscInfo("Nightly test", "No");
  TestReportAddMiscInfo("Test type", "Requirement-Based test");
  TestReportAddMiscInfo("Regression Test", "No");
  TestReportAddMiscInfo("Fault injection method used", "No");
  TestReportAddMiscInfo("Resource usage evaluation", "No");
  TestReportAddMiscInfo("Priority", "No");
  TestReportAddMiscInfo("Safety relevant", "No");
  
  AddRequirementInfo("Requirement under test", "ARCH_SW_ERH_0020");
  AddRequirementInfo("ARCH_SW_ERH_0020", "The ERH_KU8_MOSFET_LOW_SC_AEC_CFG should have the following properties: ? Qualification Count = 50;? Qualification_time = Qualification_count * Autotest_Periodicity = 5000ms;? Deskill Count = 100;? Deskill_time = Deskill_count * Autotest_Periodicity = 10000ms;- associated group: KU32_AEC_GROUP_MASK_HARDWARE.");
 //***************************************************************************************

  testCaseComment("Preconditions");
  testStep("STEP", "Bench Initialization");
  RunPreTs();
  
  
    testStep("STEP", "Set a breakpoint in function ERH_Init() at line 'erh_au16AecCounter[u8Index] = KU16_ZERO;'.");
    debugger_setRelativeFunctionBpAtLine("ERH_Init", 19);
       
    debugger_reset();
    debugger_run();
    
    testStep("STEP", "Check if CPU stopped in function ERH_Init() at line 'erh_au16AecCounter[u8Index] = KU16_ZERO;'.");
    debugger_waitUntilBPisReached(500);
  
    
    debugger_deleteAllBP();
  
  
    testStep("STEP", "Set a breakpoint in ERH_Init() at the end of the function.");
    debugger_setRelativeFunctionBpAtLine("ERH_Init", 65);
    
    debugger_run();
    testWaitForTimeoutSilent(500);

    testCaseComment("Action: ARCH_SW_ERH_0020");
    testStep("STEP", "Evaluate if erh_au16AecCounter[u8Index], where u8Index is ATM_KU8_ID_TEST_MOSFET_LOW_SHORT_CIRCUIT, is equal to KU16_ZERO. --> erh_au16AecCounter[u8Index] == KU16_ZERO");
    result = debugger_readGlobalVariable("uint16", "erh_au16AecCounter,,app.elf", 0x04);
    EvalManStepEqual("Expected test result", result, KU16_ZERO);
 
    
    debugger_deleteAllBP();
    debugger_reset();
  
        
    testStep("STEP", "Set a breakpoint in function PAL_Autotest_CheckMosfetLowSC() at line '*pu8TestResult = pal_u8ResultOfAutoTest;'.");
    debugger_setRelativeFunctionBpAtLine("PAL_Autotest_CheckMosfetLowSC", 97);
    
    debugger_run();
    
    testStep("STEP", "Check if CPU stopped in function PAL_Autotest_CheckMosfetLowSC() at line '*pu8TestResult = pal_u8ResultOfAutoTest;'.");
    debugger_waitUntilBPisReached(10000);
    
    testStep("STEP", "Set variable *pu8TestResult to KU8_ATM_TEST_NOK.");
    debugger_writeLocalVariable("*pu8TestResult", 0x02);
    testWaitForTimeoutSilent(2000);


    debugger_deleteAllBP();
  
            
    testStep("STEP", "Set a breakpoint in function erh_ManageFailedCounterEvent() at line 'erh_au16AecCounter[cu8Index] += KU16_ONE;'.");
    debugger_setRelativeFunctionBpAtLine("erh_ManageFailedCounterEvent", 60);
    
    debugger_run();
    
    testStep("STEP", "Check if CPU stopped in function erh_ManageFailedCounterEvent() at line 'erh_au16AecCounter[cu8Index] += KU16_ONE;'.");
    debugger_waitUntilBPisReached(500);
  
    debugger_stepOver();
    
    testCaseComment("Action: ARCH_SW_ERH_0020");
    testStep("STEP", "Evaluate if erh_au16AecCounter[u8Index], where u8Index is ATM_KU8_ID_TEST_MOSFET_LOW_SHORT_CIRCUIT, is equal to KU16_ONE. --> erh_au16AecCounter[u8Index] == KU16_ONE");
    result = debugger_readGlobalVariable("uint16", "erh_au16AecCounter,,app.elf", 0x04);
    EvalManStepEqual("Expected test result",  result, KU16_ONE);
  
  
  testCaseComment("Postcondition");
  testStep("STEP", "Return ECU to default values");
  RunPostTs();
}



testcase SW_IT_ERH_MOSFET_OC_01()
{
  //***********************************Test report header*********************************
  testReportAddMiscInfoBlock("AUTOLIV ELECTRONICS document");
  TestReportAddMiscInfo("Nightly test", "No");
  TestReportAddMiscInfo("Test type", "Requirement-Based test");
  TestReportAddMiscInfo("Regression Test", "No");
  TestReportAddMiscInfo("Fault injection method used", "No");
  TestReportAddMiscInfo("Resource usage evaluation", "No");
  TestReportAddMiscInfo("Priority", "No");
  TestReportAddMiscInfo("Safety relevant", "No");
  
  AddRequirementInfo("Requirement under test", "ARCH_SW_ERH_0021");
  AddRequirementInfo("ARCH_SW_ERH_0021", "The ERH_KU8_MOSFET_OC_AEC_CFG should have the following properties:? Qualification_time = instantaneously;? Deskill_time = 1 (after each reset);- associated group: KU32_AEC_GROUP_MASK_HARDWARE.");
 //***************************************************************************************

  testCaseComment("Preconditions");
  testStep("STEP", "Bench Initialization");
  RunPreTs();
  
  
    testStep("STEP", "Set a breakpoint in function ERH_Init() at line 'erh_au16AecCounter[u8Index] = KU16_ZERO;'.");
    debugger_setRelativeFunctionBpAtLine("ERH_Init", 19);
       
    debugger_reset();
    debugger_run();
    
    testStep("STEP", "Check if CPU stopped in function ERH_Init() at line 'erh_au16AecCounter[u8Index] = KU16_ZERO;'.");
    debugger_waitUntilBPisReached(500);
  
    
    debugger_deleteAllBP();
  
  
    testStep("STEP", "Set a breakpoint in ERH_Init() at the end of the function.");
    debugger_setRelativeFunctionBpAtLine("ERH_Init", 65);
    
    debugger_run();
    testWaitForTimeoutSilent(500);

    testCaseComment("Action: ARCH_SW_ERH_0021");
    testStep("STEP", "Evaluate if erh_au16AecCounter[u8Index], where u8Index is ATM_KU8_ID_TEST_MOSFET_OPEN_CIRCUIT, is equal to KU16_ZERO. --> erh_au16AecCounter[u8Index] == KU16_ZERO");
    result = debugger_readGlobalVariable("uint16", "erh_au16AecCounter,,app.elf", 0x07);
    EvalManStepEqual("Expected test result", result, KU16_ZERO);
 
    
    debugger_deleteAllBP();
    debugger_reset();
  

    testStep("STEP", "Set a breakpoint in function PAL_Autotest_CheckMosfetOCAT() at line '*pu8TestResult = pal_u8ResultOfAutoTest;'.");
    debugger_setRelativeFunctionBpAtLine("PAL_Autotest_CheckMosfetOCAT", 288);
    
    debugger_run();
    
    testStep("STEP", "Check if CPU stopped in function PAL_Autotest_CheckMosfetOCAT() at line '*pu8TestResult = pal_u8ResultOfAutoTest;'.");
    debugger_waitUntilBPisReached(10000);
    
    testStep("STEP", "Set variable *pu8TestResult to KU8_ATM_TEST_NOK.");
    debugger_writeLocalVariable("*pu8TestResult", 0x02);
    testWaitForTimeoutSilent(2000);


    debugger_deleteAllBP();
  
            
    testStep("STEP", "Set a breakpoint in function erh_ManageFailedCounterEvent() at line 'erh_au16AecCounter[cu8Index] += KU16_ONE;'.");
    debugger_setRelativeFunctionBpAtLine("erh_ManageFailedCounterEvent", 60);
    
    debugger_run();
    
    testStep("STEP", "Check if CPU stopped in function erh_ManageFailedCounterEvent() at line 'erh_au16AecCounter[cu8Index] += KU16_ONE;'.");
    debugger_waitUntilBPisReached(500);
  
    debugger_stepOver();
    
    testCaseComment("Action: ARCH_SW_ERH_0021");
    testStep("STEP", "Evaluate if erh_au16AecCounter[u8Index], where u8Index is ATM_KU8_ID_TEST_MOSFET_OPEN_CIRCUIT, is equal to KU16_ONE. --> erh_au16AecCounter[u8Index] == KU16_ONE");
    result = debugger_readGlobalVariable("uint16", "erh_au16AecCounter,,app.elf", 0x07);
    EvalManStepEqual("Expected test result",  result, KU16_ONE);
  
  
  testCaseComment("Postcondition");
  testStep("STEP", "Return ECU to default values");
  RunPostTs();
}


testcase SW_IT_ERH_HALL_SENSOR_01()
{
  //***********************************Test report header*********************************
  testReportAddMiscInfoBlock("AUTOLIV ELECTRONICS document");
  TestReportAddMiscInfo("Nightly test", "No");
  TestReportAddMiscInfo("Test type", "Requirement-Based test");
  TestReportAddMiscInfo("Regression Test", "No");
  TestReportAddMiscInfo("Fault injection method used", "No");
  TestReportAddMiscInfo("Resource usage evaluation", "No");
  TestReportAddMiscInfo("Priority", "No");
  TestReportAddMiscInfo("Safety relevant", "No");
  
  AddRequirementInfo("Requirement under test", "ARCH_SW_ERH_0022");
  AddRequirementInfo("ARCH_SW_ERH_0022", "The ERH_KU8_HALL_SENSOR_AEC_CFG should have the following properties: ? Qualification Count = 1; ? Qualification_time = Qualification_count * Autotest_Periodicity = 100ms;? Deskill Count = 1;? Deskill_time = Deskill_count * Autotest_Periodicity = 100ms;- associated group: KU32_AEC_GROUP_MASK_HARDWARE.");
 //***************************************************************************************

  testCaseComment("Preconditions");
  testStep("STEP", "Bench Initialization");
  RunPreTs();
  
  
    testStep("STEP", "Set a breakpoint in function ERH_Init() at line 'erh_au16AecCounter[u8Index] = KU16_ZERO;'.");
    debugger_setRelativeFunctionBpAtLine("ERH_Init", 19);
       
    debugger_reset();
    debugger_run();
    
    testStep("STEP", "Check if CPU stopped in function ERH_Init() at line 'erh_au16AecCounter[u8Index] = KU16_ZERO;'.");
    debugger_waitUntilBPisReached(500);
  
    
    debugger_deleteAllBP();
  
  
    testStep("STEP", "Set a breakpoint in ERH_Init() at the end of the function.");
    debugger_setRelativeFunctionBpAtLine("ERH_Init", 65);
    
    debugger_run();
    testWaitForTimeoutSilent(500);

    testCaseComment("Action: ARCH_SW_ERH_0022");
    testStep("STEP", "Evaluate if erh_au16AecCounter[u8Index], where u8Index is ATM_KU8_ID_TEST_HALL_EFFECT_SENSORS, is equal to KU16_ZERO. --> erh_au16AecCounter[u8Index] == KU16_ZERO");
    result = debugger_readGlobalVariable("uint16", "erh_au16AecCounter,,app.elf", 0x09);
    EvalManStepEqual("Expected test result", result, KU16_ZERO);
 
    
    debugger_deleteAllBP();
    debugger_reset();
  

    testStep("STEP", "Set a breakpoint in function BMM_Autotest_CheckHallEffectSensor() at line '*pu8TestResult = pal_u8ResultOfAutoTest;'.");
    debugger_setRelativeFunctionBpAtLine("BMM_Autotest_CheckHallEffectSensor", 59);
    
    debugger_run();
    
    testStep("STEP", "Check if CPU stopped in function BMM_Autotest_CheckHallEffectSensor() at line '*pu8TestResult = pal_u8ResultOfAutoTest;'.");
    debugger_waitUntilBPisReached(10000);
    
    testStep("STEP", "Set variable *pu8TestResult to KU8_ATM_TEST_NOK.");
    debugger_writeLocalVariable("*pu8TestResult", 0x02);
    testWaitForTimeoutSilent(2000);


    debugger_deleteAllBP();
  
            
    testStep("STEP", "Set a breakpoint in function erh_ManageFailedCounterEvent() at line 'erh_au16AecCounter[cu8Index] += KU16_ONE;'.");
    debugger_setRelativeFunctionBpAtLine("erh_ManageFailedCounterEvent", 60);
    
    debugger_run();
    
    testStep("STEP", "Check if CPU stopped in function erh_ManageFailedCounterEvent() at line 'erh_au16AecCounter[cu8Index] += KU16_ONE;'.");
    debugger_waitUntilBPisReached(500);
  
    debugger_stepOver();
    
    testCaseComment("Action: ARCH_SW_ERH_0022");
    testStep("STEP", "Evaluate if erh_au16AecCounter[u8Index], where u8Index is ATM_KU8_ID_TEST_HALL_EFFECT_SENSORS, is equal to KU16_ONE. --> erh_au16AecCounter[u8Index] == KU16_ONE");
    result = debugger_readGlobalVariable("uint16", "erh_au16AecCounter,,app.elf", 0x09);
    EvalManStepEqual("Expected test result",  result, KU16_ONE);
  
  
  testCaseComment("Postcondition");
  testStep("STEP", "Return ECU to default values");
  RunPostTs();
}


testcase SW_IT_ERH_ENABLE_OUT_OF_ORDER_01()
{
  //***********************************Test report header*********************************
  testReportAddMiscInfoBlock("AUTOLIV ELECTRONICS document");
  TestReportAddMiscInfo("Nightly test", "No");
  TestReportAddMiscInfo("Test type", "Requirement-Based test");
  TestReportAddMiscInfo("Regression Test", "No");
  TestReportAddMiscInfo("Fault injection method used", "No");
  TestReportAddMiscInfo("Resource usage evaluation", "No");
  TestReportAddMiscInfo("Priority", "No");
  TestReportAddMiscInfo("Safety relevant", "No");
  
  AddRequirementInfo("Requirement under test", "ARCH_SW_ERH_0023");
  AddRequirementInfo("ARCH_SW_ERH_0023", "The ERH_KU8_ENABLE_OUT_OF_ORDER_AEC_CFG should have the following properties:? Qualification Count = 2; ? Qualification_time = Qualification_count * Autotest_Periodicity = 200ms;? Deskill Count = 60;? Deskill_time = Deskill_count * Autotest_Periodicity = 6000ms;- associated group: KU32_AEC_GROUP_MASK_HARDWARE.");
 //***************************************************************************************

  testCaseComment("Preconditions");
  testStep("STEP", "Bench Initialization");
  RunPreTs();
  
  
    testStep("STEP", "Set a breakpoint in function ERH_Init() at line 'erh_au16AecCounter[u8Index] = KU16_ZERO;'.");
    debugger_setRelativeFunctionBpAtLine("ERH_Init", 19);
       
    debugger_reset();
    debugger_run();
    
    testStep("STEP", "Check if CPU stopped in function ERH_Init() at line 'erh_au16AecCounter[u8Index] = KU16_ZERO;'.");
    debugger_waitUntilBPisReached(500);
  
    
    debugger_deleteAllBP();
  
  
    testStep("STEP", "Set a breakpoint in ERH_Init() at the end of the function.");
    debugger_setRelativeFunctionBpAtLine("ERH_Init", 65);
    
    debugger_run();
    testWaitForTimeoutSilent(500);

    testCaseComment("Action: ARCH_SW_ERH_0023");
    testStep("STEP", "Evaluate if erh_au16AecCounter[u8Index], where u8Index is ATM_KU8_ID_TEST_DRIVER_COMMAND, is equal to KU16_ZERO. --> erh_au16AecCounter[u8Index] == KU16_ZERO");
    result = debugger_readGlobalVariable("uint16", "erh_au16AecCounter,,app.elf", 0x02);
    EvalManStepEqual("Expected test result", result, KU16_ZERO);
 
    
    debugger_deleteAllBP();
    debugger_reset();
  

    testStep("STEP", "Set a breakpoint in function PAL_Autotest_CheckCommandConsistency() at line '*pu8TestResult = pal_u8ResultOfAutoTest;'.");
    debugger_setRelativeFunctionBpAtLine("PAL_Autotest_CheckCommandConsistency", 27);
    
    debugger_run();
    
    testStep("STEP", "Check if CPU stopped in function PAL_Autotest_CheckCommandConsistency() at line '*pu8TestResult = pal_u8ResultOfAutoTest;'.");
    debugger_waitUntilBPisReached(10000);
    
    testStep("STEP", "Set variable *pu8TestResult to KU8_ATM_TEST_NOK.");
    debugger_writeLocalVariable("*pu8TestResult", 0x02);
    testWaitForTimeoutSilent(2000);


    debugger_deleteAllBP();
  
            
    testStep("STEP", "Set a breakpoint in function erh_ManageFailedCounterEvent() at line 'erh_au16AecCounter[cu8Index] += KU16_ONE;'.");
    debugger_setRelativeFunctionBpAtLine("erh_ManageFailedCounterEvent", 60);
    
    debugger_run();
    
    testStep("STEP", "Check if CPU stopped in function erh_ManageFailedCounterEvent() at line 'erh_au16AecCounter[cu8Index] += KU16_ONE;'.");
    debugger_waitUntilBPisReached(500);
  
    debugger_stepOver();
    
    testCaseComment("Action: ARCH_SW_ERH_0023");
    testStep("STEP", "Evaluate if erh_au16AecCounter[u8Index], where u8Index is ATM_KU8_ID_TEST_DRIVER_COMMAND, is equal to KU16_ONE. --> erh_au16AecCounter[u8Index] == KU16_ONE");
    result = debugger_readGlobalVariable("uint16", "erh_au16AecCounter,,app.elf", 0x02);
    EvalManStepEqual("Expected test result",  result, KU16_ONE);
  
  
  testCaseComment("Postcondition");
  testStep("STEP", "Return ECU to default values");
  RunPostTs();
}


testcase SW_IT_ERH_WARM_RESET_01()
{
  //***********************************Test report header*********************************
  testReportAddMiscInfoBlock("AUTOLIV ELECTRONICS document");
  TestReportAddMiscInfo("Nightly test", "No");
  TestReportAddMiscInfo("Test type", "Requirement-Based test");
  TestReportAddMiscInfo("Regression Test", "No");
  TestReportAddMiscInfo("Fault injection method used", "No");
  TestReportAddMiscInfo("Resource usage evaluation", "No");
  TestReportAddMiscInfo("Priority", "No");
  TestReportAddMiscInfo("Safety relevant", "No");
  
  AddRequirementInfo("Requirement under test", "ARCH_SW_ERH_0024");
  AddRequirementInfo("ARCH_SW_ERH_0024", "The ERH_KU8_WARM_RESET_AEC_CFG should have the following properties: ? Qualification Count = Instantaneously; ? Deskill Count = None (shall never be deskilled even after reset);? Linked Auto-test: 'TF_H12 - To Handle reste causes';- associated group: ERH_OTHER_GROUP.");
 //***************************************************************************************

  testCaseComment("Preconditions");
  testStep("STEP", "Bench Initialization");
  RunPreTs();
  
     
    testStep("STEP", "Set a breakpoint in function ERH_Init() at line 'erh_au16AecCounter[u8Index] = KU16_ZERO;'.");
    debugger_setRelativeFunctionBpAtLine("ERH_Init", 19);
    
    debugger_reset();
    debugger_run();
    
    testStep("STEP", "Check if CPU stopped in function ERH_Init() at line 'erh_au16AecCounter[u8Index] = KU16_ZERO;'.");
    debugger_waitUntilBPisReached(500);
  
    
    debugger_deleteAllBP();
  
  
    testStep("STEP", "Set a breakpoint in ERH_Init() at the end of the function.");
    debugger_setRelativeFunctionBpAtLine("ERH_Init", 65);
    
    debugger_run();
    testWaitForTimeoutSilent(500);

    testCaseComment("Action: ARCH_SW_ERH_0024");
    testStep("STEP", "Evaluate if erh_au16AecCounter[u8Index], where u8Index is ATM_KU8_ID_RESET_CAUSE, is equal to KU16_ZERO. --> erh_au16AecCounter[u8Index] == KU16_ZERO");
    result = debugger_readGlobalVariable("uint16", "erh_au16AecCounter,,app.elf", 0x1B);
    EvalManStepEqual("Expected test result", result, KU16_ZERO);
 
    
    debugger_deleteAllBP();
    debugger_reset();
    debugger_run();
  

    testStep("STEP", "Set a breakpoint in function RCM_Autotest_RunResetCause() at line '*pu8TestResult = pal_u8ResultOfAutoTest;'.");
    debugger_setRelativeFunctionBpAtLine("RCM_Autotest_RunResetCause", 43);
    
    debugger_run();
    
    testStep("STEP", "Check if CPU stopped in function RCM_Autotest_RunResetCause() at line '*pu8TestResult = pal_u8ResultOfAutoTest;'.");
    debugger_waitUntilBPisReached(10000);
    
    testStep("STEP", "Set variable *pu8TestResult to KU8_ATM_TEST_NOK.");
    debugger_writeLocalVariable("*pu8TestResult", 0x02);
    testWaitForTimeoutSilent(2000);


    debugger_deleteAllBP();
  
            
    testStep("STEP", "Set a breakpoint in function erh_ManageFailedCounterEvent() at line 'erh_au16AecCounter[cu8Index] += KU16_ONE;'.");
    debugger_setRelativeFunctionBpAtLine("erh_ManageFailedCounterEvent", 60);
    
    debugger_run();
    
    testStep("STEP", "Check if CPU stopped in function erh_ManageFailedCounterEvent() at line 'erh_au16AecCounter[cu8Index] += KU16_ONE;'.");
    debugger_waitUntilBPisReached(500);
  
    debugger_stepOver();
    
    testCaseComment("Action: ARCH_SW_ERH_0024");
    testStep("STEP", "Evaluate if erh_au16AecCounter[u8Index], where u8Index is ATM_KU8_ID_RESET_CAUSE, is equal to KU16_ONE. --> erh_au16AecCounter[u8Index] == KU16_ONE");
    result = debugger_readGlobalVariable("uint16", "erh_au16AecCounter,,app.elf", 0x1B);
    EvalManStepEqual("Expected test result",  result, KU16_ONE);
  
  
  testCaseComment("Postcondition");
  testStep("STEP", "Return ECU to default values");
  RunPostTs();
}


testcase SW_IT_ERH_TEMPERATURE_SENSOR_FAILURE_01()
{
  //***********************************Test report header*********************************
  testReportAddMiscInfoBlock("AUTOLIV ELECTRONICS document");
  TestReportAddMiscInfo("Nightly test", "No");
  TestReportAddMiscInfo("Test type", "Requirement-Based test");
  TestReportAddMiscInfo("Regression Test", "No");
  TestReportAddMiscInfo("Fault injection method used", "No");
  TestReportAddMiscInfo("Resource usage evaluation", "No");
  TestReportAddMiscInfo("Priority", "No");
  TestReportAddMiscInfo("Safety relevant", "No");
  
  AddRequirementInfo("Requirement under test", "ARCH_SW_ERH_0025");
  AddRequirementInfo("ARCH_SW_ERH_0025", "The ERH_KU8_TEMPERATURE_SENSOR_FAILURE_AEC_CFG should have the following properties: ? Qualification Count = 1; ? Qualification_time = Qualification_count * Autotest_Periodicity = 5000ms; ? Deskill Count = 1;? Deskill_time = Deskill_count * Autotest_Periodicity = 5000ms;- associated group: KU32_AEC_GROUP_MASK_HARDWARE.");
 //***************************************************************************************

  testCaseComment("Preconditions");
  testStep("STEP", "Bench Initialization");
  RunPreTs();
  
  
    testStep("STEP", "Set a breakpoint in function ERH_Init() at line 'erh_au16AecCounter[u8Index] = KU16_ZERO;'.");
    debugger_setRelativeFunctionBpAtLine("ERH_Init", 19);
       
    debugger_reset();
    debugger_run();
    
    testStep("STEP", "Check if CPU stopped in function ERH_Init() at line 'erh_au16AecCounter[u8Index] = KU16_ZERO;'.");
    debugger_waitUntilBPisReached(500);
  
    
    debugger_deleteAllBP();
  
  
    testStep("STEP", "Set a breakpoint in ERH_Init() at the end of the function.");
    debugger_setRelativeFunctionBpAtLine("ERH_Init", 65);
    
    debugger_run();
    testWaitForTimeoutSilent(500);

    testCaseComment("Action: ARCH_SW_ERH_0025");
    testStep("STEP", "Evaluate if erh_au16AecCounter[u8Index], where u8Index is ATM_KU8_ID_TEST_SENSOR_TEMPERATURE, is equal to KU16_ZERO. --> erh_au16AecCounter[u8Index] == KU16_ZERO");
    result = debugger_readGlobalVariable("uint16", "erh_au16AecCounter,,app.elf", 0x0D);
    EvalManStepEqual("Expected test result", result, KU16_ZERO);
 
    
    debugger_deleteAllBP();
    debugger_reset();
    debugger_run();
  

    testStep("STEP", "Set a breakpoint in function PMP_Autotest_CheckTemperatureSensor() at line '*pu8TestResult = pal_u8ResultOfAutoTest;'.");
    debugger_setRelativeFunctionBpAtLine("PMP_Autotest_CheckTemperatureSensor", 43);
    
    debugger_run();
    
    testStep("STEP", "Check if CPU stopped in function PMP_Autotest_CheckTemperatureSensor() at line '*pu8TestResult = pal_u8ResultOfAutoTest;'.");
    debugger_waitUntilBPisReached(10000);
    
    testStep("STEP", "Set variable *pu8TestResult to KU8_ATM_TEST_NOK.");
    debugger_writeLocalVariable("*pu8TestResult", 0x02);
    testWaitForTimeoutSilent(2000);


    debugger_deleteAllBP();
  
            
    testStep("STEP", "Set a breakpoint in function erh_ManageFailedCounterEvent() at line 'erh_au16AecCounter[cu8Index] += KU16_ONE;'.");
    debugger_setRelativeFunctionBpAtLine("erh_ManageFailedCounterEvent", 60);
    
    debugger_run();
    
    testStep("STEP", "Check if CPU stopped in function erh_ManageFailedCounterEvent() at line 'erh_au16AecCounter[cu8Index] += KU16_ONE;'.");
    debugger_waitUntilBPisReached(500);
  
    debugger_stepOver();
    
    testCaseComment("Action: ARCH_SW_ERH_0025");
    testStep("STEP", "Evaluate if erh_au16AecCounter[u8Index], where u8Index is ATM_KU8_ID_TEST_SENSOR_TEMPERATURE, is equal to KU16_ONE. --> erh_au16AecCounter[u8Index] == KU16_ONE");
    result = debugger_readGlobalVariable("uint16", "erh_au16AecCounter,,app.elf", 0x0D);
    EvalManStepEqual("Expected test result",  result, KU16_ONE);
  
  
  testCaseComment("Postcondition");
  testStep("STEP", "Return ECU to default values");
  RunPostTs();
}


testcase SW_IT_ERH_MOTOR_BLOCKED_01()
{
  //***********************************Test report header*********************************
  testReportAddMiscInfoBlock("AUTOLIV ELECTRONICS document");
  TestReportAddMiscInfo("Nightly test", "No");
  TestReportAddMiscInfo("Test type", "Requirement-Based test");
  TestReportAddMiscInfo("Regression Test", "No");
  TestReportAddMiscInfo("Fault injection method used", "No");
  TestReportAddMiscInfo("Resource usage evaluation", "No");
  TestReportAddMiscInfo("Priority", "No");
  TestReportAddMiscInfo("Safety relevant", "No");
  
  AddRequirementInfo("Requirement under test", "ARCH_SW_ERH_0026");
  AddRequirementInfo("ARCH_SW_ERH_0026", "The ERH_KU8_MOTOR_BLOCKED_AEC_CFG should have the following properties:? Qualification Count = 5; ? Qualification_time = Qualification_count * Autotest_Periodicity = 50ms; ? Deskill Count = 1; ? Deskill_time = Deskill_count * Autotest_Periodicity = 10ms; - associated group: KU32_AEC_GROUP_MASK_MOTOR.");
 //***************************************************************************************

  testCaseComment("Preconditions");
  testStep("STEP", "Bench Initialization");
  RunPreTs();
  
  
    testStep("STEP", "Set a breakpoint in function ERH_Init() at line 'erh_au16AecCounter[u8Index] = KU16_ZERO;'.");
    debugger_setRelativeFunctionBpAtLine("ERH_Init", 19);
       
    debugger_reset();
    debugger_run();
    
    testStep("STEP", "Check if CPU stopped in function ERH_Init() at line 'erh_au16AecCounter[u8Index] = KU16_ZERO;'.");
    debugger_waitUntilBPisReached(500);
  
    
    debugger_deleteAllBP();
  
  
    testStep("STEP", "Set a breakpoint in ERH_Init() at the end of the function.");
    debugger_setRelativeFunctionBpAtLine("ERH_Init", 65);
    
    debugger_run();
    testWaitForTimeoutSilent(500);

    testCaseComment("Action: ARCH_SW_ERH_0026");
    testStep("STEP", "Evaluate if erh_au16AecCounter[u8Index], where u8Index is ATM_KU8_ID_TEST_MOTOR_BLOCKED, is equal to KU16_ZERO. --> erh_au16AecCounter[u8Index] == KU16_ZERO");
    result = debugger_readGlobalVariable("uint16", "erh_au16AecCounter,,app.elf", 0x0B);
    EvalManStepEqual("Expected test result", result, KU16_ZERO);
 
    
    debugger_deleteAllBP();
    debugger_reset();
    debugger_run();
  

    testStep("STEP", "Set a breakpoint in function PAL_Autotest_CheckMotorDisengagement() at line '*pu8TestResult = pal_u8ResultOfAutoTest;'.");
    debugger_setRelativeFunctionBpAtLine("PAL_Autotest_CheckMotorDisengagement", 169);
    
    debugger_run();
    
    testStep("STEP", "Check if CPU stopped in function PAL_Autotest_CheckMotorDisengagement() at line '*pu8TestResult = pal_u8ResultOfAutoTest;'.");
    debugger_waitUntilBPisReached(10000);
    
    testStep("STEP", "Set variable *pu8TestResult to KU8_ATM_TEST_NOK.");
    debugger_writeLocalVariable("*pu8TestResult", 0x02);
    testWaitForTimeoutSilent(2000);


    debugger_deleteAllBP();
  
            
    testStep("STEP", "Set a breakpoint in function erh_ManageFailedCounterEvent() at line 'erh_au16AecCounter[cu8Index] += KU16_ONE;'.");
    debugger_setRelativeFunctionBpAtLine("erh_ManageFailedCounterEvent", 60);
    
    debugger_run();
    
    testStep("STEP", "Check if CPU stopped in function erh_ManageFailedCounterEvent() at line 'erh_au16AecCounter[cu8Index] += KU16_ONE;'.");
    debugger_waitUntilBPisReached(500);
  
    debugger_stepOver();
    
    testCaseComment("Action: ARCH_SW_ERH_0026");
    testStep("STEP", "Evaluate if erh_au16AecCounter[u8Index], where u8Index is ATM_KU8_ID_TEST_MOTOR_BLOCKED, is equal to KU16_ONE. --> erh_au16AecCounter[u8Index] == KU16_ONE");
    result = debugger_readGlobalVariable("uint16", "erh_au16AecCounter,,app.elf", 0x0B);
    EvalManStepEqual("Expected test result",  result, KU16_ONE);
  
  
  testCaseComment("Postcondition");
  testStep("STEP", "Return ECU to default values");
  RunPostTs();
}


testcase SW_IT_ERH_MOTOR_IN_SC_01()
{
  //***********************************Test report header*********************************
  testReportAddMiscInfoBlock("AUTOLIV ELECTRONICS document");
  TestReportAddMiscInfo("Nightly test", "No");
  TestReportAddMiscInfo("Test type", "Requirement-Based test");
  TestReportAddMiscInfo("Regression Test", "No");
  TestReportAddMiscInfo("Fault injection method used", "No");
  TestReportAddMiscInfo("Resource usage evaluation", "No");
  TestReportAddMiscInfo("Priority", "No");
  TestReportAddMiscInfo("Safety relevant", "No");
  
  AddRequirementInfo("Requirement under test", "ARCH_SW_ERH_0027");
  AddRequirementInfo("ARCH_SW_ERH_0027", "The ERH_KU8_MOTOR_IN_SC_AEC_CFG should have the following properties: ? Qualification Count = 6; ? Qualification_time = Qualification_count * Autotest_Periodicity = 60ms; ? Deskill Count = 1 (shall be deskilled after reset); ? associated group: KU32_AEC_GROUP_MASK_MOTOR.");
 //***************************************************************************************

  testCaseComment("Preconditions");
  testStep("STEP", "Bench Initialization");
  RunPreTs();
  
  
    testStep("STEP", "Set a breakpoint in function ERH_Init() at line 'erh_au16AecCounter[u8Index] = KU16_ZERO;'.");
    debugger_setRelativeFunctionBpAtLine("ERH_Init", 19);
       
    debugger_reset();
    debugger_run();
    
    testStep("STEP", "Check if CPU stopped in function ERH_Init() at line 'erh_au16AecCounter[u8Index] = KU16_ZERO;'.");
    debugger_waitUntilBPisReached(500);
  
    
    debugger_deleteAllBP();
  
  
    testStep("STEP", "Set a breakpoint in ERH_Init() at the end of the function.");
    debugger_setRelativeFunctionBpAtLine("ERH_Init", 65);
    
    debugger_run();
    testWaitForTimeoutSilent(500);

    testCaseComment("Action: ARCH_SW_ERH_0027");
    testStep("STEP", "Evaluate if erh_au16AecCounter[u8Index], where u8Index is ATM_KU8_ID_TEST_MOTOR_SHORT_CIRCUIT, is equal to KU16_ZERO. --> erh_au16AecCounter[u8Index] == KU16_ZERO");
    result = debugger_readGlobalVariable("uint16", "erh_au16AecCounter,,app.elf", 0x0F);
    EvalManStepEqual("Expected test result", result, KU16_ZERO);
 
    
    debugger_deleteAllBP();
    debugger_reset();
    debugger_run();
  

    testStep("STEP", "Set a breakpoint in function PAL_Autotest_CheckMotorSC() at line '*pu8TestResult = pal_u8ResultOfAutoTest;'.");
    debugger_setRelativeFunctionBpAtLine("PAL_Autotest_CheckMotorSC", 246);
    
    debugger_run();
    
    testStep("STEP", "Check if CPU stopped in function PAL_Autotest_CheckMotorSC() at line '*pu8TestResult = pal_u8ResultOfAutoTest;'.");
    debugger_waitUntilBPisReached(10000);
    
    testStep("STEP", "Set variable *pu8TestResult to KU8_ATM_TEST_NOK.");
    debugger_writeLocalVariable("*pu8TestResult", 0x02);
    testWaitForTimeoutSilent(2000);


    debugger_deleteAllBP();
  
            
    testStep("STEP", "Set a breakpoint in function erh_ManageFailedCounterEvent() at line 'erh_au16AecCounter[cu8Index] += KU16_ONE;'.");
    debugger_setRelativeFunctionBpAtLine("erh_ManageFailedCounterEvent", 60);
    
    debugger_run();
    
    testStep("STEP", "Check if CPU stopped in function erh_ManageFailedCounterEvent() at line 'erh_au16AecCounter[cu8Index] += KU16_ONE;'.");
    debugger_waitUntilBPisReached(500);
  
    debugger_stepOver();
    
    testCaseComment("Action: ARCH_SW_ERH_0027");
    testStep("STEP", "Evaluate if erh_au16AecCounter[u8Index], where u8Index is ATM_KU8_ID_TEST_MOTOR_SHORT_CIRCUIT, is equal to KU16_ONE. --> erh_au16AecCounter[u8Index] == KU16_ONE");
    result = debugger_readGlobalVariable("uint16", "erh_au16AecCounter,,app.elf", 0x0F);
    EvalManStepEqual("Expected test result",  result, KU16_ONE);
  
  
  testCaseComment("Postcondition");
  testStep("STEP", "Return ECU to default values");
  RunPostTs();
}


testcase SW_IT_ERH_MOTOR_CURRENT_01()
{
  //***********************************Test report header*********************************
  testReportAddMiscInfoBlock("AUTOLIV ELECTRONICS document");
  TestReportAddMiscInfo("Nightly test", "No");
  TestReportAddMiscInfo("Test type", "Requirement-Based test");
  TestReportAddMiscInfo("Regression Test", "No");
  TestReportAddMiscInfo("Fault injection method used", "No");
  TestReportAddMiscInfo("Resource usage evaluation", "No");
  TestReportAddMiscInfo("Priority", "No");
  TestReportAddMiscInfo("Safety relevant", "No");
  
  AddRequirementInfo("Requirement under test", "ARCH_SW_ERH_0028");
  AddRequirementInfo("ARCH_SW_ERH_0028", "The ERH_KU8_MOTOR_CURRENT_AEC_CFG should have the following properties: ? Qualification Count: - Medium Current threshold: 1200 ms; - High Current threshold: 120000 ms; ? Deskill Count = 60000 ms; - associated group: KU32_AEC_GROUP_MASK_MOTOR.");
 //***************************************************************************************
  
  testCaseComment("Preconditions");
  testStep("STEP", "Bench Initialization");
  RunPreTs();
  
  
    testStep("STEP", "Set a breakpoint in function ERH_Init() at line 'erh_au16AecCounter[u8Index] = KU16_ZERO;'.");
    debugger_setRelativeFunctionBpAtLine("ERH_Init", 19);
       
    debugger_reset();
    debugger_run();
    
    testStep("STEP", "Check if CPU stopped in function ERH_Init() at line 'erh_au16AecCounter[u8Index] = KU16_ZERO;'.");
    debugger_waitUntilBPisReached(500);
  
    
    debugger_deleteAllBP();
  
  
    testStep("STEP", "Set a breakpoint in ERH_Init() at the end of the function.");
    debugger_setRelativeFunctionBpAtLine("ERH_Init", 65);
    
    debugger_run();
    testWaitForTimeoutSilent(500);

    testCaseComment("Action: ARCH_SW_ERH_0028");
    testStep("STEP", "Evaluate if erh_au16AecCounter[u8Index], where u8Index is ATM_KU8_ID_TEST_MOTOR_CURRENT, is equal to KU16_ZERO. --> erh_au16AecCounter[u8Index] == KU16_ZERO");
    result = debugger_readGlobalVariable("uint16", "erh_au16AecCounter,,app.elf", 0x0A);
    EvalManStepEqual("Expected test result", result, KU16_ZERO);
 
    
    debugger_deleteAllBP();
    debugger_reset();
    debugger_run();
  

    testStep("STEP", "Set a breakpoint in function PAL_Autotest_CheckMotorCurrent() at line '*pu8TestResult = pal_u8ResultOfAutoTest;'.");
    debugger_setRelativeFunctionBpAtLine("PAL_Autotest_CheckMotorCurrent", 117);
    
    debugger_run();
    
    testStep("STEP", "Check if CPU stopped in function PAL_Autotest_CheckMotorCurrent() at line '*pu8TestResult = pal_u8ResultOfAutoTest;'.");
    debugger_waitUntilBPisReached(10000);
    
    testStep("STEP", "Set variable *pu8TestResult to KU8_ATM_TEST_NOK.");
    debugger_writeLocalVariable("*pu8TestResult", 0x02);
    testWaitForTimeoutSilent(2000);


    debugger_deleteAllBP();
  
            
    testStep("STEP", "Set a breakpoint in function erh_ManageFailedCounterEvent() at line 'erh_au16AecCounter[cu8Index] += KU16_ONE;'.");
    debugger_setRelativeFunctionBpAtLine("erh_ManageFailedCounterEvent", 60);
    
    debugger_run();
    
    testStep("STEP", "Check if CPU stopped in function erh_ManageFailedCounterEvent() at line 'erh_au16AecCounter[cu8Index] += KU16_ONE;'.");
    debugger_waitUntilBPisReached(500);
  
    debugger_stepOver();
    
    testCaseComment("Action: ARCH_SW_ERH_0028");
    testStep("STEP", "Evaluate if erh_au16AecCounter[u8Index], where u8Index is ATM_KU8_ID_TEST_MOTOR_CURRENT, is equal to KU16_ONE. --> erh_au16AecCounter[u8Index] == KU16_ONE");
    result = debugger_readGlobalVariable("uint16", "erh_au16AecCounter,,app.elf", 0x0A);
    EvalManStepEqual("Expected test result",  result, KU16_ONE);
  
  
  testCaseComment("Postcondition");
  testStep("STEP", "Return ECU to default values");
  RunPostTs();
}


testcase SW_IT_ERH_END_OF_LIFE_HIGH_01()
{
  //***********************************Test report header*********************************
  testReportAddMiscInfoBlock("AUTOLIV ELECTRONICS document");
  TestReportAddMiscInfo("Nightly test", "No");
  TestReportAddMiscInfo("Test type", "Requirement-Based test");
  TestReportAddMiscInfo("Regression Test", "No");
  TestReportAddMiscInfo("Fault injection method used", "No");
  TestReportAddMiscInfo("Resource usage evaluation", "No");
  TestReportAddMiscInfo("Priority", "No");
  TestReportAddMiscInfo("Safety relevant", "No");
  
  AddRequirementInfo("Requirement under test", "ARCH_SW_ERH_0029");
  AddRequirementInfo("ARCH_SW_ERH_0029", "The ERH_KU8_END_OF_LIFE_HIGH_AEC_CFG (NGU should have the following properties: ? Qualification Count: Instantaneously (i.e. : NVP_u16CounterToValidateEOLHighForce = 1; ? Deskill Count: None (shall never be deskilled even after reset) (i.e. : NVP_u16CounterToDeskillEOLHighForce = 0); - associated group: KU32_AEC_GROUP_MASK_EOL_LOW_HIGH.");
 //***************************************************************************************
  
  testCaseComment("Preconditions");
  testStep("STEP", "Bench Initialization");
  RunPreTs();
  
  
    testStep("STEP", "Set a breakpoint in function ERH_Init() at line 'erh_au16AecCounter[u8Index] = KU16_ZERO;'.");
    debugger_setRelativeFunctionBpAtLine("ERH_Init", 19);
       
    debugger_reset();
    debugger_run();
    
    testStep("STEP", "Check if CPU stopped in function ERH_Init() at line 'erh_au16AecCounter[u8Index] = KU16_ZERO;'.");
    debugger_waitUntilBPisReached(500);
  
    
    debugger_deleteAllBP();
  
  
    testStep("STEP", "Set a breakpoint in ERH_Init() at the end of the function.");
    debugger_setRelativeFunctionBpAtLine("ERH_Init", 65);
    
    debugger_run();
    testWaitForTimeoutSilent(500);

    testCaseComment("Action: ARCH_SW_ERH_0029");
    testStep("STEP", "Evaluate if erh_au16AecCounter[u8Index], where u8Index is ATM_KU8_ID_END_OF_LIFE_HIGH_FORCE, is equal to KU16_ZERO. --> erh_au16AecCounter[u8Index] == KU16_ZERO");
    result = debugger_readGlobalVariable("uint16", "erh_au16AecCounter,,app.elf", 0x1D);
    EvalManStepEqual("Expected test result", result, KU16_ZERO);
 
    
    debugger_deleteAllBP();
    debugger_reset();
    debugger_run();
  

    testStep("STEP", "Set a breakpoint in function EOL_Autotest_CheckProductEndOfLifeHighForce() at line '*pu8TestResult = pal_u8ResultOfAutoTest;'.");
    debugger_setRelativeFunctionBpAtLine("EOL_Autotest_CheckProductEndOfLifeHighForce", 22);
    
    debugger_run();
    
    testStep("STEP", "Check if CPU stopped in function EOL_Autotest_CheckProductEndOfLifeHighForce() at line '*pu8TestResult = pal_u8ResultOfAutoTest;'.");
    debugger_waitUntilBPisReached(10000);
    
    testStep("STEP", "Set variable *pu8TestResult to KU8_ATM_TEST_NOK.");
    debugger_writeLocalVariable("*pu8TestResult", 0x02);
    testWaitForTimeoutSilent(2000);


    debugger_deleteAllBP();
  
            
    testStep("STEP", "Set a breakpoint in function erh_ManageFailedCounterEvent() at line 'erh_au16AecCounter[cu8Index] += KU16_ONE;'.");
    debugger_setRelativeFunctionBpAtLine("erh_ManageFailedCounterEvent", 60);
    
    debugger_run();
    
    testStep("STEP", "Check if CPU stopped in function erh_ManageFailedCounterEvent() at line 'erh_au16AecCounter[cu8Index] += KU16_ONE;'.");
    debugger_waitUntilBPisReached(500);
  
    debugger_stepOver();
    
    testCaseComment("Action: ARCH_SW_ERH_0029");
    testStep("STEP", "Evaluate if erh_au16AecCounter[u8Index], where u8Index is ATM_KU8_ID_END_OF_LIFE_HIGH_FORCE, is equal to KU16_ONE. --> erh_au16AecCounter[u8Index] == KU16_ONE");
    result = debugger_readGlobalVariable("uint16", "erh_au16AecCounter,,app.elf", 0x1D);
    EvalManStepEqual("Expected test result",  result, KU16_ONE);
  
  
  testCaseComment("Postcondition");
  testStep("STEP", "Return ECU to default values");
  RunPostTs();
}


testcase SW_IT_ERH_END_OF_LIFE_LOW_01()
{
  //***********************************Test report header*********************************
  testReportAddMiscInfoBlock("AUTOLIV ELECTRONICS document");
  TestReportAddMiscInfo("Nightly test", "No");
  TestReportAddMiscInfo("Test type", "Requirement-Based test");
  TestReportAddMiscInfo("Regression Test", "No");
  TestReportAddMiscInfo("Fault injection method used", "No");
  TestReportAddMiscInfo("Resource usage evaluation", "No");
  TestReportAddMiscInfo("Priority", "No");
  TestReportAddMiscInfo("Safety relevant", "No");
  
  AddRequirementInfo("Requirement under test", "ARCH_SW_ERH_0030");
  AddRequirementInfo("ARCH_SW_ERH_0030", "The ERH_KU8_END_OF_LIFE_LOW_AEC_CFG should have the following properties: ? Qualification Count: Instantaneously (i.e. : NVP_u16CounterToValidateEOLLowForce = 1; ? Deskill Count: None (shall never be deskilled even after reset) (i.e. : NVP_u16CounterToDeskillEOLLowForce = 0); - associated group: KU32_AEC_GROUP_MASK_EOL_LOW_HIGH");
 //***************************************************************************************
  
  testCaseComment("Preconditions");
  testStep("STEP", "Bench Initialization");
  RunPreTs();
  
  
    testStep("STEP", "Set a breakpoint in function ERH_Init() at line 'erh_au16AecCounter[u8Index] = KU16_ZERO;'.");
    debugger_setRelativeFunctionBpAtLine("ERH_Init", 19);
       
    debugger_reset();
    debugger_run();
    
    testStep("STEP", "Check if CPU stopped in function ERH_Init() at line 'erh_au16AecCounter[u8Index] = KU16_ZERO;'.");
    debugger_waitUntilBPisReached(500);
  
    
    debugger_deleteAllBP();
  
  
    testStep("STEP", "Set a breakpoint in ERH_Init() at the end of the function.");
    debugger_setRelativeFunctionBpAtLine("ERH_Init", 65);
    
    debugger_run();
    testWaitForTimeoutSilent(500);

    testCaseComment("Action: ARCH_SW_ERH_0030");
    testStep("STEP", "Evaluate if erh_au16AecCounter[u8Index], where u8Index is ATM_KU8_ID_END_OF_LIFE_LOW_FORCE, is equal to KU16_ZERO. --> erh_au16AecCounter[u8Index] == KU16_ZERO");
    result = debugger_readGlobalVariable("uint16", "erh_au16AecCounter,,app.elf", 0x1C);
    EvalManStepEqual("Expected test result", result, KU16_ZERO);
 
    
    debugger_deleteAllBP();
    debugger_reset();
    debugger_run();
  

    testStep("STEP", "Set a breakpoint in function EOL_Autotest_CheckProductEndOfLifeLowForce() at line '*pu8TestResult = pal_u8ResultOfAutoTest;'.");
    debugger_setRelativeFunctionBpAtLine("EOL_Autotest_CheckProductEndOfLifeLowForce", 20);
    
    debugger_run();
    
    testStep("STEP", "Check if CPU stopped in function EOL_Autotest_CheckProductEndOfLifeLowForce() at line '*pu8TestResult = pal_u8ResultOfAutoTest;'.");
    debugger_waitUntilBPisReached(10000);
    
    testStep("STEP", "Set variable *pu8TestResult to KU8_ATM_TEST_NOK.");
    debugger_writeLocalVariable("*pu8TestResult", 0x02);
    testWaitForTimeoutSilent(2000);


    debugger_deleteAllBP();
  
            
    testStep("STEP", "Set a breakpoint in function erh_ManageFailedCounterEvent() at line 'erh_au16AecCounter[cu8Index] += KU16_ONE;'.");
    debugger_setRelativeFunctionBpAtLine("erh_ManageFailedCounterEvent", 60);
    
    debugger_run();
    
    testStep("STEP", "Check if CPU stopped in function erh_ManageFailedCounterEvent() at line 'erh_au16AecCounter[cu8Index] += KU16_ONE;'.");
    debugger_waitUntilBPisReached(500);
  
    debugger_stepOver();
    
    testCaseComment("Action: ARCH_SW_ERH_0030");
    testStep("STEP", "Evaluate if erh_au16AecCounter[u8Index], where u8Index is ATM_KU8_ID_END_OF_LIFE_LOW_FORCE, is equal to KU16_ONE. --> erh_au16AecCounter[u8Index] == KU16_ONE");
    result = debugger_readGlobalVariable("uint16", "erh_au16AecCounter,,app.elf", 0x1C);
    EvalManStepEqual("Expected test result",  result, KU16_ONE);
  
  
  testCaseComment("Postcondition");
  testStep("STEP", "Return ECU to default values");
  RunPostTs();
}


testcase SW_IT_ERH_END_OF_LIFE_COMFORT_01()
{
 //***********************************Test report header*********************************
  testReportAddMiscInfoBlock("AUTOLIV ELECTRONICS document");
  TestReportAddMiscInfo("Nightly test", "No");
  TestReportAddMiscInfo("Test type", "Requirement-Based test");
  TestReportAddMiscInfo("Regression Test", "No");
  TestReportAddMiscInfo("Fault injection method used", "No");
  TestReportAddMiscInfo("Resource usage evaluation", "No");
  TestReportAddMiscInfo("Priority", "No");
  TestReportAddMiscInfo("Safety relevant", "No");
  
  AddRequirementInfo("Requirement under test", "ARCH_SW_ERH_0031");
  AddRequirementInfo("ARCH_SW_ERH_0031", "The ERH_KU8_END_OF_LIFE_COMFORT_AEC_CFG should have the following properties: ? Qualification Count: Instantaneously (i.e. : NVP_u16CounterToValidateEOLComfort = 1; ? Deskill Count: None (shall never be deskilled even after reset) (i.e. : NVP_u16CounterToDeskillEOLComfort = 0);- associated group: KU32_AEC_GROUP_MASK_EOL_COMFORT");
 //***************************************************************************************
  
  testCaseComment("Preconditions");
  testStep("STEP", "Bench Initialization");
  RunPreTs();
  
  
    testStep("STEP", "Set a breakpoint in function ERH_Init() at line 'erh_au16AecCounter[u8Index] = KU16_ZERO;'.");
    debugger_setRelativeFunctionBpAtLine("ERH_Init", 19);
       
    debugger_reset();
    debugger_run();
    
    testStep("STEP", "Check if CPU stopped in function ERH_Init() at line 'erh_au16AecCounter[u8Index] = KU16_ZERO;'.");
    debugger_waitUntilBPisReached(500);
  
    
    debugger_deleteAllBP();
  
  
    testStep("STEP", "Set a breakpoint in ERH_Init() at the end of the function.");
    debugger_setRelativeFunctionBpAtLine("ERH_Init", 65);
    
    debugger_run();
    testWaitForTimeoutSilent(500);

    testCaseComment("Action: ARCH_SW_ERH_0031");
    testStep("STEP", "Evaluate if erh_au16AecCounter[u8Index], where u8Index is ATM_KU8_ID_END_OF_LIFE_COMFORT, is equal to KU16_ZERO. --> erh_au16AecCounter[u8Index] == KU16_ZERO");
    result = debugger_readGlobalVariable("uint16", "erh_au16AecCounter,,app.elf", 0x1E);
    EvalManStepEqual("Expected test result", result, KU16_ZERO);
 
    
    debugger_deleteAllBP();
    debugger_reset();
    debugger_run();
  

    testStep("STEP", "Set a breakpoint in function EOL_Autotest_CheckProductEndOfLifeComfort() at line '*pu8TestResult = pal_u8ResultOfAutoTest;'.");
    debugger_setRelativeFunctionBpAtLine("EOL_Autotest_CheckProductEndOfLifeComfort", 11);
    
    debugger_run();
    
    testStep("STEP", "Check if CPU stopped in function EOL_Autotest_CheckProductEndOfLifeComfort() at line '*pu8TestResult = pal_u8ResultOfAutoTest;'.");
    debugger_waitUntilBPisReached(10000);
    
    testStep("STEP", "Set variable *pu8TestResult to KU8_ATM_TEST_NOK.");
    debugger_writeLocalVariable("*pu8TestResult", 0x02);
    testWaitForTimeoutSilent(2000);


    debugger_deleteAllBP();
  
            
    testStep("STEP", "Set a breakpoint in function erh_ManageFailedCounterEvent() at line 'erh_au16AecCounter[cu8Index] += KU16_ONE;'.");
    debugger_setRelativeFunctionBpAtLine("erh_ManageFailedCounterEvent", 60);
    
    debugger_run();
    
    testStep("STEP", "Check if CPU stopped in function erh_ManageFailedCounterEvent() at line 'erh_au16AecCounter[cu8Index] += KU16_ONE;'.");
    debugger_waitUntilBPisReached(500);
  
    debugger_stepOver();
    
    testCaseComment("Action: ARCH_SW_ERH_0031");
    testStep("STEP", "Evaluate if erh_au16AecCounter[u8Index], where u8Index is ATM_KU8_ID_END_OF_LIFE_COMFORT, is equal to KU16_ONE. --> erh_au16AecCounter[u8Index] == KU16_ONE");
    result = debugger_readGlobalVariable("uint16", "erh_au16AecCounter,,app.elf", 0x1E);
    EvalManStepEqual("Expected test result",  result, KU16_ONE);
  
  
  testCaseComment("Postcondition");
  testStep("STEP", "Return ECU to default values");
  RunPostTs();
}


testcase SW_IT_ERH_TIMEOUT_PRESAFE_01()
{
 //***********************************Test report header*********************************
  testReportAddMiscInfoBlock("AUTOLIV ELECTRONICS document");
  TestReportAddMiscInfo("Nightly test", "No");
  TestReportAddMiscInfo("Test type", "Requirement-Based test");
  TestReportAddMiscInfo("Regression Test", "No");
  TestReportAddMiscInfo("Fault injection method used", "No");
  TestReportAddMiscInfo("Resource usage evaluation", "No");
  TestReportAddMiscInfo("Priority", "No");
  TestReportAddMiscInfo("Safety relevant", "No");
  
  AddRequirementInfo("Requirement under test", "ARCH_SW_ERH_0032");
  AddRequirementInfo("ARCH_SW_ERH_0032", "The ERH_KU8_TIMEOUT_PRESAFE_AEC_CFG should have the following properties: ? Qualification Count = Instantaneously; ? Deskill Count = 3; - associated group: KU32_AEC_GROUP_MASK_TIMEOUT_PRESAFE");
 //***************************************************************************************
  
  testCaseComment("Preconditions");
  testStep("STEP", "Bench Initialization");
  RunPreTs();
  
  
    testStep("STEP", "Set a breakpoint in function ERH_Init() at line 'erh_au16AecCounter[u8Index] = KU16_ZERO;'.");
    debugger_setRelativeFunctionBpAtLine("ERH_Init", 19);
       
    debugger_reset();
    debugger_run();
    
    testStep("STEP", "Check if CPU stopped in function ERH_Init() at line 'erh_au16AecCounter[u8Index] = KU16_ZERO;'.");
    debugger_waitUntilBPisReached(500);
  
    
    debugger_deleteAllBP();
  
  
    testStep("STEP", "Set a breakpoint in ERH_Init() at the end of the function.");
    debugger_setRelativeFunctionBpAtLine("ERH_Init", 65);
    
    debugger_run();
    testWaitForTimeoutSilent(500);

    testCaseComment("Action: ARCH_SW_ERH_0032");
    testStep("STEP", "Evaluate if erh_au16AecCounter[u8Index], where u8Index is ATM_KU8_ID_TIMEOUT_PRESAFE, is equal to KU16_ZERO. --> erh_au16AecCounter[u8Index] == KU16_ZERO");
    result = debugger_readGlobalVariable("uint16", "erh_au16AecCounter,,app.elf", 0x21);
    EvalManStepEqual("Expected test result", result, KU16_ZERO);
 
    
    debugger_deleteAllBP();
    debugger_reset();
  

    testStep("STEP", "Set a breakpoint in function CIL_Autotest_Presafe_CheckTimeoutError() at line '*pu8TestResult = pal_u8ResultOfAutoTest;'.");
    debugger_setRelativeFunctionBpAtLine("CIL_Autotest_Presafe_CheckTimeoutError", 61);
    
    debugger_run();
    
    testStep("STEP", "Check if CPU stopped in function CIL_Autotest_Presafe_CheckTimeoutError() at line '*pu8TestResult = pal_u8ResultOfAutoTest;'.");
    debugger_waitUntilBPisReached(10000);
    
    testStep("STEP", "Set variable *pu8TestResult to KU8_ATM_TEST_NOK.");
    debugger_writeLocalVariable("*pu8TestResult", 0x02);
    testWaitForTimeoutSilent(2000);


    debugger_deleteAllBP();
  
            
    testStep("STEP", "Set a breakpoint in function erh_ManageFailedCounterEvent() at line 'erh_au16AecCounter[cu8Index] += KU16_ONE;'.");
    debugger_setRelativeFunctionBpAtLine("erh_ManageFailedCounterEvent", 60);
    
    debugger_run();
    
    testStep("STEP", "Check if CPU stopped in function erh_ManageFailedCounterEvent() at line 'erh_au16AecCounter[cu8Index] += KU16_ONE;'.");
    debugger_waitUntilBPisReached(500);
  
    debugger_stepOver();
    
    testCaseComment("Action: ARCH_SW_ERH_0032");
    testStep("STEP", "Evaluate if erh_au16AecCounter[u8Index], where u8Index is ATM_KU8_ID_TIMEOUT_PRESAFE, is equal to KU16_ONE. --> erh_au16AecCounter[u8Index] == KU16_ONE");
    result = debugger_readGlobalVariable("uint16", "erh_au16AecCounter,,app.elf", 0x21);
    EvalManStepEqual("Expected test result",  result, KU16_ONE);
  
  
  testCaseComment("Postcondition");
  testStep("STEP", "Return ECU to default values");
  RunPostTs();
}


testcase SW_IT_ERH_TIMEOUT_BUCKLE_01()
{
 //***********************************Test report header*********************************
  testReportAddMiscInfoBlock("AUTOLIV ELECTRONICS document");
  TestReportAddMiscInfo("Nightly test", "No");
  TestReportAddMiscInfo("Test type", "Requirement-Based test");
  TestReportAddMiscInfo("Regression Test", "No");
  TestReportAddMiscInfo("Fault injection method used", "No");
  TestReportAddMiscInfo("Resource usage evaluation", "No");
  TestReportAddMiscInfo("Priority", "No");
  TestReportAddMiscInfo("Safety relevant", "No");
  
  AddRequirementInfo("Requirement under test", "ARCH_SW_ERH_0033");
  AddRequirementInfo("ARCH_SW_ERH_0033", "The ERH_KU8_TIMEOUT_BUCKLE_AEC_CFG should have the following properties: ? Qualification Count = Instantaneously; ? Deskill Count = 3; - associated group: KU32_AEC_GROUP_MASK_TIMEOUT_BUCKLE.");
  //***************************************************************************************
  
  testCaseComment("Preconditions");
  testStep("STEP", "Bench Initialization");
  RunPreTs();
  
  
    testStep("STEP", "Set a breakpoint in function ERH_Init() at line 'erh_au16AecCounter[u8Index] = KU16_ZERO;'.");
    debugger_setRelativeFunctionBpAtLine("ERH_Init", 19);
       
    debugger_reset();
    debugger_run();
    
    testStep("STEP", "Check if CPU stopped in function ERH_Init() at line 'erh_au16AecCounter[u8Index] = KU16_ZERO;'.");
    debugger_waitUntilBPisReached(500);
  
    
    debugger_deleteAllBP();
  
  
    testStep("STEP", "Set a breakpoint in ERH_Init() at the end of the function.");
    debugger_setRelativeFunctionBpAtLine("ERH_Init", 65);
    
    debugger_run();
    testWaitForTimeoutSilent(500);

    testCaseComment("Action: ARCH_SW_ERH_0033");
    testStep("STEP", "Evaluate if erh_au16AecCounter[u8Index], where u8Index is ATM_KU8_ID_TIMEOUT_BUCKLE, is equal to KU16_ZERO. --> erh_au16AecCounter[u8Index] == KU16_ZERO");
    result = debugger_readGlobalVariable("uint16", "erh_au16AecCounter,,app.elf", 0x22);
    EvalManStepEqual("Expected test result", result, KU16_ZERO);
 
    
    debugger_deleteAllBP();
    debugger_reset();
    debugger_run();
  

    testStep("STEP", "Set a breakpoint in function CIL_Autotest_Buckle_CheckTimeoutError() at line '*pu8TestResult = pal_u8ResultOfAutoTest;'.");
    debugger_setRelativeFunctionBpAtLine("CIL_Autotest_Buckle_CheckTimeoutError", 61);
    
    debugger_run();
    
    testStep("STEP", "Check if CPU stopped in function CIL_Autotest_Buckle_CheckTimeoutError() at line '*pu8TestResult = pal_u8ResultOfAutoTest;'.");
    debugger_waitUntilBPisReached(10000);
    
    testStep("STEP", "Set variable *pu8TestResult to KU8_ATM_TEST_NOK.");
    debugger_writeLocalVariable("*pu8TestResult", 0x02);
    testWaitForTimeoutSilent(2000);


    debugger_deleteAllBP();
  
            
    testStep("STEP", "Set a breakpoint in function erh_ManageFailedCounterEvent() at line 'erh_au16AecCounter[cu8Index] += KU16_ONE;'.");
    debugger_setRelativeFunctionBpAtLine("erh_ManageFailedCounterEvent", 60);
    
    debugger_run();
    
    testStep("STEP", "Check if CPU stopped in function erh_ManageFailedCounterEvent() at line 'erh_au16AecCounter[cu8Index] += KU16_ONE;'.");
    debugger_waitUntilBPisReached(500);
  
    debugger_stepOver();
    
    testCaseComment("Action: ARCH_SW_ERH_0033");
    testStep("STEP", "Evaluate if erh_au16AecCounter[u8Index], where u8Index is ATM_KU8_ID_TIMEOUT_BUCKLE, is equal to KU16_ONE. --> erh_au16AecCounter[u8Index] == KU16_ONE");
    result = debugger_readGlobalVariable("uint16", "erh_au16AecCounter,,app.elf", 0x22);
    EvalManStepEqual("Expected test result",  result, KU16_ONE);
  
  
  testCaseComment("Postcondition");
  testStep("STEP", "Return ECU to default values");
  RunPostTs();
}


testcase SW_IT_ERH_IMPLAUSIBLE_DATA_PRESAFE_01()
{
 //***********************************Test report header*********************************
  testReportAddMiscInfoBlock("AUTOLIV ELECTRONICS document");
  TestReportAddMiscInfo("Nightly test", "No");
  TestReportAddMiscInfo("Test type", "Requirement-Based test");
  TestReportAddMiscInfo("Regression Test", "No");
  TestReportAddMiscInfo("Fault injection method used", "No");
  TestReportAddMiscInfo("Resource usage evaluation", "No");
  TestReportAddMiscInfo("Priority", "No");
  TestReportAddMiscInfo("Safety relevant", "No");
  
  AddRequirementInfo("Requirement under test", "ARCH_SW_ERH_0034");
  AddRequirementInfo("ARCH_SW_ERH_0034", "The ERH_KU8_IMPLAUSIBLE_DATA_PRESAFE_AEC_CFG should have the following properties: ? Qualification Count = 10; ? Deskill Count = 3; - associated group: KU32_AEC_GROUP_MASK_IMPLAUSIBLE_DATA_PRESAFE.");
 //***************************************************************************************
  
  testCaseComment("Preconditions");
  testStep("STEP", "Bench Initialization");
  RunPreTs();
  
  
    testStep("STEP", "Set a breakpoint in function ERH_Init() at line 'erh_au16AecCounter[u8Index] = KU16_ZERO;'.");
    debugger_setRelativeFunctionBpAtLine("ERH_Init", 19);
    
    debugger_reset();
    debugger_run();
    
    testStep("STEP", "Check if CPU stopped in function ERH_Init() at line 'erh_au16AecCounter[u8Index] = KU16_ZERO;'.");
    debugger_waitUntilBPisReached(500);
  
    
    debugger_deleteAllBP();
  
  
    testStep("STEP", "Set a breakpoint in ERH_Init() at the end of the function.");
    debugger_setRelativeFunctionBpAtLine("ERH_Init", 65);
    
    debugger_run();
    testWaitForTimeoutSilent(500);
    
    testCaseComment("Action: ARCH_SW_ERH_0034");
    testStep("STEP", "Evaluate if erh_au16AecCounter[u8Index], where u8Index is ATM_KU8_ID_IMPLAUSIBLE_DATA_PRESAFE, is equal to KU16_ZERO. --> erh_au16AecCounter[u8Index] == KU16_ZERO");
    result = debugger_readGlobalVariable("uint16", "erh_au16AecCounter,,app.elf", 0x23);
    EvalManStepEqual("Expected test result", result, KU16_ZERO);
 
    
    debugger_deleteAllBP();
    debugger_reset();
    debugger_run();
  

    testStep("STEP", "Set a breakpoint in function CIL_Autotest_CheckImplausibleData_Presafe() at line '*pu8TestResult = pal_u8ResultOfAutoTest;'.");
    debugger_setRelativeFunctionBpAtLine("CIL_Autotest_CheckImplausibleData_Presafe", 13);
    
    debugger_run();
    
    testStep("STEP", "Check if CPU stopped in function CIL_Autotest_CheckImplausibleData_Presafe() at line '*pu8TestResult = pal_u8ResultOfAutoTest;'.");
    debugger_waitUntilBPisReached(10000);
    
    testStep("STEP", "Set variable *pu8TestResult to KU8_ATM_TEST_NOK.");
    debugger_writeLocalVariable("*pu8TestResult", 0x02);
    testWaitForTimeoutSilent(2000);


    debugger_deleteAllBP();
  
            
    testStep("STEP", "Set a breakpoint in function erh_ManageFailedCounterEvent() at line 'erh_au16AecCounter[cu8Index] += KU16_ONE;'.");
    debugger_setRelativeFunctionBpAtLine("erh_ManageFailedCounterEvent", 60);
    
    debugger_run();
    
    testStep("STEP", "Check if CPU stopped in function erh_ManageFailedCounterEvent() at line 'erh_au16AecCounter[cu8Index] += KU16_ONE;'.");
    debugger_waitUntilBPisReached(500);
  
    debugger_stepOver();
    
    testCaseComment("Action: ARCH_SW_ERH_0034");
    testStep("STEP", "Evaluate if erh_au16AecCounter[u8Index], where u8Index is ATM_KU8_ID_IMPLAUSIBLE_DATA_PRESAFE, is equal to KU16_ONE. --> erh_au16AecCounter[u8Index] == KU16_ONE");
    result = debugger_readGlobalVariable("uint16", "erh_au16AecCounter,,app.elf", 0x23);
    EvalManStepEqual("Expected test result",  result, KU16_ONE);
  
  
  testCaseComment("Postcondition");
  testStep("STEP", "Return ECU to default values");
  RunPostTs();
}


testcase SW_IT_ERH_IMPLAUSIBLE_DATA_IGNITION_01()
{
 //***********************************Test report header*********************************
  testReportAddMiscInfoBlock("AUTOLIV ELECTRONICS document");
  TestReportAddMiscInfo("Nightly test", "No");
  TestReportAddMiscInfo("Test type", "Requirement-Based test");
  TestReportAddMiscInfo("Regression Test", "No");
  TestReportAddMiscInfo("Fault injection method used", "No");
  TestReportAddMiscInfo("Resource usage evaluation", "No");
  TestReportAddMiscInfo("Priority", "No");
  TestReportAddMiscInfo("Safety relevant", "No");
  
  AddRequirementInfo("Requirement under test", "ARCH_SW_ERH_0035");
  AddRequirementInfo("ARCH_SW_ERH_0035", "The ERH_KU8_IMPLAUSIBLE_DATA_IGNITION_AEC_CFG should have the following properties: ?  Qualification Count = 10; ? Deskill Count = 3; - associated group: KU32_AEC_GROUP_MASK_IMPLAUSIBLE_DATA_IGNITION.");
 //***************************************************************************************
  
  testCaseComment("Preconditions");
  testStep("STEP", "Bench Initialization");
  RunPreTs();
  
  
    testStep("STEP", "Set a breakpoint in function ERH_Init() at line 'erh_au16AecCounter[u8Index] = KU16_ZERO;'.");
    debugger_setRelativeFunctionBpAtLine("ERH_Init", 19);
    
    debugger_reset();
    debugger_run();
    
    testStep("STEP", "Check if CPU stopped in function ERH_Init() at line 'erh_au16AecCounter[u8Index] = KU16_ZERO;'.");
    debugger_waitUntilBPisReached(500);
  
    
    debugger_deleteAllBP();
  
  
    testStep("STEP", "Set a breakpoint in ERH_Init() at the end of the function.");
    debugger_setRelativeFunctionBpAtLine("ERH_Init", 65);
    
    debugger_run();
    testWaitForTimeoutSilent(500);
    
    testCaseComment("Action: ARCH_SW_ERH_0035");
    testStep("STEP", "Evaluate if erh_au16AecCounter[u8Index], where u8Index is ATM_KU8_ID_IMPLAUSIBLE_DATA_IGNITION, is equal to KU16_ZERO. --> erh_au16AecCounter[u8Index] == KU16_ZERO");
    result = debugger_readGlobalVariable("uint16", "erh_au16AecCounter,,app.elf", 0x24);
    EvalManStepEqual("Expected test result", result, KU16_ZERO);
 
    
    debugger_deleteAllBP();
    debugger_reset();
    debugger_run();
  

    testStep("STEP", "Set a breakpoint in function CIL_Autotest_CheckImplausibleData_Ignition() at line '*pu8TestResult = pal_u8ResultOfAutoTest;'.");
    debugger_setRelativeFunctionBpAtLine("CIL_Autotest_CheckImplausibleData_Ignition", 13);
    
    debugger_run();
    
    testStep("STEP", "Check if CPU stopped in function CIL_Autotest_CheckImplausibleData_Ignition() at line '*pu8TestResult = pal_u8ResultOfAutoTest;'.");
    debugger_waitUntilBPisReached(10000);
    
    testStep("STEP", "Set variable *pu8TestResult to KU8_ATM_TEST_NOK.");
    debugger_writeLocalVariable("*pu8TestResult", 0x02);
    testWaitForTimeoutSilent(2000);


    debugger_deleteAllBP();
  
            
    testStep("STEP", "Set a breakpoint in function erh_ManageFailedCounterEvent() at line 'erh_au16AecCounter[cu8Index] += KU16_ONE;'.");
    debugger_setRelativeFunctionBpAtLine("erh_ManageFailedCounterEvent", 60);
    
    debugger_run();
    
    testStep("STEP", "Check if CPU stopped in function erh_ManageFailedCounterEvent() at line 'erh_au16AecCounter[cu8Index] += KU16_ONE;'.");
    debugger_waitUntilBPisReached(500);
  
    debugger_stepOver();
    
    testCaseComment("Action: ARCH_SW_ERH_0035");
    testStep("STEP", "Evaluate if erh_au16AecCounter[u8Index], where u8Index is ATM_KU8_ID_IMPLAUSIBLE_DATA_IGNITION, is equal to KU16_ONE. --> erh_au16AecCounter[u8Index] == KU16_ONE");
    result = debugger_readGlobalVariable("uint16", "erh_au16AecCounter,,app.elf", 0x24);
    EvalManStepEqual("Expected test result",  result, KU16_ONE);
  
  
  testCaseComment("Postcondition");
  testStep("STEP", "Return ECU to default values");
  RunPostTs();
}


testcase SW_IT_ERH_IMPLAUSIBLE_DATA_BUCKLE_01()
{
 //***********************************Test report header*********************************
  testReportAddMiscInfoBlock("AUTOLIV ELECTRONICS document");
  TestReportAddMiscInfo("Nightly test", "No");
  TestReportAddMiscInfo("Test type", "Requirement-Based test");
  TestReportAddMiscInfo("Regression Test", "No");
  TestReportAddMiscInfo("Fault injection method used", "No");
  TestReportAddMiscInfo("Resource usage evaluation", "No");
  TestReportAddMiscInfo("Priority", "No");
  TestReportAddMiscInfo("Safety relevant", "No");
  
  AddRequirementInfo("Requirement under test", "ARCH_SW_ERH_0036");
  AddRequirementInfo("ARCH_SW_ERH_0036", "The ERH_KU8_IMPLAUSIBLE_DATA_BUCKLE_AEC_CFG should have the following properties: ? Qualification Count = 10; ? Deskill Count = 3; - associated group: KU32_AEC_GROUP_MASK_IMPLAUSIBLE_DATA_BUCKLE_ORC.");
 //***************************************************************************************
  
  testCaseComment("Preconditions");
  testStep("STEP", "Bench Initialization");
  RunPreTs();
  
  
    testStep("STEP", "Set a breakpoint in function ERH_Init() at line 'erh_au16AecCounter[u8Index] = KU16_ZERO;'.");
    debugger_setRelativeFunctionBpAtLine("ERH_Init", 19);
    
    debugger_reset();
    debugger_run();
    
    testStep("STEP", "Check if CPU stopped in function ERH_Init() at line 'erh_au16AecCounter[u8Index] = KU16_ZERO;'.");
    debugger_waitUntilBPisReached(500);
  
    
    debugger_deleteAllBP();
  
  
    testStep("STEP", "Set a breakpoint in ERH_Init() at the end of the function.");
    debugger_setRelativeFunctionBpAtLine("ERH_Init", 65);
    
    debugger_run();
    testWaitForTimeoutSilent(500);
    
    testCaseComment("Action: ARCH_SW_ERH_0036");
    testStep("STEP", "Evaluate if erh_au16AecCounter[u8Index], where u8Index is ATM_KU8_ID_IMPLAUSIBLE_DATA_BUCKLE, is equal to KU16_ZERO. --> erh_au16AecCounter[u8Index] == KU16_ZERO");
    result = debugger_readGlobalVariable("uint16", "erh_au16AecCounter,,app.elf", 0x25);
    EvalManStepEqual("Expected test result", result, KU16_ZERO);
 
    
    debugger_deleteAllBP();
    debugger_reset();
    debugger_run();
  

    testStep("STEP", "Set a breakpoint in function CIL_Autotest_CheckImplausibleData_Buckle() at line '*pu8TestResult = pal_u8ResultOfAutoTest;'.");
    debugger_setRelativeFunctionBpAtLine("CIL_Autotest_CheckImplausibleData_Buckle", 14);
    
    debugger_run();
    
    testStep("STEP", "Check if CPU stopped in function CIL_Autotest_CheckImplausibleData_Buckle() at line '*pu8TestResult = pal_u8ResultOfAutoTest;'.");
    debugger_waitUntilBPisReached(10000);
    
    testStep("STEP", "Set variable *pu8TestResult to KU8_ATM_TEST_NOK.");
    debugger_writeLocalVariable("*pu8TestResult", 0x02);
    testWaitForTimeoutSilent(2000);


    debugger_deleteAllBP();
  
            
    testStep("STEP", "Set a breakpoint in function erh_ManageFailedCounterEvent() at line 'erh_au16AecCounter[cu8Index] += KU16_ONE;'.");
    debugger_setRelativeFunctionBpAtLine("erh_ManageFailedCounterEvent", 60);
    
    debugger_run();
    
    testStep("STEP", "Check if CPU stopped in function erh_ManageFailedCounterEvent() at line 'erh_au16AecCounter[cu8Index] += KU16_ONE;'.");
    debugger_waitUntilBPisReached(500);
  
    debugger_stepOver();
    
    testCaseComment("Action: ARCH_SW_ERH_0036");
    testStep("STEP", "Evaluate if erh_au16AecCounter[u8Index], where u8Index is ATM_KU8_ID_IMPLAUSIBLE_DATA_BUCKLE, is equal to KU16_ONE. --> erh_au16AecCounter[u8Index] == KU16_ONE");
    result = debugger_readGlobalVariable("uint16", "erh_au16AecCounter,,app.elf", 0x25);
    EvalManStepEqual("Expected test result",  result, KU16_ONE);
  
  
  testCaseComment("Postcondition");
  testStep("STEP", "Return ECU to default values");
  RunPostTs();
}


testcase SW_IT_ERH_SYSTEM_OV_01()
{
 //***********************************Test report header*********************************
  testReportAddMiscInfoBlock("AUTOLIV ELECTRONICS document");
  TestReportAddMiscInfo("Nightly test", "No");
  TestReportAddMiscInfo("Test type", "Requirement-Based test");
  TestReportAddMiscInfo("Regression Test", "No");
  TestReportAddMiscInfo("Fault injection method used", "No");
  TestReportAddMiscInfo("Resource usage evaluation", "No");
  TestReportAddMiscInfo("Priority", "No");
  TestReportAddMiscInfo("Safety relevant", "No");
  
  AddRequirementInfo("Requirement under test", "ARCH_SW_ERH_0037");
  AddRequirementInfo("ARCH_SW_ERH_0037", "The ERH_KU8_SYSTEM_OV_AEC_CFG should have the following properties: ? Qualification_time = 15s; ? Deskill_time = 15sec; - associated group: KU32_AEC_GROUP_MASK_SYSTEM_OV.");
 //***************************************************************************************
  
  testCaseComment("Preconditions");
  testStep("STEP", "Bench Initialization");
  RunPreTs();
  
  
    testStep("STEP", "Set a breakpoint in function ERH_Init() at line 'erh_au16AecCounter[u8Index] = KU16_ZERO;'.");
    debugger_setRelativeFunctionBpAtLine("ERH_Init", 19);
    
    debugger_reset();
    debugger_run();
    
    testStep("STEP", "Check if CPU stopped in function ERH_Init() at line 'erh_au16AecCounter[u8Index] = KU16_ZERO;'.");
    debugger_waitUntilBPisReached(500);
  
    
    debugger_deleteAllBP();
    
  
    testStep("STEP", "Set a breakpoint in ERH_Init() at the end of the function.");
    debugger_setRelativeFunctionBpAtLine("ERH_Init", 65);
    
    debugger_run();
    testWaitForTimeoutSilent(500);
    
    testCaseComment("Action: ARCH_SW_ERH_0037");
    testStep("STEP", "Evaluate if erh_au16AecCounter[u8Index], where u8Index is ATM_KU8_ID_SYSTEM_OV, is equal to KU16_ZERO. --> erh_au16AecCounter[u8Index] == KU16_ZERO");
    result = debugger_readGlobalVariable("uint16", "erh_au16AecCounter,,app.elf", 0x2D);
    EvalManStepEqual("Expected test result", result, KU16_ZERO);
 
    
    debugger_deleteAllBP();
    debugger_reset();
    debugger_run();
  

    testStep("STEP", "Set a breakpoint in function PMP_Autotest_CheckSystemOV() at line '*pu8TestResult = pal_u8ResultOfAutoTest;'.");
    debugger_setRelativeFunctionBpAtLine("PMP_Autotest_CheckSystemOV", 62);
    
    debugger_run();
    
    testStep("STEP", "Check if CPU stopped in function PMP_Autotest_CheckSystemOV() at line '*pu8TestResult = pal_u8ResultOfAutoTest;'.");
    debugger_waitUntilBPisReached(10000);
    
    testStep("STEP", "Set variable *pu8TestResult to KU8_ATM_TEST_NOK.");
    debugger_writeLocalVariable("*pu8TestResult", 0x02);
    testWaitForTimeoutSilent(2000);


    debugger_deleteAllBP();
  
            
    testStep("STEP", "Set a breakpoint in function erh_ManageFailedCounterEvent() at line 'erh_au16AecCounter[cu8Index] += KU16_ONE;'.");
    debugger_setRelativeFunctionBpAtLine("erh_ManageFailedCounterEvent", 60);
    
    debugger_run();
    
    testStep("STEP", "Check if CPU stopped in function erh_ManageFailedCounterEvent() at line 'erh_au16AecCounter[cu8Index] += KU16_ONE;'.");
    debugger_waitUntilBPisReached(500);
  
    debugger_stepOver();
    
    testCaseComment("Action: ARCH_SW_ERH_0037");
    testStep("STEP", "Evaluate if erh_au16AecCounter[u8Index], where u8Index is ATM_KU8_ID_SYSTEM_OV, is equal to KU16_ONE. --> erh_au16AecCounter[u8Index] == KU16_ONE");
    result = debugger_readGlobalVariable("uint16", "erh_au16AecCounter,,app.elf", 0x2D);
    EvalManStepEqual("Expected test result",  result, KU16_ONE);
  
  
  testCaseComment("Postcondition");
  testStep("STEP", "Return ECU to default values");
  RunPostTs();
}


testcase SW_IT_ERH_SYSTEM_UV_01()
{
 //***********************************Test report header*********************************
  testReportAddMiscInfoBlock("AUTOLIV ELECTRONICS document");
  TestReportAddMiscInfo("Nightly test", "No");
  TestReportAddMiscInfo("Test type", "Requirement-Based test");
  TestReportAddMiscInfo("Regression Test", "No");
  TestReportAddMiscInfo("Fault injection method used", "No");
  TestReportAddMiscInfo("Resource usage evaluation", "No");
  TestReportAddMiscInfo("Priority", "No");
  TestReportAddMiscInfo("Safety relevant", "No");
  
  AddRequirementInfo("Requirement under test", "ARCH_SW_ERH_0038");
  AddRequirementInfo("ARCH_SW_ERH_0038", "The ERH_KU8_SYSTEM_UV_AEC_CFG should have the following properties: ? Qualification_time = 15; ? Deskill_time = 15sec; - associated group: KU32_AEC_GROUP_MASK_SYSTEM_UV.");
 //***************************************************************************************
  
  testCaseComment("Preconditions");
  testStep("STEP", "Bench Initialization");
  RunPreTs();
  
  
    testStep("STEP", "Set a breakpoint in function ERH_Init() at line 'erh_au16AecCounter[u8Index] = KU16_ZERO;'.");
    debugger_setRelativeFunctionBpAtLine("ERH_Init", 19);
    
    debugger_reset();
    debugger_run();
    
    testStep("STEP", "Check if CPU stopped in function ERH_Init() at line 'erh_au16AecCounter[u8Index] = KU16_ZERO;'.");
    debugger_waitUntilBPisReached(500);
  
    
    debugger_deleteAllBP();
    
  
    testStep("STEP", "Set a breakpoint in ERH_Init() at the end of the function.");
    debugger_setRelativeFunctionBpAtLine("ERH_Init", 65);
    
    debugger_run();
    testWaitForTimeoutSilent(500);
    
    testCaseComment("Action: ARCH_SW_ERH_0038");
    testStep("STEP", "Evaluate if erh_au16AecCounter[u8Index], where u8Index is ATM_KU8_ID_SYSTEM_UV, is equal to KU16_ZERO. --> erh_au16AecCounter[u8Index] == KU16_ZERO");
    result = debugger_readGlobalVariable("uint16", "erh_au16AecCounter,,app.elf", 0x2E);
    EvalManStepEqual("Expected test result", result, KU16_ZERO);
 
    
    debugger_deleteAllBP();
    debugger_reset();
    debugger_run();
  

    testStep("STEP", "Set a breakpoint in function PMP_Autotest_CheckSystemUV() at line '*pu8TestResult = pal_u8ResultOfAutoTest;'.");
    debugger_setRelativeFunctionBpAtLine("PMP_Autotest_CheckSystemUV", 71);
    
    debugger_run();
    
    testStep("STEP", "Check if CPU stopped in function PMP_Autotest_CheckSystemUV() at line '*pu8TestResult = pal_u8ResultOfAutoTest;'.");
    debugger_waitUntilBPisReached(10000);
    
    testStep("STEP", "Set variable *pu8TestResult to KU8_ATM_TEST_NOK.");
    debugger_writeLocalVariable("*pu8TestResult", 0x02);
    testWaitForTimeoutSilent(2000);


    debugger_deleteAllBP();
  
            
    testStep("STEP", "Set a breakpoint in function erh_ManageFailedCounterEvent() at line 'erh_au16AecCounter[cu8Index] += KU16_ONE;'.");
    debugger_setRelativeFunctionBpAtLine("erh_ManageFailedCounterEvent", 60);
    
    debugger_run();
    
    testStep("STEP", "Check if CPU stopped in function erh_ManageFailedCounterEvent() at line 'erh_au16AecCounter[cu8Index] += KU16_ONE;'.");
    debugger_waitUntilBPisReached(500);
  
    debugger_stepOver();
    
    testCaseComment("Action: ARCH_SW_ERH_0038");
    testStep("STEP", "Evaluate if erh_au16AecCounter[u8Index], where u8Index is ATM_KU8_ID_SYSTEM_UV, is equal to KU16_ONE. --> erh_au16AecCounter[u8Index] == KU16_ONE");
    result = debugger_readGlobalVariable("uint16", "erh_au16AecCounter,,app.elf", 0x2E);
    EvalManStepEqual("Expected test result",  result, KU16_ONE);
  
  
  testCaseComment("Postcondition");
  testStep("STEP", "Return ECU to default values");
  RunPostTs();
}


testcase SW_IT_ERH_TIMEOUT_POWERTRAIN_01()
{
 //***********************************Test report header*********************************
  testReportAddMiscInfoBlock("AUTOLIV ELECTRONICS document");
  TestReportAddMiscInfo("Nightly test", "No");
  TestReportAddMiscInfo("Test type", "Requirement-Based test");
  TestReportAddMiscInfo("Regression Test", "No");
  TestReportAddMiscInfo("Fault injection method used", "No");
  TestReportAddMiscInfo("Resource usage evaluation", "No");
  TestReportAddMiscInfo("Priority", "No");
  TestReportAddMiscInfo("Safety relevant", "No");
  
  AddRequirementInfo("Requirement under test", "ARCH_SW_ERH_0039");
  AddRequirementInfo("ARCH_SW_ERH_0039", "The ERH_KU8_TIMEOUT_POWERTRAIN_AEC_CFG should have the following properties: ? Qualification Count = Instantaneously; ? Deskill Count = 3; - associated group: KU32_AEC_GROUP_MASK_TIMEOUT_POWERTRAIN");
 //***************************************************************************************
  
  testCaseComment("Preconditions");
  testStep("STEP", "Bench Initialization");
  RunPreTs();
  
  
    testStep("STEP", "Set a breakpoint in function ERH_Init() at line 'erh_au16AecCounter[u8Index] = KU16_ZERO;'.");
    debugger_setRelativeFunctionBpAtLine("ERH_Init", 19);
    
    debugger_reset();
    debugger_run();
    
    testStep("STEP", "Check if CPU stopped in function ERH_Init() at line 'erh_au16AecCounter[u8Index] = KU16_ZERO;'.");
    debugger_waitUntilBPisReached(500);
  
    
    debugger_deleteAllBP();
    
  
    testStep("STEP", "Set a breakpoint in ERH_Init() at the end of the function.");
    debugger_setRelativeFunctionBpAtLine("ERH_Init", 65);
    
    debugger_run();
    testWaitForTimeoutSilent(500);
    
    testCaseComment("Action: ARCH_SW_ERH_0039");
    testStep("STEP", "Evaluate if erh_au16AecCounter[u8Index], where u8Index is ATM_KU8_ID_TIMEOUT_POWERTRAIN, is equal to KU16_ZERO. --> erh_au16AecCounter[u8Index] == KU16_ZERO");
    result = debugger_readGlobalVariable("uint16", "erh_au16AecCounter,,app.elf", 0x2B);
    EvalManStepEqual("Expected test result", result, KU16_ZERO);
 
    
    debugger_deleteAllBP();
    debugger_reset();
    debugger_run();
  

    testStep("STEP", "Set a breakpoint in function CIL_Autotest_CheckTimeoutError_Powertrain() at line '*pu8TestResult = pal_u8ResultOfAutoTest;'.");
    debugger_setRelativeFunctionBpAtLine("CIL_Autotest_CheckTimeoutError_Powertrain", 60);
    
    debugger_run();
    
    testStep("STEP", "Check if CPU stopped in function CIL_Autotest_CheckTimeoutError_Powertrain() at line '*pu8TestResult = pal_u8ResultOfAutoTest;'.");
    debugger_waitUntilBPisReached(10000);
    
    testStep("STEP", "Set variable *pu8TestResult to KU8_ATM_TEST_NOK.");
    debugger_writeLocalVariable("*pu8TestResult", 0x02);
    testWaitForTimeoutSilent(2000);


    debugger_deleteAllBP();
  
            
    testStep("STEP", "Set a breakpoint in function erh_ManageFailedCounterEvent() at line 'erh_au16AecCounter[cu8Index] += KU16_ONE;'.");
    debugger_setRelativeFunctionBpAtLine("erh_ManageFailedCounterEvent", 60);
    
    debugger_run();
    
    testStep("STEP", "Check if CPU stopped in function erh_ManageFailedCounterEvent() at line 'erh_au16AecCounter[cu8Index] += KU16_ONE;'.");
    debugger_waitUntilBPisReached(500);
  
    debugger_stepOver();
    
    testCaseComment("Action: ARCH_SW_ERH_0039");
    testStep("STEP", "Evaluate if erh_au16AecCounter[u8Index], where u8Index is ATM_KU8_ID_TIMEOUT_POWERTRAIN, is equal to KU16_ONE. --> erh_au16AecCounter[u8Index] == KU16_ONE");
    result = debugger_readGlobalVariable("uint16", "erh_au16AecCounter,,app.elf", 0x2B);
    EvalManStepEqual("Expected test result",  result, KU16_ONE);
  
  
  testCaseComment("Postcondition");
  testStep("STEP", "Return ECU to default values");
  RunPostTs();
}


testcase SW_IT_ERH_IMPLAUSIBLE_DATA_POWERTRAIN_RDY_01()
{
 //***********************************Test report header*********************************
  testReportAddMiscInfoBlock("AUTOLIV ELECTRONICS document");
  TestReportAddMiscInfo("Nightly test", "No");
  TestReportAddMiscInfo("Test type", "Requirement-Based test");
  TestReportAddMiscInfo("Regression Test", "No");
  TestReportAddMiscInfo("Fault injection method used", "No");
  TestReportAddMiscInfo("Resource usage evaluation", "No");
  TestReportAddMiscInfo("Priority", "No");
  TestReportAddMiscInfo("Safety relevant", "No");
  
  AddRequirementInfo("Requirement under test", "ARCH_SW_ERH_0040");
  AddRequirementInfo("ARCH_SW_ERH_0040", "The ERH_KU8_IMPLAUSIBLE_DATA_POWERTRAIN_RDY_AEC_CFG should have the following properties: ? Qualification Count =10; ? Deskill Count = 3; - associated group: KU32_AEC_GROUP_MASK_IMPLAUSIBLE_DATA_POWERTRAIN.");
 //***************************************************************************************
  
  testCaseComment("Preconditions");
  testStep("STEP", "Bench Initialization");
  RunPreTs();
  
  
    testStep("STEP", "Set a breakpoint in function ERH_Init() at line 'erh_au16AecCounter[u8Index] = KU16_ZERO;'.");
    debugger_setRelativeFunctionBpAtLine("ERH_Init", 19);
    
    debugger_reset();
    debugger_run();
    
    testStep("STEP", "Check if CPU stopped in function ERH_Init() at line 'erh_au16AecCounter[u8Index] = KU16_ZERO;'.");
    debugger_waitUntilBPisReached(500);
  
    
    debugger_deleteAllBP();
    
  
    testStep("STEP", "Set a breakpoint in ERH_Init() at the end of the function.");
    debugger_setRelativeFunctionBpAtLine("ERH_Init", 65);
    
    debugger_run();
    testWaitForTimeoutSilent(500);
    
    testCaseComment("Action: ARCH_SW_ERH_0040");
    testStep("STEP", "Evaluate if erh_au16AecCounter[u8Index], where u8Index is ATM_KU8_ID_IMPLAUSIBLE_DATA_POWERTRAIN_RDY, is equal to KU16_ZERO. --> erh_au16AecCounter[u8Index] == KU16_ZERO");
    result = debugger_readGlobalVariable("uint16", "erh_au16AecCounter,,app.elf", 0x2A);
    EvalManStepEqual("Expected test result", result, KU16_ZERO);
 
    
    debugger_deleteAllBP();
    debugger_reset();
    debugger_run();
  

    testStep("STEP", "Set a breakpoint in function CIL_Autotest_CheckImplausibleData_PowertrainRdy() at line '*pu8TestResult = pal_u8ResultOfAutoTest;'.");
    debugger_setRelativeFunctionBpAtLine("CIL_Autotest_CheckImplausibleData_PowertrainRdy", 11);
    
    debugger_run();
    
    testStep("STEP", "Check if CPU stopped in function CIL_Autotest_CheckImplausibleData_PowertrainRdy() at line '*pu8TestResult = pal_u8ResultOfAutoTest;'.");
    debugger_waitUntilBPisReached(10000);
    
    testStep("STEP", "Set variable *pu8TestResult to KU8_ATM_TEST_NOK.");
    debugger_writeLocalVariable("*pu8TestResult", 0x02);
    testWaitForTimeoutSilent(2000);


    debugger_deleteAllBP();
  
            
    testStep("STEP", "Set a breakpoint in function erh_ManageFailedCounterEvent() at line 'erh_au16AecCounter[cu8Index] += KU16_ONE;'.");
    debugger_setRelativeFunctionBpAtLine("erh_ManageFailedCounterEvent", 60);
    
    debugger_run();
    
    testStep("STEP", "Check if CPU stopped in function erh_ManageFailedCounterEvent() at line 'erh_au16AecCounter[cu8Index] += KU16_ONE;'.");
    debugger_waitUntilBPisReached(500);
  
    debugger_stepOver();
    
    testCaseComment("Action: ARCH_SW_ERH_0040");
    testStep("STEP", "Evaluate if erh_au16AecCounter[u8Index], where u8Index is ATM_KU8_ID_IMPLAUSIBLE_DATA_POWERTRAIN_RDY, is equal to KU16_ONE. --> erh_au16AecCounter[u8Index] == KU16_ONE");
    result = debugger_readGlobalVariable("uint16", "erh_au16AecCounter,,app.elf", 0x2A);
    EvalManStepEqual("Expected test result",  result, KU16_ONE);
  
  
  testCaseComment("Postcondition");
  testStep("STEP", "Return ECU to default values");
  RunPostTs();
}


testcase SW_IT_ERH_IMPLAUSIBLE_DATA_ORC_01()
{
 //***********************************Test report header*********************************
  testReportAddMiscInfoBlock("AUTOLIV ELECTRONICS document");
  TestReportAddMiscInfo("Nightly test", "No");
  TestReportAddMiscInfo("Test type", "Requirement-Based test");
  TestReportAddMiscInfo("Regression Test", "No");
  TestReportAddMiscInfo("Fault injection method used", "No");
  TestReportAddMiscInfo("Resource usage evaluation", "No");
  TestReportAddMiscInfo("Priority", "No");
  TestReportAddMiscInfo("Safety relevant", "No");
  
  AddRequirementInfo("Requirement under test", "ARCH_SW_ERH_0041");
  AddRequirementInfo("ARCH_SW_ERH_0041", "The ERH_KU8_IMPLAUSIBLE_DATA_ORC_AEC_CFG should have the following properties: ? Qualification Count =10; ? Deskill Count = 3; - associated group: KU32_AEC_GROUP_MASK_IMPLAUSIBLE_DATA_BUCKLE_ORC.");
 //***************************************************************************************
  
  testCaseComment("Preconditions");
  testStep("STEP", "Bench Initialization");
  RunPreTs();
  
  
    testStep("STEP", "Set a breakpoint in function ERH_Init() at line 'erh_au16AecCounter[u8Index] = KU16_ZERO;'.");
    debugger_setRelativeFunctionBpAtLine("ERH_Init", 19);
    
    debugger_reset();
    debugger_run();
    
    testStep("STEP", "Check if CPU stopped in function ERH_Init() at line 'erh_au16AecCounter[u8Index] = KU16_ZERO;'.");
    debugger_waitUntilBPisReached(500);
  
    
    debugger_deleteAllBP();
    
  
    testStep("STEP", "Set a breakpoint in ERH_Init() at the end of the function.");
    debugger_setRelativeFunctionBpAtLine("ERH_Init", 65);
    
    debugger_run();
    testWaitForTimeoutSilent(500);
    
    testCaseComment("Action: ARCH_SW_ERH_0041");
    testStep("STEP", "Evaluate if erh_au16AecCounter[u8Index], where u8Index is ATM_KU8_ID_IMPLAUSIBLE_DATA_ORC, is equal to KU16_ZERO. --> erh_au16AecCounter[u8Index] == KU16_ZERO");
    result = debugger_readGlobalVariable("uint16", "erh_au16AecCounter,,app.elf", 0x29);
    EvalManStepEqual("Expected test result", result, KU16_ZERO);
 
    
    debugger_deleteAllBP();
    debugger_reset();
    debugger_run();
  

    testStep("STEP", "Set a breakpoint in function CIL_Autotest_CheckImplausibleData_ORC() at line '*pu8TestResult = pal_u8ResultOfAutoTest;'.");
    debugger_setRelativeFunctionBpAtLine("CIL_Autotest_CheckImplausibleData_ORC", 12);
    
    debugger_run();
    
    testStep("STEP", "Check if CPU stopped in function CIL_Autotest_CheckImplausibleData_ORC() at line '*pu8TestResult = pal_u8ResultOfAutoTest;'.");
    debugger_waitUntilBPisReached(10000);
    
    testStep("STEP", "Set variable *pu8TestResult to KU8_ATM_TEST_NOK.");
    debugger_writeLocalVariable("*pu8TestResult", 0x02);
    testWaitForTimeoutSilent(2000);


    debugger_deleteAllBP();
  
            
    testStep("STEP", "Set a breakpoint in function erh_ManageFailedCounterEvent() at line 'erh_au16AecCounter[cu8Index] += KU16_ONE;'.");
    debugger_setRelativeFunctionBpAtLine("erh_ManageFailedCounterEvent", 60);
    
    debugger_run();
    
    testStep("STEP", "Check if CPU stopped in function erh_ManageFailedCounterEvent() at line 'erh_au16AecCounter[cu8Index] += KU16_ONE;'.");
    debugger_waitUntilBPisReached(500);
  
    debugger_stepOver();
    
    testCaseComment("Action: ARCH_SW_ERH_0041");
    testStep("STEP", "Evaluate if erh_au16AecCounter[u8Index], where u8Index is ATM_KU8_ID_IMPLAUSIBLE_DATA_ORC, is equal to KU16_ONE. --> erh_au16AecCounter[u8Index] == KU16_ONE");
    result = debugger_readGlobalVariable("uint16", "erh_au16AecCounter,,app.elf", 0x29);
    EvalManStepEqual("Expected test result",  result, KU16_ONE);
  
  
  testCaseComment("Postcondition");
  testStep("STEP", "Return ECU to default values");
  RunPostTs();
}


testcase SW_IT_ERH_TIMEOUT_BLTHD_L_01()
{
 //***********************************Test report header*********************************
  testReportAddMiscInfoBlock("AUTOLIV ELECTRONICS document");
  TestReportAddMiscInfo("Nightly test", "No");
  TestReportAddMiscInfo("Test type", "Requirement-Based test");
  TestReportAddMiscInfo("Regression Test", "No");
  TestReportAddMiscInfo("Fault injection method used", "No");
  TestReportAddMiscInfo("Resource usage evaluation", "No");
  TestReportAddMiscInfo("Priority", "No");
  TestReportAddMiscInfo("Safety relevant", "No");
  
  AddRequirementInfo("Requirement under test", "ARCH_SW_ERH_0042");
  AddRequirementInfo("ARCH_SW_ERH_0042", "The ERH_KU8_TIMEOUT_BLTHD_L_AEC_CFG should have the following properties: ? Qualification Count = Instantaneously; ? Deskill Count = 3; - associated group: KU32_AEC_GROUP_MASK_TIMEOUT_BH_L.");
 //***************************************************************************************
  
  testCaseComment("Preconditions");
  testStep("STEP", "Bench Initialization");
  RunPreTs();
  
  
    testStep("STEP", "Set a breakpoint in function ERH_Init() at line 'erh_au16AecCounter[u8Index] = KU16_ZERO;'.");
    debugger_setRelativeFunctionBpAtLine("ERH_Init", 19);
    
    debugger_reset();
    debugger_run();
    
    testStep("STEP", "Check if CPU stopped in function ERH_Init() at line 'erh_au16AecCounter[u8Index] = KU16_ZERO;'.");
    debugger_waitUntilBPisReached(500);
  
    
    debugger_deleteAllBP();
    
  
    testStep("STEP", "Set a breakpoint in ERH_Init() at the end of the function.");
    debugger_setRelativeFunctionBpAtLine("ERH_Init", 65);
    
    debugger_run();
    testWaitForTimeoutSilent(500);
    
    testCaseComment("Action: ARCH_SW_ERH_0042");
    testStep("STEP", "Evaluate if erh_au16AecCounter[u8Index], where u8Index is ATM_KU8_ID_TIMEOUT_BLTHD_L, is equal to KU16_ZERO. --> erh_au16AecCounter[u8Index] == KU16_ZERO");
    result = debugger_readGlobalVariable("uint16", "erh_au16AecCounter,,app.elf", 0x27);
    EvalManStepEqual("Expected test result", result, KU16_ZERO);
 
    
    debugger_deleteAllBP();
    debugger_reset();
    debugger_run();
  

    testStep("STEP", "Set a breakpoint in function CIL_Autotest_CheckTimeoutError_BelthandoverL() at line '*pu8TestResult = pal_u8ResultOfAutoTest;'.");
    debugger_setRelativeFunctionBpAtLine("CIL_Autotest_CheckTimeoutError_BelthandoverL", 80);
    
    debugger_run();
    
    testStep("STEP", "Check if CPU stopped in function CIL_Autotest_CheckTimeoutError_BelthandoverL() at line '*pu8TestResult = pal_u8ResultOfAutoTest;'.");
    debugger_waitUntilBPisReached(10000);
    
    testStep("STEP", "Set variable *pu8TestResult to KU8_ATM_TEST_NOK.");
    debugger_writeLocalVariable("*pu8TestResult", 0x02);
    testWaitForTimeoutSilent(2000);


    debugger_deleteAllBP();
  
            
    testStep("STEP", "Set a breakpoint in function erh_ManageFailedCounterEvent() at line 'erh_au16AecCounter[cu8Index] += KU16_ONE;'.");
    debugger_setRelativeFunctionBpAtLine("erh_ManageFailedCounterEvent", 60);
    
    debugger_run();
    
    testStep("STEP", "Check if CPU stopped in function erh_ManageFailedCounterEvent() at line 'erh_au16AecCounter[cu8Index] += KU16_ONE;'.");
    debugger_waitUntilBPisReached(500);
  
    debugger_stepOver();
    
    testCaseComment("Action: ARCH_SW_ERH_0042");
    testStep("STEP", "Evaluate if erh_au16AecCounter[u8Index], where u8Index is ATM_KU8_ID_TIMEOUT_BLTHD_L, is equal to KU16_ONE. --> erh_au16AecCounter[u8Index] == KU16_ONE");
    result = debugger_readGlobalVariable("uint16", "erh_au16AecCounter,,app.elf", 0x27);
    EvalManStepEqual("Expected test result",  result, KU16_ONE);
  
  
  testCaseComment("Postcondition");
  testStep("STEP", "Return ECU to default values");
  RunPostTs();
}


testcase SW_IT_ERH_TIMEOUT_BLTHD_R_01()
{
 //***********************************Test report header*********************************
  testReportAddMiscInfoBlock("AUTOLIV ELECTRONICS document");
  TestReportAddMiscInfo("Nightly test", "No");
  TestReportAddMiscInfo("Test type", "Requirement-Based test");
  TestReportAddMiscInfo("Regression Test", "No");
  TestReportAddMiscInfo("Fault injection method used", "No");
  TestReportAddMiscInfo("Resource usage evaluation", "No");
  TestReportAddMiscInfo("Priority", "No");
  TestReportAddMiscInfo("Safety relevant", "No");
  
  AddRequirementInfo("Requirement under test", "ARCH_SW_ERH_0043");
  AddRequirementInfo("ARCH_SW_ERH_0043", "The ERH_KU8_TIMEOUT_BLTHD_R_AEC_CFG should have the following properties: ? Qualification Count = Instantaneously; ? Deskill Count = 3; - associated group: KU32_AEC_GROUP_MASK_TIMEOUT_BH_R.");
 //***************************************************************************************
  
  testCaseComment("Preconditions");
  testStep("STEP", "Bench Initialization");
  RunPreTs();
  
  
    testStep("STEP", "Set a breakpoint in function ERH_Init() at line 'erh_au16AecCounter[u8Index] = KU16_ZERO;'.");
    debugger_setRelativeFunctionBpAtLine("ERH_Init", 19);
    
    debugger_reset();
    debugger_run();
    
    testStep("STEP", "Check if CPU stopped in function ERH_Init() at line 'erh_au16AecCounter[u8Index] = KU16_ZERO;'.");
    debugger_waitUntilBPisReached(500);
  
    
    debugger_deleteAllBP();
    
  
    testStep("STEP", "Set a breakpoint in ERH_Init() at the end of the function.");
    debugger_setRelativeFunctionBpAtLine("ERH_Init", 65);
    
    debugger_run();
    testWaitForTimeoutSilent(500);
    
    testCaseComment("Action: ARCH_SW_ERH_0043");
    testStep("STEP", "Evaluate if erh_au16AecCounter[u8Index], where u8Index is ATM_KU8_ID_TIMEOUT_BLTHD_R, is equal to KU16_ZERO. --> erh_au16AecCounter[u8Index] == KU16_ZERO");
    result = debugger_readGlobalVariable("uint16", "erh_au16AecCounter,,app.elf", 0x26);
    EvalManStepEqual("Expected test result", result, KU16_ZERO);
 
    
    debugger_deleteAllBP();
    debugger_reset();
    debugger_run();
  

    testStep("STEP", "Set a breakpoint in function CIL_Autotest_CheckTimeoutError_BelthandoverR() at line '*pu8TestResult = pal_u8ResultOfAutoTest;'.");
    debugger_setRelativeFunctionBpAtLine("CIL_Autotest_CheckTimeoutError_BelthandoverR", 79);
    
    debugger_run();
    
    testStep("STEP", "Check if CPU stopped in function CIL_Autotest_CheckTimeoutError_BelthandoverR() at line '*pu8TestResult = pal_u8ResultOfAutoTest;'.");
    debugger_waitUntilBPisReached(10000);
    
    testStep("STEP", "Set variable *pu8TestResult to KU8_ATM_TEST_NOK.");
    debugger_writeLocalVariable("*pu8TestResult", 0x02);
    testWaitForTimeoutSilent(2000);


    debugger_deleteAllBP();
  
            
    testStep("STEP", "Set a breakpoint in function erh_ManageFailedCounterEvent() at line 'erh_au16AecCounter[cu8Index] += KU16_ONE;'.");
    debugger_setRelativeFunctionBpAtLine("erh_ManageFailedCounterEvent", 60);
    
    debugger_run();
    
    testStep("STEP", "Check if CPU stopped in function erh_ManageFailedCounterEvent() at line 'erh_au16AecCounter[cu8Index] += KU16_ONE;'.");
    debugger_waitUntilBPisReached(500);
  
    debugger_stepOver();
    
    testCaseComment("Action: ARCH_SW_ERH_0043");
    testStep("STEP", "Evaluate if erh_au16AecCounter[u8Index], where u8Index is ATM_KU8_ID_TIMEOUT_BLTHD_R, is equal to KU16_ONE. --> erh_au16AecCounter[u8Index] == KU16_ONE");
    result = debugger_readGlobalVariable("uint16", "erh_au16AecCounter,,app.elf", 0x26);
    EvalManStepEqual("Expected test result",  result, KU16_ONE);
  
  
  testCaseComment("Postcondition");
  testStep("STEP", "Return ECU to default values");
  RunPostTs();
}


testcase SW_IT_ERH_TIMEOUT_API_01()
{
 //***********************************Test report header*********************************
  testReportAddMiscInfoBlock("AUTOLIV ELECTRONICS document");
  TestReportAddMiscInfo("Nightly test", "No");
  TestReportAddMiscInfo("Test type", "Requirement-Based test");
  TestReportAddMiscInfo("Regression Test", "No");
  TestReportAddMiscInfo("Fault injection method used", "No");
  TestReportAddMiscInfo("Resource usage evaluation", "No");
  TestReportAddMiscInfo("Priority", "No");
  TestReportAddMiscInfo("Safety relevant", "No");
  
  AddRequirementInfo("Requirement under test", "ARCH_SW_ERH_0044");
  AddRequirementInfo("ARCH_SW_ERH_0044", "The ERH_KU8_TIMEOUT_API should have the following properties: ? Qualification Count = Instantaneously; ? Deskill Count = 3; - associated group: KU32_AEC_GROUP_MASK_TIMEOUT_API.");
 //***************************************************************************************
  
  testCaseComment("Preconditions");
  testStep("STEP", "Bench Initialization");
  RunPreTs();
  
  
    testStep("STEP", "Set a breakpoint in function ERH_Init() at line 'erh_au16AecCounter[u8Index] = KU16_ZERO;'.");
    debugger_setRelativeFunctionBpAtLine("ERH_Init", 19);
    
    debugger_reset();
    debugger_run();
    
    testStep("STEP", "Check if CPU stopped in function ERH_Init() at line 'erh_au16AecCounter[u8Index] = KU16_ZERO;'.");
    debugger_waitUntilBPisReached(500);
  
    
    debugger_deleteAllBP();
    
  
    testStep("STEP", "Set a breakpoint in ERH_Init() at the end of the function.");
    debugger_setRelativeFunctionBpAtLine("ERH_Init", 65);
    
    debugger_run();
    testWaitForTimeoutSilent(500);
    
    testCaseComment("Action: ARCH_SW_ERH_0044");
    testStep("STEP", "Evaluate if erh_au16AecCounter[u8Index], where u8Index is ATM_KU8_ID_TIMEOUT_API, is equal to KU16_ZERO. --> erh_au16AecCounter[u8Index] == KU16_ZERO");
    result = debugger_readGlobalVariable("uint16", "erh_au16AecCounter,,app.elf", 0x2F);
    EvalManStepEqual("Expected test result", result, KU16_ZERO);
 
    
    debugger_deleteAllBP();
    debugger_reset();
    debugger_run();
  

    testStep("STEP", "Set a breakpoint in function CIL_Autotest_CheckTimeoutError_API() at line '*pu8TestResult = pal_u8ResultOfAutoTest;'.");
    debugger_setRelativeFunctionBpAtLine("CIL_Autotest_CheckTimeoutError_API", 11);
    
    debugger_run();
    
    testStep("STEP", "Check if CPU stopped in function CIL_Autotest_CheckTimeoutError_API() at line '*pu8TestResult = pal_u8ResultOfAutoTest;'.");
    debugger_waitUntilBPisReached(10000);
    
    testStep("STEP", "Set variable *pu8TestResult to KU8_ATM_TEST_NOK.");
    debugger_writeLocalVariable("*pu8TestResult", 0x02);
    testWaitForTimeoutSilent(2000);


    debugger_deleteAllBP();
  
            
    testStep("STEP", "Set a breakpoint in function erh_ManageFailedCounterEvent() at line 'erh_au16AecCounter[cu8Index] += KU16_ONE;'.");
    debugger_setRelativeFunctionBpAtLine("erh_ManageFailedCounterEvent", 60);
    
    debugger_run();
    
    testStep("STEP", "Check if CPU stopped in function erh_ManageFailedCounterEvent() at line 'erh_au16AecCounter[cu8Index] += KU16_ONE;'.");
    debugger_waitUntilBPisReached(500);
  
    debugger_stepOver();
    
    testCaseComment("Action: ARCH_SW_ERH_0044");
    testStep("STEP", "Evaluate if erh_au16AecCounter[u8Index], where u8Index is ATM_KU8_ID_TIMEOUT_API, is equal to KU16_ONE. --> erh_au16AecCounter[u8Index] == KU16_ONE");
    result = debugger_readGlobalVariable("uint16", "erh_au16AecCounter,,app.elf", 0x27);
    EvalManStepEqual("Expected test result",  result, KU16_ONE);
  
  
  testCaseComment("Postcondition");
  testStep("STEP", "Return ECU to default values");
  RunPostTs();
}


testcase SW_IT_ERH_END_OF_LIFE_MAX_FORCE_01()
{
 //***********************************Test report header*********************************
  testReportAddMiscInfoBlock("AUTOLIV ELECTRONICS document");
  TestReportAddMiscInfo("Nightly test", "No");
  TestReportAddMiscInfo("Test type", "Requirement-Based test");
  TestReportAddMiscInfo("Regression Test", "No");
  TestReportAddMiscInfo("Fault injection method used", "No");
  TestReportAddMiscInfo("Resource usage evaluation", "No");
  TestReportAddMiscInfo("Priority", "No");
  TestReportAddMiscInfo("Safety relevant", "No");
  
  AddRequirementInfo("Requirement under test", "ARCH_SW_ERH_0045");
  AddRequirementInfo("ARCH_SW_ERH_0045", "The ERH_KU8_END_OF_LIFE_MAX_FORCE_AEC_CFG (NGU should have the following properties: ? Qualification Count: Instantaneously (i.e. : NVP_u16CounterToValidateEOLMaxForce = 1;? Deskill Count: None (shall never be deskilled even after reset) (i.e. : NVP_u16CounterToDeskillEOLMaxForce = 0); - associated group: KU32_AEC_GROUP_MASK_EOL_MAX.");
 //***************************************************************************************
  
  testCaseComment("Preconditions");
  testStep("STEP", "Bench Initialization");
  RunPreTs();
  
  
    testStep("STEP", "Set a breakpoint in function ERH_Init() at line 'erh_au16AecCounter[u8Index] = KU16_ZERO;'.");
    debugger_setRelativeFunctionBpAtLine("ERH_Init", 19);
    
    debugger_reset();
    debugger_run();
    
    testStep("STEP", "Check if CPU stopped in function ERH_Init() at line 'erh_au16AecCounter[u8Index] = KU16_ZERO;'.");
    debugger_waitUntilBPisReached(500);
  
    
    debugger_deleteAllBP();
    
  
    testStep("STEP", "Set a breakpoint in ERH_Init() at the end of the function.");
    debugger_setRelativeFunctionBpAtLine("ERH_Init", 65);
    
    debugger_run();
    testWaitForTimeoutSilent(500);
    
    testCaseComment("Action: ARCH_SW_ERH_0045");
    testStep("STEP", "Evaluate if erh_au16AecCounter[u8Index], where u8Index is ATM_KU8_ID_END_OF_LIFE_MAX_FORCE, is equal to KU16_ZERO. --> erh_au16AecCounter[u8Index] == KU16_ZERO");
    result = debugger_readGlobalVariable("uint16", "erh_au16AecCounter,,app.elf", 0x1F);
    EvalManStepEqual("Expected test result", result, KU16_ZERO);
 
    
    debugger_deleteAllBP();
    debugger_reset();
    debugger_run();
  

    testStep("STEP", "Set a breakpoint in function EOL_Autotest_CheckProductEndOfLifeMaxForce() at line '*pu8TestResult = pal_u8ResultOfAutoTest;'.");
    debugger_setRelativeFunctionBpAtLine("EOL_Autotest_CheckProductEndOfLifeMaxForce", 19);
    
    debugger_run();
    
    testStep("STEP", "Check if CPU stopped in function EOL_Autotest_CheckProductEndOfLifeMaxForce() at line '*pu8TestResult = pal_u8ResultOfAutoTest;'.");
    debugger_waitUntilBPisReached(10000);
    
    testStep("STEP", "Set variable *pu8TestResult to KU8_ATM_TEST_NOK.");
    debugger_writeLocalVariable("*pu8TestResult", 0x02);
    testWaitForTimeoutSilent(2000);


    debugger_deleteAllBP();
  
            
    testStep("STEP", "Set a breakpoint in function erh_ManageFailedCounterEvent() at line 'erh_au16AecCounter[cu8Index] += KU16_ONE;'.");
    debugger_setRelativeFunctionBpAtLine("erh_ManageFailedCounterEvent", 60);
    
    debugger_run();
    
    testStep("STEP", "Check if CPU stopped in function erh_ManageFailedCounterEvent() at line 'erh_au16AecCounter[cu8Index] += KU16_ONE;'.");
    debugger_waitUntilBPisReached(500);
  
    debugger_stepOver();
    
    testCaseComment("Action: ARCH_SW_ERH_0045");
    testStep("STEP", "Evaluate if erh_au16AecCounter[u8Index], where u8Index is ATM_KU8_ID_END_OF_LIFE_MAX_FORCE, is equal to KU16_ONE. --> erh_au16AecCounter[u8Index] == KU16_ONE");
    result = debugger_readGlobalVariable("uint16", "erh_au16AecCounter,,app.elf", 0x1F);
    EvalManStepEqual("Expected test result",  result, KU16_ONE);
  
  
  testCaseComment("Postcondition");
  testStep("STEP", "Return ECU to default values");
  RunPostTs();
}


testcase SW_IT_ERH_STEERING_CONFIG_01()
{
 //***********************************Test report header*********************************
  testReportAddMiscInfoBlock("AUTOLIV ELECTRONICS document");
  TestReportAddMiscInfo("Nightly test", "No");
  TestReportAddMiscInfo("Test type", "Requirement-Based test");
  TestReportAddMiscInfo("Regression Test", "No");
  TestReportAddMiscInfo("Fault injection method used", "No");
  TestReportAddMiscInfo("Resource usage evaluation", "No");
  TestReportAddMiscInfo("Priority", "No");
  TestReportAddMiscInfo("Safety relevant", "No");
  
  AddRequirementInfo("Requirement under test", "ARCH_SW_ERH_0046");
  AddRequirementInfo("ARCH_SW_ERH_0046", "The ERH_KU8_STEERING_CONFIG_AEC_CFG should have the following properties: ? Qualification Count = Instantaneously; ? Deskill Count = Instantaneously; -associated group: KU32_AEC_GROUP_MASK_STEERING_CONFIG.");
 //***************************************************************************************
  
  testCaseComment("Preconditions");
  testStep("STEP", "Bench Initialization");
  RunPreTs();
  
  
    testStep("STEP", "Set a breakpoint in function ERH_Init() at line 'erh_au16AecCounter[u8Index] = KU16_ZERO;'.");
    debugger_setRelativeFunctionBpAtLine("ERH_Init", 19);
    
    debugger_reset();
    debugger_run();
    
    testStep("STEP", "Check if CPU stopped in function ERH_Init() at line 'erh_au16AecCounter[u8Index] = KU16_ZERO;'.");
    debugger_waitUntilBPisReached(500);
  
    
    debugger_deleteAllBP();
    
  
    testStep("STEP", "Set a breakpoint in ERH_Init() at the end of the function.");
    debugger_setRelativeFunctionBpAtLine("ERH_Init", 65);
    
    debugger_run();
    testWaitForTimeoutSilent(500);
    
    testCaseComment("Action: ARCH_SW_ERH_0046");
    testStep("STEP", "Evaluate if erh_au16AecCounter[u8Index], where u8Index is ATM_KU8_ID_STEERING_CONFIGURATION, is equal to KU16_ZERO. --> erh_au16AecCounter[u8Index] == KU16_ZERO");
    result = debugger_readGlobalVariable("uint16", "erh_au16AecCounter,,app.elf", 0x2C);
    EvalManStepEqual("Expected test result", result, KU16_ZERO);
 
    
    debugger_deleteAllBP();
    debugger_reset();
    debugger_run();
  

    testStep("STEP", "Set a breakpoint in function CIL_Autotest_CheckSteeringConfiguration() at line '*pu8TestResult = pal_u8ResultOfAutoTest;'.");
    debugger_setRelativeFunctionBpAtLine("CIL_Autotest_CheckSteeringConfiguration", 12);
    
    debugger_run();
    
    testStep("STEP", "Check if CPU stopped in function CIL_Autotest_CheckSteeringConfiguration() at line '*pu8TestResult = pal_u8ResultOfAutoTest;'.");
    debugger_waitUntilBPisReached(10000);
    
    testStep("STEP", "Set variable *pu8TestResult to KU8_ATM_TEST_NOK.");
    debugger_writeLocalVariable("*pu8TestResult", 0x02);
    testWaitForTimeoutSilent(2000);


    debugger_deleteAllBP();
  
            
    testStep("STEP", "Set a breakpoint in function erh_ManageFailedCounterEvent() at line 'erh_au16AecCounter[cu8Index] += KU16_ONE;'.");
    debugger_setRelativeFunctionBpAtLine("erh_ManageFailedCounterEvent", 60);
    
    debugger_run();
    
    testStep("STEP", "Check if CPU stopped in function erh_ManageFailedCounterEvent() at line 'erh_au16AecCounter[cu8Index] += KU16_ONE;'.");
    debugger_waitUntilBPisReached(500);
  
    debugger_stepOver();
    
    testCaseComment("Action: ARCH_SW_ERH_0046");
    testStep("STEP", "Evaluate if erh_au16AecCounter[u8Index], where u8Index is ATM_KU8_ID_STEERING_CONFIGURATION, is equal to KU16_ONE. --> erh_au16AecCounter[u8Index] == KU16_ONE");
    result = debugger_readGlobalVariable("uint16", "erh_au16AecCounter,,app.elf", 0x2C);
    EvalManStepEqual("Expected test result",  result, KU16_ONE);
  
  
  testCaseComment("Postcondition");
  testStep("STEP", "Return ECU to default values");
  RunPostTs();
}


testcase SW_IT_ERH_TIMEOUT_IGNITION_01()
{
 //***********************************Test report header*********************************
  testReportAddMiscInfoBlock("AUTOLIV ELECTRONICS document");
  TestReportAddMiscInfo("Nightly test", "No");
  TestReportAddMiscInfo("Test type", "Requirement-Based test");
  TestReportAddMiscInfo("Regression Test", "No");
  TestReportAddMiscInfo("Fault injection method used", "No");
  TestReportAddMiscInfo("Resource usage evaluation", "No");
  TestReportAddMiscInfo("Priority", "No");
  TestReportAddMiscInfo("Safety relevant", "No");
  
  AddRequirementInfo("Requirement under test", "ARCH_SW_ERH_0047");
  AddRequirementInfo("ARCH_SW_ERH_0047", "The ERH_KU8_TIMEOUT_IGNITION_AEC_CFG should have the following properties: ? Qualification Count = Instantaneously; ? Deskill Count = 1; - associated group: KU32_AEC_GROUP_MASK_TIMEOUT_IGNITION.");
 //***************************************************************************************
  
  testCaseComment("Preconditions");
  testStep("STEP", "Bench Initialization");
  RunPreTs();
  
  
    testStep("STEP", "Set a breakpoint in function ERH_Init() at line 'erh_au16AecCounter[u8Index] = KU16_ZERO;'.");
    debugger_setRelativeFunctionBpAtLine("ERH_Init", 19);
    
    debugger_reset();
    debugger_run();
    
    testStep("STEP", "Check if CPU stopped in function ERH_Init() at line 'erh_au16AecCounter[u8Index] = KU16_ZERO;'.");
    debugger_waitUntilBPisReached(500);
  
    
    debugger_deleteAllBP();
    
  
    testStep("STEP", "Set a breakpoint in ERH_Init() at the end of the function.");
    debugger_setRelativeFunctionBpAtLine("ERH_Init", 65);
    
    debugger_run();
    testWaitForTimeoutSilent(500);
    
    testCaseComment("Action: ARCH_SW_ERH_0047");
    testStep("STEP", "Evaluate if erh_au16AecCounter[u8Index], where u8Index is ATM_KU8_ID_STEERING_CONFIGURATION, is equal to KU16_ZERO. --> erh_au16AecCounter[u8Index] == KU16_ZERO");
    result = debugger_readGlobalVariable("uint16", "erh_au16AecCounter,,app.elf", 0x2C);
    EvalManStepEqual("Expected test result", result, KU16_ZERO);
 
    
    debugger_deleteAllBP();
    debugger_reset();
    debugger_run();
  

    testStep("STEP", "Set a breakpoint in function CIL_Autotest_CheckSteeringConfiguration() at line '*pu8TestResult = pal_u8ResultOfAutoTest;'.");
    debugger_setRelativeFunctionBpAtLine("CIL_Autotest_CheckSteeringConfiguration", 12);
    
    debugger_run();
    
    testStep("STEP", "Check if CPU stopped in function CIL_Autotest_CheckSteeringConfiguration() at line '*pu8TestResult = pal_u8ResultOfAutoTest;'.");
    debugger_waitUntilBPisReached(10000);
    
    testStep("STEP", "Set variable *pu8TestResult to KU8_ATM_TEST_NOK.");
    debugger_writeLocalVariable("*pu8TestResult", 0x02);
    testWaitForTimeoutSilent(2000);


    debugger_deleteAllBP();
  
            
    testStep("STEP", "Set a breakpoint in function erh_ManageFailedCounterEvent() at line 'erh_au16AecCounter[cu8Index] += KU16_ONE;'.");
    debugger_setRelativeFunctionBpAtLine("erh_ManageFailedCounterEvent", 60);
    
    debugger_run();
    
    testStep("STEP", "Check if CPU stopped in function erh_ManageFailedCounterEvent() at line 'erh_au16AecCounter[cu8Index] += KU16_ONE;'.");
    debugger_waitUntilBPisReached(500);
  
    debugger_stepOver();
    
    testCaseComment("Action: ARCH_SW_ERH_0047");
    testStep("STEP", "Evaluate if erh_au16AecCounter[u8Index], where u8Index is ATM_KU8_ID_STEERING_CONFIGURATION, is equal to KU16_ONE. --> erh_au16AecCounter[u8Index] == KU16_ONE");
    result = debugger_readGlobalVariable("uint16", "erh_au16AecCounter,,app.elf", 0x2C);
    EvalManStepEqual("Expected test result",  result, KU16_ONE);
  
  
  testCaseComment("Postcondition");
  testStep("STEP", "Return ECU to default values");
  RunPostTs();
}


testcase SW_IT_ERH_TIMEOUT_BELTADJ_01()
{
 //***********************************Test report header*********************************
  testReportAddMiscInfoBlock("AUTOLIV ELECTRONICS document");
  TestReportAddMiscInfo("Nightly test", "No");
  TestReportAddMiscInfo("Test type", "Requirement-Based test");
  TestReportAddMiscInfo("Regression Test", "No");
  TestReportAddMiscInfo("Fault injection method used", "No");
  TestReportAddMiscInfo("Resource usage evaluation", "No");
  TestReportAddMiscInfo("Priority", "No");
  TestReportAddMiscInfo("Safety relevant", "No");
  
  AddRequirementInfo("Requirement under test", "ARCH_SW_ERH_0092");
  AddRequirementInfo("ARCH_SW_ERH_0092", "The ERH_KU8_TIMEOUT_BELT_ADJ_AEC_CFG should have the following properties: ? Qualification Count = 10; ? Deskill Count = 1; - associated group: KU32_AEC_GROUP_MASK_ODOSPEEDOMETER.");
 //***************************************************************************************
  
  testCaseComment("Preconditions");
  testStep("STEP", "Bench Initialization");
  RunPreTs();
  
  
    testStep("STEP", "Set a breakpoint in function ERH_Init() at line 'erh_au16AecCounter[u8Index] = KU16_ZERO;'.");
    debugger_setRelativeFunctionBpAtLine("ERH_Init", 19);
    
    debugger_reset();
    debugger_run();
    
    testStep("STEP", "Check if CPU stopped in function ERH_Init() at line 'erh_au16AecCounter[u8Index] = KU16_ZERO;'.");
    debugger_waitUntilBPisReached(500);
  
    
    debugger_deleteAllBP();
    
  
    testStep("STEP", "Set a breakpoint in ERH_Init() at the end of the function.");
    debugger_setRelativeFunctionBpAtLine("ERH_Init", 65);
    
    debugger_run();
    testWaitForTimeoutSilent(500);
    
    testCaseComment("Action: ARCH_SW_ERH_0092");
    testStep("STEP", "Evaluate if erh_au16AecCounter[u8Index], where u8Index is ATM_KU8_ID_TIMEOUT_BELT_ADJ, is equal to KU16_ZERO. --> erh_au16AecCounter[u8Index] == KU16_ZERO");
    result = debugger_readGlobalVariable("uint16", "erh_au16AecCounter,,app.elf", 0x35);
    EvalManStepEqual("Expected test result", result, KU16_ZERO);
 
    
    debugger_deleteAllBP();
    debugger_reset();
    debugger_run();
  

    testStep("STEP", "Set a breakpoint in function CIL_Autotest_CheckTimeoutError_BeltAdj() at line '*pu8TestResult = pal_u8ResultOfAutoTest;'.");
    debugger_setRelativeFunctionBpAtLine("CIL_Autotest_CheckTimeoutError_BeltAdj", 11);
    
    debugger_run();
    
    testStep("STEP", "Check if CPU stopped in function CIL_Autotest_CheckTimeoutError_BeltAdj() at line '*pu8TestResult = pal_u8ResultOfAutoTest;'.");
    debugger_waitUntilBPisReached(10000);
    
    testStep("STEP", "Set variable *pu8TestResult to KU8_ATM_TEST_NOK.");
    debugger_writeLocalVariable("*pu8TestResult", 0x02);
    testWaitForTimeoutSilent(2000);


    debugger_deleteAllBP();
  
            
    testStep("STEP", "Set a breakpoint in function erh_ManageFailedCounterEvent() at line 'erh_au16AecCounter[cu8Index] += KU16_ONE;'.");
    debugger_setRelativeFunctionBpAtLine("erh_ManageFailedCounterEvent", 60);
    
    debugger_run();
    
    testStep("STEP", "Check if CPU stopped in function erh_ManageFailedCounterEvent() at line 'erh_au16AecCounter[cu8Index] += KU16_ONE;'.");
    debugger_waitUntilBPisReached(500);
  
    debugger_stepOver();
    
    testCaseComment("Action: ARCH_SW_ERH_0092");
    testStep("STEP", "Evaluate if erh_au16AecCounter[u8Index], where u8Index is ATM_KU8_ID_TIMEOUT_BELT_ADJ, is equal to KU16_ONE. --> erh_au16AecCounter[u8Index] == KU16_ONE");
    result = debugger_readGlobalVariable("uint16", "erh_au16AecCounter,,app.elf", 0x35);
    EvalManStepEqual("Expected test result",  result, KU16_ONE);
  
  
  testCaseComment("Postcondition");
  testStep("STEP", "Return ECU to default values");
  RunPostTs();
}


// R07.1

testcase SW_IT_ERH_SetAecEvent_01() // Check
{
  //***********************************Test report header*********************************
  testReportAddMiscInfoBlock("AUTOLIV ELECTRONICS document");
  TestReportAddMiscInfo("Nightly test", "No");
  TestReportAddMiscInfo("Test type", "Requirement-Based test");
  TestReportAddMiscInfo("Regression Test", "No");
  TestReportAddMiscInfo("Fault injection method used", "No");
  TestReportAddMiscInfo("Resource usage evaluation", "No");
  TestReportAddMiscInfo("Priority", "No");
  TestReportAddMiscInfo("Safety relevant", "No");
  
  AddRequirementInfo("Requirement under test", "ARCH_SW_ERH_0080, ARCH_SW_ERH_0083");
  AddRequirementInfo("ARCH_SW_ERH_0080", "This prototype shall manage the Qualification status and Deskill status of the AECs.");
  AddRequirementInfo("ARCH_SW_ERH_0083", "This prototype shall manage the Qualification status and Deskill status of the DTCs by AECs group status.");
  //***************************************************************************************

  testCaseComment("Preconditions");
  testStep("STEP", "Bench Initialization");
  RunPreTs();

    
    testStep("STEP", "Set a breakpoint in function ERH_runSetAecEvent () at line 'erh_ManageAECCommand(u8Command, u8Index, &stAecData);'.");
    debugger_setRelativeFunctionBpAtLine("ERH_runSetAecEvent", 44);
  
    testCaseComment("Action: ARCH_SW_ERH_0080, ARCH_SW_ERH_0083");
    testStep("STEP", "Check if CPU stopped in function ERH_runSetAecEvent() at line 'erh_ManageAECCommand(u8Command, u8Index, &stAecData);");
    debugger_waitUntilBPisReached(500);
  
    
    testStep("STEP", "Step in function erh_ManageAECCommand().");
    debugger_stepIn();
  
    testWaitForTimeoutSilent(1000);
  
    testStep("STEP", "Set a breakpoint in function erh_ManageFailedCounterEvent () at line 'u16AECQualificationThresold = ((uint16)'.");
    debugger_setRelativeFunctionBpAtLine("erh_ManageFailedCounterEvent", 0);
  
    debugger_run();
  
    testCaseComment("Action: ARCH_SW_ERH_0080, ARCH_SW_ERH_0083");
    testStep("STEP", "Check if CPU stopped at line 'u16AECQualificationThresold = ((uint16)' --> CPU stopped at BP");
    debugger_waitUntilBPisReached(500);


  testCaseComment("Postcondition");
  testStep("STEP", "Return ECU to default values");
  RunPostTs();
  
}


testcase SW_IT_ERH_CheckAEC_01()
{
  //***********************************Test report header*********************************
  testReportAddMiscInfoBlock("AUTOLIV ELECTRONICS document");
  TestReportAddMiscInfo("Nightly test", "No");
  TestReportAddMiscInfo("Test type", "Requirement-Based test");
  TestReportAddMiscInfo("Regression Test", "No");
  TestReportAddMiscInfo("Fault injection method used", "No");
  TestReportAddMiscInfo("Resource usage evaluation", "No");
  TestReportAddMiscInfo("Priority", "No");
  TestReportAddMiscInfo("Safety relevant", "No");
  
  AddRequirementInfo("Requirement under test", "ARCH_SW_ERH_0073, ARCH_SW_ERH_0084, ARCH_SW_ERH_0085");
  AddRequirementInfo("ARCH_SW_ERH_0073", "The erh_UpdateGroup function shall be called to update the group status after all errors of the group has just been cleared.");
  AddRequirementInfo("ARCH_SW_ERH_0084", "A DTC shall be qualified if a group of AECs is qualified (minim one AEC from group is qualified).");
  AddRequirementInfo("ARCH_SW_ERH_0085", "A DTC shall be deskilled if all AECs from the associated group are deskilled.");
 //***************************************************************************************

  testCaseComment("Preconditions");
  testStep("STEP", "Bench Initialization");
  RunPreTs();
    
  
    testStep("STEP", "Set a breakpoint in function ERH_ResetAllAECStatus() at line 'if (ERH_KU8_AEC_QUALIFIED_STATUS_MASK == (erh_au8AecStatus[u8OutputIndex]'.");
    debugger_setRelativeFunctionBpAtLine("ERH_ResetAllAECStatus", 25);
  
    debugger_reset();
    debugger_run();
    
    testStep("STEP", "Send diagnostic request 14 FF FF FF.");
    diagSendRequest(reqFaultMem_ClearGroup);
    testWaitForTimeoutSilent(500);
   
    testStep("STEP", "Set a breakpoint in function ERH_ResetAllAECStatus() at line 'if (ERH_KU8_AEC_QUALIFIED_STATUS_MASK == (erh_au8AecStatus[u8OutputIndex]'.");
    debugger_waitUntilBPisReached(500);
  
    testStep("STEP", "Check if CPU stopped in function ERH_ResetAllAECStatus() at line 'erh_au8AecStatus[u8OutputIndex] = KU8_ZERO;'.");
    debugger_writeGlobalVariable("uint8", "erh_au8AecStatus,,app.elf", 0, 1);
  
  
    testStep("STEP", "Set a breakpoint in function ERH_ResetAllAECStatus() at line 'erh_au8AecStatus[u8OutputIndex] = KU8_ZERO;'.");
    debugger_setRelativeFunctionBpAtLine("ERH_ResetAllAECStatus", 33);
  
    debugger_run();  
  
    testStep("STEP", "Check if CPU stopped in function ERH_ResetAllAECStatus() at line 'erh_au8AecStatus[u8OutputIndex] = KU8_ZERO;'.");
    debugger_waitUntilBPisReached(500);
  
  
    testStep("STEP", "Step in function erh_UpdateGroup().");
    debugger_stepIn();
  
  
    testStep("STEP", "Set a breakpoint at line 'case (uint32)KU32_AEC_GROUP_MASK_UNDER_VO:'.");
    debugger_setRelativeFunctionBpAtLine("erh_UpdateGroup", 36);
  
    debugger_reset();
    debugger_run();
  
    testCaseComment("Action: ARCH_SW_ERH_0073, ARCH_SW_ERH_0084,ARCH_SW_ERH_0085");
    testStep("STEP", "Check if CPU stopped at line 'case (uint32)KU32_AEC_GROUP_MASK_UNDER_VO:'. --> CPU stopped in function erh_UpdateGroup()");
    debugger_waitUntilBPisReached(5000);

  
  testCaseComment("Postcondition");
  testStep("STEP", "Return ECU to default values");
  RunPostTs();
}


testcase SW_IT_ERH_CheckAEC_02()
{
  //***********************************Test report header*********************************
  testReportAddMiscInfoBlock("AUTOLIV ELECTRONICS document");
  TestReportAddMiscInfo("Nightly test", "No");
  TestReportAddMiscInfo("Test type", "Requirement-Based test");
  TestReportAddMiscInfo("Regression Test", "No");
  TestReportAddMiscInfo("Fault injection method used", "No");
  TestReportAddMiscInfo("Resource usage evaluation", "No");
  TestReportAddMiscInfo("Priority", "No");
  TestReportAddMiscInfo("Safety relevant", "No");
  
  AddRequirementInfo("Requirement under test", "ARCH_SW_ERH_0075, ARCH_SW_ERH_0076");
  AddRequirementInfo("ARCH_SW_ERH_0075", "The NvM_SetRamBlockStatus interface shall be called to notify NVM that AEC status block shall be stored in NVM by the next call of NvM_WriteAll function.");
  AddRequirementInfo("ARCH_SW_ERH_0076", "NvM_WriteBlock shall be called to copy the data of the RAM block to its corresponding NVM block.");
  //***************************************************************************************

  testCaseComment("Preconditions");
  testStep("STEP", "Bench Initialization");
  RunPreTs();

    
    testStep("STEP", "Set a breakpoint in function ERH_ResetAllAECStatus() at line 'Result = Rte_Call_pclNvmServicesAecBlock_WriteBlock'.");
    debugger_setRelativeFunctionBpAtLine("ERH_ResetAllAECStatus", 65);
  
    debugger_reset();
    debugger_run();
  
    testStep("STEP", "Start Development Session."); 
    AuthenticateECU(2);
    EnterDiagnosticSession("development");
    
    testStep("STEP", "Send diagnostic request 14 FF FF FF.");
    diagSendRequest(reqFaultMem_ClearGroup);
    testWaitForTimeoutSilent(500);

    testStep("STEP", "Check if CPU stopped in function ERH_ResetAllAECStatus() at line 'Result = Rte_Call_pclNvmServicesAecBlock_WriteBlock(&NVP_BLOCK_ID_AEC_STATUS_RamBlockData);'.");
    debugger_waitUntilBPisReached(500);
  
    
    testCaseComment("Action: ARCH_SW_ERH_0075, ARCH_SW_ERH_0076");
    testStep("STEP", "Step in function Rte_Call_pclNvmServicesAecBlock_WriteBlock --> Stepped in NvM_WriteBlock");
    debugger_stepIn();
    debugger_stepIn();
    testWaitForTimeoutSilent(3000);
    debugger_isCPUStoppedAtFunction("NvM_WriteBlock");   


  testCaseComment("Postcondition");
  testStep("STEP", "Return ECU to default values");
  RunPostTs();
  
}


testcase SW_IT_ERH_CheckAecId_01()
{
  //***********************************Test report header*********************************
  testReportAddMiscInfoBlock("AUTOLIV ELECTRONICS document");
  TestReportAddMiscInfo("Nightly test", "No");
  TestReportAddMiscInfo("Test type", "Requirement-Based test");
  TestReportAddMiscInfo("Regression Test", "No");
  TestReportAddMiscInfo("Fault injection method used", "No");
  TestReportAddMiscInfo("Resource usage evaluation", "No");
  TestReportAddMiscInfo("Priority", "No");
  TestReportAddMiscInfo("Safety relevant", "No");
  
  AddRequirementInfo("Requirement under test", "ARCH_SW_ERH_0074");
  AddRequirementInfo("ARCH_SW_ERH_0074", "The erh_CheckAecId function shall be called to Check the validity of all AEC identifiers and to get the counter index and the status array of each AEC.");
  //***************************************************************************************

  testCaseComment("Preconditions");
  testStep("STEP", "Bench Initialization");
  RunPreTs();

    
    testStep("STEP", "Set a breakpoint in function ERH_ResetAllAECStatus() at line '(void) erh_CheckAecId(u8AECIndex, &u8OutputIndex, &stAecData);'.");
    debugger_setRelativeFunctionBpAtLine("ERH_ResetAllAECStatus", 22);
  
    debugger_reset();
    debugger_run();
    
    testStep("STEP", "Send diagnostic request 14 FF FF FF.");
    diagSendRequest(reqFaultMem_ClearGroup);
    testWaitForTimeoutSilent(500);
  
    testStep("STEP", "Check if CPU stopped in function ERH_ResetAllAECStatus() at line '(void) erh_CheckAecId(u8AECIndex, &u8OutputIndex, &stAecData);'. --> CPU stopped at BP");
    debugger_waitUntilBPisReached(500);
  
  
    debugger_deleteAllBP();
  
  
    testStep("STEP", "Set a breakpoint in function erh_CheckAecId() at line 'if ((ERH_KU8_UNDEFINED_AEC_CFG < cu8AecId)'.");
    debugger_setRelativeFunctionBpAtLine("erh_CheckAecId", 4);
  
    debugger_run();
    
    testCaseComment("Action: ARCH_SW_ERH_0074");
    testStep("STEP", "Check if CPU stopped in function erh_CheckAecId() at line 'if ((ERH_KU8_UNDEFINED_AEC_CFG < cu8AecId)'. --> CPU stopped at BP");
    debugger_waitUntilBPisReached(500);


  testCaseComment("Postcondition");
  testStep("STEP", "Return ECU to default values");
  RunPostTs();
  
}


testcase SW_IT_ERH_IMPLAUSIBLE_DATA_POWERTRAIN_DRV_01()
{
  //***********************************Test report header*********************************
  testReportAddMiscInfoBlock("AUTOLIV ELECTRONICS document");
  TestReportAddMiscInfo("Nightly test", "No");
  TestReportAddMiscInfo("Test type", "Requirement-Based test");
  TestReportAddMiscInfo("Regression Test", "No");
  TestReportAddMiscInfo("Fault injection method used", "No");
  TestReportAddMiscInfo("Resource usage evaluation", "No");
  TestReportAddMiscInfo("Priority", "No");
  TestReportAddMiscInfo("Safety relevant", "No");
  
  AddRequirementInfo("Requirement under test", "ARCH_SW_ERH_0086, ARCH_SW_ERH_0050");
  AddRequirementInfo("ARCH_SW_ERH_0086", "The ERH_KU8_IMPLAUSIBLE_DATA_POWERTRAIN_DRV_AEC_CFG should have the following properties: Qualification Count = 10; Deskill Count = 3; associated group: KU32_AEC_GROUP_MASK_IMPLAUSIBLE_DATA_POWERTRAIN");
  AddRequirementInfo("ARCH_SW_ERH_0050", "All AEC shall have an identifier and should be linked to one Autotest");
  //*************************************************************************************** 

  testCaseComment("Preconditions");
  testStep("STEP", "Bench Initialization");
  RunPreTs();
  
    
    testStep("STEP", "Set a breakpoint in function ERH_Init() at line 'erh_au16AecCounter[u8Index] = KU16_ZERO;'.");
    debugger_setRelativeFunctionBpAtLine("ERH_Init", 19);
    
    debugger_reset();
    debugger_run();
    
    testStep("STEP", "Check if CPU stopped in function ERH_Init() at line 'erh_au16AecCounter[u8Index] = KU16_ZERO;'.");
    debugger_waitUntilBPisReached(500);
  
    
    debugger_deleteAllBP();
    
  
    testStep("STEP", "Set a breakpoint in ERH_Init() at the end of the function.");
    debugger_setRelativeFunctionBpAtLine("ERH_Init", 65);
    
    debugger_run();
    testWaitForTimeoutSilent(500);
    
    testCaseComment("Action: ARCH_SW_ERH_0086, ARCH_SW_ERH_0050");
    testStep("STEP", "Evaluate if erh_au16AecCounter[u8Index], where u8Index is ATM_KU8_ID_IMPLAUSIBLE_DATA_POWERTRAIN_DRV, is equal to KU16_ZERO. --> erh_au16AecCounter[u8Index] == KU16_ZERO");
    result = debugger_readGlobalVariable("uint16", "erh_au16AecCounter,,app.elf", 0x30);
    EvalManStepEqual("Expected test result", result, KU16_ZERO);
 
    
    debugger_deleteAllBP();
    debugger_reset();
    debugger_run();
  

    testStep("STEP", "Set a breakpoint in function CIL_Autotest_CheckImplausibleData_PowertrainDrv() at line '*pu8TestResult = pal_u8ResultOfAutoTest;'.");
    debugger_setRelativeFunctionBpAtLine("CIL_Autotest_CheckImplausibleData_PowertrainDrv", 11);
    
    debugger_run();
    
    testStep("STEP", "Check if CPU stopped in function CIL_Autotest_CheckImplausibleData_PowertrainDrv() at line '*pu8TestResult = pal_u8ResultOfAutoTest;'.");
    debugger_waitUntilBPisReached(10000);
    
    testStep("STEP", "Set variable *pu8TestResult to KU8_ATM_TEST_NOK.");
    debugger_writeLocalVariable("*pu8TestResult", 0x02);
    testWaitForTimeoutSilent(2000);


    debugger_deleteAllBP();
  
            
    testStep("STEP", "Set a breakpoint in function erh_ManageFailedCounterEvent() at line 'erh_au16AecCounter[cu8Index] += KU16_ONE;'.");
    debugger_setRelativeFunctionBpAtLine("erh_ManageFailedCounterEvent", 60);
    
    debugger_run();
    
    testStep("STEP", "Check if CPU stopped in function erh_ManageFailedCounterEvent() at line 'erh_au16AecCounter[cu8Index] += KU16_ONE;'.");
    debugger_waitUntilBPisReached(500);
    
    debugger_stepOver();
    
    testCaseComment("Action: ARCH_SW_ERH_0086");
    testStep("STEP", "Evaluate if erh_au16AecCounter[u8Index], where u8Index is ATM_KU8_ID_IMPLAUSIBLE_DATA_POWERTRAIN_DRV, is equal to KU16_ONE. --> erh_au16AecCounter[u8Index] == KU16_ONE");
    result = debugger_readGlobalVariable("uint16", "erh_au16AecCounter,,app.elf", 0x30);
    EvalManStepEqual("Expected test result",  result, KU16_ONE);

  
  testCaseComment("Postcondition");
  testStep("STEP", "Return ECU to default values");
  RunPostTs();
}


testcase SW_IT_ERH_AEC_status_02()
{
  //***********************************Test report header*********************************
  testReportAddMiscInfoBlock("AUTOLIV ELECTRONICS document");
  TestReportAddMiscInfo("Nightly test", "No");
  TestReportAddMiscInfo("Test type", "Requirement-Based test");
  TestReportAddMiscInfo("Regression Test", "No");
  TestReportAddMiscInfo("Fault injection method used", "No");
  TestReportAddMiscInfo("Resource usage evaluation", "No");
  TestReportAddMiscInfo("Priority", "No");
  TestReportAddMiscInfo("Safety relevant", "No");
  
  AddRequirementInfo("Requirement under test", "ARCH_SW_ERH_0060, ARCH_SW_ERH_0048, ARCH_SW_ERH_0100, ARCH_SW_ERH_0081");
  AddRequirementInfo("ARCH_SW_ERH_0060", "All AECs status and counters shall be initialized with 0x00.");
  AddRequirementInfo("ARCH_SW_ERH_0048", "The CAN BUS ERROR shall qualify the U122488 DTC..");
  AddRequirementInfo("ARCH_SW_ERH_0100", "Dem_SetOperationCycleState and Dem_SetEnableCondition called to enable conditions for error handler mechanism.");
  AddRequirementInfo("ARCH_SW_ERH_0081", "DcmControlDtcSetting shall be called to get the status of DTCs setting Mode.");
  //***************************************************************************************

  testCaseComment("Preconditions");
  testStep("STEP", "Bench Initialization");
  RunPreTs();
  

    testStep("STEP", "Set a breakpoint in function ERH_Init() at line 'erh_au8AecStatus[u8Index] = KU8_ZERO;'.");
    debugger_setRelativeFunctionBpAtLine("ERH_Init", 29);
  
    debugger_reset();
    debugger_run();
  
    testCaseComment("Action: ARCH_SW_ERH_0060");
    testStep("STEP", "Check if CPU stopped in function ERH_Init() at line 'erh_au8AecStatus[u8Index] = KU8_ZERO;'. --> CPU stopped at BP");
    debugger_waitUntilBPisReached(500);
    
    
    testCaseComment("Action: ARCH_SW_ERH_0060");
    testStep("STEP", "Check if erh_au8AecStatus[0] is 0x0. --> erh_au8AecStatus[0] == 0x00");
    debuggerResultVariable = debugger_readGlobalVariable("uint8", "erh_au16AecCounter,,app.elf", 0);
    EvalManStepEqual("Variable is equal to 0x00", debuggerResultVariable, 0x00);
    
  
    testCaseComment("Action: ARCH_SW_ERH_0100, ARCH_SW_ERH_0081");
    testStep("STEP", "Set a breakpoint in function ERH_Init() at line (void)Dem_SetOperationCycleState(DemConf_DemOperationCycle_PowerCycle, DEM_CYCLE_STATE_START);.");
    debugger_setRelativeFunctionBpAtLine("ERH_Init", 59);
  
    debugger_reset();
    debugger_run();
    
    debugger_waitUntilBPisReached(500);
  

    testStep("STEP", "Set a breakpoint in function ERH_Init() at line '(void)Dem_SetEnableCondition(DemConf_DemEnableCondition_DEM_SL_NETWORK_COMM_NO_CLAMP15,TRUE);'.");
    debugger_setRelativeFunctionBpAtLine("ERH_Init", 71);
  
    debugger_run();
    
    testCaseComment("Action: ARCH_SW_ERH_0100, ARCH_SW_ERH_0048");
    testStep("STEP", "Check if CPU stopped in function ERH_Init() at line '(void)Dem_SetEnableCondition(DemConf_DemEnableCondition_DEM_SL_NETWORK_COMM_NO_CLAMP15,TRUE);'. --> CPU stopped at BP");
    debugger_waitUntilBPisReached(500);
 

  testCaseComment("Postcondition");
  testStep("STEP", "Return ECU to default values");
  RunPostTs();
  
}


testcase SW_IT_ERH_runGetAecStatus_01()
{
  //***********************************Test report header*********************************
  testReportAddMiscInfoBlock("AUTOLIV ELECTRONICS document");
  TestReportAddMiscInfo("Nightly test", "No");
  TestReportAddMiscInfo("Test type", "Requirement-Based test");
  TestReportAddMiscInfo("Regression Test", "No");
  TestReportAddMiscInfo("Fault injection method used", "No");
  TestReportAddMiscInfo("Resource usage evaluation", "No");
  TestReportAddMiscInfo("Priority", "No");
  TestReportAddMiscInfo("Safety relevant", "No");
  
  AddRequirementInfo("Requirement under test", "ARCH_SW_ERH_0064, ARCH_SW_ERH_0090");
  AddRequirementInfo("ARCH_SW_ERH_0064", "All AECs status and counters shall be initialized with 0x00.");
  AddRequirementInfo("ARCH_SW_ERH_0090", "The ERH_KU8_VARIANT_CODING_AEC_CFG should have the following properties: ? Qualification Count =1; ? Deskill Count = 1; - associated group: KU32_AEC_GROUP_MASK_VARIANT_CODING");
  //***************************************************************************************

  testCaseComment("Preconditions");
  testStep("STEP", "Bench Initialization");
  RunPreTs();

  
    testStep("STEP", "Set a breakpoint in function ERH_Init() at line 'erh_au16AecCounter[u8Index] = KU16_ZERO;'.");
    debugger_setRelativeFunctionBpAtLine("ERH_Init", 19);
    
    debugger_reset();
    debugger_run();
    
    testCaseComment("Action: ARCH_SW_ERH_0064");
    testStep("STEP", "Check if CPU stopped in function ERH_Init() at line 'erh_au16AecCounter[u8Index] = KU16_ZERO;'.");
    debugger_waitUntilBPisReached(500);
  
    
    debugger_deleteAllBP();
  
  
    testStep("STEP", "Set a breakpoint in function ERH_Init() at line 'erh_au8AecStatus[u8Index] = KU8_ZERO;'.");
    debugger_setRelativeFunctionBpAtLine("ERH_Init", 29);
    
    debugger_run();
    
    testCaseComment("Action: ARCH_SW_ERH_0064");
    testStep("STEP", "Check if CPU stopped in function ERH_Init() at line 'erh_au8AecStatus[u8Index] = KU8_ZERO;'.");
    debugger_waitUntilBPisReached(500);
  
    
    debugger_deleteAllBP();
    
  
    testStep("STEP", "Set a breakpoint in ERH_Init() at the end of the function.");
    debugger_setRelativeFunctionBpAtLine("ERH_Init", 65);
    
    debugger_run();
    testWaitForTimeoutSilent(500);
    
    testCaseComment("Action: ARCH_SW_ERH_0090");
    testStep("STEP", "Evaluate if erh_au16AecCounter[u8Index], where u8Index is ATM_KU8_ID_VARIANT_CODING, is equal to KU16_ZERO. --> erh_au16AecCounter[u8Index] == KU16_ZERO");
    result = debugger_readGlobalVariable("uint16", "erh_au16AecCounter,,app.elf", 0x34);
    EvalManStepEqual("Expected test result", result, KU16_ZERO);
 
    
    debugger_deleteAllBP();
    debugger_reset();
  

    testStep("STEP", "Set a breakpoint in function CIL_Autotest_CheckVariantCoding() at line '*pu8TestResult = pal_u8ResultOfAutoTest;'.");
    debugger_setRelativeFunctionBpAtLine("CIL_Autotest_CheckVariantCoding", 13);
    
    debugger_run();
    
    testStep("STEP", "Check if CPU stopped in function CIL_Autotest_CheckVariantCoding() at line '*pu8TestResult = pal_u8ResultOfAutoTest;'.");
    debugger_waitUntilBPisReached(10000);
    
    testStep("STEP", "Set variable *pu8TestResult to KU8_ATM_TEST_NOK.");
    debugger_writeLocalVariable("*pu8TestResult", 0x02);
    testWaitForTimeoutSilent(2000);


    debugger_deleteAllBP();
  
            
    testStep("STEP", "Set a breakpoint in function erh_ManageFailedCounterEvent() at line 'erh_au16AecCounter[cu8Index] += KU16_ONE;'.");
    debugger_setRelativeFunctionBpAtLine("erh_ManageFailedCounterEvent", 60);
    
    debugger_run();
    
    testStep("STEP", "Check if CPU stopped in function erh_ManageFailedCounterEvent() at line 'erh_au16AecCounter[cu8Index] += KU16_ONE;'.");
    debugger_waitUntilBPisReached(500);
    
    debugger_stepOver();
    
    testCaseComment("Action: ARCH_SW_ERH_0090");
    testStep("STEP", "Evaluate if erh_au16AecCounter[u8Index], where u8Index is ATM_KU8_ID_VARIANT_CODING, is equal to KU16_ONE. --> erh_au16AecCounter[u8Index] == KU16_ONE");
    result = debugger_readGlobalVariable("uint16", "erh_au16AecCounter,,app.elf", 0x34);
    EvalManStepEqual("Expected test result",  result, KU16_ONE);
  

  testCaseComment("Postcondition");
  testStep("STEP", "Return ECU to default values");
  RunPostTs();
}



testcase SW_IT_ERH_ResetAllAECStatus_01()
{
  //***********************************Test report header*********************************
  testReportAddMiscInfoBlock("AUTOLIV ELECTRONICS document");
  TestReportAddMiscInfo("Nightly test", "No");
  TestReportAddMiscInfo("Test type", "Requirement-Based test");
  TestReportAddMiscInfo("Regression Test", "No");
  TestReportAddMiscInfo("Fault injection method used", "No");
  TestReportAddMiscInfo("Resource usage evaluation", "No");
  TestReportAddMiscInfo("Priority", "No");
  TestReportAddMiscInfo("Safety relevant", "No");
  
  AddRequirementInfo("Requirement under test", "ARCH_SW_ERH_0070");
  AddRequirementInfo("ARCH_SW_ERH_0070", "All AECs status shall be reset if the function is called.");
  //***************************************************************************************

  testCaseComment("Preconditions");
  testStep("STEP", "Bench Initialization");
  RunPreTs();
    
  
    testStep("STEP", "Set a breakpoint in function ERH_ResetAllAECStatus() at line 'erh_au8AecStatus[u8OutputIndex] = KU8_ZERO;' under 'if (ERH_KU8_AEC_QUALIFIED_STATUS_MASK == (erh_au8AecStatus[u8OutputIndex] & ERH_KU8_AEC_QUALIFIED_STATUS_MASK))'.");
    debugger_setRelativeFunctionBpAtLine("ERH_ResetAllAECStatus", 33);
  
    debugger_reset();
    debugger_run();
  
    testStep("STEP", "Start Development Session."); 
    AuthenticateECU(2);
    EnterDiagnosticSession("development");
    
    testStep("STEP", "Send diagnostic request 14 FF FF FF.");
    diagSendRequest(reqFaultMem_ClearGroup);
    testWaitForTimeoutSilent(500);
    
    testCaseComment("Action: ARCH_SW_ERH_0070");
    testStep("STEP", "Check if CPU stopped in function ERH_ResetAllAECStatus() at line 'erh_au8AecStatus[u8OutputIndex] = KU8_ZERO;' under 'if (ERH_KU8_AEC_QUALIFIED_STATUS_MASK == (erh_au8AecStatus[u8OutputIndex] & ERH_KU8_AEC_QUALIFIED_STATUS_MASK))'. --> CPU stopped at BP");
    debugger_waitUntilBPisReached(1000);
  
  
    debugger_deleteAllBP();
  
  
    testStep("STEP", "Set a breakpoint in function ERH_ResetAllAECStatus() at line 'NVP_BLOCK_ID_AEC_STATUS_RamBlockData.NVP_au8AECStatus[u8OutputIndex] = (erh_au8AecStatus[u8OutputIndex] & (uint8) (~(uint32) ERH_KU8_AEC_EVER_TESTED_STATUS_MASK));'.");
    debugger_setRelativeFunctionBpAtLine("ERH_ResetAllAECStatus", 33);
  
    debugger_run();
  
    testCaseComment("Action: ARCH_SW_ERH_0070");
    testStep("STEP", "Check if CPU stopped in function ERH_ResetAllAECStatus() at line 'NVP_BLOCK_ID_AEC_STATUS_RamBlockData.NVP_au8AECStatus[u8OutputIndex] = (erh_au8AecStatus[u8OutputIndex] & (uint8) (~(uint32) ERH_KU8_AEC_EVER_TESTED_STATUS_MASK));'. --> CPU stopped at BP");
    debugger_waitUntilBPisReached(1000);

  
  testCaseComment("Postcondition");
  testStep("STEP", "Return ECU to default values");
  RunPostTs();
  
}


testcase SW_IT_ERH_IMPLAUSIBLE_DATA_API_01()
{
  //***********************************Test report header*********************************
  testReportAddMiscInfoBlock("AUTOLIV ELECTRONICS document");
  TestReportAddMiscInfo("Nightly test", "No");
  TestReportAddMiscInfo("Test type", "Requirement-Based test");
  TestReportAddMiscInfo("Regression Test", "No");
  TestReportAddMiscInfo("Fault injection method used", "No");
  TestReportAddMiscInfo("Resource usage evaluation", "No");
  TestReportAddMiscInfo("Priority", "No");
  TestReportAddMiscInfo("Safety relevant", "No");
  
  AddRequirementInfo("Requirement under test", "ARCH_SW_ERH_0089");
  AddRequirementInfo("ARCH_SW_ERH_0089", "The ERH_KU8_IMPLAUSIBLE_DATA_API_AEC_CFG should have the following properties: ? Qualification Count =10; ? Deskill Count = 3; - associated group: KU32_AEC_GROUP_MASK_IMPLAUSIBLE_DATA_API");
  //***************************************************************************************

  testCaseComment("Preconditions");
  testStep("STEP", "Bench Initialization");
  RunPreTs();

 
    testStep("STEP", "Set a breakpoint in function ERH_Init() at line 'erh_au16AecCounter[u8Index] = KU16_ZERO;'.");
    debugger_setRelativeFunctionBpAtLine("ERH_Init", 19);
    
    debugger_reset();
    debugger_run();
    
    testStep("STEP", "Check if CPU stopped in function ERH_Init() at line 'erh_au16AecCounter[u8Index] = KU16_ZERO;'.");
    debugger_waitUntilBPisReached(500);
  
    
    debugger_deleteAllBP();
    
  
    testStep("STEP", "Set a breakpoint in ERH_Init() at the end of the function.");
    debugger_setRelativeFunctionBpAtLine("ERH_Init", 65);
    
    debugger_run();
    testWaitForTimeoutSilent(500);
    
    testCaseComment("Action: ARCH_SW_ERH_0089");
    testStep("STEP", "Evaluate if erh_au16AecCounter[u8Index], where u8Index is ATM_KU8_ID_IMPLAUSIBLE_DATA_API, is equal to KU16_ZERO. --> erh_au16AecCounter[u8Index] == KU16_ZERO");
    result = debugger_readGlobalVariable("uint16", "erh_au16AecCounter,,app.elf", 0x33);
    EvalManStepEqual("Expected test result", result, KU16_ZERO);
 
    
    debugger_deleteAllBP();
    debugger_reset();
    debugger_run();
  

    testStep("STEP", "Set a breakpoint in function CIL_Autotest_CheckImplausibleData_API() at line '*pu8TestResult = pal_u8ResultOfAutoTest;'.");
    debugger_setRelativeFunctionBpAtLine("CIL_Autotest_CheckImplausibleData_API", 17);
    
    debugger_run();
    
    testStep("STEP", "Check if CPU stopped in function CIL_Autotest_CheckImplausibleData_API() at line '*pu8TestResult = pal_u8ResultOfAutoTest;'.");
    debugger_waitUntilBPisReached(10000);
    
    testStep("STEP", "Set variable *pu8TestResult to KU8_ATM_TEST_NOK.");
    debugger_writeLocalVariable("*pu8TestResult", 0x02);
    testWaitForTimeoutSilent(2000);


    debugger_deleteAllBP();
  
            
    testStep("STEP", "Set a breakpoint in function erh_ManageFailedCounterEvent() at line 'erh_au16AecCounter[cu8Index] += KU16_ONE;'.");
    debugger_setRelativeFunctionBpAtLine("erh_ManageFailedCounterEvent", 60);
    
    debugger_run();
    
    testStep("STEP", "Check if CPU stopped in function erh_ManageFailedCounterEvent() at line 'erh_au16AecCounter[cu8Index] += KU16_ONE;'.");
    debugger_waitUntilBPisReached(500);
    
    debugger_stepOver();
    
    testCaseComment("Action: ARCH_SW_ERH_0089");
    testStep("STEP", "Evaluate if erh_au16AecCounter[u8Index], where u8Index is ATM_KU8_ID_IMPLAUSIBLE_DATA_API, is equal to KU16_ONE. --> erh_au16AecCounter[u8Index] == KU16_ONE");
    result = debugger_readGlobalVariable("uint16", "erh_au16AecCounter,,app.elf", 0x33);
    EvalManStepEqual("Expected test result",  result, KU16_ONE);
  

  testCaseComment("Postcondition");
  testStep("STEP", "Return ECU to default values");
  RunPostTs();
}


testcase SW_IT_ERH_TIMEOUT_ODOSPEEDOMETER_01()
{
  //***********************************Test report header*********************************
  testReportAddMiscInfoBlock("AUTOLIV ELECTRONICS document");
  TestReportAddMiscInfo("Nightly test", "No");
  TestReportAddMiscInfo("Test type", "Requirement-Based test");
  TestReportAddMiscInfo("Regression Test", "No");
  TestReportAddMiscInfo("Fault injection method used", "No");
  TestReportAddMiscInfo("Resource usage evaluation", "No");
  TestReportAddMiscInfo("Priority", "No");
  TestReportAddMiscInfo("Safety relevant", "No");
  
  AddRequirementInfo("Requirement under test", "ARCH_SW_ERH_0087, ARCH_SW_ERH_0088");                                                                                               
  AddRequirementInfo("ARCH_SW_ERH_0087", "The ERH_KU8_TIMEOUT_ODOSPEEDOMETER should have the following properties: Qualification Count = 10; Deskill Count = 1; - associated group: KU32_AEC_GROUP_MASK_ODOSPEEDOMETER");
  AddRequirementInfo("ARCH_SW_ERH_0088", "The ERH_KU8_TIMEOUT_SECTICKCOUNT shall qualify the following DTC: U112087");
   //***************************************************************************************

  testCaseComment("Preconditions");
  testStep("STEP", "Bench Initialization");
  RunPreTs();

    
    testStep("STEP", "Set a breakpoint in function ERH_Init() at line 'erh_au16AecCounter[u8Index] = KU16_ZERO;'.");
    debugger_setRelativeFunctionBpAtLine("ERH_Init", 19);
    
    debugger_reset();
    debugger_run();
    
    testStep("STEP", "Check if CPU stopped in function ERH_Init() at line 'erh_au16AecCounter[u8Index] = KU16_ZERO;'.");
    debugger_waitUntilBPisReached(500);
  
    
    debugger_deleteAllBP();
    
  
    testStep("STEP", "Set a breakpoint in ERH_Init() at the end of the function.");
    debugger_setRelativeFunctionBpAtLine("ERH_Init", 65);
    
    debugger_run();
    testWaitForTimeoutSilent(500);
    
    testCaseComment("Action: ARCH_SW_ERH_0087, ARCH_SW_ERH_0088");
    testStep("STEP", "Evaluate if erh_au16AecCounter[u8Index], where u8Index is ATM_KU8_ID_TIMEOUT_ODOSPEEDOMETER, is equal to KU16_ZERO. --> erh_au16AecCounter[u8Index] == KU16_ZERO");
    result = debugger_readGlobalVariable("uint16", "erh_au16AecCounter,,app.elf", 0x31);
    EvalManStepEqual("Expected test result", result, KU16_ZERO);
 
    
    debugger_deleteAllBP();
    debugger_reset();
    debugger_run();
  

    testStep("STEP", "Set a breakpoint in function CIL_Autotest_CheckTimeoutError_OdoSpeedometer() at line '*pu8TestResult = pal_u8ResultOfAutoTest;'.");
    debugger_setRelativeFunctionBpAtLine("CIL_Autotest_CheckTimeoutError_OdoSpeedometer", 11);
    
    debugger_run();
    
    testStep("STEP", "Check if CPU stopped in function CIL_Autotest_CheckTimeoutError_OdoSpeedometer() at line '*pu8TestResult = pal_u8ResultOfAutoTest;'.");
    debugger_waitUntilBPisReached(10000);
    
    testStep("STEP", "Set variable *pu8TestResult to KU8_ATM_TEST_NOK.");
    debugger_writeLocalVariable("*pu8TestResult", 0x02);
    testWaitForTimeoutSilent(2000);


    debugger_deleteAllBP();
  
            
    testStep("STEP", "Set a breakpoint in function erh_ManageFailedCounterEvent() at line 'erh_au16AecCounter[cu8Index] += KU16_ONE;'.");
    debugger_setRelativeFunctionBpAtLine("erh_ManageFailedCounterEvent", 60);
    
    debugger_run();
    
    testStep("STEP", "Check if CPU stopped in function erh_ManageFailedCounterEvent() at line 'erh_au16AecCounter[cu8Index] += KU16_ONE;'.");
    debugger_waitUntilBPisReached(500);
    
    debugger_stepOver();
    
    testCaseComment("Action: ARCH_SW_ERH_0087, ARCH_SW_ERH_0088");
    testStep("STEP", "Evaluate if erh_au16AecCounter[u8Index], where u8Index is ATM_KU8_ID_TIMEOUT_ODOSPEEDOMETER, is equal to KU16_ONE. --> erh_au16AecCounter[u8Index] == KU16_ONE");
    result = debugger_readGlobalVariable("uint16", "erh_au16AecCounter,,app.elf", 0x31);
    EvalManStepEqual("Expected test result",  result, KU16_ONE);
  
  
  testCaseComment("Postcondition");
  testStep("STEP", "Return ECU to default values");
  RunPostTs();
}