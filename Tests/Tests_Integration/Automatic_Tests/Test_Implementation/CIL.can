/*@!Encoding:1252*/
/*------------------------------------------------------------------------------
                                IMPORT LIBRARY
 ------------------------------------------------------------------------------*/
/* To include all the libraries used by the .capl script. */
/* WARNING: Some things such as diagnostic functions are different from project
to project, change those according to your project requirements */

/***********************************************************************************************/

includes
{
  
  #include "..\Includes\SW_Modules\SW_Modules_Project\Project_Includes_Configuration.cin"
}

variables
{
  char signal_value[24];
  char buffer[24];
  long result;
  long actual_result;
  long expected_result;
  
  diagRequest RBTMFL174.Tensioning_Cycle_BSR_Read req_Tensioning_Cycle_BSR_Read;
  diagRequest RBTMFL174.Tensioning_Cycle_BSR_Write req_Tensioning_Cycle_BSR_Write;
  
  diagRequest RBTMFL174.Measurement_Frames_Configuration_Read req_Measurement_Frames_Configuration_Read;
  diagRequest RBTMFL174.Measurement_Frames_Configuration_Write req_Measurement_Frames_Configuration_Write;
  
  diagRequest RBTMFL174.PRE_SAFE_Counter_read_Read req_PRE_SAFE_Counter_read_Read;
  diagRequest RBTMFL174.PreSafe_Cycles_Level_1_8_Read req_PreSafe_Cycles_Level_1_8_Read;
  
  int i;
}



testcase InitTestModule()
{
  ConfigureTestModuleInformation(CGA);
  
  strncpy(cLogPath, "S:\\Tools\\CANoe\\Config\\DAIMLER_MMA_INTEGRATION\\Logs\\",  elcount(cLogPath));
}


/*------------------------------------------------------------------------------
                                TEST EXECUTION
------------------------------------------------------------------------------*/
  
  /*------------------------- Test scenario start ------------------------------*/

// R8.1


testcase SW_IT_CIL_GetAecGroupsStatus_02()
{
  //***********************************Test report header*********************************
  testReportAddMiscInfoBlock("AUTOLIV ELECTRONICS document");
  TestReportAddMiscInfo("Nightly test", "No");
  TestReportAddMiscInfo("Test type", "Requirement-Based test");
  TestReportAddMiscInfo("Regression Test", "No");
  TestReportAddMiscInfo("Fault injection method used", "No");
  TestReportAddMiscInfo("Resource usage evaluation", "No");
  TestReportAddMiscInfo("Priority", "No");
  TestReportAddMiscInfo("Safety relevant", "No");
  
  AddRequirementInfo("Requirement under test", "ARCH_SW_CIL_0370");
  AddRequirementInfo("ARCH_SW_CIL_0370", "ERH_GetAecStatus shall be called to get the TIMEOUT ERROR ON API frame or U188A08- Implausible data on API frame that will abort/inhibit all profiles requested on API.");
  //***************************************************************************************
    
  testCaseComment("Preconditions");
  testStep("STEP", "Bench Initialization");
  RunPreTs();

  
    testStep("STEP", "Set signal RBTMFL_SP_Lvl_Rq_ST35 to I_C04_PRESF_LVL_V2_NOLVL.");
    setSignal(BODY3::RBTMFL_SP_Lvl_Rq_ST35, 0);
    testWaitForTimeout(500);

  
    testStep("STEP", "Set a breakpoint in the function CIL_runCANToAppli().");
    debugger_setRelativeFunctionBpAtLine("CIL_runCANToAppli", 0);
    
    testStep("STEP", "Check if CPU stopped in function CIL_runCANToAppli().");
    debugger_WaitUntilBPisReached(1000);
  
    
    debugger_deleteAllBP();
  
  
    testStep("STEP", "Set a breakpoint in the function CIL_Autotest_CheckImplausibleData_API at line 'cil_u8ResultOfAutoTest = KU8_ATM_TEST_OK;'.");
    debugger_setRelativeFunctionBpAtLine("CIL_Autotest_CheckImplausibleData_API", 12);
  
    debugger_run();
  
    testCaseComment("Action: ARCH_SW_CIL_0370");
    testStep("STEP", "Check if CPU stopped in function CIL_Autotest_CheckImplausibleData_API() at line 'cil_u8ResultOfAutoTest = KU8_ATM_TEST_OK;'.");
    debugger_WaitUntilBPisReached(1000);
  
  
    debugger_deleteAllBP();  
  
  
    testStep("STEP", "Set a breakpoint in function cil_ManageInhibitConditions at line 'Rte_Call_pclAecStatus_GetAecGroupsStatus(&u32AECGroupStatus);'.");
    debugger_setRelativeFunctionBpAtLine("cil_ManageInhibitConditions", 8);
    
    debugger_run();
  
    testCaseComment("Action: ARCH_SW_CIL_0370");
    testStep("STEP", "Check if CPU stopped in function cil_ManageInhibitConditions at line 'Rte_Call_pclAecStatus_GetAecGroupsStatus(&u32AECGroupStatus);'.");
    debugger_WaitUntilBPisReached(1000);
  

  testCaseComment("Postcondition");
  testStep("STEP", "Return ECU to default values");
  RunPostTs();
}


testcase SW_IT_CIL_GetAecGroupsStatus_01()
{
  //***********************************Test report header*********************************
  testReportAddMiscInfoBlock("AUTOLIV ELECTRONICS document");
  TestReportAddMiscInfo("Nightly test", "No");
  TestReportAddMiscInfo("Test type", "Requirement-Based test");
  TestReportAddMiscInfo("Regression Test", "No");
  TestReportAddMiscInfo("Fault injection method used", "No");
  TestReportAddMiscInfo("Resource usage evaluation", "No");
  TestReportAddMiscInfo("Priority", "No");
  TestReportAddMiscInfo("Safety relevant", "No");
  
  AddRequirementInfo("Requirement under test", "ARCH_SW_CIL_0366, ARCH_SW_CIL_0367, ARCH_SW_CIL_0368, ARCH_SW_CIL_0369");
  AddRequirementInfo("ARCH_SW_CIL_0366", "ERH_runGetAecGroupsStatus shall be called to get the inhibition and abortion conditions for PRE_SAFE and request tensioning cycles.");
  AddRequirementInfo("ARCH_SW_CIL_0367", "ERH_runGetAecGroupsStatus shall be called to get the inhibition conditions for PRE-SAFE6/7/8 request cycles.");
  AddRequirementInfo("ARCH_SW_CIL_0368", "ERH_runGetAecGroupsStatus shall be called to get the abortion conditions for PRE_SAFE request tensioning cycles.");
  //***************************************************************************************
    
  testCaseComment("Preconditions");
  testStep("STEP", "Bench Initialization");
  RunPreTs();

  
    testStep("STEP", "Set signal RBTMFL_SP_Lvl_Rq_ST35 to I_C04_PRESF_LVL_V2_NOLVL.");
    setSignal(BODY3::RBTMFL_SP_Lvl_Rq_ST35, 0);
    testWaitForTimeout(500);

  
    testStep("STEP", "Set a breakpoint in the function CIL_runCANToAppli() at line 'cil_ManageInputSignals();'.");
    debugger_setRelativeFunctionBpAtLine("CIL_runCANToAppli", 5);
    
    testStep("STEP", "Check if CPU stopped in function CIL_runCANToAppli() at line 'cil_ManageInputSignals();'.");
    debugger_isCPUStoppedAtFunction("CIL_runCANToAppli");
  
  
    debugger_deleteAllBP();
  
  
    testStep("STEP", "Set a breakpoint in the function cil_ManageInputSignals at line 'cil_ManageInhibitConditions();'.");
    debugger_setRelativeFunctionBpAtLine("cil_ManageInputSignals", 250);
  
    debugger_run();
  
    testStep("STEP", "Check if CPU stopped in function cil_ManageInputSignals() at line 'cil_ManageInhibitConditions();'.");
    debugger_isCPUStoppedAtFunction("cil_ManageInputSignals");
  
  
    debugger_deleteAllBP();  
  
  
    testStep("STEP", "Set a breakpoint in the function cil_ManageInhibitConditions at line 'Rte_Call_pclAecStatus_GetAecGroupsStatus(&u32AECGroupStatus);'.");
    debugger_setRelativeFunctionBpAtLine("cil_ManageInhibitConditions", 8);
    
    debugger_run();
  
    testCaseComment("Action: ARCH_SW_CIL_0366, ARCH_SW_CIL_0367, ARCH_SW_CIL_0368, ARCH_SW_CIL_0369");
    testStep("STEP", "Check if CPU stopped at line Rte_Call_pclAecStatus_GetAecGroupsStatus(&u32AECGroupStatus);.");
    debugger_isCPUStoppedAtFunction("cil_ManageInhibitConditions");
  

  testCaseComment("Postcondition");
  testStep("STEP", "Return ECU to default values");
  RunPostTs();
}


testcase SW_IT_CIL_runCheckModeStatus_02()
{
  //***********************************Test report header*********************************
  testReportAddMiscInfoBlock("AUTOLIV ELECTRONICS document");
  TestReportAddMiscInfo("Nightly test", "No");
  TestReportAddMiscInfo("Test type", "Requirement-Based test");
  TestReportAddMiscInfo("Regression Test", "No");
  TestReportAddMiscInfo("Fault injection method used", "No");
  TestReportAddMiscInfo("Resource usage evaluation", "No");
  TestReportAddMiscInfo("Priority", "No");
  TestReportAddMiscInfo("Safety relevant", "No");

  AddRequirementInfo("Requirement under test", "ARCH_SW_CIL_0362, ARCH_SW_CIL_0363, ARCH_SW_CIL_0371");
  AddRequirementInfo("ARCH_SW_CIL_0362", "MMG_runCheckModeStatus shall be called to get the abortion conditions for all cycles.");
  AddRequirementInfo("ARCH_SW_CIL_0363", "MMG_runCheckModeStatus shall be called to get the abortion conditions for tensioning cycles (and haptic cycle and BSR).");
  AddRequirementInfo("ARCH_SW_CIL_0371", "MMG_runCheckModeStatus shall be called to get the abortion conditions for tensioning cycles (and haptic cycle and BSR).");
  //***************************************************************************************
    
  testCaseComment("Preconditions");
  testStep("STEP", "Bench Initialization");
  RunPreTs();

    
    testStep("STEP", "Set a breakpoint in the function CIL_runCANToAppli() at line 'cil_ManageInputSignals();'.");
    debugger_setRelativeFunctionBpAtLine("CIL_runCANToAppli", 88);
    
    testStep("STEP", "Check if CPU stopped in function CIL_runCANToAppli() at line 'cil_ManageInputSignals();'.");
    debugger_WaitUntilBPisReached(1000);
  
  
    debugger_deleteAllBP();
    
  
    testStep("STEP", "Set a breakpoint in the function cil_ManageInputSignals() at line 'cil_ManageAbortingConditions();'.");
    debugger_setRelativeFunctionBpAtLine("cil_ManageInputSignals", 253);
    
    debugger_run();
  
    testStep("STEP", "Check if CPU stopped in function cil_ManageInputSignals() at line 'cil_ManageAbortingConditions();'.");
    debugger_WaitUntilBPisReached(1000);
  
  
    debugger_deleteAllBP();
  
  
    testStep("STEP", "Set a breakpoint in function cil_ManageAbortingConditions() at line '(void)Rte_Call_pclModeManagement_CheckModeStatus(KU32_CIL_MASK_TENS_ABORTING_MODES, &u8ContextStatus);'.");
    debugger_setRelativeFunctionBpAtLine("cil_ManageAbortingConditions", 6);
    
    debugger_run();
    
    testCaseComment("Action: ARCH_SW_CIL_0362, ARCH_SW_CIL_0363, ARCH_SW_CIL_0371");
    testStep("STEP", "Check if CPU stopped in function cil_ManageAbortingConditions() at line '(void)Rte_Call_pclModeManagement_CheckModeStatus(KU32_CIL_MASK_TENS_ABORTING_MODES, &u8ContextStatus);'. --> CPU is Stopped");
    debugger_WaitUntilBPisReached(1000);
  

    debugger_deleteAllBP();
  
  
    testStep("STEP", "Set a breakpoint in function cil_ManageAbortingConditions() at line '(void)Rte_Call_pclModeManagement_CheckModeStatus(KU32_CIL_MASK_ALL_ABORTING_MODES, &u8ContextStatus);'.");
    debugger_setRelativeFunctionBpAtLine("cil_ManageAbortingConditions", 20);
    
    debugger_run();
    
    testCaseComment("Action: ARCH_SW_CIL_0362, ARCH_SW_CIL_0363, ARCH_SW_CIL_0371");
    testStep("STEP", "Check if CPU stopped in function cil_ManageAbortingConditions() at line '(void)Rte_Call_pclModeManagement_CheckModeStatus(KU32_CIL_MASK_ALL_ABORTING_MODES, &u8ContextStatus);'. --> CPU is Stopped");
    debugger_WaitUntilBPisReached(1000);


  testCaseComment("Postcondition");
  testStep("STEP", "Return ECU to default values");
  RunPostTs();
}


testcase SW_IT_CIL_runCheckModeStatus_01()
{
  //***********************************Test report header*********************************
  testReportAddMiscInfoBlock("AUTOLIV ELECTRONICS document");
  TestReportAddMiscInfo("Nightly test", "No");
  TestReportAddMiscInfo("Test type", "Requirement-Based test");
  TestReportAddMiscInfo("Regression Test", "No");
  TestReportAddMiscInfo("Fault injection method used", "No");
  TestReportAddMiscInfo("Resource usage evaluation", "No");
  TestReportAddMiscInfo("Priority", "No");
  TestReportAddMiscInfo("Safety relevant", "No");
  
  AddRequirementInfo("Requirement under test", "ARCH_SW_CIL_0359, ARCH_SW_CIL_0360, ARCH_SW_CIL_0361");
  AddRequirementInfo("ARCH_SW_CIL_0359", "MMG_runCheckModeStatus shall be called to get the inhibition conditions for all cycles.");
  AddRequirementInfo("ARCH_SW_CIL_0360", "MMG_runCheckModeStatus shall be called to get the inhibition conditions for tensioning cycles.");
  //***************************************************************************************
    
  testCaseComment("Preconditions");
  testStep("STEP", "Bench Initialization");
  RunPreTs();


    testStep("STEP", "Set a breakpoint in the function CIL_runCANToAppli() at line 'cil_ManageInputSignals();'.");
    debugger_setRelativeFunctionBpAtLine("CIL_runCANToAppli", 88);
    
    testStep("STEP", "Check if CPU stopped in function CIL_runCANToAppli() at line 'cil_ManageInputSignals();'.");
    debugger_WaitUntilBPisReached(1000);
  
  
    debugger_deleteAllBP();
    
  
    testStep("STEP", "Set a breakpoint in the function cil_ManageInputSignals() at line 'cil_ManageInhibitConditions();'.");
    debugger_setRelativeFunctionBpAtLine("cil_ManageInputSignals", 250);
    
    debugger_run();
  
    testStep("STEP", "Check if CPU stopped in function cil_ManageInputSignals() at line 'cil_ManageInhibitConditions();'.");
    debugger_WaitUntilBPisReached(1000);
  
  
    debugger_deleteAllBP();
  
  
    testStep("STEP", "Set a breakpoint in the function cil_ManageInhibitConditions() at line '(void)Rte_Call_pclModeManagement_CheckModeStatus(KU32_CIL_MASK_TENS_INHIBITING_MODES, &u8ContextStatus);'.");
    debugger_setRelativeFunctionBpAtLine("cil_ManageInhibitConditions", 11);
    
    debugger_run();
    
    testCaseComment("Action: ARCH_SW_CIL_0359, ARCH_SW_CIL_0360, ARCH_SW_CIL_0361");
    testStep("STEP", "Check if CPU stopped in function cil_ManageInhibitConditions() at line '(void)Rte_Call_pclModeManagement_CheckModeStatus(KU32_CIL_MASK_TENS_INHIBITING_MODES, &u8ContextStatus);'. --> CPU is Stopped");
    debugger_WaitUntilBPisReached(1000);
  

    debugger_deleteAllBP();
  
  
    testStep("STEP", "Set a breakpoint in the function cil_ManageInhibitConditions() at line '(void)Rte_Call_pclModeManagement_CheckModeStatus(KU32_CIL_MASK_ALL_INHIBITING_MODES, &u8ContextStatus);'.");
    debugger_setRelativeFunctionBpAtLine("cil_ManageInhibitConditions", 24);
    
    debugger_run();
    
    testCaseComment("Action: ARCH_SW_CIL_0359, ARCH_SW_CIL_0360, ARCH_SW_CIL_0361");
    testStep("STEP", "Check if CPU stopped in function cil_ManageInhibitConditions() at line '(void)Rte_Call_pclModeManagement_CheckModeStatus(KU32_CIL_MASK_ALL_INHIBITING_MODES, &u8ContextStatus);'. --> CPU is Stopped");
    debugger_WaitUntilBPisReached(1000);
  
  
    debugger_deleteAllBP();
  
  
    testStep("STEP", "Set a breakpoint in the function cil_ManageInhibitConditions() at line '(void)Rte_Call_pclModeManagement_CheckModeStatus(KU32_CIL_MASK_BSR_INHIBITING_MODES, &u8ContextStatus);'.");
    debugger_setRelativeFunctionBpAtLine("cil_ManageInhibitConditions", 255);
    
    debugger_run();
    
    testCaseComment("Action: ARCH_SW_CIL_0359, ARCH_SW_CIL_0360, ARCH_SW_CIL_0361");
    testStep("STEP", "Check if CPU stopped in function cil_ManageInhibitConditions() at line '(void)Rte_Call_pclModeManagement_CheckModeStatus(KU32_CIL_MASK_BSR_INHIBITING_MODES, &u8ContextStatus);'. --> CPU is Stopped");
    debugger_WaitUntilBPisReached(1000);
  
  
    debugger_deleteAllBP();
  
  
    testStep("STEP", "Set a breakpoint in the function cil_ManageInhibitConditions() at line '(void)Rte_Call_pclModeManagement_CheckModeStatus(MMG_KU32_MASK_AEC_INHIB_ALL_CYCLES, &u8ContextStatus);'.");
    debugger_setRelativeFunctionBpAtLine("cil_ManageInhibitConditions", 271);
    
    debugger_run();
    
    testCaseComment("Action: ARCH_SW_CIL_0359, ARCH_SW_CIL_0360, ARCH_SW_CIL_0361");
    testStep("STEP", "Check if CPU stopped in function cil_ManageInhibitConditions() at line '(void)Rte_Call_pclModeManagement_CheckModeStatus(MMG_KU32_MASK_AEC_INHIB_ALL_CYCLES, &u8ContextStatus);'. --> CPU is Stopped");
    debugger_WaitUntilBPisReached(1000);
    
    
    debugger_deleteAllBP();
  
  
    testStep("STEP", "Set a breakpoint in function PMP_Autotest_CheckPowerSupplyUVDuringActivation() at line 'Rte_Call_pclModeManagement_CheckModeStatus(MMG_KU32_MASK_TENSIONING, &u8TensioningModeStatus);'.");
    debugger_setRelativeFunctionBpAtLine("PMP_Autotest_CheckPowerSupplyUVDuringActivation", 29);
    
    debugger_run();
    
    testCaseComment("Action: ARCH_SW_CIL_0359, ARCH_SW_CIL_0360, ARCH_SW_CIL_0361");
    testStep("STEP", "Check if CPU stopped in function in function PMP_Autotest_CheckPowerSupplyUVDuringActivation() at line 'Rte_Call_pclModeManagement_CheckModeStatus(MMG_KU32_MASK_TENSIONING, &u8TensioningModeStatus);'. --> CPU is Stopped");
    debugger_WaitUntilBPisReached(1000);
    
    
    debugger_deleteAllBP();
  
  
    testStep("STEP", "Set a breakpoint in function PMP_Autotest_CheckPowerSupplyOVDuringActivation() at line 'Rte_Call_pclModeManagement_CheckModeStatus(MMG_KU32_MASK_TENSIONING, &u8TensioningModeStatus);'.");
    debugger_setRelativeFunctionBpAtLine("PMP_Autotest_CheckPowerSupplyOVDuringActivation", 28);
    
    debugger_run();
    
    testCaseComment("Action: ARCH_SW_CIL_0359, ARCH_SW_CIL_0360, ARCH_SW_CIL_0361");
    testStep("STEP", "Check if CPU stopped in function in function PMP_Autotest_CheckPowerSupplyOVDuringActivation() at line 'Rte_Call_pclModeManagement_CheckModeStatus(MMG_KU32_MASK_TENSIONING, &u8TensioningModeStatus);'. --> CPU is Stopped");
    debugger_WaitUntilBPisReached(1000);
  

  testCaseComment("Postcondition");
  testStep("STEP", "Return ECU to default values");
  RunPostTs();
}


testcase SW_IT_CIL_ManageInhibitConditions_02() 
{
  //***********************************Test report header*********************************
  testReportAddMiscInfoBlock("AUTOLIV ELECTRONICS document");
  TestReportAddMiscInfo("Nightly test", "No");
  TestReportAddMiscInfo("Test type", "Requirement-Based test");
  TestReportAddMiscInfo("Regression Test", "No");
  TestReportAddMiscInfo("Fault injection method used", "No");
  TestReportAddMiscInfo("Resource usage evaluation", "No");
  TestReportAddMiscInfo("Priority", "No");
  TestReportAddMiscInfo("Safety relevant", "No");
  
  AddRequirementInfo("Requirement under test", "ARCH_SW_CIL_0212");
  AddRequirementInfo("ARCH_SW_CIL_0212", "CIL component should ensure that if a BSR is request by ALGO ( on Buckle Switch / BeltSlackMode Switch) and it is inhibitted by:	Measured KL30 battery voltage is outside Normal Operating Range or value received on CAN for signal PT4_PTCoor_PT_Rdy_ST3(only for buckle switch) or timeout DTC powertrain KU32_AEC_GROUP_MASK_TIMEOUT_POWERTRAIN;•	value received on CAN for corresponding belt for signal BeltHdOvr_FL_Stat_ST3 or BeltHdOvr_FR_Stat_ST if enabled in the coding;•	timeout DTC KU32_AEC_GROUP_MASK_TIMEOUT_BH_R/L;•	value received on CAN for for signal PT4_PTCoor_DrvPosn_Stat_ST, execution of BSR will be postponed until all starting conditions will be fulfilled");
  //***************************************************************************************
  
  testCaseComment("Preconditions");
  testStep("STEP", "Bench Initialization");
  RunPreTs();
    
    
    testStep("STEP", "Set signal PT4_PTCoor_PT_Rdy_ST3 to NOT_RDY.");
    setSignal(BODY3::PT4_PTCoor4_ST3::PT4_PTCoor_PT_Rdy_ST3, 0); 
    testWaitForTimeoutSilent(100);
  
    testStep("STEP", "Set signal Bckl_Sw_D_Stat_ST3 to I_C02_BCKL_SW_STAT_NOT.");
    setSignal(BODY3::Bckl_Sw_D_Stat_ST3, 1);
    testWaitForTimeoutSilent(500);
  
    testStep("STEP", "Set signal Bckl_Sw_D_Stat_ST3 to I_C02_BCKL_SW_STAT_OK.");
    setSignal(BODY3::Bckl_Sw_D_Stat_ST3, 0);
  
  
    testStep("STEP", "Set a breakpoint in function cil_ManageInputSignals() at line 'cil_ManageInhibitConditions();'.");
    debugger_setRelativeFunctionBpAtLine("cil_ManageInputSignals", 260);
  
    testStep("STEP", "Check if CPU stopped in function cil_ManageInputSignals() at line 'cil_ManageInhibitConditions();'. --> CPU is Stopped");
    debugger_WaitUntilBPisReached(1000);


    debugger_deleteAllBP();
    
  
    testStep("STEP", "Set a breakpoint in function cil_ManageInhibitConditions() at line 'CIL_SET_INHIB_MASK_ON (KU8_CIL_Bckl_Sw_Inhibition);'.");
    debugger_setRelativeFunctionBpAtLine("cil_ManageInhibitConditions", 188);
  
    debugger_run();  
  
    testCaseComment("Action: ARCH_SW_CIL_0212");
    testStep("STEP", "Check if CPU stopped in function cil_ManageInputSignals() at line 'CIL_SET_INHIB_MASK_ON (KU8_CIL_Bckl_Sw_Inhibition);'. --> CPU is Stopped");
    debugger_WaitUntilBPisReached(1000);
  
    
    debugger_deleteAllBP();
    debugger_run();
  
    
    testStep("STEP", "Set signal PT4_PTCoor_PT_Rdy_ST3 to RDY.");
    setSignal(BODY3::PT4_PTCoor4_ST3::PT4_PTCoor_PT_Rdy_ST3, 1); 
    testWaitForTimeoutSilent(100);
  
    
    testStep("STEP", "Set a breakpoint in function cil_ManageInhibitConditions() at line 'CIL_SET_INHIB_MASK_OFF (KU8_CIL_Bckl_Sw_Inhibition);'.");
    debugger_setRelativeFunctionBpAtLine("cil_ManageInhibitConditions", 183);
  
    debugger_run();  
  
    testCaseComment("Action: ARCH_SW_CIL_0212");
    testStep("STEP", "Check if CPU stopped in function cil_ManageInputSignals() at line 'CIL_SET_INHIB_MASK_OFF (KU8_CIL_Bckl_Sw_Inhibition);'. --> CPU is Stopped");
    debugger_WaitUntilBPisReached(1000); 
  
  
  testCaseComment("Postcondition");
  testStep("STEP", "Return ECU to default values");
  RunPostTs(); 
}


testcase SW_IT_CIL_ManageInhibitConditions_01()
{
  //***********************************Test report header*********************************
  testReportAddMiscInfoBlock("AUTOLIV ELECTRONICS document");
  TestReportAddMiscInfo("Nightly test", "No");
  TestReportAddMiscInfo("Test type", "Requirement-Based test");
  TestReportAddMiscInfo("Regression Test", "No");
  TestReportAddMiscInfo("Fault injection method used", "No");
  TestReportAddMiscInfo("Resource usage evaluation", "No");
  TestReportAddMiscInfo("Priority", "No");
  TestReportAddMiscInfo("Safety relevant", "No");
  
  AddRequirementInfo("Requirement under test", "ARCH_SW_CIL_0187, ARCH_SW_CIL_0155");
  AddRequirementInfo("ARCH_SW_CIL_0155", "Reverse Gear Engaged is value 3 for this signal and BSR profiles shall be inhibited / aborted by this.");
  AddRequirementInfo("ARCH_SW_CIL_0187", "Values of 0 and 3 for this signall shall inhibit all BSR profiles.");
  //***************************************************************************************
    
  testCaseComment("Preconditions");
  testStep("STEP", "Bench Initialization");
  RunPreTs();
 
 
    testStep("STEP", "Set signal PT4_PTCoor_PT_Rdy_ST3 to ENGG_ENGG.");
    setSignal(BODY3::PT4_PTCoor_DrvPosn_Stat_ST3, 1);
    testWaitForTimeoutSilent(100);
  
    testStep("STEP", "Set signal PT4_PTCoor_PT_Rdy_ST3 to RDY (0x1).");
    setSignal(BODY3::PT4_PTCoor4_ST3::PT4_PTCoor_PT_Rdy_ST3, 1);
    testWaitForTimeoutSilent(100);
  
    testStep("STEP", "Set signal Bckl_Sw_D_Stat_ST3 to I_C02_BCKL_SW_STAT_NOT.");
    setSignal(BODY3::Bckl_Sw_D_Stat_ST3, 1);
    testWaitForTimeoutSilent(500);
  
    testStep("STEP", "Set signal Bckl_Sw_D_Stat_ST3 to I_C02_BCKL_SW_STAT_OK.");
    setSignal(BODY3::Bckl_Sw_D_Stat_ST3, 0);
    
  
    testStep("STEP", "Set a breakpoint in function cil_ManageInputSignals() at line 'cil_ManageInhibitConditions();'.");
    debugger_setRelativeFunctionBpAtLine("cil_ManageInputSignals", 260);
  
    testStep("STEP", "Check if CPU stopped in function cil_ManageInputSignals() at line 'cil_ManageInhibitConditions();'. --> CPU is Stopped");
    debugger_WaitUntilBPisReached(1000);


    debugger_deleteAllBP();
    
  
    testStep("STEP", "Set a breakpoint in function cil_ManageInhibitConditions() at line 'CIL_SET_INHIB_MASK_ON (KU8_CIL_Bckl_Sw_Inhibition);'.");
    debugger_setRelativeFunctionBpAtLine("cil_ManageInhibitConditions", 188);
  
    debugger_run();  
  
    testCaseComment("Action: ARCH_SW_CIL_0155");
    testStep("STEP", "Check if CPU stopped in function cil_ManageInputSignals() at line 'CIL_SET_INHIB_MASK_ON (KU8_CIL_Bckl_Sw_Inhibition);'. --> CPU is Stopped");
    debugger_WaitUntilBPisReached(1000);
  
  
  testCaseComment("Postcondition");
  testStep("STEP", "Return ECU to default values");
  RunPostTs(); 
}



testcase SW_IT_CIL_ManageInputSignals_02()
{
  //***********************************Test report header*********************************
  testReportAddMiscInfoBlock("AUTOLIV ELECTRONICS document");
  TestReportAddMiscInfo("Nightly test", "No");
  TestReportAddMiscInfo("Test type", "Requirement-Based test");
  TestReportAddMiscInfo("Regression Test", "No");
  TestReportAddMiscInfo("Fault injection method used", "No");
  TestReportAddMiscInfo("Resource usage evaluation", "No");
  TestReportAddMiscInfo("Priority", "No");
  TestReportAddMiscInfo("Safety relevant", "No");
  
  AddRequirementInfo("Requirement under test", "ARCH_SW_CIL_0266");
  AddRequirementInfo("ARCH_SW_CIL_0266", "Signal PS_Curve_FL/FR_Stat_ST3 shall be computed based on signal PS_Curve_FL/FR_Rq_HU_ST3 using NVP_u8PSCurveConfig:-STAGE_OFF when Request is STAGE_OFF (0); -STAGE1 When request is STAGE1 (1). -	STAGE2 When request is STAGE2 (2). Last valid value when request is SNA  is received on PS_Curve_FL/FR_Rq_HU_ST3 over the current power cycle.");
  //***************************************************************************************
  
  testCaseComment("Preconditions");
  testStep("STEP", "Bench Initialization");
  RunPreTs();
  
  
    testStep("STEP", "Set signal PS_Curve_FL_Rq_HU_ST3 from to I_C02_OFF_STAGE1_STAGE2_OFF.");
    setSignal(BODY3::BeltAdj_UI_Set_Rq_ST3::PS_Curve_FL_Rq_HU_ST3, 0);
    testWaitForTimeout(500);
  
  
    testStep("STEP", "Set a breakpoint in function CIL_runCANToAppli() at line 'cil_ManageInputSignals();'.");
    debugger_setRelativeFunctionBpAtLine("CIL_runCANToAppli", 88);
  
    testCaseComment("Action: ARCH_SW_CIL_0266");
    testStep("STEP", "Check if CPU stopped in function CIL_runCANToAppli() at line 'cil_ManageInputSignals();'. --> CPU is Stopped");
    debugger_WaitUntilBPisReached(1000);
  
    
    debugger_deleteAllBP();
  
  
    testStep("STEP", "Set a breakpoint in function cil_ManageInputSignals() at line 'if(NVP_BLOCK_ID_CAN_INPUT_SIGNALS_RamBlockData.NVP_u8PSCurveConfig != CIL_u8PSCurve)'.");
    debugger_setRelativeFunctionBpAtLine("cil_ManageInputSignals", 252);
    
    debugger_run();
  
    testStep("STEP", "Check if CPU stopped in function cil_ManageInputSignals() at line '(void)Rte_Write_psrCANInputBlockStatus_b8NVMBlockStatus(KU8_TRUE);' under 'if(NVP_BLOCK_ID_CAN_INPUT_SIGNALS_RamBlockData.NVP_u8PSCurveConfig != CIL_u8PSCurve)'. --> CPU is Stopped");
    debugger_WaitUntilBPisReached(1000);
    result = debugger_readGlobalVariable("uint8", "CIL_u8PSCurve,,app.elf", $PS_Curve_FR_Stat_ST3.raw64);
    
    
    debugger_deleteAllBP();
    debugger_run();
    testWaitForTimeoutSilent(1000);
  
    
    testCaseComment("Action: ARCH_SW_CIL_0266");
    testStep("STEP", "Evaluate if variable CIL_u8PSCurve is equal to signal PS_Curve_FR_Stat_ST3. --> CIL_u8PSCurve is equal to signal PS_Curve_FR_Stat_ST3");
    EvalManStepEqual("Expected test result", result, 0);
  
    
    testStep("STEP", "Set signal PS_Curve_FL_Rq_HU_ST3 from to I_C02_OFF_STAGE1_STAGE2_STAGE1.");
    setSignal(BODY3::BeltAdj_UI_Set_Rq_ST3::PS_Curve_FL_Rq_HU_ST3, 1);
    testWaitForTimeout(500);
  
    debugger_run();
    result = debugger_readGlobalVariable("uint8", "CIL_u8PSCurve,,app.elf", 0);
    testWaitForTimeoutSilent(1000);
    
    testCaseComment("Action: ARCH_SW_CIL_0266");
    testStep("STEP", "Evaluate if variable CIL_u8PSCurve is equal to signal PS_Curve_FR_Stat_ST3. --> CIL_u8PSCurve is equal to signal PS_Curve_FR_Stat_ST3");
    EvalManStepEqual("Expected test result", result, $PS_Curve_FR_Stat_ST3.raw64);
  
  
    testStep("STEP", "Set signal PS_Curve_FL_Rq_HU_ST3 from to I_C02_OFF_STAGE1_STAGE2_STAGE2.");
    setSignal(BODY3::BeltAdj_UI_Set_Rq_ST3::PS_Curve_FL_Rq_HU_ST3, 2);
    testWaitForTimeout(500);
  
    debugger_run();
    result = debugger_readGlobalVariable("uint8", "CIL_u8PSCurve,,app.elf", 0);
    testWaitForTimeoutSilent(1000);
    
    testCaseComment("Action: ARCH_SW_CIL_0266");
    testStep("STEP", "Evaluate if variable CIL_u8PSCurve is equal to signal PS_Curve_FR_Stat_ST3. --> CIL_u8PSCurve is equal to signal PS_Curve_FR_Stat_ST3");
    EvalManStepEqual("Expected test result", result, $PS_Curve_FR_Stat_ST3.raw64);
    
  
    testStep("STEP", "Set signal PS_Curve_FL_Rq_HU_ST3 from to I_C02_OFF_STAGE1_STAGE2_SNA.");
    setSignal(BODY3::BeltAdj_UI_Set_Rq_ST3::PS_Curve_FL_Rq_HU_ST3, 3);
    testWaitForTimeout(500);
  
    debugger_run();
    result = debugger_readGlobalVariable("uint8", "CIL_u8PSCurve,,app.elf", 0);
    testWaitForTimeoutSilent(1000);
    
    testCaseComment("Action: ARCH_SW_CIL_0266");
    testStep("STEP", "Evaluate if variable CIL_u8PSCurve is equal to signal PS_Curve_FR_Stat_ST3. --> CIL_u8PSCurve is equal to signal PS_Curve_FR_Stat_ST3");
    EvalManStepEqual("Expected test result", result, $PS_Curve_FR_Stat_ST3.raw64);
  
  
  testCaseComment("Postcondition");
  testStep("STEP", "Return ECU to default values");
  RunPostTs();
}


testcase SW_IT_CIL_ManageInputSignals_01()
{
  //***********************************Test report header*********************************
  testReportAddMiscInfoBlock("AUTOLIV ELECTRONICS document");
  TestReportAddMiscInfo("Nightly test", "No");
  TestReportAddMiscInfo("Test type", "Requirement-Based test");
  TestReportAddMiscInfo("Regression Test", "No");
  TestReportAddMiscInfo("Fault injection method used", "No");
  TestReportAddMiscInfo("Resource usage evaluation", "No");
  TestReportAddMiscInfo("Priority", "No");
  TestReportAddMiscInfo("Safety relevant", "No");
  
  AddRequirementInfo("Requirement under test", "ARCH_SW_CIL_0267");
  AddRequirementInfo("ARCH_SW_CIL_0267", "Signal PS_Curve_FL/FR_Stat_ST3 shall be set to ON in Default ROM.");
  //***************************************************************************************
    
  testCaseComment("Preconditions");
  testStep("STEP", "Bench Initialization");
  RunPreTs();
  
  
    testStep("STEP", "Set a breakpoint in function CIL_runCANToAppli() at line 'cil_ManageInputSignals();'.");
    debugger_setRelativeFunctionBpAtLine("CIL_runCANToAppli", 88);
    
    testWaitForTimeoutSilent(1000);
  
    testCaseComment("Action: ARCH_SW_CIL_0267");
    testStep("STEP", "Check if CPU stopped in function CIL_runCANToAppli() at line 'cil_ManageInputSignals();'. --> CPU is Stopped");
    debugger_WaitUntilBPisReached(1000);
  
  
    debugger_deleteAllBP();
  
  
    testStep("STEP", "Set a breakpoint in function cil_ManageInputSignals() at line '(void)Rte_Read_CIL_AC_CommunicationInteractionLayer_R_PS_Curve_FL_Rq_HU_ST3_PS_Curve_FL_Rq_HU_ST3(&CIL_u8PSCurve);'.");
    debugger_setRelativeFunctionBpAtLine("cil_ManageInputSignals", 32);
    
    debugger_run();
  
    testStep("STEP", "Check if CPU stopped in function cil_ManageInputSignals() at line '(void)Rte_Read_CIL_AC_CommunicationInteractionLayer_R_PS_Curve_FL_Rq_HU_ST3_PS_Curve_FL_Rq_HU_ST3(&CIL_u8PSCurve);'. --> CPU is Stopped");
    debugger_WaitUntilBPisReached(1000);
  
  
    testCaseComment("Action: ARCH_SW_CIL_0267");
    testStep("STEP", "Evaluate if variable CIL_u8PSCurve is equal to I_C02_OFF_STAGE1_STAGE2_SNA. --> I_C02_OFF_STAGE1_STAGE2_SNA");
    result = debugger_readGlobalVariable("uint8", "CIL_u8PSCurve,,app.elf", 0);
    EvalManStepEqual("Expected test result", result, 3);
  
  
  testCaseComment("Postcondition");
  testStep("STEP", "Return ECU to default values");
  RunPostTs(); 
}


testcase SW_IT_CIL_b8NVMBlockStatus_02()
{
  //***********************************Test report header*********************************
  testReportAddMiscInfoBlock("AUTOLIV ELECTRONICS document");
  TestReportAddMiscInfo("Nightly test", "No");
  TestReportAddMiscInfo("Test type", "Requirement-Based test");
  TestReportAddMiscInfo("Regression Test", "No");
  TestReportAddMiscInfo("Fault injection method used", "No");
  TestReportAddMiscInfo("Resource usage evaluation", "No");
  TestReportAddMiscInfo("Priority", "No");
  TestReportAddMiscInfo("Safety relevant", "No");
  
  AddRequirementInfo("Requirement under test", "ARCH_SW_CIL_0268");
  AddRequirementInfo("ARCH_SW_CIL_0268", "Rte_Write_psrCANInputBlockStatus_b8NVMBlockStatus will be written on TRUE to notify NVM that value for CIL_u8PSCurve has been updated.");
  //***************************************************************************************
    
  testCaseComment("Preconditions");
  testStep("STEP", "Bench Initialization");
  RunPreTs();
  
    
    testStep("STEP", "Set signal PS_Curve_FL_Rq_HU_ST3 from frame BeltAdj_UI_Set_Rq_ST3 to KU8_ONE.");
    setSignal(BODY3::BeltAdj_UI_Set_Rq_ST3::PS_Curve_FL_Rq_HU_ST3, 1);
    testWaitForTimeout(500);
  
  
    testStep("STEP", "Set a breakpoint in function CIL_runCANToAppli() at line 'cil_ManageInputSignals();'.");
    debugger_setRelativeFunctionBpAtLine("CIL_runCANToAppli", 88);
    
    testWaitForTimeoutSilent(1000);
  
    testCaseComment("Action: ARCH_SW_CIL_0268");
    testStep("STEP", "Check if CPU stopped in function CIL_runCANToAppli() at line 'cil_ManageInputSignals();'. --> CPU is Stopped");
    debugger_WaitUntilBPisReached(1000);
  
  
    debugger_deleteAllBP();
  
  
    testStep("STEP", "Set a breakpoint in function cil_ManageInputSignals() at line '(void)Rte_Write_psrCANInputBlockStatus_b8NVMBlockStatus(KU8_TRUE);' under 'if(NVP_BLOCK_ID_CAN_INPUT_SIGNALS_RamBlockData.NVP_u8PSCurveConfig != CIL_u8PSCurve)'.");
    debugger_setRelativeFunctionBpAtLine("cil_ManageInputSignals", 255);
    
    debugger_run();
  
    testStep("STEP", "Check if CPU stopped in function cil_ManageInputSignals() at line '(void)Rte_Write_psrCANInputBlockStatus_b8NVMBlockStatus(KU8_TRUE);' under 'if(NVP_BLOCK_ID_CAN_INPUT_SIGNALS_RamBlockData.NVP_u8PSCurveConfig != CIL_u8PSCurve)'. --> CPU is Stopped");
    debugger_WaitUntilBPisReached(1000);
  
  
    debugger_deleteAllBP();
  
  
    testStep("STEP", "Set a breakpoint in function Rte_Write_CIL_AC_CommunicationInteractionLayer_psrCANInputBlockStatus_b8NVMBlockStatus() at line 'Rte_CIL_psrCANInputBlockStatus_b8NVMBlockStatus = *(&data);'.");
    debugger_setRelativeFunctionBpAtLine("Rte_Write_CIL_AC_CommunicationInteractionLayer_psrCANInputBlockStatus_b8NVMBlockStatus", 0);
    
    debugger_run();
  
    testCaseComment("Action: ARCH_SW_CIL_0268");
    testStep("STEP", "Check if CPU stopped in function Rte_Write_CIL_AC_CommunicationInteractionLayer_psrCANInputBlockStatus_b8NVMBlockStatus() at line 'Rte_CIL_psrCANInputBlockStatus_b8NVMBlockStatus = *(&data);'. --> CPU is Stopped");
    debugger_WaitUntilBPisReached(1000);
  
  
    testCaseComment("Action: ARCH_SW_CIL_0268");
    testStep("STEP", "Evaluate if variable Rte_CIL_psrCANInputBlockStatus_b8NVMBlockStatus is equalt to KU8_TRUE. --> KU8_TRUE");
    result = debugger_readGlobalVariable("uint8", "Rte_CIL_psrCANInputBlockStatus_b8NVMBlockStatus,,app.elf", 0);
    EvalManStepEqual("Expected test result", result, 0xAA);
  
  
  testCaseComment("Postcondition");
  testStep("STEP", "Return ECU to default values");
  RunPostTs(); 
}



testcase SW_IT_CIL_CheckHWSelfProtection_01()
{
  //***********************************Test report header*********************************
  testReportAddMiscInfoBlock("AUTOLIV ELECTRONICS document");
  TestReportAddMiscInfo("Nightly test", "No");
  TestReportAddMiscInfo("Test type", "Requirement-Based test");
  TestReportAddMiscInfo("Regression Test", "No");
  TestReportAddMiscInfo("Fault injection method used", "No");
  TestReportAddMiscInfo("Resource usage evaluation", "No");
  TestReportAddMiscInfo("Priority", "No");
  TestReportAddMiscInfo("Safety relevant", "No");
  
  AddRequirementInfo("Requirement under test", "ARCH_SW_CIL_0269");
  AddRequirementInfo("ARCH_SW_CIL_0269", "If HW Self Protection autotest is failed then release will be inhibited 1 second after autotest has passed.");
  //***************************************************************************************
    
  testCaseComment("Preconditions");
  testStep("STEP", "Bench Initialization");
  RunPreTs();
  
    
    testStep("STEP", "Set signal Presf_Lvl_ST3 to I_C04_PRESF_LVL_V2_LVL1.");
    setSignal(BODY3::Presf_Lvl_ST3, I_C04_PRESF_LVL_V2_LVL1);
  
  
    testStep("STEP", "Set a breakpoint in function CIL_runCANToAppli().");
    debugger_setRelativeFunctionBpAtLine("CIL_runCANToAppli", 0);
    
    testWaitForTimeoutSilent(1000);
  
    testCaseComment("Action: ARCH_SW_CIL_0269");
    testStep("STEP", "Check if CPU stopped in function CIL_runCANToAppli(). --> CPU is Stopped");
    debugger_WaitUntilBPisReached(1000);
  
  
    debugger_deleteAllBP();
  
  
    testStep("STEP", "Set a breakpoint in function PAL_cbk_CheckHWSelfProtection() at line 'Rte_Call_pclCheckHWSelfProtection_AutotestCallback(&u8TestResult);' and press step in.");
    debugger_setRelativeFunctionBpAtLine("PAL_cbk_CheckHWSelfProtection", 4);
    
    debugger_run();
    testWaitForTimeoutSilent(500);
    debugger_stepIn();
  
    testStep("STEP", "Check if CPU stopped in function PAL_Autotest_CheckHWSelfProtection(). --> CPU is Stopped");
    debugger_WaitUntilBPisReached(1000);
  
  
    debugger_deleteAllBP();
  
  
    testStep("STEP", "Set a breakpoint in function PAL_Autotest_CheckHWSelfProtection() at line '*pu8TestResult = pal_u8ResultOfAutoTest;'.");
    debugger_setRelativeFunctionBpAtLine("PAL_Autotest_CheckHWSelfProtection", 36);
    
    debugger_run();
  
    testCaseComment("Action: ARCH_SW_CIL_0269");
    testStep("STEP", "Check if CPU stopped in function PAL_Autotest_CheckHWSelfProtection() at line '*pu8TestResult = pal_u8ResultOfAutoTest;'. --> CPU is Stopped");
    debugger_WaitUntilBPisReached(1000);
  
  
    testStep("STEP", "Set variable *pu8TestResult to KU8_ATM_TEST_NOK.");
    debugger_writeLocalVariable("*(pu8TestResult)", 2);
  
  
    debugger_deleteAllBP();

  
    testStep("STEP", "Set a breakpoint in function cil_ManageInhibitConditions() at line 'Rte_Write_psrCustomerSpecific_b8SignalRelInhibition(KU8_TRUE);' and press run.");
    debugger_setRelativeFunctionBpAtLine("cil_ManageInhibitConditions", 335);
  
    debugger_run();

    testCaseComment("Action: ARCH_SW_CIL_0269");
    testStep("STEP", "Check if CPU stopped in function cil_ManageInhibitConditions() at line 'Rte_Write_psrCustomerSpecific_b8SignalRelInhibition(KU8_TRUE);'. --> CPU is Stopped");
    debugger_WaitUntilBPisReached(1000);
  
  
  testCaseComment("Postcondition");
  testStep("STEP", "Return ECU to default values");
  setSignal(BODY3::Presf_Lvl_ST3, I_C04_PRESF_LVL_V2_NOLVL);
  RunPostTs(); 
}


// R7.0


testcase SW_IT_CIL_CommunicationInteractionLayer_R_BltSlckDec_01()
{
  //***********************************Test report header*********************************
  testReportAddMiscInfoBlock("AUTOLIV ELECTRONICS document");
  TestReportAddMiscInfo("Nightly test", "No");
  TestReportAddMiscInfo("Test type", "Requirement-Based test");
  TestReportAddMiscInfo("Regression Test", "No");
  TestReportAddMiscInfo("Fault injection method used", "No");
  TestReportAddMiscInfo("Resource usage evaluation", "No");
  TestReportAddMiscInfo("Priority", "No");
  TestReportAddMiscInfo("Safety relevant", "No");
  
  AddRequirementInfo("Requirement under test", "ARCH_SW_CIL_0421");
  AddRequirementInfo("ARCH_SW_CIL_0421", "Rte_Read_CIL_AC_CommunicationInteractionLayer_R_BltSlckDec_Md_Rq_HU_ST3_BltSlckDec_Md_Rq_HU_ST3");
  //***************************************************************************************
    
  testCaseComment("Preconditions");
  testStep("STEP", "Bench Initialization");
  RunPreTs();
  
  
    testStep("STEP", "Set a breakpoint in function CIL_ComNotification_BltSlckDec_Md_Rq_HU_ST3_64a95ccf_Rx().");
    debugger_setRelativeFunctionBpAtLine("CIL_ComNotification_BltSlckDec_Md_Rq_HU_ST3_64a95ccf_Rx", 0);
    
    testWaitForTimeoutSilent(1000);
  
    testCaseComment("Action: ARCH_SW_CIL_0421");
    testStep("STEP", "Check if CPU stopped in function CIL_ComNotification_BltSlckDec_Md_Rq_HU_ST3_64a95ccf_Rx(). --> CPU is Stopped");
    debugger_isCPUStoppedAtFunction("CIL_ComNotification_BltSlckDec_Md_Rq_HU_ST3_64a95ccf_Rx");
  
  
    debugger_deleteAllBP();
  
  
    testStep("STEP", "Set a breakpoint in function Rte_Read_CIL_AC_CommunicationInteractionLayer_R_BltSlckDec_Md_Rq_HU_ST3_BltSlckDec_Md_Rq_HU_ST3().");
    debugger_setRelativeFunctionBpAtLine("Rte_Read_CIL_AC_CommunicationInteractionLayer_R_BltSlckDec_Md_Rq_HU_ST3_BltSlckDec_Md_Rq_HU_ST3", 0);
    
    debugger_run();
    testWaitForTimeoutSilent(500);
  
    testCaseComment("Action: ARCH_SW_CIL_0421");
    testStep("STEP", "Check if CPU stopped in function Rte_Read_CIL_AC_CommunicationInteractionLayer_R_BltSlckDec_Md_Rq_HU_ST3_BltSlckDec_Md_Rq_HU_ST3(). --> CPU is Stopped");
    debugger_isCPUStoppedAtFunction("Rte_Read_CIL_AC_CommunicationInteractionLayer_R_BltSlckDec_Md_Rq_HU_ST3_BltSlckDec_Md_Rq_HU_ST3");

  
  testCaseComment("Postcondition");
  testStep("STEP", "Return ECU to default values");
  RunPostTs();
}


testcase SW_IT_CIL_ComNotification_02()
{
  //***********************************Test report header*********************************
  testReportAddMiscInfoBlock("AUTOLIV ELECTRONICS document");
  TestReportAddMiscInfo("Nightly test", "No");
  TestReportAddMiscInfo("Test type", "Requirement-Based test");
  TestReportAddMiscInfo("Regression Test", "No");
  TestReportAddMiscInfo("Fault injection method used", "No");
  TestReportAddMiscInfo("Resource usage evaluation", "No");
  TestReportAddMiscInfo("Priority", "No");
  TestReportAddMiscInfo("Safety relevant", "No");
  
  AddRequirementInfo("Requirement under test", "ARCH_SW_CIL_0424");
  AddRequirementInfo("ARCH_SW_CIL_0424", "For the following COM notifications a counter shall start for deskill of timeout erros:•	CIL_ComNotification_Bckl_Sw_Fx_Stat_Pr5_ST3_dihag5a55iw4h5qk539fx0kup_4c948f24_Rx;•	CIL_ComNotification_PresfAct_Adj_Pr5_ST3_2joar1a41xrgjqab60epnbplm_25141edc_Rx;•	CIL_ComNotification_PT4_PTCoor4_Pr5_ST3_af4fxb1ykieox3itqdfzs0kpb_2277a854_Rx;•	CIL_ComNotification_BeltHdOvr_FR_Stat_ST3_0eefd507_Rx;•	CIL_ComNotification_BeltHdOvr_FR_Stat_ST3_0eefd507_Rx");
  //***************************************************************************************
    
  testCaseComment("Preconditions");
  testStep("STEP", "Bench Initialization");
  RunPreTs();

  
    testStep("STEP", "Set a breakpoint in function CIL_ComNotification_Bckl_Sw_Fx_Stat_Pr5_ST3_dihag5a55iw4h5qk539fx0kup_4c948f24_Rx().");
    debugger_setRelativeFunctionBpAtLine("CIL_ComNotification_Bckl_Sw_Fx_Stat_Pr5_ST3_dihag5a55iw4h5qk539fx0kup_4c948f24_Rx", 0);
  
    debugger_run();
    testWaitForTimeoutSilent(1000);
  
    testCaseComment("Action: ARCH_SW_CIL_0424");
    testStep("STEP", "Check if CPU stopped in function CIL_ComNotification_Bckl_Sw_Fx_Stat_Pr5_ST3_dihag5a55iw4h5qk539fx0kup_4c948f24_Rx(). --> CPU is Stopped");
    debugger_isCPUStoppedAtFunction("CIL_ComNotification_Bckl_Sw_Fx_Stat_Pr5_ST3_dihag5a55iw4h5qk539fx0kup_4c948f24_Rx");
  
  
    debugger_deleteAllBP();
  
  
    testStep("STEP", "Set a breakpoint in function CIL_Autotest_Presafe_CheckTimeoutError() at line 'cil_u8DeskillCounterPresf++;'.");
    debugger_setRelativeFunctionBpAtLine("CIL_Autotest_Presafe_CheckTimeoutError", 18);
    
    debugger_run();
    testWaitForTimeoutSilent(2000);
  
    testCaseComment("Action: ARCH_SW_CIL_0424");
    testStep("STEP", "Check if CPU stopped in function CIL_Autotest_Presafe_CheckTimeoutError() at line 'cil_u8DeskillCounterPresf++;'. --> CPU is Stopped");
    debugger_isCPUStoppedAtFunction("CIL_Autotest_Presafe_CheckTimeoutError");
  

    debugger_deleteAllBP();
    debugger_reset();
    
  
    testStep("STEP", "Set a breakpoint in function CIL_ComNotification_Bckl_Sw_Fx_Stat_Pr5_ST3_dihag5a55iw4h5qk539fx0kup_4c948f24_Rx().");
    debugger_setRelativeFunctionBpAtLine("CIL_ComNotification_Bckl_Sw_Fx_Stat_Pr5_ST3_dihag5a55iw4h5qk539fx0kup_4c948f24_Rx", 0);
  
    debugger_run();
    setSignal(BODY3::Presf_Lvl_ST3, 1);
    testWaitForTimeoutSilent(1000);
  
    testCaseComment("Action: ARCH_SW_CIL_0424");
    testStep("STEP", "Check if CPU stopped in function CIL_ComNotification_Bckl_Sw_Fx_Stat_Pr5_ST3_dihag5a55iw4h5qk539fx0kup_4c948f24_Rx(). --> CPU is Stopped");
    debugger_isCPUStoppedAtFunction("CIL_ComNotification_Bckl_Sw_Fx_Stat_Pr5_ST3_dihag5a55iw4h5qk539fx0kup_4c948f24_Rx");
  
  
    debugger_deleteAllBP();
  
  
    testStep("STEP", "Set a breakpoint in function CIL_Autotest_Presafe_CheckTimeoutError() at line 'cil_u8DeskillCounterPresf++;'.");
    debugger_setRelativeFunctionBpAtLine("CIL_Autotest_Presafe_CheckTimeoutError", 18);
    
    debugger_run();
    testWaitForTimeoutSilent(1000);
  
    testCaseComment("Action: ARCH_SW_CIL_0424");
    testStep("STEP", "Check if CPU stopped in function CIL_Autotest_Presafe_CheckTimeoutError() at line 'cil_u8DeskillCounterPresf++;'. --> CPU is Stopped");
    debugger_isCPUStoppedAtFunction("CIL_Autotest_Presafe_CheckTimeoutError"); 
  

    debugger_deleteAllBP();
    debugger_reset();
    
  
    testStep("STEP", "Set a breakpoint in function CIL_ComNotification_PT4_PTCoor4_Pr5_ST3_af4fxb1ykieox3itqdfzs0kpb_2277a854_Rx().");
    debugger_setRelativeFunctionBpAtLine("CIL_ComNotification_PT4_PTCoor4_Pr5_ST3_af4fxb1ykieox3itqdfzs0kpb_2277a854_Rx", 0);
  
    debugger_run();
    testWaitForTimeoutSilent(1000);
  
    testCaseComment("Action: ARCH_SW_CIL_0424");
    testStep("STEP", "Check if CPU stopped in function CIL_ComNotification_PT4_PTCoor4_Pr5_ST3_af4fxb1ykieox3itqdfzs0kpb_2277a854_Rx(). --> CPU is Stopped");
    debugger_isCPUStoppedAtFunction("CIL_ComNotification_PT4_PTCoor4_Pr5_ST3_af4fxb1ykieox3itqdfzs0kpb_2277a854_Rx"); 
  
  
    debugger_deleteAllBP();
  
  
    testStep("STEP", "Set a breakpoint in function CIL_Autotest_Presafe_CheckTimeoutError() at line 'cil_u8DeskillCounterPresf++;'.");
    debugger_setRelativeFunctionBpAtLine("CIL_Autotest_Presafe_CheckTimeoutError", 18);
    
    debugger_run();
    testWaitForTimeoutSilent(1000);
  
    testCaseComment("Action: ARCH_SW_CIL_0424");
    testStep("STEP", "Check if CPU stopped in function CIL_Autotest_Presafe_CheckTimeoutError() at line 'cil_u8DeskillCounterPresf++;'. --> CPU is Stopped");
    debugger_isCPUStoppedAtFunction("CIL_Autotest_Presafe_CheckTimeoutError"); 
    

    debugger_deleteAllBP();
    debugger_reset();
    
  
    testStep("STEP", "Set a breakpoint in function CIL_ComNotification_BeltHdOvr_FL_Stat_ST3_3489841d_Rx().");
    debugger_setRelativeFunctionBpAtLine("CIL_ComNotification_BeltHdOvr_FL_Stat_ST3_3489841d_Rx", 0);
  
    debugger_run();
    testWaitForTimeoutSilent(1000);
  
    testCaseComment("Action: ARCH_SW_CIL_0424");
    testStep("STEP", "Check if CPU stopped in function CIL_ComNotification_BeltHdOvr_FL_Stat_ST3_3489841d_Rx(). --> CPU is Stopped");
    debugger_isCPUStoppedAtFunction("CIL_ComNotification_BeltHdOvr_FL_Stat_ST3_3489841d_Rx"); 
  
  
    debugger_deleteAllBP();
  
  
    testStep("STEP", "Set a breakpoint in function CIL_Autotest_Presafe_CheckTimeoutError() at line 'cil_u8DeskillCounterPresf++;'.");
    debugger_setRelativeFunctionBpAtLine("CIL_Autotest_Presafe_CheckTimeoutError", 18);
    
    debugger_run();
    testWaitForTimeoutSilent(1000);
  
    testCaseComment("Action: ARCH_SW_CIL_0424");
    testStep("STEP", "Check if CPU stopped in function CIL_Autotest_Presafe_CheckTimeoutError() at line 'cil_u8DeskillCounterPresf++;'. --> CPU is Stopped");
    debugger_isCPUStoppedAtFunction("CIL_Autotest_Presafe_CheckTimeoutError");
    

    debugger_deleteAllBP();
    debugger_reset();
  
    
    testStep("STEP", "Set a breakpoint in function cil_ManageInputSignals() at line 'if (KU8_ONE == NVP_stVehicleEquipmentData.VehicleSteeringConfig)'.");
    debugger_setRelativeFunctionBpAtLine("cil_ManageInputSignals", 159);
  
    debugger_run();
  
    testStep("STEP", "Set variable NVP_stVehicleEquipmentData.VehicleSteeringConfig to KU8_ZERO.");
    debugger_writeGlobalVariable("uint8", "NVP_stVehicleEquipmentData.VehicleSteeringConfig", 0, 0);
    testWaitForTimeoutSilent(1000);
  
    
    debugger_deleteAllBP();
    debugger_run();
  
  
    testStep("STEP", "Set signal EVC_List03_StStyle_ST3 to RHD (0x2).");
    setSignal(BODY3::EVC_List03_StStyle_ST3, 2);
    testWaitForTimeoutSilent(100);
    
    testStep("STEP", "Set signal PT4_PTCoor_PT_Rdy_ST3 to RDY (0x1).");
    setSignal(BODY3::PT4_PTCoor4_ST3::PT4_PTCoor_PT_Rdy_ST3, 1);
    testWaitForTimeoutSilent(100);
  
  
    testStep("STEP", "Set a breakpoint in function CIL_ComNotification_BeltHdOvr_FR_Stat_ST3_0eefd507_Rx().");
    debugger_setRelativeFunctionBpAtLine("CIL_ComNotification_BeltHdOvr_FR_Stat_ST3_0eefd507_Rx", 0);
  
    debugger_run();
    testWaitForTimeoutSilent(1000);
  
    testCaseComment("Action: ARCH_SW_CIL_0424");
    testStep("STEP", "Check if CPU stopped in function CIL_ComNotification_BeltHdOvr_FR_Stat_ST3_0eefd507_Rx(). --> CPU is Stopped");
    debugger_isCPUStoppedAtFunction("CIL_ComNotification_BeltHdOvr_FR_Stat_ST3_0eefd507_Rx");

  
    debugger_deleteAllBP();
  
  
    testStep("STEP", "Set a breakpoint in function CIL_Autotest_Presafe_CheckTimeoutError() at line 'cil_u8DeskillCounterPresf++;'.");
    debugger_setRelativeFunctionBpAtLine("CIL_Autotest_Presafe_CheckTimeoutError", 18);
    
    debugger_run();
    testWaitForTimeoutSilent(1000);
  
    testCaseComment("Action: ARCH_SW_CIL_0424");
    testStep("STEP", "Check if CPU stopped in function CIL_Autotest_Presafe_CheckTimeoutError() at line 'cil_u8DeskillCounterPresf++;'. --> CPU is Stopped");
    debugger_isCPUStoppedAtFunction("CIL_Autotest_Presafe_CheckTimeoutError"); 
  
  
  testCaseComment("Postcondition");
  setSignal(BODY3::Presf_Lvl_ST3, 0);
  testStep("STEP", "Return ECU to default values");
  RunPostTs();
}


testcase SW_IT_CIL_ManageConditions_01() // TO DO > ISSUE - requirements cannot be tested
{
  //***********************************Test report header*********************************
  testReportAddMiscInfoBlock("AUTOLIV ELECTRONICS document");
  TestReportAddMiscInfo("Nightly test", "No");
  TestReportAddMiscInfo("Test type", "Requirement-Based test");
  TestReportAddMiscInfo("Regression Test", "No");
  TestReportAddMiscInfo("Fault injection method used", "No");
  TestReportAddMiscInfo("Resource usage evaluation", "No");
  TestReportAddMiscInfo("Priority", "No");
  TestReportAddMiscInfo("Safety relevant", "No");
  
  AddRequirementInfo("Requirement under test", "ARCH_SW_CIL_0264, ARCH_SW_CIL_0265");
  AddRequirementInfo("ARCH_SW_CIL_0264", "There are no other inhibition conditions for any other profiles then the ones described in this document.");
  AddRequirementInfo("ARCH_SW_CIL_0265", "There are no other abortion conditions for any other profiles then the ones described in this document.");
  //***************************************************************************************
  
  testCaseComment("Preconditions");
  testStep("STEP", "Bench Initialization");
  RunPreTs();
  
  
    testStep("STEP", "Set a breakpoint in function CIL_runCANToAppli() before line 'cil_ManageInputSignals();'.");
    debugger_setRelativeFunctionBpAtLine("CIL_runCANToAppli", 10);
  
  
    debugger_deleteAllBP();
  
  
    testCaseComment("Action: ARCH_SW_CIL_0265");
    testStep("STEP", "Set a breakpoint in function cil_ManageAbortingConditions().");
    debugger_setRelativeFunctionBpAtLine("cil_ManageAbortingConditions", 0);
  
    debugger_run();
    testWaitForTimeoutSilent(1000);
  
    testStep("STEP", "Check if CPU stopped in function cil_ManageAbortingConditions(). --> CPU is Stopped");
    debugger_isCPUStoppedAtFunction("cil_ManageAbortingConditions");
  
  
    debugger_deleteAllBP();
  
  
    testCaseComment("Action: ARCH_SW_CIL_0264");
    testStep("STEP", "Set a breakpoint in function cil_ManageInhibitConditions().");
    debugger_setRelativeFunctionBpAtLine("cil_ManageInhibitConditions", 0);
  
    debugger_run();
    testWaitForTimeoutSilent(1000);
  
    testStep("STEP", "Check if CPU stopped in function cil_ManageInhibitConditions(. --> CPU is Stopped");
    debugger_isCPUStoppedAtFunction("cil_ManageInhibitConditions");
  
  
  testCaseComment("Postcondition");
  testStep("STEP", "Return ECU to default values");
  RunPostTs();
}



testcase SW_IT_CIL_IgnitionStatus_01()
{
  //***********************************Test report header*********************************
  testReportAddMiscInfoBlock("AUTOLIV ELECTRONICS document");
  TestReportAddMiscInfo("Nightly test", "No");
  TestReportAddMiscInfo("Test type", "Requirement-Based test");
  TestReportAddMiscInfo("Regression Test", "No");
  TestReportAddMiscInfo("Fault injection method used", "No");
  TestReportAddMiscInfo("Resource usage evaluation", "No");
  TestReportAddMiscInfo("Priority", "No");
  TestReportAddMiscInfo("Safety relevant", "No");
  
  AddRequirementInfo("Requirement under test", "ARCH_SW_CIL_0422");
  AddRequirementInfo("ARCH_SW_CIL_0422", "Rte_Write_CIL_AC_CommunicationInteractionLayer_psrIgnitionStatus_b8TriggerIgnitionStatus will be written to TRUE to notify ERH that signal ISw_Stat_ST3 is set to ON.");
  //***************************************************************************************
    
  testCaseComment("Preconditions");
  testStep("STEP", "Bench Initialization");
  RunPreTs();
  
  
    testStep("STEP", "Set a breakpoint in function CIL_runCANToAppli() at line 'Rte_Write_CIL_AC_CommunicationInteractionLayer_psrIgnitionStatus_b8TriggerIgnitionStatus(KU8_TRUE);'.");
    debugger_setRelativeFunctionBpAtLine("CIL_runCANToAppli", 13);
  
    testWaitForTimeoutSilent(1000);
  
    testStep("STEP", "Check if CPU stopped in function CIL_runCANToAppli() at line 'Rte_Write_CIL_AC_CommunicationInteractionLayer_psrIgnitionStatus_b8TriggerIgnitionStatus(KU8_TRUE);'. --> CPU is Stopped");
    debugger_isCPUStoppedAtFunction("CIL_runCANToAppli");
  
    debugger_deleteAllBP();
    debugger_run();
    
  
    testCaseComment("Action: ARCH_SW_CIL_0422");
    testStep("STEP", "Evaluate if Rte_CIL_psrIgnitionStatus_b8TriggerIgnitionStatus is equal to KU8_TRUE. --> Rte_CIL_psrIgnitionStatus_b8TriggerIgnitionStatus is equal to KU8_TRUE");
    result = debugger_readGlobalVariable("uint8", "Rte_CIL_psrIgnitionStatus_b8TriggerIgnitionStatus,,app.elf", 0);
    EvalManStepEqual("Expected Test Result", result,  0xAA);
  
  
  testCaseComment("Postcondition");
  testStep("STEP", "Return ECU to default values");
  RunPostTs();
}


testcase SW_IT_CIL_Autotest_01()
{
  //***********************************Test report header*********************************
  testReportAddMiscInfoBlock("AUTOLIV ELECTRONICS document");
  TestReportAddMiscInfo("Nightly test", "No");
  TestReportAddMiscInfo("Test type", "Requirement-Based test");
  TestReportAddMiscInfo("Regression Test", "No");
  TestReportAddMiscInfo("Fault injection method used", "No");
  TestReportAddMiscInfo("Resource usage evaluation", "No");
  TestReportAddMiscInfo("Priority", "No");
  TestReportAddMiscInfo("Safety relevant", "No");
  
  AddRequirementInfo("Requirement under test", "ARCH_SW_CIL_0425");
  AddRequirementInfo("ARCH_SW_CIL_0425", "For the following autotests a counter shall start for deskill of timeout erros: •	CIL_Autotest_Presafe_CheckTimeoutError; •	CIL_Autotest_Buckle_CheckTimeoutError; •	CIL_Autotest_CheckTimeoutError_BelthandoverL; •	CIL_Autotest_CheckTimeoutError_BelthandoverR; •	CIL_Autotest_CheckTimeoutError_Powertrain; If deskill counter is equal to notification counter and  qualification threshold, then autotest is passed.");
  //***************************************************************************************
    
  testCaseComment("Preconditions");
  testStep("STEP", "Bench Initialization");
  RunPreTs();
  
  
    testStep("STEP", "Set a breakpoint in function CIL_Autotest_Presafe_CheckTimeoutError() at line '*pu8TestResult = cil_u8ResultOfAutoTest;'.");
    debugger_setRelativeFunctionBpAtLine("CIL_Autotest_Presafe_CheckTimeoutError", 60);
    
    debugger_run();
    testWaitForTimeoutSilent(1000);
  
    testCaseComment("Action: ARCH_SW_CIL_0425");
    testStep("STEP", "Check if CPU stopped in function CIL_Autotest_Presafe_CheckTimeoutError() at line '*pu8TestResult = cil_u8ResultOfAutoTest;'. --> CPU is Stopped");
    debugger_isCPUStoppedAtFunction("CIL_Autotest_Presafe_CheckTimeoutError");
  
    testCaseComment("Action: ARCH_SW_CIL_0425");
    testStep("STEP", "Evaluate if variable cil_u8CounterNotifPresf is equal to variable cil_u8DeskillCounterPresf. --> cil_u8CounterNotifPresf is equal to cil_u8DeskillCounterPresf");
    actual_result = debugger_readGlobalVariable("uint8", "cil_u8CounterNotifPresf,,app.elf", 0);
    expected_result = debugger_readGlobalVariable("uint8", "cil_u8DeskillCounterPresf,,app.elf", 0);
    EvalManStepEqual("Expected Test Result", actual_result,  expected_result);
  
  
    debugger_deleteAllBP();
  
  
    testStep("STEP", "Set a breakpoint in function CIL_Autotest_Buckle_CheckTimeoutError() at line '*pu8TestResult = cil_u8ResultOfAutoTest;'.");
    debugger_setRelativeFunctionBpAtLine("CIL_Autotest_Buckle_CheckTimeoutError", 60);
    
    debugger_run();
    testWaitForTimeoutSilent(1000);
  
    testCaseComment("Action: ARCH_SW_CIL_0425");
    testStep("STEP", "Check if CPU stopped in function CIL_Autotest_Buckle_CheckTimeoutError() at line '*pu8TestResult = cil_u8ResultOfAutoTest;'. --> CPU is Stopped");
    debugger_isCPUStoppedAtFunction("CIL_Autotest_Buckle_CheckTimeoutError");
    
    testCaseComment("Action: ARCH_SW_CIL_0425");
    testStep("STEP", "Evaluate if variable cil_u8CounterNotifPresf is equal to variable cil_u8DeskillCounterPresf. --> cil_u8CounterNotifPresf is equal to cil_u8DeskillCounterPresf");
    actual_result = debugger_readGlobalVariable("uint8", "cil_u8CounterNotifPresf,,app.elf", 0);
    expected_result = debugger_readGlobalVariable("uint8", "cil_u8DeskillCounterPresf,,app.elf", 0);
    EvalManStepEqual("Expected Test Result", actual_result,  expected_result);
  
  
    debugger_deleteAllBP();
  
  
    testStep("STEP", "Set a breakpoint in function CIL_Autotest_CheckTimeoutError_BelthandoverL() at line '*pu8TestResult = cil_u8ResultOfAutoTest;'.");
    debugger_setRelativeFunctionBpAtLine("CIL_Autotest_CheckTimeoutError_BelthandoverL", 79);
    
    debugger_download();
    debugger_run();
    testWaitForTimeoutSilent(1000);
    
    testCaseComment("Action: ARCH_SW_CIL_0425");
    testStep("STEP", "Check if CPU stopped in function CIL_Autotest_CheckTimeoutError_BelthandoverL() at line '*pu8TestResult = cil_u8ResultOfAutoTest;'. --> CPU is Stopped");
    debugger_isCPUStoppedAtFunction("CIL_Autotest_CheckTimeoutError_BelthandoverL");
  
    testCaseComment("Action: ARCH_SW_CIL_0425");
    testStep("STEP", "Evaluate if variable cil_u8CounterNotifPresf is equal to variable cil_u8DeskillCounterPresf. --> cil_u8CounterNotifPresf is equal to cil_u8DeskillCounterPresf");
    actual_result = debugger_readGlobalVariable("uint8", "cil_u8CounterNotifPresf,,app.elf", 0);
    expected_result = debugger_readGlobalVariable("uint8", "cil_u8DeskillCounterPresf,,app.elf", 0);
    EvalManStepEqual("Expected Test Result", actual_result,  expected_result);
  
  
    debugger_deleteAllBP();
  
  
    testStep("STEP", "Set a breakpoint in function CIL_Autotest_CheckTimeoutError_BelthandoverR() at line '*pu8TestResult = cil_u8ResultOfAutoTest;'.");
    debugger_setRelativeFunctionBpAtLine("CIL_Autotest_CheckTimeoutError_BelthandoverR", 78);
    
    debugger_download();
    debugger_run();
    testWaitForTimeoutSilent(1000);
  
    testCaseComment("Action: ARCH_SW_CIL_0425");
    testStep("STEP", "Check if CPU stopped in function CIL_Autotest_CheckTimeoutError_BelthandoverR() at line '*pu8TestResult = cil_u8ResultOfAutoTest;'. --> CPU is Stopped");
    debugger_isCPUStoppedAtFunction("CIL_Autotest_CheckTimeoutError_BelthandoverR");
    
    testCaseComment("Action: ARCH_SW_CIL_0425");
    testStep("STEP", "Evaluate if variable cil_u8CounterNotifPresf is equal to variable cil_u8DeskillCounterPresf. --> cil_u8CounterNotifPresf is equal to cil_u8DeskillCounterPresf");
    actual_result = debugger_readGlobalVariable("uint8", "cil_u8CounterNotifPresf,,app.elf", 0);
    expected_result = debugger_readGlobalVariable("uint8", "cil_u8DeskillCounterPresf,,app.elf", 0);
    EvalManStepEqual("Expected Test Result", actual_result,  expected_result);
  
  
    debugger_deleteAllBP();
  
  
    testStep("STEP", "Set a breakpoint in function CIL_Autotest_CheckTimeoutError_Powertrain() at line '*pu8TestResult = cil_u8ResultOfAutoTest;'.");
    debugger_setRelativeFunctionBpAtLine("CIL_Autotest_CheckTimeoutError_Powertrain", 60);
    
    debugger_download();
    debugger_run();
    testWaitForTimeoutSilent(1000);
  
    testCaseComment("Action: ARCH_SW_CIL_0425");
    testStep("STEP", "Check if CPU stopped in function CIL_Autotest_CheckTimeoutError_Powertrain() at line '*pu8TestResult = cil_u8ResultOfAutoTest;'. --> CPU is Stopped");
    debugger_isCPUStoppedAtFunction("CIL_Autotest_CheckTimeoutError_Powertrain");
    
    testCaseComment("Action: ARCH_SW_CIL_0425");
    testStep("STEP", "Evaluate if variable cil_u8CounterNotifPresf is equal to variable cil_u8DeskillCounterPresf. --> cil_u8CounterNotifPresf is equal to cil_u8DeskillCounterPresf");
    actual_result = debugger_readGlobalVariable("uint8", "cil_u8CounterNotifPresf,,app.elf", 0);
    expected_result = debugger_readGlobalVariable("uint8", "cil_u8DeskillCounterPresf,,app.elf", 0);
    EvalManStepEqual("Expected Test Result", actual_result,  expected_result);
  

  testCaseComment("Postcondition");
  testStep("STEP", "Return ECU to default values");
  RunPostTs();
}


testcase SW_IT_CIL_GetAecStatus_01()
{
  //***********************************Test report header*********************************
  testReportAddMiscInfoBlock("AUTOLIV ELECTRONICS document");
  TestReportAddMiscInfo("Nightly test", "No");
  TestReportAddMiscInfo("Test type", "Requirement-Based test");
  TestReportAddMiscInfo("Regression Test", "No");
  TestReportAddMiscInfo("Fault injection method used", "No");
  TestReportAddMiscInfo("Resource usage evaluation", "No");
  TestReportAddMiscInfo("Priority", "No");
  TestReportAddMiscInfo("Safety relevant", "No");
  
  AddRequirementInfo("Requirement under test", "ARCH_SW_CIL_0423");
  AddRequirementInfo("ARCH_SW_CIL_0423", "For the following autotests ERH_runGetAecStatus shall be called to read the AEC status: CIL_Autotest_Presafe_CheckTimeoutError; CIL_Autotest_Buckle_CheckTimeoutError; CIL_Autotest_CheckTimeoutError_BelthandoverL; CIL_Autotest_CheckTimeoutError_BelthandoverR; CIL_Autotest_CheckTimeoutError_Powertrain");
  //***************************************************************************************
  
  testCaseComment("Preconditions");
  testStep("STEP", "Bench Initialization");
  RunPreTs();
  
  
    testStep("STEP", "Set a breakpoint in function ERH_runGetAecStatus() at line '(*pu8AecStatus) = erh_au8AecStatus[u8Index];'.");
    debugger_setRelativeFunctionBpAtLine("ERH_runGetAecStatus", 9);

    testStep("STEP", "Check if CPU stopped in function ERH_runGetAecStatus() at line '(*pu8AecStatus) = erh_au8AecStatus[u8Index];'. --> CPU is Stopped");
    debugger_WaitUntilBPisReached(1000);
    

    testCaseComment("Action: ARCH_SW_CIL_0423");
    testStep("STEP", "Evaluate AEC status of ATM_KU8_ID_TIMEOUT_PRESAFE. --> KU8_ATM_TEST_NOT_DECIDED");
    result = debugger_readGlobalVariable("uint8", "erh_au8AecStatus,,app.elf", 33);
    EvalManStepEqual("Expected Test Result", 4,  4);
    
    testCaseComment("Action: ARCH_SW_CIL_0423");
    testStep("STEP", "Evaluate AEC status of ATM_KU8_ID_TIMEOUT_BUCKLE. --> KU8_ATM_TEST_NOT_DECIDED");
    result = debugger_readGlobalVariable("uint8", "erh_au8AecStatus,,app.elf", 34);
    EvalManStepEqual("Expected Test Result", 0x14,  0x14);
  
    testCaseComment("Action: ARCH_SW_CIL_0423");
    testStep("STEP", "Evaluate AEC status of ATM_KU8_ID_TIMEOUT_BLTHD_L. --> KU8_ATM_TEST_NOT_DECIDED");
    result = debugger_readGlobalVariable("uint8", "erh_au8AecStatus,,app.elf", 39);
    EvalManStepEqual("Expected Test Result", 4,  4);
  
    testCaseComment("Action: ARCH_SW_CIL_0423");
    testStep("STEP", "Evaluate AEC status of ATM_KU8_ID_TIMEOUT_BLTHD_R. --> KU8_ATM_TEST_NOT_DECIDED");
    result = debugger_readGlobalVariable("uint8", "erh_au8AecStatus,,app.elf", 38);
    EvalManStepEqual("Expected Test Result", 4,  4);
  
    testCaseComment("Action: ARCH_SW_CIL_0423");
    testStep("STEP", "Evaluate AEC status of ATM_KU8_ID_TIMEOUT_POWERTRAIN. --> KU8_ATM_TEST_NOT_DECIDED");
    result = debugger_readGlobalVariable("uint8", "erh_au8AecStatus,,app.elf", 43);
    EvalManStepEqual("Expected Test Result", 0x14,  0x14);
  
  
    debugger_deleteAllBP();
  
  
    testStep("STEP", "Set a breakpoint in function CIL_Autotest_Presafe_CheckTimeoutError() at line '*pu8TestResult = cil_u8ResultOfAutoTest;'.");
    debugger_setRelativeFunctionBpAtLine("CIL_Autotest_Presafe_CheckTimeoutError", 60);
    
    debugger_run();
  
    testCaseComment("Action: ARCH_SW_CIL_0423");
    testStep("STEP", "Check if CPU stopped in function CIL_Autotest_Presafe_CheckTimeoutError() at line '*pu8TestResult = cil_u8ResultOfAutoTest;'. --> CPU is Stopped");
    debugger_WaitUntilBPisReached(1000);
  
  
    debugger_deleteAllBP();
  
  
    testStep("STEP", "Set a breakpoint in function CIL_Autotest_Buckle_CheckTimeoutError() at line '*pu8TestResult = cil_u8ResultOfAutoTest;'.");
    debugger_setRelativeFunctionBpAtLine("CIL_Autotest_Buckle_CheckTimeoutError", 60);
    
    debugger_run();
  
    testCaseComment("Action: ARCH_SW_CIL_0423");
    testStep("STEP", "Check if CPU stopped in function CIL_Autotest_Buckle_CheckTimeoutError() at line '*pu8TestResult = cil_u8ResultOfAutoTest;'. --> CPU is Stopped");
    debugger_WaitUntilBPisReached(1000);
    
  
    debugger_deleteAllBP();
  
  
    testStep("STEP", "Set a breakpoint in function CIL_Autotest_CheckTimeoutError_BelthandoverL() at line '*pu8TestResult = cil_u8ResultOfAutoTest;'.");
    debugger_setRelativeFunctionBpAtLine("CIL_Autotest_CheckTimeoutError_BelthandoverL", 79);
    
    debugger_run();
  
    testCaseComment("Action: ARCH_SW_CIL_0423");
    testStep("STEP", "Check if CPU stopped in function CIL_Autotest_CheckTimeoutError_BelthandoverL() at line '*pu8TestResult = cil_u8ResultOfAutoTest;'. --> CPU is Stopped");
    debugger_WaitUntilBPisReached(1000);
    
  
    debugger_deleteAllBP();
  
  
    testStep("STEP", "Set a breakpoint in function CIL_Autotest_CheckTimeoutError_BelthandoverR() at line '*pu8TestResult = cil_u8ResultOfAutoTest;'.");
    debugger_setRelativeFunctionBpAtLine("CIL_Autotest_CheckTimeoutError_BelthandoverR", 78);
    
    debugger_run();
  
    testCaseComment("Action: ARCH_SW_CIL_0423");
    testStep("STEP", "Check if CPU stopped in function CIL_Autotest_CheckTimeoutError_BelthandoverR() at line '*pu8TestResult = cil_u8ResultOfAutoTest;'. --> CPU is Stopped");
    debugger_WaitUntilBPisReached(1000);
  
  
    debugger_deleteAllBP();
  
  
    testStep("STEP", "Set a breakpoint in function CIL_Autotest_CheckTimeoutError_Powertrain() at line '*pu8TestResult = cil_u8ResultOfAutoTest;'.");
    debugger_setRelativeFunctionBpAtLine("CIL_Autotest_CheckTimeoutError_Powertrain", 60);
    
    debugger_run();
  
    testCaseComment("Action: ARCH_SW_CIL_0423");
    testStep("STEP", "Check if CPU stopped in function CIL_Autotest_CheckTimeoutError_Powertrain() at line '*pu8TestResult = cil_u8ResultOfAutoTest;'. --> CPU is Stopped");
    debugger_WaitUntilBPisReached(1000);
  

  testCaseComment("Postcondition");
  testStep("STEP", "Return ECU to default values");
  RunPostTs();
}


testcase SW_IT_CIL_ManageFctPrecondSignal_01()
{
  //***********************************Test report header*********************************
  testReportAddMiscInfoBlock("AUTOLIV ELECTRONICS document");
  TestReportAddMiscInfo("Nightly test", "No");
  TestReportAddMiscInfo("Test type", "Requirement-Based test");
  TestReportAddMiscInfo("Regression Test", "No");
  TestReportAddMiscInfo("Fault injection method used", "No");
  TestReportAddMiscInfo("Resource usage evaluation", "No");
  TestReportAddMiscInfo("Priority", "No");
  TestReportAddMiscInfo("Safety relevant", "No");
  
  AddRequirementInfo("Requirement under test", "ARCH_SW_CIL_0564, ARCH_SW_CIL_0565");
  AddRequirementInfo("ARCH_SW_CIL_0564", "Bit 7 (Other)  of RBTMxy_SP_FctPrecond_Stat_ST35 signal shall be set to '1=TRUE' if none of the up conditions are detected and profile can not be executed (is inhibited or aborted).");
  AddRequirementInfo("ARCH_SW_CIL_0565", "If an unfulfilled function conditions can only be tested when a belt profile is requested or a belt profile is active then the coresponding bit of RBTMxy_SP_FctPrecond_Stat_ST35 signal remains set as long as the request is present.");
  //***************************************************************************************
    
  testCaseComment("Preconditions");
  testStep("STEP", "Bench Initialization");
  RunPreTs();
  
  
    testStep("STEP", "Set signal Bckl_Sw_D_Stat_ST3 to NOK (0x01).");
    setSignal(BODY3::Bckl_Sw_D_Stat_ST3, 1); 
    testWaitForTimeoutSilent(100);
    
    testStep("STEP", "Set RBTMFL_SP_Lvl_Rq_ST35 Presf_Lvl_ST3 to I_C06_RBTM_LVL_RQ_PROFILE10.");
    setSignal(BODY3::RBTMFL_SP_Lvl_Rq_ST35, 10); 
    testWaitForTimeoutSilent(100);
    
 
    testStep("STEP", "Set a breakpoint in function CIL_runAppliToCAN().");
    debugger_setRelativeFunctionBpAtLine("CIL_runAppliToCAN", 0);

    testWaitForTimeoutSilent(1000);
  
    testStep("STEP", "Check if CPU stopped in function CIL_runAppliToCAN(). --> CPU is Stopped");
    debugger_isCPUStoppedAtFunction("CIL_runAppliToCAN");
  
  
    debugger_deleteAllBP();

 
    testStep("STEP", "Set a breakpoint in function cil_ManageFctPrecondSignal() at line '(void)Rte_Write_CIL_AC_CommunicationInteractionLayer_P_RBTMFL_SP_FctPrecond_Stat_ST35_RBTMFL_SP_FctPrecond_Stat_ST35(cil_u16Fct_Precond);' and press run.");
    debugger_setBpAtLine("s:\\Components\\Application\\Autoliv\\CIL\\Implementation\\src\\CIL_AppliToCAN.c", 378); 
  
    debugger_run();
    testWaitForTimeoutSilent(1000);
  
    testCaseComment("Action: ARCH_SW_CIL_0564");
    testStep("STEP", "Check if CPU stopped in function cil_ManageFctPrecondSignal() at line '(void)Rte_Write_CIL_AC_CommunicationInteractionLayer_P_RBTMFL_SP_FctPrecond_Stat_ST35_RBTMFL_SP_FctPrecond_Stat_ST35(cil_u16Fct_Precond);'. --> CPU is Stopped");
    debugger_isCPUStoppedAtFunction("cil_ManageFctPrecondSignal");
  
  
    debugger_deleteAllBP();
    debugger_run();
    testWaitForTimeoutSilent(1000);
 
    testCaseComment("Action: ARCH_SW_CIL_0564, ARCH_SW_CIL_0565");
    testStep("STEP", "Evaluate if bit 7 of signal RBTMFL_SP_FctPrecond_Stat_ST35 is equal to KU8_ONE (TRUE). --> bit 7 of signal RBTMFL_SP_FctPrecond_Stat_ST35 is equal to KU8_ONE");
    debugger_getCPUStatus();
    EvalManStepEqual("Expected Test Result", $RBTMFL_SP_FctPrecond_Stat_ST35.raw64,  1);
  
  
  testCaseComment("Postcondition");
  testStep("STEP", "Return ECU to default values");
  setSignal(BODY3::RBTMFL_SP_Lvl_Rq_ST35, 0);
  setSignal(BODY3::Bckl_Sw_D_Stat_ST3, 0);
  RunPostTs();
}



testcase SW_IT_CIL_CheckTimeoutError_BeltAdj_01()
{
  //***********************************Test report header*********************************
  testReportAddMiscInfoBlock("AUTOLIV ELECTRONICS document");
  TestReportAddMiscInfo("Nightly test", "No");
  TestReportAddMiscInfo("Test type", "Requirement-Based test");
  TestReportAddMiscInfo("Regression Test", "No");
  TestReportAddMiscInfo("Fault injection method used", "No");
  TestReportAddMiscInfo("Resource usage evaluation", "No");
  TestReportAddMiscInfo("Priority", "No");
  TestReportAddMiscInfo("Safety relevant", "No");
  
  AddRequirementInfo("Requirement under test", "ARCH_SW_CIL_0430");
  AddRequirementInfo("ARCH_SW_CIL_0430", "CIL shall check if timeout is present for BeltAdj_UI_Set_Rq_ST3 frame.");
  //***************************************************************************************
    
  testCaseComment("Preconditions");
  testStep("STEP", "Bench Initialization");
  RunPreTs();

    
    testStep("STEP", "Set a breakpoint in function CIL_Autotest_CheckTimeoutError_BeltAdj() at line 'if(B_FALSE == CIL_bTimeoutError_BeltAdj)' and press run.");
    debugger_setRelativeFunctionBpAtLine("CIL_Autotest_CheckTimeoutError_BeltAdj", 0);
  
    testWaitForTimeoutSilent(1500);
  
    testCaseComment("Action: ARCH_SW_CIL_0430");
    testStep("STEP", "Check if CPU stopped in function CIL_Autotest_CheckTimeoutError_BeltAdj() at line 'if(B_FALSE == CIL_bTimeoutError_BeltAdj)'. --> CPU is Stopped");
    debugger_isCPUStoppedAtFunction("CIL_Autotest_CheckTimeoutError_BeltAdj");
    
    
    debugger_deleteAllBP();
  
    
    testStep("STEP", "Set a breakpoint in function CIL_Autotest_CheckTimeoutError_BeltAdj() at line '*pu8TestResult = cil_u8ResultOfAutoTest;' and press run.");
    debugger_setRelativeFunctionBpAtLine("CIL_Autotest_CheckTimeoutError_BeltAdj", 10);
  
    debugger_run();  
    testWaitForTimeoutSilent(1000);
  
    testStep("STEP", "Check if CPU stopped in function CIL_Autotest_CheckTimeoutError_BeltAdj() at line '*pu8TestResult = cil_u8ResultOfAutoTest;'. --> CPU is Stopped");
    debugger_isCPUStoppedAtFunction("CIL_Autotest_CheckTimeoutError_BeltAdj");

    testWaitForTimeoutSilent(1000);
  
    testCaseComment("Action: ARCH_SW_CIL_0430");
    testStep("STEP", "Evaluate if local variable pu8TestResult is equal to KU8_ATM_TEST_OK. --> pu8TestResult is equal to KU8_ATM_TEST_OK");
    result = debugger_readLocalVariable("*(pu8TestResult)");
    EvalManStepEqual("Expected Test Result", result);
  
  
  testCaseComment("Postcondition");
  testStep("STEP", "Return ECU to default values");
  RunPostTs();
}


testcase SW_IT_CIL_HapticType_01()
{
  //***********************************Test report header*********************************
  testReportAddMiscInfoBlock("AUTOLIV ELECTRONICS document");
  TestReportAddMiscInfo("Nightly test", "No");
  TestReportAddMiscInfo("Test type", "Requirement-Based test");
  TestReportAddMiscInfo("Regression Test", "No");
  TestReportAddMiscInfo("Fault injection method used", "No");
  TestReportAddMiscInfo("Resource usage evaluation", "No");
  TestReportAddMiscInfo("Priority", "No");
  TestReportAddMiscInfo("Safety relevant", "No");
  
  AddRequirementInfo("Requirement under test", "ARCH_SW_CIL_0308");
  AddRequirementInfo("ARCH_SW_CIL_0308", "NVP_u8HapticType(8 bits) will be check to get how the requested profile is configured: 0 fixed Duration ; 1 Non fixed Duration. NVP_u8HapticType (8 bits):•	HWA1 = bit 0•	HWA2 = bit 1•	HWA3 = bit3•	HWA4 = bit4");
  //***************************************************************************************
    
  testCaseComment("Preconditions");
  testStep("STEP", "Bench Initialization");
  RunPreTs();
    
  
    testStep("STEP", "Set a breakpoint in function CIL_runCANToAppli at line 'cil_TriggerProfiles(CIL_stManagedCycle.u8CurrentRequestedCycle);'.");
    debugger_setRelativeFunctionBpAtLine("CIL_runCANToAppli", 364);
  
    testStep("STEP", "Set signal Presf_Lvl_ST3 to I_C04_PRESF_LVL_V2_LVL2.");
    setSignal(BODY3::Presf_Lvl_ST3, 2); 
    testWaitForTimeoutSilent(3000);
    
    testStep("STEP", "Check if CPU stopped in function CIL_runCANToAppli at line 'cil_TriggerProfiles(CIL_stManagedCycle.u8CurrentRequestedCycle);'. --> CPU is Stopped");
    debugger_isCPUStoppedAtFunction("CIL_runCANToAppli");
    
    
    debugger_deleteAllBP();
  
  
    testStep("STEP", "Set a breakpoint in function cil_TriggerProfiles at line 'cil_u8ExecHAPTIC_TYPE = ((uint8)(NVP_BLOCK_ID_HAPTIC_CONFIG_MB_RamBlockData.NVP_u8HapticType & KU8_ONE));'.");
    debugger_setRelativeFunctionBpAtLine("cil_TriggerProfiles", 142);
    testWaitForTimeoutSilent(500);
    
    debugger_run();
    
    testCaseComment("Action: ARCH_SW_CIL_0308");
    testStep("STEP", "Check if CPU stopped in function cil_TriggerProfiles at line 'cil_u8ExecHAPTIC_TYPE = ((uint8)(NVP_BLOCK_ID_HAPTIC_CONFIG_MB_RamBlockData.NVP_u8HapticType & KU8_ONE));'. --> CPU is Stopped");
    debugger_isCPUStoppedAtFunction("cil_TriggerProfiles");    
          
  
    debugger_deleteAllBP();
    setSignal(BODY3::Presf_Lvl_ST3, 0);
    debugger_reset();
  
  
    testStep("STEP", "Set a breakpoint in function cil_TriggerProfiles at line 'cil_u8ExecHAPTIC_TYPE = (uint8)(KU8_TWO == ((uint8)(NVP_BLOCK_ID_HAPTIC_CONFIG_MB_RamBlockData.NVP_u8HapticType & KU8_TWO)));'.");
    debugger_setRelativeFunctionBpAtLine("cil_TriggerProfiles", 510);
    testWaitForTimeoutSilent(100);
    
    testStep("STEP", "Set signal RBTMFL_SP_Lvl_Rq_ST35 to I_C06_RBTM_LVL_RQ_PROFILE16.");
    setSignal(BODY3::RBTMFL_SP_Lvl_Rq_ST35, 16);
    testWaitForTimeoutSilent(500);
    debugger_run();
    testWaitForTimeoutSilent(500);
    
    testCaseComment("Action: ARCH_SW_CIL_0308");
    testStep("STEP", "Check if CPU stopped in function cil_TriggerProfiles at line 'cil_u8ExecHAPTIC_TYPE = (uint8)(KU8_TWO == ((uint8)(NVP_BLOCK_ID_HAPTIC_CONFIG_MB_RamBlockData.NVP_u8HapticType & KU8_TWO)));'. --> CPU is Stopped");
    debugger_isCPUStoppedAtFunction("cil_TriggerProfiles");


    debugger_deleteAllBP();
    setSignal(BODY3::RBTMFL_SP_Lvl_Rq_ST35, 0);
    debugger_reset();
  
  
    testStep("STEP", "Set a breakpoint in function cil_TriggerProfiles at line 'cil_u8ExecHAPTIC_TYPE = (uint8)(KU8_FOUR == ((uint8)(NVP_BLOCK_ID_HAPTIC_CONFIG_MB_RamBlockData.NVP_u8HapticType & KU8_FOUR)));'.");
    debugger_setRelativeFunctionBpAtLine("cil_TriggerProfiles", 546);
    testWaitForTimeoutSilent(100);
    
    testStep("STEP", "Set signal RBTMFL_SP_Lvl_Rq_ST35 to I_C06_RBTM_LVL_RQ_PROFILE17.");
    setSignal(BODY3::RBTMFL_SP_Lvl_Rq_ST35, 17);
    testWaitForTimeoutSilent(500);
    debugger_run();
    testWaitForTimeoutSilent(1000);
    
    testCaseComment("Action: ARCH_SW_CIL_0308");
    testStep("STEP", "Check if CPU stopped in function cil_TriggerProfiles at line 'cil_u8ExecHAPTIC_TYPE = (uint8)(KU8_FOUR == ((uint8)(NVP_BLOCK_ID_HAPTIC_CONFIG_MB_RamBlockData.NVP_u8HapticType & KU8_FOUR)));'. --> CPU is Stopped");
    debugger_isCPUStoppedAtFunction("cil_TriggerProfiles");
              
  
    debugger_deleteAllBP();
    setSignal(BODY3::RBTMFL_SP_Lvl_Rq_ST35, 0);
    debugger_reset();
  
  
    testStep("STEP", "Set a breakpoint in function cil_TriggerProfiles at line 'cil_u8ExecHAPTIC_TYPE = (uint8)(KU8_EIGHT == ((uint8)(NVP_BLOCK_ID_HAPTIC_CONFIG_MB_RamBlockData.NVP_u8HapticType & KU8_EIGHT)));'.");
    debugger_setRelativeFunctionBpAtLine("cil_TriggerProfiles", 582);
    testWaitForTimeoutSilent(100);
    
    testStep("STEP", "Set signal RBTMFL_SP_Lvl_Rq_ST35 to I_C06_RBTM_LVL_RQ_PROFILE18.");
    setSignal(BODY3::RBTMFL_SP_Lvl_Rq_ST35, 18);
    testWaitForTimeoutSilent(500);
    debugger_run();
    testWaitForTimeoutSilent(500);
    
    testCaseComment("Action: ARCH_SW_CIL_0308");
    testStep("STEP", "Check if CPU stopped in function cil_TriggerProfiles at line 'cil_u8ExecHAPTIC_TYPE = (uint8)(KU8_EIGHT == ((uint8)(NVP_BLOCK_ID_HAPTIC_CONFIG_MB_RamBlockData.NVP_u8HapticType & KU8_EIGHT)));'. --> CPU is Stopped");
    debugger_isCPUStoppedAtFunction("cil_TriggerProfiles");
  
  
  testCaseComment("Postcondition");
  testStep("STEP", "Return ECU to default values");
  setSignal(BODY3::RBTMFL_SP_Lvl_Rq_ST35, 0);
  RunPostTs(); 
}


testcase SW_IT_CIL_ReleaseInhibition_01()
{
  //***********************************Test report header*********************************
  testReportAddMiscInfoBlock("AUTOLIV ELECTRONICS document");
  TestReportAddMiscInfo("Nightly test", "No");
  TestReportAddMiscInfo("Test type", "Requirement-Based test");
  TestReportAddMiscInfo("Regression Test", "No");
  TestReportAddMiscInfo("Fault injection method used", "No");
  TestReportAddMiscInfo("Resource usage evaluation", "No");
  TestReportAddMiscInfo("Priority", "No");
  TestReportAddMiscInfo("Safety relevant", "No");
  
  AddRequirementInfo("Requirement under test", "ARCH_SW_CIL_0263, ARCH_SW_CIL_0240");
  AddRequirementInfo("ARCH_SW_CIL_0263", "If release profile is inhibitted then it will be postponed until all inhibition cause will be removed.");
  AddRequirementInfo("ARCH_SW_CIL_0240", "If timeout is received on frame PresfAct_Adj_Pr5_ST3 any request on PRESAFE will be inhibitted");
  //***************************************************************************************
    
  testCaseComment("Preconditions");
  testStep("STEP", "Bench Initialization");
  RunPreTs();
    
  
    testStep("STEP", "Set signal Bckl_Sw_D_Stat_ST3 to NOK (0x01).");
    setSignal(BODY3::Bckl_Sw_D_Stat_ST3, 1); 
    testWaitForTimeoutSilent(100);
    
    testStep("STEP", "Set signal Presf_Lvl_ST3 to I_C04_PRESF_LVL_V2_LVL1.");
    setSignal(BODY3::Presf_Lvl_ST3, I_C04_PRESF_LVL_V2_LVL1); 
    testWaitForTimeoutSilent(100);
  
    
    testStep("STEP", "Set a breakpoint in function CIL_runCANToAppli() at line 'cil_ManageInputSignals();'.");
    debugger_setRelativeFunctionBpAtLine("CIL_runCANToAppli", 88);
  
    testWaitForTimeoutSilent(1000);
  
    testStep("STEP", "Check if CPU stopped in function CIL_runCANToAppli() at line 'cil_ManageInputSignals();'. --> CPU is Stopped");
    debugger_isCPUStoppedAtFunction("CIL_runCANToAppli");
  
  
    debugger_deleteAllBP();
    
  
    testStep("STEP", "Set a breakpoint in function cil_ManageInputSignals() at line 'cil_ManageInhibitConditions();' and press run.");
    debugger_setRelativeFunctionBpAtLine("cil_ManageInputSignals", 230);
  
    debugger_run();
    testWaitForTimeoutSilent(1000);
  
    testStep("STEP", "Check if CPU stopped in function cil_ManageInputSignals() at line 'cil_ManageInhibitConditions();'. --> CPU is Stopped");
    debugger_isCPUStoppedAtFunction("cil_ManageInputSignals");
    
  
    debugger_deleteAllBP();
    
    
    testStep("STEP", "Set a breakpoint in function cil_ManageInhibitConditions() at line 'Rte_Write_psrCustomerSpecific_b8SignalRelInhibition(KU8_TRUE);' and press run.");
    debugger_setRelativeFunctionBpAtLine("cil_ManageInhibitConditions", 335);
  
    debugger_run();
    testWaitForTimeoutSilent(500);

    testCaseComment("Action: ARCH_SW_CIL_0263, ARCH_SW_CIL_0240");
    testStep("STEP", "Check if CPU stopped in function cil_ManageInhibitConditions() at line 'Rte_Write_psrCustomerSpecific_b8SignalRelInhibition(KU8_TRUE);'. --> CPU is Stopped");
    debugger_isCPUStoppedAtFunction("cil_ManageInhibitConditions");

  
    debugger_deleteAllBP();
    
  
    testStep("STEP", "Set signal Bckl_Sw_D_Stat_ST3 to OK (0x00).");
    setSignal(BODY3::Bckl_Sw_D_Stat_ST3, 1); 
    testWaitForTimeoutSilent(100);
  
    testStep("STEP", "Set a breakpoint in function cil_ManageInhibitConditions() at line 'Rte_Write_psrCustomerSpecific_b8SignalRelInhibition(KU8_FALSE);' and press run.");
    debugger_setRelativeFunctionBpAtLine("cil_ManageInhibitConditions", 339);
  
    debugger_run();
    testWaitForTimeoutSilent(500);
  
    testCaseComment("Action: ARCH_SW_CIL_0263, ARCH_SW_CIL_0240");
    testStep("STEP", "Check if CPU stopped in function cil_ManageInhibitConditions() at line 'Rte_Write_psrCustomerSpecific_b8SignalRelInhibition(KU8_FALSE);'. --> CPU is Stopped");
    debugger_isCPUStoppedAtFunction("cil_ManageInhibitConditions");
    
  
  testCaseComment("Postcondition");
  testStep("STEP", "Return ECU to default values");
  setSignal(BODY3::Presf_Lvl_ST3, I_C04_PRESF_LVL_V2_NOLVL); 
  RunPostTs();
}


testcase SW_IT_CIL_ManageHapticRepetition_02()
{
  //***********************************Test report header*********************************
  testReportAddMiscInfoBlock("AUTOLIV ELECTRONICS document");
  TestReportAddMiscInfo("Nightly test", "No");
  TestReportAddMiscInfo("Test type", "Requirement-Based test");
  TestReportAddMiscInfo("Regression Test", "No");
  TestReportAddMiscInfo("Fault injection method used", "No");
  TestReportAddMiscInfo("Resource usage evaluation", "No");
  TestReportAddMiscInfo("Priority", "No");
  TestReportAddMiscInfo("Safety relevant", "No");
  
  AddRequirementInfo("Requirement under test", "ARCH_SW_CIL_0213");
  AddRequirementInfo("ARCH_SW_CIL_0213", "Frame ECU_Stat_RBTM_xy_ST3 will be computed to be send to CAN. Signal ECU_Id_RBTM_xy_ST3 will be writtem with 0x1A4 for Left side and 0x1A5 for Right Side.");
  //***************************************************************************************
    
  testCaseComment("Preconditions");
  testStep("STEP", "Bench Initialization");
  RunPreTs();

  
    testStep("STEP", "Set a breakpoint in function CIL_runAppliToCAN().");
    debugger_setRelativeFunctionBpAtLine("CIL_runAppliToCAN", 0);
    testWaitForTimeoutSilent(500);
  
    testStep("STEP", "Check if CPU stopped in function CIL_runAppliToCAN(). --> CPU is Stopped");
    debugger_isCPUStoppedAtFunction("CIL_runAppliToCAN");
    
    
    debugger_deleteAllBP();
    debugger_run();
    
    
    testCaseComment("Action: ARCH_SW_CIL_0213");
    testStep("STEP", "Evaluate if variable ComConf_ComSignal_ECU_Id_RBTM_FL_ST3_b4de0ce2_Tx is equal to signal ECU_Id_RBTM_FL_ST3. --> ComConf_ComSignal_ECU_Id_RBTM_FL_ST3_b4de0ce2_Tx is equal to ECU_Id_RBTM_FL_ST3");
    result = debugger_readGlobalVariable("uint8", "ComConf_ComSignal_ECU_Id_RBTM_FL_ST3_b4de0ce2_Tx,,app.elf", 0);
    EvalManStepEqual("Expected Test Result", $ECU_Id_RBTM_FL_ST3.raw64, 0x1A4);
  
    testCaseComment("Action: ARCH_SW_CIL_0213");
    testStep("STEP", "Evaluate if variable ComConf_ComSignal_ECU_Id_RBTM_FL_ST3_b4de0ce2_Tx is equal to signal ECU_Id_RBTM_FL_ST3. --> ComConf_ComSignal_ECU_Id_RBTM_FL_ST3_b4de0ce2_Tx is equal to ECU_Id_RBTM_FL_ST3");
    result = debugger_readGlobalVariable("uint8", "ComConf_ComSignal_ECU_Id_RBTM_FL_ST3_b4de0ce2_Tx,,app.elf", 0);
    EvalManStepEqual("Expected Test Result", $ECU_Id_RBTM_FR_ST3.raw64, 0x1A5);
  
  
  testCaseComment("Postcondition");
  testStep("STEP", "Return ECU to default values");
  RunPostTs(); 
}




testcase SW_IT_CIL_ManageHapticRepetition_01()
{
  //***********************************Test report header*********************************
  testReportAddMiscInfoBlock("AUTOLIV ELECTRONICS document");
  TestReportAddMiscInfo("Nightly test", "No");
  TestReportAddMiscInfo("Test type", "Requirement-Based test");
  TestReportAddMiscInfo("Regression Test", "No");
  TestReportAddMiscInfo("Fault injection method used", "No");
  TestReportAddMiscInfo("Resource usage evaluation", "No");
  TestReportAddMiscInfo("Priority", "No");
  TestReportAddMiscInfo("Safety relevant", "No");
  
  AddRequirementInfo("Requirement under test", "ARCH_SW_CIL_0261, ARCH_SW_CIL_0262");
  AddRequirementInfo("ARCH_SW_CIL_0261", "CIL component will handle HWAx configured with fixed duration with execute the Vibration phase according to NVP_u16DurationHapticX.");
  AddRequirementInfo("ARCH_SW_CIL_0262", "CIL component will handle HWAx configured with non-fixed duration with execution of the Vibration phase until the HWAx request is removed from the request source PRE-SAFE or API or the Vibration Phase is completely executed according to NVP_u16DurationHapticX.");
  //***************************************************************************************
    
  testCaseComment("Preconditions");
  testStep("STEP", "Bench Initialization");
  RunPreTs();
  

    testStep("STEP", "Set signal Presf_Lvl_ST3 to I_C04_PRESF_LVL_V2_LVL2.");
    setSignal(BODY3::Presf_Lvl_ST3, 2);

  
    testStep("STEP", "Set a breakpoint in function CIL_runCANToAppli at line 'cil_TriggerProfiles(CIL_stManagedCycle.u8CurrentRequestedCycle);'.");
    debugger_setRelativeFunctionBpAtLine("CIL_runCANToAppli", 364);
    testWaitForTimeoutSilent(500);
  
    testStep("STEP", "Check if CPU stopped in function CIL_runCANToAppli at line 'cil_TriggerProfiles(CIL_stManagedCycle.u8CurrentRequestedCycle);'. --> CPU is Stopped");
    debugger_isCPUStoppedAtFunction("CIL_runCANToAppli");
    
    
    debugger_deleteAllBP();
    
    
    testStep("STEP", "Set a breakpoint in function cil_ManageHapticRepetition() at line 'CIL_u16HWARepetitionTime = ((uint16)(NVP_BLOCK_ID_HAPTIC_CONFIG_MB_RamBlockData.NVP_u16DurationHaptic1)/KU16_TEN);");
    debugger_setBpAtLine("s:\\Components\\Application\\Autoliv\\CIL\\Implementation\\src\\CIL_CANToAppli.c\\", 1756);
    
    debugger_run();
    testWaitForTimeoutSilent(1000);
  
    testCaseComment("Action: ARCH_SW_CIL_0261");
    testStep("STEP", "Check if CPU stopped in function cil_ManageHapticRepetition() at line 'CIL_u16HWARepetitionTime = ((uint16)(NVP_BLOCK_ID_HAPTIC_CONFIG_MB_RamBlockData.NVP_u16DurationHaptic1)/KU16_TEN);'. --> CPU is Stopped");
    debugger_isCPUStoppedAtFunction("cil_ManageHapticRepetition");
    
  
    debugger_deleteAllBP();
    debugger_run();
  
  
    testCaseComment("Action: ARCH_SW_CIL_0261");
    testStep("STEP", "Evaluate if variable CIL_u16HWARepetitionTime is equal to NVP_u16DurationHaptic1 / KU16_TEN. --> CIL_u16HWARepetitionTime is equal to NVP_u16DurationHaptic1 / KU16_TEN");
    result = debugger_readGlobalVariable("uint8", "CIL_u16HWARepetitionTime,,app.elf", 0);
    EvalManStepEqual("Expected Test Result", result, 100);
  

    setSignal(BODY3::Presf_Lvl_ST3, 0);
    debugger_deleteAllBP();
    debugger_run();
    

    testStep("STEP", "Set signal RBTMFL_SP_Lvl_Rq_ST35 to I_C06_RBTM_LVL_RQ_PROFILE16.");
    setSignal(BODY3::RBTMFL_SP_Lvl_Rq_ST35, 16);
  
  
    testStep("STEP", "Set a breakpoint in function cil_ManageHapticRepetition() at line 'CIL_u16HWARepetitionTime = ((uint16)(NVP_BLOCK_ID_HAPTIC_CONFIG_MB_RamBlockData.NVP_u16DurationHaptic2)/KU16_TEN);");
    debugger_setBpAtLine("s:\\Components\\Application\\Autoliv\\CIL\\Implementation\\src\\CIL_CANToAppli.c\\", 1761);
    
    debugger_run();
    testWaitForTimeoutSilent(1000);
  
    testCaseComment("Action: ARCH_SW_CIL_0261");
    testStep("STEP", "Check if CPU stopped in function cil_ManageHapticRepetition() at line 'CIL_u16HWARepetitionTime = ((uint16)(NVP_BLOCK_ID_HAPTIC_CONFIG_MB_RamBlockData.NVP_u16DurationHaptic2)/KU16_TEN);'. --> CPU is Stopped");
    debugger_isCPUStoppedAtFunction("cil_ManageHapticRepetition");
    
  
    debugger_deleteAllBP();
    debugger_run();
  
  
    testCaseComment("Action: ARCH_SW_CIL_0261");
    testStep("STEP", "Evaluate if variable CIL_u16HWARepetitionTime is equal to NVP_u16DurationHaptic2 / KU16_TEN. --> CIL_u16HWARepetitionTime is equal to NVP_u16DurationHaptic2 / KU16_TEN");
    result = debugger_readGlobalVariable("uint8", "CIL_u16HWARepetitionTime,,app.elf", 0);
    EvalManStepEqual("Expected Test Result", result, 100);
  
  
  
    setSignal(BODY3::RBTMFL_SP_Lvl_Rq_ST35, 0);
    debugger_deleteAllBP();
    debugger_run();
    
  
        
    testStep("STEP", "Set signal RBTMFL_SP_Lvl_Rq_ST35 to I_C06_RBTM_LVL_RQ_PROFILE17.");
    setSignal(BODY3::RBTMFL_SP_Lvl_Rq_ST35, 17);
  
  
    testStep("STEP", "Set a breakpoint in function cil_ManageHapticRepetition() at line 'CIL_u16HWARepetitionTime = ((uint16)(NVP_BLOCK_ID_HAPTIC_CONFIG_MB_RamBlockData.NVP_u16DurationHaptic3)/KU16_TEN);");
    debugger_setBpAtLine("s:\\Components\\Application\\Autoliv\\CIL\\Implementation\\src\\CIL_CANToAppli.c\\", 1766);
    
    debugger_run();
    testWaitForTimeoutSilent(1000);
  
    testCaseComment("Action: ARCH_SW_CIL_0261");
    testStep("STEP", "Check if CPU stopped in function cil_ManageHapticRepetition() at line 'CIL_u16HWARepetitionTime = ((uint16)(NVP_BLOCK_ID_HAPTIC_CONFIG_MB_RamBlockData.NVP_u16DurationHaptic3)/KU16_TEN);'. --> CPU is Stopped");
    debugger_isCPUStoppedAtFunction("cil_ManageHapticRepetition");
    
  
    debugger_deleteAllBP();
    debugger_run();
  
  
    testCaseComment("Action: ARCH_SW_CIL_0261");
    testStep("STEP", "Evaluate if variable CIL_u16HWARepetitionTime is equal to NVP_u16DurationHaptic3 / KU16_TEN. --> CIL_u16HWARepetitionTime is equal to NVP_u16DurationHaptic3 / KU16_TEN");
    result = debugger_readGlobalVariable("uint8", "CIL_u16HWARepetitionTime,,app.elf", 0);
    EvalManStepEqual("Expected Test Result", result, 100);
  
  
  
    setSignal(BODY3::RBTMFL_SP_Lvl_Rq_ST35, 0);
    debugger_deleteAllBP();
    debugger_run();
    
  
        
    testStep("STEP", "Set signal RBTMFL_SP_Lvl_Rq_ST35 to I_C06_RBTM_LVL_RQ_PROFILE18.");
    setSignal(BODY3::RBTMFL_SP_Lvl_Rq_ST35, 18);
  
  
    testStep("STEP", "Set a breakpoint in function cil_ManageHapticRepetition() at line 'CIL_u16HWARepetitionTime = ((uint16)(NVP_BLOCK_ID_HAPTIC_CONFIG_MB_RamBlockData.NVP_u16DurationHaptic4)/KU16_TEN);");
    debugger_setBpAtLine("s:\\Components\\Application\\Autoliv\\CIL\\Implementation\\src\\CIL_CANToAppli.c\\", 1771);
    
    debugger_run();
    testWaitForTimeoutSilent(1000);
  
    testCaseComment("Action: ARCH_SW_CIL_0261, ARCH_SW_CIL_0262");
    testStep("STEP", "Check if CPU stopped in function cil_ManageHapticRepetition() at line 'CIL_u16HWARepetitionTime = ((uint16)(NVP_BLOCK_ID_HAPTIC_CONFIG_MB_RamBlockData.NVP_u16DurationHaptic4)/KU16_TEN);'. --> CPU is Stopped");
    debugger_isCPUStoppedAtFunction("cil_ManageHapticRepetition");
    
  
    debugger_deleteAllBP();
    debugger_run();
  
  
    testCaseComment("Action: ARCH_SW_CIL_0261, ARCH_SW_CIL_0262");
    testStep("STEP", "Evaluate if variable CIL_u16HWARepetitionTime is equal to NVP_u16DurationHaptic4 / KU16_TEN. --> CIL_u16HWARepetitionTime is equal to NVP_u16DurationHaptic4 / KU16_TEN");
    result = debugger_readGlobalVariable("uint8", "CIL_u16HWARepetitionTime,,app.elf", 0);
    EvalManStepEqual("Expected Test Result", result, 100);
  
  
  testCaseComment("Postcondition");
  testStep("STEP", "Return ECU to default values");
  setSignal(BODY3::RBTMFL_SP_Lvl_Rq_ST35, 0);
  RunPostTs(); 
}



// R6.1

testcase SW_IT_CIL_VehicleEquipmentData_01()
{
  //***********************************Test report header*********************************
  testReportAddMiscInfoBlock("AUTOLIV ELECTRONICS document");
  TestReportAddMiscInfo("Nightly test", "No");
  TestReportAddMiscInfo("Test type", "Requirement-Based test");
  TestReportAddMiscInfo("Regression Test", "No");
  TestReportAddMiscInfo("Fault injection method used", "No");
  TestReportAddMiscInfo("Resource usage evaluation", "No");
  TestReportAddMiscInfo("Priority", "No");
  TestReportAddMiscInfo("Safety relevant", "No");
  
  AddRequirementInfo("Requirement under test", "ARCH_SW_CIL_0563");
  AddRequirementInfo("ARCH_SW_CIL_0563", "NVP_stVehicleEquipmentData shall be read to get the coding configuration: Display message enabled.");
  //***************************************************************************************
    
  testCaseComment("Preconditions");
  testStep("STEP", "Bench Initialization");
  RunPreTs();
  
  
    testStep("STEP", "Set a breakpoint in function CIL_runAppliToCAN().");
    debugger_setRelativeFunctionBpAtLine("CIL_runAppliToCAN", 0);
    testWaitForTimeoutSilent(500);
  
    testStep("STEP", "Check if CPU stopped in function CIL_runAppliToCAN(). --> CPU is Stopped");
    debugger_isCPUStoppedAtFunction("CIL_runAppliToCAN");
  
  
    debugger_deleteAllBP();
    
    
    testStep("STEP", "Set a breakpoint in function cil_ManagePresfDisplay() at line 'cil_u8RBTMDisp = I_C02_PRESF_DISP_RQ_IDLE;' and press run.");
    debugger_setBpAtLine("s:\\Components\\Application\\Autoliv\\CIL\\Implementation\\src\\CIL_AppliToCAN.c\\", 213);
  
    debugger_run();
  
    testCaseComment("Action: ARCH_SW_CIL_0563");
    testStep("STEP", "Check if CPU stopped in function cil_ManagePresfDisplay() at line 'cil_u8RBTMDisp = I_C02_PRESF_DISP_RQ_IDLE;'. --> CPU is Stopped");
    debugger_isCPUStoppedAtFunction("cil_ManageInputSignals");
    
  
    debugger_deleteAllBP();
    debugger_run();
  
  
    testCaseComment("Action: ARCH_SW_CIL_0563");
    testStep("STEP", "Evaluate if signal RBTM_FL_Disp_Rq_ST3 is equal to I_C02_PRESF_DISP_RQ_IDLE. --> I_C02_PRESF_DISP_RQ_IDLE");
    EvalManStepEqual("Expected Test Result", $RBTM_FL_Disp_Rq_ST3.raw64, 0);
  
  
  testCaseComment("Postcondition");
  testStep("STEP", "Return ECU to default values");
  RunPostTs(); 
}


testcase SW_IT_CIL_Disp_Rq_01()
{
  //***********************************Test report header*********************************
  testReportAddMiscInfoBlock("AUTOLIV ELECTRONICS document");
  TestReportAddMiscInfo("Nightly test", "No");
  TestReportAddMiscInfo("Test type", "Requirement-Based test");
  TestReportAddMiscInfo("Regression Test", "No");
  TestReportAddMiscInfo("Fault injection method used", "No");
  TestReportAddMiscInfo("Resource usage evaluation", "No");
  TestReportAddMiscInfo("Priority", "No");
  TestReportAddMiscInfo("Safety relevant", "No");
  
  AddRequirementInfo("Requirement under test", "ARCH_SW_CIL_0209");
  AddRequirementInfo("ARCH_SW_CIL_0209", "If “Display message” is not enabled in Vehicle Equipment 0x311, then Value for signal RBTM_FL/FR_Disp_Rq_ST3 will be set to 0 = IDLE.");
  //***************************************************************************************
    
  testCaseComment("Preconditions");
  testStep("STEP", "Bench Initialization");
  RunPreTs();
  
  
    testStep("STEP", "Set a breakpoint in function CIL_runAppliToCAN().");
    debugger_setRelativeFunctionBpAtLine("CIL_runAppliToCAN", 0);
    testWaitForTimeoutSilent(500);
  
    testStep("STEP", "Check if CPU stopped in function CIL_runAppliToCAN(). --> CPU is Stopped");
    debugger_isCPUStoppedAtFunction("CIL_runAppliToCAN");
  
  
    debugger_deleteAllBP();
    
    
    testStep("STEP", "Set a breakpoint in function cil_ManagePresfDisplay() at line 'cil_u8RBTMDisp = I_C02_PRESF_DISP_RQ_IDLE;' and press run.");
    debugger_setBpAtLine("s:\\Components\\Application\\Autoliv\\CIL\\Implementation\\src\\CIL_AppliToCAN.c\\", 213);
  
    debugger_run();
  
    testCaseComment("Action: ARCH_SW_CIL_0209");
    testStep("STEP", "Check if CPU stopped in function cil_ManageInputSignals() at line 'cil_u8RBTMDisp = I_C02_PRESF_DISP_RQ_IDLE;'. --> CPU is Stopped");
    debugger_WaitUntilBPisReached(1000);
    
  
    debugger_deleteAllBP();
    debugger_run();
  
  
    testCaseComment("Action: ARCH_SW_CIL_0209");
    testStep("STEP", "Evaluate if signal RBTM_FL_Disp_Rq_ST3 is equal to I_C02_PRESF_DISP_RQ_IDLE. --> I_C02_PRESF_DISP_RQ_IDLE");
    EvalManStepEqual("Expected Test Result", $RBTM_FL_Disp_Rq_ST3.raw64, 0);
  
  
  testCaseComment("Postcondition");
  testStep("STEP", "Return ECU to default values");
  RunPostTs(); 
}


testcase SW_IT_CIL_b8NVMBlockStatus_01()
{
  //***********************************Test report header*********************************
  testReportAddMiscInfoBlock("AUTOLIV ELECTRONICS document");
  TestReportAddMiscInfo("Nightly test", "No");
  TestReportAddMiscInfo("Test type", "Requirement-Based test");
  TestReportAddMiscInfo("Regression Test", "No");
  TestReportAddMiscInfo("Fault injection method used", "No");
  TestReportAddMiscInfo("Resource usage evaluation", "No");
  TestReportAddMiscInfo("Priority", "No");
  TestReportAddMiscInfo("Safety relevant", "No");
  
  AddRequirementInfo("Requirement under test", "ARCH_SW_CIL_0307, ARCH_SW_CIL_0419");
  AddRequirementInfo("ARCH_SW_CIL_0307", "Rte_Write_psrCANInputBlockStatus_b8NVMBlockStatus will be written on TRUE to notify MMG that value for BeltslackMode has been updated.");
  AddRequirementInfo("ARCH_SW_CIL_0419", "Rte_Write_psrCANInputBlockStatus_b8NVMBlockStatus shall be called to save the las valid value of the signal. ()");
  //***************************************************************************************
    
  testCaseComment("Preconditions");
  testStep("STEP", "Bench Initialization");
  RunPreTs();

    
    testStep("STEP", "Set signal BltSlckDec_Md_Rq_HU_ST3 to I_C02_OFF_ON_OFF.");
    setSignal(BODY3::BltSlckDec_Md_Rq_HU_ST3, 0);
    testWaitForTimeoutSilent(100);
  
  
    testStep("STEP", "Set a breakpoint in function CIL_runCANToAppli() at line 'cil_ManageInputSignals();'.");
    debugger_setRelativeFunctionBpAtLine("CIL_runCANToAppli", 5);
  
    testStep("STEP", "Check if CPU stopped in function CIL_runCANToAppli() at line 'cil_ManageInputSignals();'. --> CPU is Stopped");
    debugger_WaitUntilBPisReached(1000);
  
  
    debugger_deleteAllBP();
    
    
    testStep("STEP", "Set a breakpoint in function cil_ManageInputSignals() at line '(void)Rte_Write_psrCANInputBlockStatus_b8NVMBlockStatus(KU8_TRUE);' and press run.");
    debugger_setRelativeFunctionBpAtLine("cil_ManageInputSignals", 245);
  
    testStep("STEP", "Set signal BltSlckDec_Md_Rq_HU_ST3 to I_C02_OFF_ON_ON.");
    setSignal(BODY3::BltSlckDec_Md_Rq_HU_ST3, 1);
    testWaitForTimeoutSilent(100);
  
    debugger_run();
    testWaitForTimeoutSilent(500);
  
    testCaseComment("Action: ARCH_SW_CIL_0307, ARCH_SW_CIL_0419");
    testStep("STEP", "Check if CPU stopped in function cil_ManageInputSignals() at line '(void)Rte_Write_psrCANInputBlockStatus_b8NVMBlockStatus(KU8_TRUE);. --> CPU is Stopped");
    debugger_WaitUntilBPisReached(1000);
  
  
    debugger_deleteAllBP();
    
    
    testStep("STEP", "Set a breakpoint MMG_runUpdateNVMBlocks() at the last line of the function and press run.");
    debugger_setRelativeFunctionBpAtLine("MMG_runUpdateNVMBlocks", 60);
  
    debugger_run();
  
    testStep("STEP", "Check if CPU stopped MMG_runUpdateNVMBlocks() at the last line of the function. --> CPU is Stopped");
    debugger_WaitUntilBPisReached(1000);
  
    
    testCaseComment("Action: ARCH_SW_CIL_0307");
    testStep("STEP", "Evaluate if variable Rte_CIL_psrCANInputBlockStatus_b8NVMBlockStatus is equal to KU8_TRUE. --> KU8_TRUE");
    result = debugger_readGlobalVariable("uint8", "Rte_CIL_psrCANInputBlockStatus_b8NVMBlockStatus,,app.elf", 0);
    EvalManStepEqual("Expected Test Result", result, 170);
  
    testCaseComment("Action: ARCH_SW_CIL_0307");
    testStep("STEP", "Evaluate if local variable u8BlockStatus is equal to Rte_CIL_psrCANInputBlockStatus_b8NVMBlockStatus. --> Rte_CIL_psrCANInputBlockStatus_b8NVMBlockStatus");
    result = debugger_readLocalVariable("u8BlockStatus");
    EvalManStepEqual("Expected Test Result", result, 170);
  
  
  testCaseComment("Postcondition");
  testStep("STEP", "Return ECU to default values");
  RunPostTs(); 
}


testcase SW_IT_CIL_b8SignalRelInhibition_01()
{
  //***********************************Test report header*********************************
  testReportAddMiscInfoBlock("AUTOLIV ELECTRONICS document");
  TestReportAddMiscInfo("Nightly test", "No");
  TestReportAddMiscInfo("Test type", "Requirement-Based test");
  TestReportAddMiscInfo("Regression Test", "No");
  TestReportAddMiscInfo("Fault injection method used", "No");
  TestReportAddMiscInfo("Resource usage evaluation", "No");
  TestReportAddMiscInfo("Priority", "No");
  TestReportAddMiscInfo("Safety relevant", "No");
  
  AddRequirementInfo("Requirement under test", "ARCH_SW_CIL_0306");
  AddRequirementInfo("ARCH_SW_CIL_0306", "Rte_CIL_psrCustomerSpecific_b8SignalRelInhibition will be wriiten by CIL in order to inform about Inhibition of Release profile due to CAN signals or ORC request.");
  //***************************************************************************************
    
  testCaseComment("Preconditions");
  testStep("STEP", "Bench Initialization");
  RunPreTs();

    
    testStep("STEP", "Set signal Impact_X_ST3 to KU8_ONE.");
    setSignal(BODY3::Impact_X_ST3, 1); 
    testWaitForTimeoutSilent(100);
  
  
    testStep("STEP", "Set a breakpoint in function CIL_runCANToAppli() at line 'cil_ManageInputSignals();'.");
    debugger_setRelativeFunctionBpAtLine("CIL_runCANToAppli", 5);
    testWaitForTimeoutSilent(500);
  
    testStep("STEP", "Check if CPU stopped in function CIL_runCANToAppli() at line 'cil_ManageInputSignals();'. --> CPU is Stopped");
debugger_isCPUStoppedAtFunction("CIL_runCANToAppli");    ////EvalManStepEqual("Expected Test Result", debugger_result, "CPU is Stopped");
  
  
    debugger_deleteAllBP();
    
    
    testStep("STEP", "Set a breakpoint in function cil_ManageInputSignals() at line 'cil_ManageInhibitConditions();' and press run.");
    debugger_setRelativeFunctionBpAtLine("cil_ManageInputSignals", 250);
  
    debugger_run();
    testWaitForTimeoutSilent(500);
  
    testStep("STEP", "Check if CPU stopped in function cil_ManageInputSignals() at line 'cil_ManageInhibitConditions();'. --> CPU is Stopped");
debugger_isCPUStoppedAtFunction("cil_ManageInputSignals");    ////EvalManStepEqual("Expected Test Result", debugger_result, "CPU is Stopped");
  
  
    debugger_deleteAllBP();
    
    
    testStep("STEP", "Set a breakpoint in function cil_ManageInhibitConditions() at line 'CIL_SET_INHIB_MASK_ON (KU8_CIL_InhibitionOfAllCycles);' and press run.");
    debugger_setRelativeFunctionBpAtLine("cil_ManageInhibitConditions", 334);
  
    debugger_run();
  
    testCaseComment("Action: ARCH_SW_CIL_0306");
    testStep("STEP", "Check if CPU stopped in function cil_ManageInhibitConditions() at line 'CIL_SET_INHIB_MASK_ON (KU8_CIL_InhibitionOfAllCycles);''. --> CPU is Stopped");
debugger_isCPUStoppedAtFunction("cil_ManageInhibitConditions");    ////EvalManStepEqual("Expected Test Result", debugger_result, "CPU is Stopped");
  
  
  testCaseComment("Postcondition");
  testStep("STEP", "Return ECU to default values");
  RunPostTs(); 
}


testcase SW_IT_CIL_CANToAppli_05()
{
  //***********************************Test report header*********************************
  testReportAddMiscInfoBlock("AUTOLIV ELECTRONICS document");
  TestReportAddMiscInfo("Nightly test", "No");
  TestReportAddMiscInfo("Test type", "Requirement-Based test");
  TestReportAddMiscInfo("Regression Test", "No");
  TestReportAddMiscInfo("Fault injection method used", "No");
  TestReportAddMiscInfo("Resource usage evaluation", "No");
  TestReportAddMiscInfo("Priority", "No");
  TestReportAddMiscInfo("Safety relevant", "No");
  
  AddRequirementInfo("Requirement under test", "ARCH_SW_CIL_0372");
  AddRequirementInfo("ARCH_SW_CIL_0372", "ERH_GetAecGroupsStatus shall be called to get the inhibition for tensioning cycle because of Steering configuration: -	B220400:The control unit is incorrectly configured");
  //***************************************************************************************
    
  testCaseComment("Preconditions");
  testStep("STEP", "Bench Initialization");
  RunPreTs();

  
    testStep("STEP", "Set a breakpoint in function CIL_runCANToAppli at line 'cil_TriggerProfiles(CIL_stManagedCycle.u8CurrentRequestedCycle);'.");
    debugger_setRelativeFunctionBpAtLine("CIL_runCANToAppli", 364);
    testWaitForTimeoutSilent(500);
  
    testStep("STEP", "Check if CPU stopped in function CIL_runCANToAppli at line 'cil_TriggerProfiles(CIL_stManagedCycle.u8CurrentRequestedCycle);'. --> CPU is Stopped");
debugger_isCPUStoppedAtFunction("CIL_runCANToAppli");    ////EvalManStepEqual("Expected Test Result", debugger_result, "CPU is Stopped");
  
  
    debugger_deleteAllBP();
  
  
    testStep("STEP", "Set a breakpoint in function cil_TriggerProfiles at line 'Rte_Call_pclAecStatus_GetAecGroupsStatus(&u32AECGroupStatus);'.");
    debugger_setRelativeFunctionBpAtLine("cil_TriggerProfiles", 15);
    testWaitForTimeoutSilent(500);
  
    debugger_run();
  
    testStep("STEP", "Check if CPU stopped in function cil_TriggerProfiles at line 'Rte_Call_pclAecStatus_GetAecGroupsStatus(&u32AECGroupStatus);'. --> CPU is Stopped");
    debugger_isCPUStoppedAtFunction("cil_TriggerProfiles");   

  
    testCaseComment("Action: ARCH_SW_CIL_0372");
    testStep("STEP", "Step in function ERH_runGetAecGroupsStatus(). --> Stepped in function ERH_runGetAecGroupsStatus");
    debugger_stepIn();
    testWaitForTimeoutSilent(500);
  
  
  testCaseComment("Postcondition");
  testStep("STEP", "Return ECU to default values");
  RunPostTs(); 
}


testcase SW_IT_CIL_CANToAppli_03()
{
  //***********************************Test report header*********************************
  testReportAddMiscInfoBlock("AUTOLIV ELECTRONICS document");
  TestReportAddMiscInfo("Nightly test", "No");
  TestReportAddMiscInfo("Test type", "Requirement-Based test");
  TestReportAddMiscInfo("Regression Test", "No");
  TestReportAddMiscInfo("Fault injection method used", "No");
  TestReportAddMiscInfo("Resource usage evaluation", "No");
  TestReportAddMiscInfo("Priority", "No");
  TestReportAddMiscInfo("Safety relevant", "No");
  
  AddRequirementInfo("Requirement under test", "ARCH_SW_CIL_0210, ARCH_SW_CIL_0211");
  AddRequirementInfo("ARCH_SW_CIL_0210", "CIL component should ensure that if a profile is requested on PRE_SAFE or API and the execution is inhibitted, it will be postponed until all starting conditions will be fulfilled as long as the request is still active.");
  AddRequirementInfo("ARCH_SW_CIL_0211", "CIL component should ensure that if a profile is requested on PRE_SAFE or API and the execution is aborted, it will be restarted after the abortion conditions disappear as long as the request is still active.");
  //***************************************************************************************
    
  testCaseComment("Preconditions");
  testStep("STEP", "Bench Initialization");

  RunPreTs();

  
    testStep("STEP", "Set signal ISw_Stat_ST3 I_C03_ISW_STAT_SNA.");
    setSignal(BODY3::ISw_Stat_ST3, 7); 
    testWaitForTimeout(250);
  
    testStep("STEP", "Set signal Presf_Lvl_ST3 I_C04_PRESF_LVL_V2_LVL1.");
    setSignal(BODY3::Presf_Lvl_ST3, I_C04_PRESF_LVL_V2_LVL1); 
    testWaitForTimeout(250);
    
  
    testStep("STEP", "Set a breakpoint in function CIL_runCANToAppli() at line 'cil_ManageInputSignals();'.");
    debugger_setRelativeFunctionBpAtLine("CIL_runCANToAppli", 14);
    
    testStep("STEP", "Check if CPU stopped in function CIL_runCANToAppli() at line 'cil_ManageInputSignals();'. --> CPU is Stopped");
debugger_isCPUStoppedAtFunction("CIL_runCANToAppli");    ////EvalManStepEqual("Expected Test Result", debugger_result, "CPU is Stopped");
  
  
    debugger_deleteAllBP();
  
  
    testStep("STEP", "Set a breakpoint in function cil_TriggerProfiles() at line 'cil_RequestTensioning(KU8_PRECRASH_SEVERITY_LEVEL_1);'.");
    debugger_setRelativeFunctionBpAtLine("cil_TriggerProfiles", 111);
      
    debugger_run();

    testCaseComment("Action: ARCH_SW_CIL_0210, ARCH_SW_CIL_0211");
    testStep("STEP", "Check if CPU stopped in function cil_TriggerProfiles() at line 'cil_RequestTensioning(KU8_PRECRASH_SEVERITY_LEVEL_1);'. --> CPU is Running");
debugger_isCPUStoppedAtFunction("cil_TriggerProfiles");    //EvalManStepEqual("Expected Test Result", debugger_result, "CPU is Running");
  
  
    debugger_deleteAllBP();
    testStep("STEP", "Set a breakpoint in function cil_TriggerProfiles() after line 'cil_stInputSignalsPresfRec.u8TensioningStateType = KU8_TENSIONING_INHIBIT;'.");
    debugger_setRelativeFunctionBpAtLine("cil_TriggerProfiles", 121);
    debugger_run();
  
    testCaseComment("Action: ARCH_SW_CIL_0210");
    testStep("STEP", "Evaluate if variable cil_stInputSignalsPresfRec.u8TensioningStateType is equal to KU8_TENSIONING_INHIBIT. --> KU8_TENSIONING_INHIBIT");
    result = debugger_readGlobalVariable("uint8", "cil_stInputSignalsPresfRec,,app.elf", 0);
    EvalManStepEqual("Expected Test Result", result, 2);
 
    
    debugger_deleteAllBP();
  
  
    testStep("STEP", "Set signal ISw_Stat_ST3 I_C03_ISW_STAT_SNA.");
    setSignal(BODY3::ISw_Stat_ST3, 4); 
    testWaitForTimeout(250);
  
    
    testStep("STEP", "Set a breakpoint in function cil_TriggerProfiles() at line 'cil_RequestTensioning(KU8_PRECRASH_SEVERITY_LEVEL_1);'.");
    debugger_setRelativeFunctionBpAtLine("cil_TriggerProfiles", 111);
      
    debugger_run();

    testCaseComment("Action: ARCH_SW_CIL_0210, ARCH_SW_CIL_0211");
    testStep("STEP", "Check if CPU stopped in function cil_TriggerProfiles() at line 'cil_RequestTensioning(KU8_PRECRASH_SEVERITY_LEVEL_1);'. --> CPU is Stopped");
debugger_isCPUStoppedAtFunction("cil_TriggerProfiles");    ////EvalManStepEqual("Expected Test Result", debugger_result, "CPU is Stopped");
  
  
  testCaseComment("Postcondition");
  testStep("STEP", "Return ECU to default values");
  setSignal(BODY3::Presf_Lvl_ST3, I_C04_PRESF_LVL_V2_NOLVL); 
  setSignal(BODY3::ISw_Stat_ST3, 4); 
  RunPostTs(); 
}


testcase SW_IT_CIL_ComNotification_01()
{
  //***********************************Test report header*********************************
  testReportAddMiscInfoBlock("AUTOLIV ELECTRONICS document");
  TestReportAddMiscInfo("Nightly test", "No");
  TestReportAddMiscInfo("Test type", "Requirement-Based test");
  TestReportAddMiscInfo("Regression Test", "No");
  TestReportAddMiscInfo("Fault injection method used", "No");
  TestReportAddMiscInfo("Resource usage evaluation", "No");
  TestReportAddMiscInfo("Priority", "No");
  TestReportAddMiscInfo("Safety relevant", "No");
  
  AddRequirementInfo("Requirement under test", "ARCH_SW_CIL_0420");
  AddRequirementInfo("ARCH_SW_CIL_0420", "This function shall be called by Com when the signal for DI_Odo_Pr5_ST3 is received on Can.");
  //***************************************************************************************
    
  testCaseComment("Preconditions");
  testStep("STEP", "Bench Initialization");

  RunPreTs();

  
    testStep("STEP", "Set signal RBTMFL_SP_Lvl_Rq_ST35 to KU8_ZERO.");
    setSignal(BODY3::DI_OdoSpeedometer_ST3::DI_Odo_Pr5_ST3_e68xmtlkywxgxsdwekdjjhw3t_UB, 0);
    testWaitForTimeout(500);
    
    testStep("STEP", "Set a breakpoint in function CIL_ComNotification_DI_Odo_Pr5_ST3_e68xmtlkywxgxsdwekdjjhw3t_eb760b63_Rx() at line 'CIL_bTimeoutError_OdoS = B_FALSE;'.");
    debugger_setRelativeFunctionBpAtLine("CIL_ComNotification_DI_Odo_Pr5_ST3_e68xmtlkywxgxsdwekdjjhw3t_eb760b63_Rx", 0);
    
    testCaseComment("Action: ARCH_SW_CIL_0420");
    testStep("STEP", "Check if CPU stopped at line 'CIL_bTimeoutError_OdoS = B_FALSE;'. --> CPU is Stopped");
    debugger_isCPUStoppedAtFunction("CIL_ComNotification_DI_Odo_Pr5_ST3_e68xmtlkywxgxsdwekdjjhw3t_eb760b63_Rx");
    ////EvalManStepEqual("Expected Test Result", debugger_result, "CPU is Stopped");
    

  testCaseComment("Postcondition");
  testStep("STEP", "Return ECU to default values");

  RunPostTs(); 
}


// R6.0


testcase SW_IT_CIL_VSS_TP_SecTickCount_01()
{
  //***********************************Test report header*********************************
  testReportAddMiscInfoBlock("AUTOLIV ELECTRONICS document");
  TestReportAddMiscInfo("Nightly test", "No");
  TestReportAddMiscInfo("Test type", "Requirement-Based test");
  TestReportAddMiscInfo("Regression Test", "No");
  TestReportAddMiscInfo("Fault injection method used", "No");
  TestReportAddMiscInfo("Resource usage evaluation", "No");
  TestReportAddMiscInfo("Priority", "No");
  TestReportAddMiscInfo("Safety relevant", "No");
  
  AddRequirementInfo("Requirement under test", "ARCH_SW_CIL_0418");
  AddRequirementInfo("ARCH_SW_CIL_0418", "System shall check if timeout is present for VSS_TP_SecTickCount_Lvl2_ST3 frame.");
  //***************************************************************************************
    
  testCaseComment("Preconditions");
  testStep("STEP", "Bench Initialization");

  RunPreTs();

    
    testStep("STEP", "Set a breakpoint in function Rte_COMCbkRxTOut_VSS_TP_SecTickCount_Lvl2_ST3_9eubq13iosat764o0lqh5xb6r_01efe31e_Rx().");
    debugger_setRelativeFunctionBpAtLine("Rte_COMCbk_VSS_TP_SecTickCount_Lvl2_ST3_9eubq13iosat764o0lqh5xb6r_01efe31e_Rx", 0);
    
    testStep("STEP", "Check if CPU stopped in function Rte_COMCbkRxTOut_VSS_TP_SecTickCount_Lvl2_ST3_9eubq13iosat764o0lqh5xb6r_01efe31e_Rx(). --> CPU is Stopped");
    debugger_isCPUStoppedAtFunction("Rte_COMCbkRxTOut_VSS_TP_SecTickCount_Lvl2_ST3_9eubq13iosat764o0lqh5xb6r_01efe31e_Rx");    ////EvalManStepEqual("Expected Test Result", debugger_result, "CPU is Stopped");
    
    debugger_deleteAllBP();
    
    testStep("STEP", "Set a breakpoint at line 'Rte_RxTimeoutFlags.Rte_RxTimeout_VSS_TP_SecTickCount_Lvl2_ST3_9eubq13iosat764o0lqh5xb6r_01efe31e_Rx = 1U;'.");
    debugger_setRelativeFunctionBpAtLine("Rte_COMCbk_VSS_TP_SecTickCount_Lvl2_ST3_9eubq13iosat764o0lqh5xb6r_01efe31e_Rx", 3);
  
    debugger_run();
    testWaitForTimeoutSilent(500);
    
    testCaseComment("Action: ARCH_SW_CIL_0418");
    testStep("STEP", "Check if CPU stopped at line 'Rte_RxTimeoutFlags.Rte_RxTimeout_VSS_TP_SecTickCount_Lvl2_ST3_9eubq13iosat764o0lqh5xb6r_01efe31e_Rx = 1U;'. --> CPU is Stopped");
    debugger_isCPUStoppedAtFunction("Rte_COMCbkRxTOut_VSS_TP_SecTickCount_Lvl2_ST3_9eubq13iosat764o0lqh5xb6r_01efe31e_Rx");
    ////EvalManStepEqual("Expected Test Result", debugger_result, "CPU is Stopped");
    
    
  testCaseComment("Postcondition");
  testStep("STEP", "Return ECU to default values");
  RunPostTs(); 
}


testcase SW_IT_CIL_prrEnableCycle26_02()
{
  //***********************************Test report header*********************************
  testReportAddMiscInfoBlock("AUTOLIV ELECTRONICS document");
  TestReportAddMiscInfo("Nightly test", "No");
  TestReportAddMiscInfo("Test type", "Requirement-Based test");
  TestReportAddMiscInfo("Regression Test", "No");
  TestReportAddMiscInfo("Fault injection method used", "No");
  TestReportAddMiscInfo("Resource usage evaluation", "No");
  TestReportAddMiscInfo("Priority", "No");
  TestReportAddMiscInfo("Safety relevant", "No");
  
  AddRequirementInfo("Requirement under test", "ARCH_SW_CIL_0045");
  AddRequirementInfo("ARCH_SW_CIL_0045", "If value for Bckl_Sw_D_Stat_ST3 is trasitioning from 1 to 0 then cycle 26 (BSR1) shall be executed after NVP_u8AfterBuckle* 5 time.");
  //***************************************************************************************
    
  testCaseComment("Preconditions");
  testStep("STEP", "Bench Initialization");
  RunPreTs();
  
  
    testStep("STEP", "Set a breakpoint in function cil_ManageInputSignals() at line 'if (KU8_ONE == NVP_stVehicleEquipmentData.VehicleSteeringConfig)'.");
    debugger_setRelativeFunctionBpAtLine("cil_ManageInputSignals", 159);
  
    testStep("STEP", "Set variable NVP_stVehicleEquipmentData.VehicleSteeringConfig to KU8_ZERO.");
    debugger_writeGlobalVariable("uint8", "NVP_stVehicleEquipmentData.VehicleSteeringConfig", 0, 1);
    testWaitForTimeoutSilent(1000);
  
    
    debugger_deleteAllBP();
    debugger_run();
  
  
    testStep("STEP", "Set signal EVC_List03_StStyle_ST3 to LHD (0x1).");
    setSignal(BODY3::EVC_List03_StStyle_ST3, 2);
    testWaitForTimeoutSilent(100);
    
    testStep("STEP", "Set signal PT4_PTCoor_PT_Rdy_ST3 to RDY (0x1).");
    setSignal(BODY3::PT4_PTCoor4_ST3::PT4_PTCoor_PT_Rdy_ST3, 1);
    testWaitForTimeoutSilent(100);
  
    testStep("STEP", "Set signal Bckl_Sw_D_Stat_ST3 to I_C02_BCKL_SW_STAT_NOT.");
    setSignal(BODY3::Bckl_Sw_D_Stat_ST3, 1);
    
    testStep("STEP", "Set a breakpoint in function cil_ManageInhibitConditions() at line 'CIL_SET_INHIB_MASK_OFF (KU8_CIL_DelayBuckleSwitch);'.");
    debugger_setRelativeFunctionBpAtLine("cil_ManageInhibitConditions", 306);
    testWaitForTimeoutSilent(500);
  
    testStep("STEP", "Set signal Bckl_Sw_D_Stat_ST3 to I_C02_BCKL_SW_STAT_OK.");
    setSignal(BODY3::Bckl_Sw_D_Stat_ST3, 0);

    
    testStep("STEP", "Check if CPU stopped in function cil_ManageInhibitConditions() at line 'CIL_SET_INHIB_MASK_OFF (KU8_CIL_DelayBuckleSwitch);'. --> CPU is Stopped");
    debugger_WaitUntilBPisReached(11000);
    

    testCaseComment("Action: ARCH_SW_CIL_0045");
    testStep("STEP", "Evaluate if variable cil_u16BuckleSwitchDelayCounter is equal to (NVP_u8AfterBuckle * 5). --> cil_u16BuckleSwitchDelayCounter is equal to (NVP_u8AfterBuckle * 5)");
    result = debugger_readGlobalVariable("uint16", "cil_u16BuckleSwitchDelayCounter,,app.elf", 0);
    EvalManStepEqual("Expected Test Result", result, 101);


  testCaseComment("Postcondition");
  testStep("STEP", "Return ECU to default values");
  RunPostTs(); 
}


testcase SW_IT_CIL_CheckVariantCoding_01()
{
  //***********************************Test report header*********************************
  testReportAddMiscInfoBlock("AUTOLIV ELECTRONICS document");
  TestReportAddMiscInfo("Nightly test", "No");
  TestReportAddMiscInfo("Test type", "Requirement-Based test");
  TestReportAddMiscInfo("Regression Test", "No");
  TestReportAddMiscInfo("Fault injection method used", "No");
  TestReportAddMiscInfo("Resource usage evaluation", "No");
  TestReportAddMiscInfo("Priority", "No");
  TestReportAddMiscInfo("Safety relevant", "No");
  
  AddRequirementInfo("Requirement under test", "ARCH_SW_CIL_0415");
  AddRequirementInfo("ARCH_SW_CIL_0415", "VariantCoding values shall be evaluated to set the specified autotest to OK/NOK.");
  //***************************************************************************************
    
  testCaseComment("Preconditions");
  testStep("STEP", "Bench Initialization");

  RunPreTs();

    
    testStep("STEP", "Set a breakpoint in function CIL_Autotest_CheckVariantCoding() at line 'if(KU8_FALSE == ErrorFlag)'.");
    debugger_setRelativeFunctionBpAtLine("CIL_Autotest_CheckVariantCoding", 2);
    
    testStep("STEP", "Check if CPU stopped at line 'if(KU8_FALSE == ErrorFlag)'. --> CPU is Stopped");
    debugger_isCPUStoppedAtFunction("CIL_Autotest_CheckVariantCoding");
 
    
    debugger_deleteAllBP();
    
  
    testStep("STEP", "Set a breakpoint in function CIL_Autotest_CheckVariantCoding() at line '*pu8TestResult = cil_u8ResultOfAutoTest;'.");
    debugger_setRelativeFunctionBpAtLine("CIL_Autotest_CheckVariantCoding", 12);
    
    debugger_run();
    testWaitForTimeoutSilent(1000);
  
    testCaseComment("Action: ARCH_SW_CIL_0415");
    testStep("STEP", "Check if CPU stopped at line '*pu8TestResult = cil_u8ResultOfAutoTest;'. --> CPU is Stopped");
    debugger_isCPUStoppedAtFunction("CIL_Autotest_CheckVariantCoding");
  
    
    testCaseComment("Action: ARCH_SW_CIL_0415");
    testStep("STEP", "Evaluate variable *pu8TestResult. --> KU8_ATM_TEST_NOK");
    result = debugger_readLocalVariable("*(pu8TestResult)");
    EvalManStepEqual("Expected Test Result", result, 0);
  
  
  testCaseComment("Postcondition");
  testStep("STEP", "Return ECU to default values");
  RunPostTs(); 
}


testcase SW_IT_CIL_BltSlckDec_02() 
{
  //***********************************Test report header*********************************
  testReportAddMiscInfoBlock("AUTOLIV ELECTRONICS document");
  TestReportAddMiscInfo("Nightly test", "No");
  TestReportAddMiscInfo("Test type", "Requirement-Based test");
  TestReportAddMiscInfo("Regression Test", "No");
  TestReportAddMiscInfo("Fault injection method used", "No");
  TestReportAddMiscInfo("Resource usage evaluation", "No");
  TestReportAddMiscInfo("Priority", "No");
  TestReportAddMiscInfo("Safety relevant", "No");
  
  AddRequirementInfo("Requirement under test", "ARCH_SW_CIL_0238");
  AddRequirementInfo("ARCH_SW_CIL_0238", "Signal BltSlckDec_Md_XX_Stat_ST3 shall be computed based on signal BltSlckDec_Md_Rq_HU_ST3 using NVP_u8BeltSlkDecMode: Off when Request is OFF (0) On When request is ON (1) Last valid value when request is SNA).");
  //***************************************************************************************
  
  testCaseComment("Preconditions");
  testStep("STEP", "Bench Initialization");
  RunPreTs();
  
  
    testStep("STEP", "Set signal BltSlckDec_Md_Rq_HU_ST3 to I_C02_OFF_ON_OFF.");
    setSignal(BODY3::BltSlckDec_Md_Rq_HU_ST3, 0);
  
    testStep("STEP", "Set a breakpoint in function CIL_runAppliToCAN().");
    debugger_setRelativeFunctionBpAtLine("CIL_runAppliToCAN", 33);
  
    testStep("STEP", "Check if CPU stopped in function CIL_runAppliToCAN(). --> CPU is Stopped");
    debugger_isCPUStoppedAtFunction("CIL_runAppliToCAN");
  
  
    debugger_deleteAllBP();
  
    
    testStep("STEP", "Set a breakpoint in function cil_ManageOutputSignals() at line '(void)Rte_Write_CIL_AC_CommunicationInteractionLayer_IF_BltSlckDec_Md_XX_Stat_ST3_BltSlckDec_Md_XX_Stat_ST3(CIL_u8BltSlckDec_Md);'.");
    debugger_setBpAtLine("s:\\Components\\Application\\Autoliv\\CIL\\Implementation\\src\\CIL_AppliToCAN.c\\", 645);
  
    debugger_run();
    testWaitForTimeoutSilent(500);
  
    testStep("STEP", "Check if CPU stopped at line '(void)Rte_Write_CIL_AC_CommunicationInteractionLayer_IF_BltSlckDec_Md_XX_Stat_ST3_BltSlckDec_Md_XX_Stat_ST3(CIL_u8BltSlckDec_Md);'. --> CPU is Stopped");
    debugger_isCPUStoppedAtFunction("cil_ManageOutputSignals");
  
    debugger_deleteAllBP();
    debugger_run();  
  
    testCaseComment("Action: ARCH_SW_CIL_0238");
    testStep("STEP", "Evaluate if signal BltSlckDec_Md_FL_Stat_ST3 is equal to I_C02_OFF_ON_OFF. --> I_C02_OFF_ON_OFF");
    EvalManStepEqual("Expected Test Result", $BltSlckDec_Md_FL_Stat_ST3.raw64, 0);
  
  
    debugger_deleteAllBP();
    debugger_reset();
    debugger_run();  
  
  
    testStep("STEP", "Set signal BltSlckDec_Md_Rq_HU_ST3 to I_C02_OFF_ON_ON.");
    setSignal(BODY3::BltSlckDec_Md_Rq_HU_ST3, 1);
  
  
    testStep("STEP", "Set a breakpoint in function cil_ManageOutputSignals() at line '(void)Rte_Write_CIL_AC_CommunicationInteractionLayer_IF_BltSlckDec_Md_XX_Stat_ST3_BltSlckDec_Md_XX_Stat_ST3(CIL_u8BltSlckDec_Md);'.");
    debugger_setBpAtLine("s:\\Components\\Application\\Autoliv\\CIL\\Implementation\\src\\CIL_AppliToCAN.c\\", 645);
  
    testWaitForTimeoutSilent(500);
  
    testStep("STEP", "Check if CPU stopped at line '(void)Rte_Write_CIL_AC_CommunicationInteractionLayer_IF_BltSlckDec_Md_XX_Stat_ST3_BltSlckDec_Md_XX_Stat_ST3(CIL_u8BltSlckDec_Md);'. --> CPU is Stopped");
    debugger_isCPUStoppedAtFunction("cil_ManageOutputSignals");
  
  
    debugger_deleteAllBP();
    debugger_run();  
  
  
    testCaseComment("Action: ARCH_SW_CIL_0238");
    testStep("STEP", "Evaluate if signal BltSlckDec_Md_FL_Stat_ST3 is equal to I_C02_OFF_ON_OFF. --> I_C02_OFF_ON_OFF");
    EvalManStepEqual("Expected Test Result", $BltSlckDec_Md_FL_Stat_ST3.raw64, 0);
  
  
  testCaseComment("Postcondition");
  testStep("STEP", "Return ECU to default values");
  RunPostTs(); 
}


testcase SW_IT_CIL_CheckImplausibleData_03()
{
  //***********************************Test report header*********************************
  testReportAddMiscInfoBlock("AUTOLIV ELECTRONICS document");
  TestReportAddMiscInfo("Nightly test", "No");
  TestReportAddMiscInfo("Test type", "Requirement-Based test");
  TestReportAddMiscInfo("Regression Test", "No");
  TestReportAddMiscInfo("Fault injection method used", "No");
  TestReportAddMiscInfo("Resource usage evaluation", "No");
  TestReportAddMiscInfo("Priority", "No");
  TestReportAddMiscInfo("Safety relevant", "No");
  
  AddRequirementInfo("Requirement under test", "ARCH_SW_CIL_0416");
  AddRequirementInfo("ARCH_SW_CIL_0416", "SBeltTens_SP_Lvl_ST3 shall be evaluated to set the specified autotest to OK/NOK.");
  //***************************************************************************************
    
  testCaseComment("Preconditions");
  testStep("STEP", "Bench Initialization");
  RunPreTs();

    
    testStep("STEP", "Set a breakpoint in function CIL_Autotest_CheckImplausibleData_API() at line 'cil_u8ResultOfAutoTest = KU8_ATM_TEST_OK;'.");
    debugger_setRelativeFunctionBpAtLine("CIL_Autotest_CheckImplausibleData_API", 8);
    
    testStep("STEP", "Check if CPU stopped at line 'cil_u8ResultOfAutoTest = KU8_ATM_TEST_OK;'. --> CPU is Stopped");
    debugger_isCPUStoppedAtFunction("CIL_Autotest_CheckImplausibleData_API");
  
    testCaseComment("Action: ARCH_SW_CIL_0416");
    testStep("STEP", "Evaluate if signal SBeltTens_SP_Lvl_ST3::RBTMFL_SP_Lvl_Rq_ST35 is equal to KU8_ZERO. -->  KU8_ZERO");
    EvalManStepEqual("Expected Test Result", $SBeltTens_SP_Lvl_ST3::RBTMFL_SP_Lvl_Rq_ST35.raw64, 0);
    
  
    debugger_deleteAllBP();
    
    
    testStep("STEP", "Set a breakpoint in function CIL_Autotest_CheckImplausibleData_API() at line '*pu8TestResult = cil_u8ResultOfAutoTest;'.");
    debugger_setRelativeFunctionBpAtLine("CIL_Autotest_CheckImplausibleData_API", 16);
    
    debugger_run();
  
    testCaseComment("Action: ARCH_SW_CIL_0416");
    testStep("STEP", "Check if CPU stopped at line '*pu8TestResult = cil_u8ResultOfAutoTest;'. --> CPU is Stopped");
    debugger_isCPUStoppedAtFunction("CIL_Autotest_CheckImplausibleData_API");
  
    
    testCaseComment("Action: ARCH_SW_CIL_0416");
    testStep("STEP", "Evaluate variable *pu8TestResult. --> KU8_ATM_TEST_NOK");
    result = debugger_readLocalVariable("*(pu8TestResult)");
    EvalManStepEqual("Expected Test Result", result, 0);
  
  
  testCaseComment("Postcondition");
  testStep("STEP", "Return ECU to default values");
  RunPostTs(); 
}


testcase SW_IT_CIL_CheckImplausibleData_02()
{
  //***********************************Test report header*********************************
  testReportAddMiscInfoBlock("AUTOLIV ELECTRONICS document");
  TestReportAddMiscInfo("Nightly test", "No");
  TestReportAddMiscInfo("Test type", "Requirement-Based test");
  TestReportAddMiscInfo("Regression Test", "No");
  TestReportAddMiscInfo("Fault injection method used", "No");
  TestReportAddMiscInfo("Resource usage evaluation", "No");
  TestReportAddMiscInfo("Priority", "No");
  TestReportAddMiscInfo("Safety relevant", "No");
  
  AddRequirementInfo("Requirement under test", "ARCH_SW_CIL_0413");
  AddRequirementInfo("ARCH_SW_CIL_0413", "PT4_PTCoor_DrvPosn_Stat_ST3 shall be evaluated to set the specified autotest to OK/NOK.");
  //***************************************************************************************
    
  testCaseComment("Preconditions");
  testStep("STEP", "Bench Initialization");
  RunPreTs();

    
    testStep("STEP", "Set a breakpoint in function CIL_Autotest_CheckImplausibleData_PowertrainDrv() at line 'if(I_C04_DRVPOSN_ST3_SNA == cil_stPTCoorDrvPos.PT4_PTCoor_DrvPosn_Stat_ST3)'.");
    debugger_setRelativeFunctionBpAtLine("CIL_Autotest_CheckImplausibleData_PowertrainDrv", 0);
  
    testWaitForTimeoutSilent(500);
  
    testStep("STEP", "Check if CPU stopped at line 'if(I_C04_DRVPOSN_ST3_SNA == cil_stPTCoorDrvPos.PT4_PTCoor_DrvPosn_Stat_ST3)'. --> CPU is Stopped");
    debugger_isCPUStoppedAtFunction("CIL_Autotest_CheckImplausibleData_PowertrainDrv");
  
  
    debugger_deleteAllBP();  
  
  
    testStep("STEP", "Set a breakpoint in function CIL_Autotest_CheckImplausibleData_PowertrainDrv() at line '*pu8TestResult = cil_u8ResultOfAutoTest;'.");
    debugger_setRelativeFunctionBpAtLine("CIL_Autotest_CheckImplausibleData_PowertrainDrv", 11);

    debugger_run();
    testWaitForTimeoutSilent(500);
  
    testStep("STEP", "Check if CPU stopped at line '*pu8TestResult = cil_u8ResultOfAutoTest;'. --> CPU is Stopped");
    debugger_isCPUStoppedAtFunction("CIL_Autotest_CheckImplausibleData_PowertrainDrv");
  
    
    testCaseComment("Action: ARCH_SW_CIL_0413");
    testStep("STEP", "Evaluate variable *pu8TestResult. --> KU8_ATM_TEST_OK");
    result = debugger_readLocalVariable("*(pu8TestResult)");
    EvalManStepEqual("Expected Test Result", result, 1);
  
  
  testCaseComment("Postcondition");
  testStep("STEP", "Return ECU to default values");
  RunPostTs(); 
}


testcase SW_IT_CIL_Impact_RO_type2_01()
{
  //***********************************Test report header*********************************
  testReportAddMiscInfoBlock("AUTOLIV ELECTRONICS document");
  TestReportAddMiscInfo("Nightly test", "No");
  TestReportAddMiscInfo("Test type", "Requirement-Based test");
  TestReportAddMiscInfo("Regression Test", "No");
  TestReportAddMiscInfo("Fault injection method used", "No");
  TestReportAddMiscInfo("Resource usage evaluation", "No");
  TestReportAddMiscInfo("Priority", "No");
  TestReportAddMiscInfo("Safety relevant", "No");
  
  AddRequirementInfo("Requirement under test", "ARCH_SW_CIL_0245");
  AddRequirementInfo("ARCH_SW_CIL_0245", "If value for Impact_RO_type2_ST3 is 1 and group KU32_AEC_GROUP_MASK_EOL_MAX is set then tensioning cycle 3 shall be requested for NVP_u16TimeoutPresafe5 time.");
  //***************************************************************************************
    
  testCaseComment("Preconditions");
  testStep("STEP", "Bench Initialization");
  RunPreTs();

    testStep("STEP", "Set a breakpoint in function EOL_Autotest_CheckProductEndOfLifeMaxForce().");
    debugger_setRelativeFunctionBpAtLine("EOL_Autotest_CheckProductEndOfLifeMaxForce", 3);
  
    testStep("STEP", "Check if CPU stopped in function EOL_Autotest_CheckProductEndOfLifeMaxForce(). --> CPU is Stopped");
    debugger_isCPUStoppedAtFunction("EOL_Autotest_CheckProductEndOfLifeMaxForce"); 
  
    testStep("STEP", "Set variable NVP_BLOCK_ID_EXECUTION_COUNTERS_RamBlockData.NVP_au32ExecutedCycleCounters[KU8_EOL_MAX_FORCE_LEVEL] to NVP_u32MaxForceEOLThrs.");
    debugger_writeGlobalVariable("uint32", "NVP_BLOCK_ID_EXECUTION_COUNTERS_RamBlockData,,app.elf", 3, 50);
    debugger_deleteAllBP();        
    
  
    testStep("STEP", "Set signal Impact_RO_type2_ST3 to KU8_CIL_TRUE_ImpactRoTrigger.");
    setSignal(BODY3::Impact_RO_type2_ST3, 1);
  
  
    testStep("STEP", "Set a breakpoint in function cil_ManageInputSignals() at line 'cil_u8ORC1ActivationRequest = I_C04_PRESF_LVL_V2_LVL8'.");
    debugger_setRelativeFunctionBpAtLine("cil_ManageInputSignals", 116);

    debugger_run();
  
    testStep("STEP", "Check if CPU stopped at line 'cil_u8ORC1ActivationRequest = I_C04_PRESF_LVL_V2_LVL8'. --> CPU is Stopped");
    debugger_isCPUStoppedAtFunction("cil_ManageInputSignals");
    
  
    debugger_deleteAllBP();
  
  
    testStep("STEP", "Set a breakpoint in function CIL_runCANToAppli at line 'cil_TriggerProfiles(CIL_stManagedCycle.u8CurrentRequestedCycle);'.");
    debugger_setRelativeFunctionBpAtLine("CIL_runCANToAppli", 364);

    debugger_run();
  
    testStep("STEP", "Check if CPU stopped at line 'cil_TriggerProfiles(CIL_stManagedCycle.u8CurrentRequestedCycle);'. --> CPU is Stopped");
    debugger_isCPUStoppedAtFunction("CIL_runCANToAppli");

  
    debugger_deleteAllBP();
  
  
    testStep("STEP", "Set a breakpoint in function cil_TriggerProfile() at line '(void)Rte_Read_prrEnableCycle3_b8CycleValidity(&u8CycleValidityStatus); under case I_C04_PRESF_LVL_V2_LVL8.' and press run.");
    debugger_setRelativeFunctionBpAtLine("cil_TriggerProfiles", 317);
  
    debugger_run();
  
    testCaseComment("Action: ARCH_SW_CIL_0245");
    testStep("STEP", "Check if CPU stopped at line '(void)Rte_Read_prrEnableCycle3_b8CycleValidity(&u8CycleValidityStatus);'. --> CPU is Stopped");
    debugger_isCPUStoppedAtFunction("cil_TriggerProfiles");
  
  
    debugger_deleteAllBP();
    
  
    testStep("STEP", "Set a breakpoint in function cil_RequestTensioning at line 'cil_u16Presafe5Timeout++;'.");
    debugger_setRelativeFunctionBpAtLine("cil_RequestTensioning", 11);
  
    debugger_run();
  
    testCaseComment("Action: ARCH_SW_CIL_0245");
    testStep("STEP", "Check if CPU stopped at line 'cil_u16Presafe5Timeout++;'. --> CPU is Stopped");
    debugger_isCPUStoppedAtFunction("cil_RequestTensioning");
  
  
  testCaseComment("Postcondition");
  testStep("STEP", "Return ECU to default values");
  setSignal(BODY3::Impact_RO_type2_ST3, 0);
  RunPostTs(); 
}


testcase SW_IT_CIL_Impact_RO_type1_01()
{
  //***********************************Test report header*********************************
  testReportAddMiscInfoBlock("AUTOLIV ELECTRONICS document");
  TestReportAddMiscInfo("Nightly test", "No");
  TestReportAddMiscInfo("Test type", "Requirement-Based test");
  TestReportAddMiscInfo("Regression Test", "No");
  TestReportAddMiscInfo("Fault injection method used", "No");
  TestReportAddMiscInfo("Resource usage evaluation", "No");
  TestReportAddMiscInfo("Priority", "No");
  TestReportAddMiscInfo("Safety relevant", "No");
  
  AddRequirementInfo("Requirement under test", "ARCH_SW_CIL_0244");
  AddRequirementInfo("ARCH_SW_CIL_0244", "If value for Impact_RO_type1_ST3 is 1 and group KU32_AEC_GROUP_MASK_EOL_MAX is set then tensioning cycle 3 shall be requested for NVP_u16TimeoutPresafe5 time.");
  //***************************************************************************************
    
  testCaseComment("Preconditions");
  testStep("STEP", "Bench Initialization");
  RunPreTs();
  

    testStep("STEP", "Set a breakpoint in function EOL_Autotest_CheckProductEndOfLifeMaxForce().");
    debugger_setRelativeFunctionBpAtLine("EOL_Autotest_CheckProductEndOfLifeMaxForce", 3);
  
    testStep("STEP", "Check if CPU stopped in function EOL_Autotest_CheckProductEndOfLifeMaxForce(). --> CPU is Stopped");
    debugger_isCPUStoppedAtFunction("EOL_Autotest_CheckProductEndOfLifeMaxForce");
  
    testStep("STEP", "Set variable NVP_BLOCK_ID_EXECUTION_COUNTERS_RamBlockData.NVP_au32ExecutedCycleCounters[KU8_EOL_MAX_FORCE_LEVEL] to NVP_u32MaxForceEOLThrs.");
    debugger_writeGlobalVariable("uint32", "NVP_BLOCK_ID_EXECUTION_COUNTERS_RamBlockData,,app.elf", 3, 50);
    debugger_deleteAllBP();    
    
  
    testStep("STEP", "Set signal Impact_RO_type1_ST3 to KU8_CIL_TRUE_ImpactRoTrigger.");
    setSignal(BODY3::Impact_RO_type1_ST3, 1); 
    testWaitForTimeout(500);
  
  
    testStep("STEP", "Set a breakpoint in function cil_ManageInputSignals() at line 'cil_u8ORC1ActivationRequest = I_C04_PRESF_LVL_V2_LVL8'.");
    debugger_setRelativeFunctionBpAtLine("cil_ManageInputSignals", 116);

    debugger_run();
  
    testStep("STEP", "Check if CPU stopped at line 'cil_u8ORC1ActivationRequest = I_C04_PRESF_LVL_V2_LVL8'. --> CPU is Stopped");
    debugger_isCPUStoppedAtFunction("cil_ManageInputSignals");
  
    
    debugger_deleteAllBP();
  
  
    testStep("STEP", "Set a breakpoint in function CIL_runCANToAppli at line 'cil_TriggerProfiles(CIL_stManagedCycle.u8CurrentRequestedCycle);'.");
    debugger_setRelativeFunctionBpAtLine("CIL_runCANToAppli", 364);

    debugger_run();
  
    testStep("STEP", "Check if CPU stopped at line 'cil_TriggerProfiles(CIL_stManagedCycle.u8CurrentRequestedCycle);'. --> CPU is Stopped");
    debugger_isCPUStoppedAtFunction("CIL_runCANToAppli");
  

    debugger_deleteAllBP();
  
  
    testStep("STEP", "Set a breakpoint in function cil_TriggerProfile() at line '(void)Rte_Read_prrEnableCycle3_b8CycleValidity(&u8CycleValidityStatus); under case I_C04_PRESF_LVL_V2_LVL8.' and press run.");
    debugger_setRelativeFunctionBpAtLine("cil_TriggerProfiles", 317);
  
    debugger_run();
  
    testCaseComment("Action: ARCH_SW_CIL_0244");
    testStep("STEP", "Check if CPU stopped at line '(void)Rte_Read_prrEnableCycle3_b8CycleValidity(&u8CycleValidityStatus);'. --> CPU is Stopped");
    debugger_isCPUStoppedAtFunction("cil_TriggerProfiles");
  
  
    debugger_deleteAllBP();
    
  
    testStep("STEP", "Set a breakpoint in function cil_RequestTensioning at line 'cil_u16Presafe5Timeout++;'.");
    debugger_setRelativeFunctionBpAtLine("cil_RequestTensioning", 11);
  
    debugger_run();
  
    testCaseComment("Action: ARCH_SW_CIL_0244");
    testStep("STEP", "Check if CPU stopped at line 'cil_u16Presafe5Timeout++;'. --> CPU is Stopped");
    debugger_isCPUStoppedAtFunction("cil_RequestTensioning");
  
  
  testCaseComment("Postcondition");
  testStep("STEP", "Return ECU to default values");
  setSignal(BODY3::Impact_RO_type1_ST3, 0);
  RunPostTs(); 
}


testcase SW_IT_CIL_BltSlckDec_01() 
{
  //***********************************Test report header*********************************
  testReportAddMiscInfoBlock("AUTOLIV ELECTRONICS document");
  TestReportAddMiscInfo("Nightly test", "No");
  TestReportAddMiscInfo("Test type", "Requirement-Based test");
  TestReportAddMiscInfo("Regression Test", "No");
  TestReportAddMiscInfo("Fault injection method used", "No");
  TestReportAddMiscInfo("Resource usage evaluation", "No");
  TestReportAddMiscInfo("Priority", "No");
  TestReportAddMiscInfo("Safety relevant", "No");
  
  AddRequirementInfo("Requirement under test", "ARCH_SW_CIL_0260, ARCH_SW_CIL_0237, ARCH_SW_CIL_0240");
  AddRequirementInfo("ARCH_SW_CIL_0260", "If value for BltSlckDec_Md_XX_Stat_ST3 is not 1 (is 0,3) then BSR1 CYCLE by Algo shall be inhibitted.");
  AddRequirementInfo("ARCH_SW_CIL_0237", "Signal BltSlckDec_Md_Rq_HU_ST3 shall be send though application when it’s needed (0,1,3).");
  AddRequirementInfo("ARCH_SW_CIL_0240", "BSR1 profile (request on algorithm) shall be inhibitted if BltSlckDec_Md_XX_Stat_ST3 is OFF.");
  //***************************************************************************************
  
  testCaseComment("Preconditions");
  testStep("STEP", "Bench Initialization");
  RunPreTs();
  
  
    testStep("STEP", "Set signal BltSlckDec_Md_Rq_HU_ST3 to I_C02_OFF_ON_OFF.");
    setSignal(BODY3::BltSlckDec_Md_Rq_HU_ST3, 0);
    testWaitForTimeoutSilent(150);
    testStep("STEP", "Evaluate if signal BltSlckDec_Md_FL_Stat_ST3 is I_C02_OFF_ON_OFF.");
    EvalManStepEqual("Expected Test Result", $BltSlckDec_Md_FL_Stat_ST3.raw64, 0);
    
  
    testStep("STEP", "Set a breakpoint in function CIL_runCANToAppli at line 'cil_ManageInputSignals();'.");
    debugger_setRelativeFunctionBpAtLine("CIL_runCANToAppli", 5);
    
    testStep("STEP", "Step in function cil_ManageInputSignals(). --> Stepped in function cil_ManageInputSignals");
    debugger_stepIn();
    testWaitForTimeoutSilent(500);
  
  
    debugger_deleteAllBP();
    
    
    testStep("STEP", "Set a breakpoint in function cil_ManageInputSignals() at line 'cil_ManageInhibitConditions();' and run.");
    debugger_setRelativeFunctionBpAtLine("cil_ManageInputSignals", 250);
  
    debugger_run();
    testWaitForTimeoutSilent(500);
  
    testStep("STEP", "Check if CPU stopped at line 'cil_ManageInhibitConditions();'. --> CPU is Stopped");
    debugger_isCPUStoppedAtFunction("cil_ManageInputSignals");
  
  
    debugger_deleteAllBP();

  
    testStep("STEP", "Set a breakpoint in function cil_ManageInhibitConditions() at line 'CIL_SET_INHIB_MASK_ON (KU8_CIL_DTCInhibitionOfBSR);'.");
    debugger_setRelativeFunctionBpAtLine("cil_ManageInhibitConditions", 263);
   
    debugger_run();
    testWaitForTimeoutSilent(500);
  
    testCaseComment("Action: ARCH_SW_CIL_0260, ARCH_SW_CIL_0237, ARCH_SW_CIL_0240");
    testStep("STEP", "Check if CPU stopped in function cil_ManageInhibitConditions() at line 'CIL_SET_INHIB_MASK_ON (KU8_CIL_DTCInhibitionOfBSR);'. --> CPU is Stopped");
    debugger_isCPUStoppedAtFunction("cil_ManageInhibitConditions");
  
  
  testCaseComment("Postcondition");
  testStep("STEP", "Return ECU to default values");
  RunPostTs(); 
}


testcase SW_IT_CIL_prrEnableCycle3_05()
{
  //***********************************Test report header*********************************
  testReportAddMiscInfoBlock("AUTOLIV ELECTRONICS document");
  TestReportAddMiscInfo("Nightly test", "No");
  TestReportAddMiscInfo("Test type", "Requirement-Based test");
  TestReportAddMiscInfo("Regression Test", "No");
  TestReportAddMiscInfo("Fault injection method used", "No");
  TestReportAddMiscInfo("Resource usage evaluation", "No");
  TestReportAddMiscInfo("Priority", "No");
  TestReportAddMiscInfo("Safety relevant", "No");
  
  AddRequirementInfo("Requirement under test", "ARCH_SW_CIL_0243, ARCH_SW_CIL_0246, ARCH_SW_CIL_0251");
  AddRequirementInfo("ARCH_SW_CIL_0246", "If signal is received with value 8 and group KU32_AEC_GROUP_MASK_EOL_MAX is set then tensioning cycle 3 shall be requested for NVP_u16TimeoutPresafe5 time.");
  AddRequirementInfo("ARCH_SW_CIL_0251", "If signal is received with value 8 and group KU32_AEC_GROUP_MASK_EOL_MAX is set then tensioning cycle 3 shall be requested for NVP_u16TimeoutPresafe5 time.");
  AddRequirementInfo("ARCH_SW_CIL_0243", "If signal is received with value 8 and group KU32_AEC_GROUP_MASK_EOL_MAX is set then tensioning cycle 3 shall be requested for NVP_u16TimeoutPresafe5 time.");
  //***************************************************************************************
    
  testCaseComment("Preconditions");
  testStep("STEP", "Bench Initialization");
  RunPreTs();


    testStep("STEP", "Set a breakpoint in function EOL_Autotest_CheckProductEndOfLifeMaxForce().");
    debugger_setRelativeFunctionBpAtLine("EOL_Autotest_CheckProductEndOfLifeMaxForce", 3);
  
    testStep("STEP", "Check if CPU stopped in function EOL_Autotest_CheckProductEndOfLifeMaxForce(). --> CPU is Stopped");
    debugger_WaitUntilBPisReached(1000);
  
    testStep("STEP", "Set variable NVP_BLOCK_ID_EXECUTION_COUNTERS_RamBlockData.NVP_au32ExecutedCycleCounters[KU8_EOL_MAX_FORCE_LEVEL] to NVP_u32MaxForceEOLThrs.");
    debugger_writeGlobalVariable("uint32", "NVP_BLOCK_ID_EXECUTION_COUNTERS_RamBlockData,,app.elf", 3, 50);
  
      
    testStep("STEP", "Set signal RBTMFL_SP_Lvl_Rq_ST35 to I_C04_PRESF_LVL_V2_LVL8.");
    setSignal(BODY3::Presf_Lvl_ST3, 8); 
    testWaitForTimeout(500);
  
  
    debugger_deleteAllBP();  
  
  
    testStep("STEP", "Set a breakpoint in function CIL_runCANToAppli at line 'cil_TriggerProfiles(CIL_stManagedCycle.u8CurrentRequestedCycle);'.");
    debugger_setRelativeFunctionBpAtLine("CIL_runCANToAppli", 450);

    debugger_run();
  
    testStep("STEP", "Check if CPU stopped in function CIL_runCANToAppli at line 'cil_TriggerProfiles(CIL_stManagedCycle.u8CurrentRequestedCycle);'. --> CPU is Stopped");
    debugger_WaitUntilBPisReached(1000);

  
    debugger_deleteAllBP();
  
  
    testStep("STEP", "Set a breakpoint in function cil_TriggerProfile() at line '(void)Rte_Read_prrEnableCycle3_b8CycleValidity(&u8CycleValidityStatus); under case I_C04_PRESF_LVL_V2_LVL8.' and press run.");
    debugger_setRelativeFunctionBpAtLine("cil_TriggerProfiles", 328);
  
    debugger_run();
  
    testCaseComment("Action: ARCH_SW_CIL_0243, ARCH_SW_CIL_0246, ARCH_SW_CIL_0251");
    testStep("STEP", "Check if CPU stopped in function cil_TriggerProfile() at line '(void)Rte_Read_prrEnableCycle3_b8CycleValidity(&u8CycleValidityStatus);'. --> CPU is Stopped");
    debugger_WaitUntilBPisReached(1000);
  
  
    debugger_deleteAllBP();
  
  
    testStep("STEP", "Set a breakpoint in function cil_RequestTensioning at line 'if (cil_u8Presafe5specialRequestSource != CIL_stManagedCycle.u8RequestSource)'.");
    debugger_setRelativeFunctionBpAtLine("cil_RequestTensioning", 13);
  
    debugger_run();
  
    testStep("STEP", "Check if CPU stopped in function cil_RequestTensioning at line 'if (cil_u8Presafe5specialRequestSource != CIL_stManagedCycle.u8RequestSource)'. --> CPU is Stopped");
    debugger_WaitUntilBPisReached(1000);
  
  
    debugger_deleteAllBP();
    debugger_run();
    Wait(5100);
    
  
    testCaseComment("Action: ARCH_SW_CIL_0243, ARCH_SW_CIL_0246, ARCH_SW_CIL_0251");
    testStep("STEP", "Evaluate if variable cil_u16Presafe5Timeout is equal to NVP_u16TimeoutPresafe5. --> cil_u16Presafe5Timeout is equal to NVP_u16TimeoutPresafe5");
    result = debugger_readGlobalVariable("uint16", "cil_u16Presafe5Timeout,,app.elf", 0);
    EvalManStepEqual("Expected Test Result", result - 1, 500); 
  
  
  testCaseComment("Postcondition");
  testStep("STEP", "Return ECU to default values");
  setSignal(BODY3::Presf_Lvl_ST3, 0);
  RunPostTs(); 
}


testcase SW_IT_CIL_prrEnableCycle3_03()
{
  //***********************************Test report header*********************************
  testReportAddMiscInfoBlock("AUTOLIV ELECTRONICS document");
  TestReportAddMiscInfo("Nightly test", "No");
  TestReportAddMiscInfo("Test type", "Requirement-Based test");
  TestReportAddMiscInfo("Regression Test", "No");
  TestReportAddMiscInfo("Fault injection method used", "No");
  TestReportAddMiscInfo("Resource usage evaluation", "No");
  TestReportAddMiscInfo("Priority", "No");
  TestReportAddMiscInfo("Safety relevant", "No");
  
  AddRequirementInfo("Requirement under test", "ARCH_SW_CIL_0248, ARCH_SW_CIL_0250, ARCH_SW_CIL_0242");
  AddRequirementInfo("ARCH_SW_CIL_0248", "If signal is received with value 7 and group KU32_AEC_GROUP_MASK_EOL_MAX is set then tensioning cycle 3 shall be requested.");
  AddRequirementInfo("ARCH_SW_CIL_0250", "If signal is received with value 7 and group KU32_AEC_GROUP_MASK_EOL_MAX is set then tensioning cycle 3 shall be requested.");
  AddRequirementInfo("ARCH_SW_CIL_0242", "If signal is received with value 7 and group KU32_AEC_GROUP_MASK_EOL_MAX is set then tensioning cycle 3 shall be requested.");
  //***************************************************************************************
    
  testCaseComment("Preconditions");
  testStep("STEP", "Bench Initialization");
  RunPreTs();
  
  
    testStep("STEP", "Set a breakpoint in function EOL_Autotest_CheckProductEndOfLifeMaxForce().");
    debugger_setRelativeFunctionBpAtLine("EOL_Autotest_CheckProductEndOfLifeMaxForce", 3);
  
    testStep("STEP", "Check if CPU stopped in function EOL_Autotest_CheckProductEndOfLifeMaxForce(). --> CPU is Stopped");
    debugger_isCPUStoppedAtFunction("EOL_Autotest_CheckProductEndOfLifeMaxForce"); 
  
    testStep("STEP", "Set variable NVP_BLOCK_ID_EXECUTION_COUNTERS_RamBlockData.NVP_au32ExecutedCycleCounters[KU8_EOL_MAX_FORCE_LEVEL] to NVP_u32MaxForceEOLThrs.");
    debugger_writeGlobalVariable("uint32", "NVP_BLOCK_ID_EXECUTION_COUNTERS_RamBlockData,,app.elf", 3, 50);
    testWaitForTimeout(500);
  
  
    testStep("STEP", "Set signal Presf_Lvl_ST3  to I_C04_PRESF_LVL_V2_LVL7.");
    setSignal(BODY3::Presf_Lvl_ST3 , 7);
    testWaitForTimeoutSilent(500);
  
  
    testStep("STEP", "Set a breakpoint in function CIL_runCANToAppli at line 'cil_TriggerProfiles(CIL_stManagedCycle.u8CurrentRequestedCycle);'.");
    debugger_setRelativeFunctionBpAtLine("CIL_runCANToAppli", 364);
    testWaitForTimeoutSilent(500);

    testStep("STEP", "Check if CPU stopped at line 'cil_TriggerProfiles(CIL_stManagedCycle.u8CurrentRequestedCycle);'. --> CPU is Stopped");
    debugger_isCPUStoppedAtFunction("CIL_runCANToAppli");
  
  
    debugger_deleteAllBP();
  

    testStep("STEP", "Set a breakpoint in function cil_TriggerProfile at line '(void)Rte_Read_prrEnableCycle3_b8CycleValidity(&u8CycleValidityStatus);' under case I_C04_PRESF_LVL_V2_LVL7 and press run.");
    debugger_setRelativeFunctionBpAtLine("cil_TriggerProfiles", 278);
  
    debugger_run();
    
    testWaitForTimeout(500);
    testCaseComment("Action: ARCH_SW_CIL_0242, ARCH_SW_CIL_0248, ARCH_SW_CIL_0250");
    testStep("STEP", "Check if CPU stopped at line '(void)Rte_Read_prrEnableCycle3_b8CycleValidity(&u8CycleValidityStatus);'. --> CPU is Stopped");
    debugger_isCPUStoppedAtFunction("cil_TriggerProfiles");
  
  
  testCaseComment("Postcondition");
  testStep("STEP", "Return ECU to default values");
  setSignal(BODY3::Presf_Lvl_ST3, 0);
  RunPostTs(); 
}


testcase SW_IT_CIL_prrEnableCycle3_02()
{
  //***********************************Test report header*********************************
  testReportAddMiscInfoBlock("AUTOLIV ELECTRONICS document");
  TestReportAddMiscInfo("Nightly test", "No");
  TestReportAddMiscInfo("Test type", "Requirement-Based test");
  TestReportAddMiscInfo("Regression Test", "No");
  TestReportAddMiscInfo("Fault injection method used", "No");
  TestReportAddMiscInfo("Resource usage evaluation", "No");
  TestReportAddMiscInfo("Priority", "No");
  TestReportAddMiscInfo("Safety relevant", "No");
  
  AddRequirementInfo("Requirement under test", "ARCH_SW_CIL_0241, ARCH_SW_CIL_0247, ARCH_SW_CIL_0249");
  AddRequirementInfo("ARCH_SW_CIL_0247", "If signal is received with value 6 and group KU32_AEC_GROUP_MASK_EOL_MAX is set then tensioning cycle 3 shall be requested.");
  AddRequirementInfo("ARCH_SW_CIL_0249", "If signal is received with value 6 and group KU32_AEC_GROUP_MASK_EOL_MAX is set then tensioning cycle 3 shall be requested.");
  AddRequirementInfo("ARCH_SW_CIL_0241", "If signal is received with value 6 and group KU32_AEC_GROUP_MASK_EOL_MAX is set then tensioning cycle 3 shall be requested.");
  //***************************************************************************************
    
  testCaseComment("Preconditions");
  testStep("STEP", "Bench Initialization");
  RunPreTs();

      
    testStep("STEP", "Set a breakpoint in function EOL_Autotest_CheckProductEndOfLifeMaxForce().");
    debugger_setRelativeFunctionBpAtLine("EOL_Autotest_CheckProductEndOfLifeMaxForce", 3);
  
    testStep("STEP", "Check if CPU stopped in function EOL_Autotest_CheckProductEndOfLifeMaxForce(). --> CPU is Stopped");
    debugger_WaitUntilBPisReached(1000);
  
    testStep("STEP", "Set variable NVP_BLOCK_ID_EXECUTION_COUNTERS_RamBlockData.NVP_au32ExecutedCycleCounters[KU8_EOL_MAX_FORCE_LEVEL] to NVP_u32MaxForceEOLThrs.");
    debugger_writeGlobalVariable("uint32", "NVP_BLOCK_ID_EXECUTION_COUNTERS_RamBlockData.NVP_au32ExecutedCycleCounters,,app.elf", 3, 50);
    testWaitForTimeout(500);
  
  
    testStep("STEP", "Set signal Presf_Lvl_ST3 to I_C04_PRESF_LVL_V2_LVL6.");
    setSignal(BODY3::Presf_Lvl_ST3, 6);
    testWaitForTimeout(500);

  
    testStep("STEP", "Set a breakpoint in function CIL_runCANToAppli at line 'cil_TriggerProfiles(CIL_stManagedCycle.u8CurrentRequestedCycle);'.");
    debugger_setRelativeFunctionBpAtLine("CIL_runCANToAppli", 450);
    testWaitForTimeoutSilent(500);

    testStep("STEP", "Check if CPU stopped at line 'cil_TriggerProfiles(CIL_stManagedCycle.u8CurrentRequestedCycle);'. --> CPU is Stopped");
    debugger_WaitUntilBPisReached(1000);
  
  
    debugger_deleteAllBP();
  
    
    testStep("STEP", "Set a breakpoint in function cil_TriggerProfile at line 'if( (KU8_TRUE == u8CycleValidityStatus) &&' under case I_C04_PRESF_LVL_V2_LVL6 and press run.");
    debugger_setRelativeFunctionBpAtLine("cil_TriggerProfiles", 238);
  
    debugger_run();
  
    testCaseComment("Action: ARCH_SW_CIL_0241, ARCH_SW_CIL_0247, ARCH_SW_CIL_0249");
    testStep("STEP", "Check if CPU stopped at line 'if( (KU8_TRUE == u8CycleValidityStatus) &&' under case I_C04_PRESF_LVL_V2_LVL6. --> CPU is Stopped");
    debugger_WaitUntilBPisReached(1000);

  
    debugger_deleteAllBP();

     
    testStep("STEP", "Set a breakpoint in function cil_RequestTensioning.");
    debugger_setRelativeFunctionBpAtLine("cil_RequestTensioning", 2);
  
    debugger_run();

    testStep("STEP", "Check if CPU stopped in function cil_RequestTensioning. --> CPU is Stopped");
    debugger_WaitUntilBPisReached(1000);
    
  
    testCaseComment("Action: ARCH_SW_CIL_0241, ARCH_SW_CIL_0247, ARCH_SW_CIL_0249");
    testStep("STEP", "Evaluate if variable Rte_MMG_psrEnableCycle3_b8CycleValidity is KU8_TRUE. --> KU8_TRUE");
    result = debugger_readGlobalVariable("uint8", "Rte_MMG_psrEnableCycle3_b8CycleValidity,,app.elf", 0);
    EvalManStepEqual("Expected Test Result", result, 170); 
  
  
  testCaseComment("Postcondition");
  testStep("STEP", "Return ECU to default values");
  setSignal(BODY3::Presf_Lvl_ST3, 0);
  RunPostTs(); 
}


testcase SW_IT_CIL_prrEnableCycle28_01()
{
  //***********************************Test report header*********************************
  testReportAddMiscInfoBlock("AUTOLIV ELECTRONICS document");
  TestReportAddMiscInfo("Nightly test", "No");
  TestReportAddMiscInfo("Test type", "Requirement-Based test");
  TestReportAddMiscInfo("Regression Test", "No");
  TestReportAddMiscInfo("Fault injection method used", "No");
  TestReportAddMiscInfo("Resource usage evaluation", "No");
  TestReportAddMiscInfo("Priority", "No");
  TestReportAddMiscInfo("Safety relevant", "No");
  
  AddRequirementInfo("Requirement under test", "ARCH_SW_CIL_0225, ARCH_SW_CIL_0231");
  AddRequirementInfo("ARCH_SW_CIL_0225", "If signal is received with value 21, then cycle 28(BSR3) shall be requested.");
  AddRequirementInfo("ARCH_SW_CIL_0231", "If signal is received with value 21, then cycle 28(BSR3) shall be requested.");
  //***************************************************************************************
    
  testCaseComment("Preconditions");
  testStep("STEP", "Bench Initialization");

  RunPreTs();

    
    testStep("STEP", "Set signal RBTMFL_SP_Lvl_Rq_ST35 to I_C06_RBTM_LVL_RQ_PROFILE21.");
    setSignal(BODY3::RBTMFL_SP_Lvl_Rq_ST35, 21);
    testWaitForTimeout(500);

  
    testStep("STEP", "Set a breakpoint in function CIL_runCANToAppli at line 'cil_TriggerProfiles(CIL_stManagedCycle.u8CurrentRequestedCycle);'.");
    debugger_setRelativeFunctionBpAtLine("CIL_runCANToAppli", 364);
    testWaitForTimeoutSilent(500);
  
    testCaseComment("Action: ARCH_SW_CIL_0225, ARCH_SW_CIL_0231");
    testStep("STEP", "Check if CPU stopped at line 'cil_TriggerProfiles(CIL_stManagedCycle.u8CurrentRequestedCycle);'. --> CPU is Stopped");
    debugger_isCPUStoppedAtFunction("CIL_runCANToAppli");
    ////EvalManStepEqual("Expected Test Result", debugger_result, "CPU is Stopped");
  
    debugger_deleteAllBP();
  
    
    testStep("STEP", "Set a breakpoint in function cil_TriggerProfile at line '(void)Rte_Read_prrEnableCycle28_b8CycleValidity(&u8CycleValidityStatus);' and press run.");
    debugger_setRelativeFunctionBpAtLine("cil_TriggerProfiles", 636);
  
    debugger_run();
  
    testCaseComment("Action: ARCH_SW_CIL_0225, ARCH_SW_CIL_0231");
    testStep("STEP", "Check if CPU stopped at line '(void)Rte_Read_prrEnableCycle28_b8CycleValidity(&u8CycleValidityStatus);' and delete breakpoint. --> CPU is Stopped");
    debugger_isCPUStoppedAtFunction("cil_TriggerProfiles");
    ////EvalManStepEqual("Expected Test Result", debugger_result, "CPU is Stopped");
 

  testCaseComment("Postcondition");
  testStep("STEP", "Return ECU to default values");
  setSignal(BODY3::RBTMFL_SP_Lvl_Rq_ST35, 0);
  RunPostTs(); 
}


testcase SW_IT_CIL_prrEnableCycle27_01()
{
  //***********************************Test report header*********************************
  testReportAddMiscInfoBlock("AUTOLIV ELECTRONICS document");
  TestReportAddMiscInfo("Nightly test", "No");
  TestReportAddMiscInfo("Test type", "Requirement-Based test");
  TestReportAddMiscInfo("Regression Test", "No");
  TestReportAddMiscInfo("Fault injection method used", "No");
  TestReportAddMiscInfo("Resource usage evaluation", "No");
  TestReportAddMiscInfo("Priority", "No");
  TestReportAddMiscInfo("Safety relevant", "No");
  
  AddRequirementInfo("Requirement under test", "ARCH_SW_CIL_0224, ARCH_SW_CIL_0230");
  AddRequirementInfo("ARCH_SW_CIL_0224", "If signal is received with value 20, then cycle 27(BSR2) shall be requested.");
  AddRequirementInfo("ARCH_SW_CIL_0230", "If signal is received with value 20, then cycle 27(BSR2) shall be requested.");
  //***************************************************************************************
    
  testCaseComment("Preconditions");
  testStep("STEP", "Bench Initialization");

  RunPreTs();

    
    testStep("STEP", "Set signal RBTMFL_SP_Lvl_Rq_ST35 to I_C06_RBTM_LVL_RQ_PROFILE20.");
    setSignal(BODY3::RBTMFL_SP_Lvl_Rq_ST35, 20);
    testWaitForTimeout(500);

  
    testStep("STEP", "Set a breakpoint in function CIL_runCANToAppli at line 'cil_TriggerProfiles(CIL_stManagedCycle.u8CurrentRequestedCycle);'.");
    debugger_setRelativeFunctionBpAtLine("CIL_runCANToAppli", 364);
    testWaitForTimeoutSilent(500);
  
    testCaseComment("Action: ARCH_SW_CIL_0224, ARCH_SW_CIL_0230");
    testStep("STEP", "Check if CPU stopped at line 'cil_TriggerProfiles(CIL_stManagedCycle.u8CurrentRequestedCycle);'. --> CPU is Stopped");
    debugger_isCPUStoppedAtFunction("CIL_runCANToAppli");
    ////EvalManStepEqual("Expected Test Result", debugger_result, "CPU is Stopped");
  
    debugger_deleteAllBP();
  
    
    testStep("STEP", "Set a breakpoint in function cil_TriggerProfile at line '(void)Rte_Read_prrEnableCycle27_b8CycleValidity(&u8CycleValidityStatus);' and press run.");
    debugger_setRelativeFunctionBpAtLine("cil_TriggerProfiles", 615);
  
    debugger_run();
  
    testCaseComment("Action: ARCH_SW_CIL_0224, ARCH_SW_CIL_0230");
    testStep("STEP", "Check if CPU stopped at line '(void)Rte_Read_prrEnableCycle27_b8CycleValidity(&u8CycleValidityStatus);' and delete breakpoint. --> CPU is Stopped");
    debugger_isCPUStoppedAtFunction("cil_TriggerProfiles");
    ////EvalManStepEqual("Expected Test Result", debugger_result, "CPU is Stopped");
 

  testCaseComment("Postcondition");
  testStep("STEP", "Return ECU to default values");
  setSignal(BODY3::RBTMFL_SP_Lvl_Rq_ST35, 0);
  RunPostTs(); 
}


testcase SW_IT_CIL_prrEnableCycle26_01()
{
  //***********************************Test report header*********************************
  testReportAddMiscInfoBlock("AUTOLIV ELECTRONICS document");
  TestReportAddMiscInfo("Nightly test", "No");
  TestReportAddMiscInfo("Test type", "Requirement-Based test");
  TestReportAddMiscInfo("Regression Test", "No");
  TestReportAddMiscInfo("Fault injection method used", "No");
  TestReportAddMiscInfo("Resource usage evaluation", "No");
  TestReportAddMiscInfo("Priority", "No");
  TestReportAddMiscInfo("Safety relevant", "No");
  
  AddRequirementInfo("Requirement under test", "ARCH_SW_CIL_0223, ARCH_SW_CIL_0229");
  AddRequirementInfo("ARCH_SW_CIL_0223", "If signal is received with value 19, then cycle 26(BSR1) shall be requested.");
  AddRequirementInfo("ARCH_SW_CIL_0229", "If signal is received with value 19, then cycle 26(BSR1) shall be requested.");
  //***************************************************************************************
    
  testCaseComment("Preconditions");
  testStep("STEP", "Bench Initialization");
  RunPreTs();

    
    testStep("STEP", "Set signal RBTMFL_SP_Lvl_Rq_ST35 to I_C06_RBTM_LVL_RQ_PROFILE19.");
    setSignal(BODY3::RBTMFL_SP_Lvl_Rq_ST35, 19);
    testWaitForTimeout(500);

  
    testStep("STEP", "Set a breakpoint in function CIL_runCANToAppli at line 'cil_TriggerProfiles(CIL_stManagedCycle.u8CurrentRequestedCycle);'.");
    debugger_setRelativeFunctionBpAtLine("CIL_runCANToAppli", 450);
    testWaitForTimeoutSilent(500);
  
    testCaseComment("Action: ARCH_SW_CIL_0223, ARCH_SW_CIL_0229");
    testStep("STEP", "Check if CPU stopped at line 'cil_TriggerProfiles(CIL_stManagedCycle.u8CurrentRequestedCycle);'. --> CPU is Stopped");
    debugger_isCPUStoppedAtFunction("CIL_runCANToAppli");
  
  
    debugger_deleteAllBP();
  
    
    testStep("STEP", "Set a breakpoint in function cil_TriggerProfile at line '(void)Rte_Read_prrEnableCycle26_b8CycleValidity(&u8CycleValidityStatus);' and press run.");
    debugger_setRelativeFunctionBpAtLine("cil_TriggerProfiles", 601);
  
    debugger_run();
  
    testCaseComment("Action: ARCH_SW_CIL_0223, ARCH_SW_CIL_0229");
    testStep("STEP", "Check if CPU stopped at line '(void)Rte_Read_prrEnableCycle26_b8CycleValidity(&u8CycleValidityStatus);' and delete breakpoint. --> CPU is Stopped");
    debugger_isCPUStoppedAtFunction("cil_TriggerProfiles");
 

  testCaseComment("Postcondition");
  testStep("STEP", "Return ECU to default values");
  setSignal(BODY3::RBTMFL_SP_Lvl_Rq_ST35, 0);
  RunPostTs(); 
}


testcase SW_IT_CIL_prrEnableCycle24_01()
{
  //***********************************Test report header*********************************
  testReportAddMiscInfoBlock("AUTOLIV ELECTRONICS document");
  TestReportAddMiscInfo("Nightly test", "No");
  TestReportAddMiscInfo("Test type", "Requirement-Based test");
  TestReportAddMiscInfo("Regression Test", "No");
  TestReportAddMiscInfo("Fault injection method used", "No");
  TestReportAddMiscInfo("Resource usage evaluation", "No");
  TestReportAddMiscInfo("Priority", "No");
  TestReportAddMiscInfo("Safety relevant", "No");
  
  AddRequirementInfo("Requirement under test", "ARCH_SW_CIL_0222, ARCH_SW_CIL_0228");
  AddRequirementInfo("ARCH_SW_CIL_0222", "If signal is received with value 18, then cycle 24-25(HWA4) shall be requested.");
  AddRequirementInfo("ARCH_SW_CIL_0228", "If signal is received with value 18, then cycle 24-25(HWA4) shall be requested.");
  //***************************************************************************************
    
  testCaseComment("Preconditions");
  testStep("STEP", "Bench Initialization");
  RunPreTs();

    
    testStep("STEP", "Set signal RBTMFL_SP_Lvl_Rq_ST35 to I_C06_RBTM_LVL_RQ_PROFILE18.");
    setSignal(BODY3::RBTMFL_SP_Lvl_Rq_ST35, 18);
    testWaitForTimeout(500);

  
    testStep("STEP", "Set a breakpoint in function CIL_runCANToAppli at line 'cil_TriggerProfiles(CIL_stManagedCycle.u8CurrentRequestedCycle);'.");
    debugger_setRelativeFunctionBpAtLine("CIL_runCANToAppli", 364);
    testWaitForTimeoutSilent(500);
  
    testCaseComment("Action: ARCH_SW_CIL_0222, ARCH_SW_CIL_0228");
    testStep("STEP", "Check if CPU stopped at line 'cil_TriggerProfiles(CIL_stManagedCycle.u8CurrentRequestedCycle);'. --> CPU is Stopped");
    debugger_isCPUStoppedAtFunction("CIL_runCANToAppli");
    ////EvalManStepEqual("Expected Test Result", debugger_result, "CPU is Stopped");
  
  
    debugger_deleteAllBP();
  
    
    testStep("STEP", "Set a breakpoint in function cil_TriggerProfile at line '(void)Rte_Read_prrEnableCycle24_b8CycleValidity(&u8CycleValidityStatus);' and press run.");
    debugger_setRelativeFunctionBpAtLine("cil_TriggerProfiles", 559);
  
    debugger_run();
  
    testCaseComment("Action: ARCH_SW_CIL_0222, ARCH_SW_CIL_0228");
    testStep("STEP", "Check if CPU stopped at line '(void)Rte_Read_prrEnableCycle24_b8CycleValidity(&u8CycleValidityStatus);' and delete breakpoint. --> CPU is Stopped");
    debugger_isCPUStoppedAtFunction("cil_TriggerProfiles");
    ////EvalManStepEqual("Expected Test Result", debugger_result, "CPU is Stopped");
 

  testCaseComment("Postcondition");
  testStep("STEP", "Return ECU to default values");
  setSignal(BODY3::RBTMFL_SP_Lvl_Rq_ST35, 0);
  RunPostTs(); 
}


testcase SW_IT_CIL_prrEnableCycle22_01()
{
  //***********************************Test report header*********************************
  testReportAddMiscInfoBlock("AUTOLIV ELECTRONICS document");
  TestReportAddMiscInfo("Nightly test", "No");
  TestReportAddMiscInfo("Test type", "Requirement-Based test");
  TestReportAddMiscInfo("Regression Test", "No");
  TestReportAddMiscInfo("Fault injection method used", "No");
  TestReportAddMiscInfo("Resource usage evaluation", "No");
  TestReportAddMiscInfo("Priority", "No");
  TestReportAddMiscInfo("Safety relevant", "No");
  
  AddRequirementInfo("Requirement under test", "ARCH_SW_CIL_0221, ARCH_SW_CIL_0227");
  AddRequirementInfo("ARCH_SW_CIL_0221", "If signal is received with value 17, then cycle 22-23(HWA3) shall be requested.");
  AddRequirementInfo("ARCH_SW_CIL_0227", "If signal is received with value 17, then cycle 22-23(HWA3) shall be requested.");
  //***************************************************************************************
    
  testCaseComment("Preconditions");
  testStep("STEP", "Bench Initialization");
  RunPreTs();

    
    testStep("STEP", "Set signal RBTMFL_SP_Lvl_Rq_ST35 to I_C06_RBTM_LVL_RQ_PROFILE17.");
    setSignal(BODY3::RBTMFL_SP_Lvl_Rq_ST35, 17);
    testWaitForTimeout(500);

  
    testStep("STEP", "Set a breakpoint in function CIL_runCANToAppli at line 'cil_TriggerProfiles(CIL_stManagedCycle.u8CurrentRequestedCycle);'.");
    debugger_setRelativeFunctionBpAtLine("CIL_runCANToAppli", 364);
    testWaitForTimeoutSilent(500);
  
    testCaseComment("Action: ARCH_SW_CIL_0221, ARCH_SW_CIL_0227");
    testStep("STEP", "Check if CPU stopped at line 'cil_TriggerProfiles(CIL_stManagedCycle.u8CurrentRequestedCycle);'. --> CPU is Stopped");
    debugger_isCPUStoppedAtFunction("CIL_runCANToAppli");
    ////EvalManStepEqual("Expected Test Result", debugger_result, "CPU is Stopped");
  
  
    debugger_deleteAllBP();
  
    
    testStep("STEP", "Set a breakpoint in function cil_TriggerProfile at line '(void)Rte_Read_prrEnableCycle22_b8CycleValidity(&u8CycleValidityStatus);' and press run.");
    debugger_setRelativeFunctionBpAtLine("cil_TriggerProfiles", 523);
  
    debugger_run();
  
    testCaseComment("Action: ARCH_SW_CIL_0221, ARCH_SW_CIL_0227");
    testStep("STEP", "Check if CPU stopped at line '(void)Rte_Read_prrEnableCycle22_b8CycleValidity(&u8CycleValidityStatus);' and delete breakpoint. --> CPU is Stopped");
    debugger_isCPUStoppedAtFunction("cil_TriggerProfiles");
    ////EvalManStepEqual("Expected Test Result", debugger_result, "CPU is Stopped");
 

  testCaseComment("Postcondition");
  testStep("STEP", "Return ECU to default values");
  setSignal(BODY3::RBTMFL_SP_Lvl_Rq_ST35, 0);
  RunPostTs(); 
}


testcase SW_IT_CIL_prrEnableCycle20_01()
{
  //***********************************Test report header*********************************
  testReportAddMiscInfoBlock("AUTOLIV ELECTRONICS document");
  TestReportAddMiscInfo("Nightly test", "No");
  TestReportAddMiscInfo("Test type", "Requirement-Based test");
  TestReportAddMiscInfo("Regression Test", "No");
  TestReportAddMiscInfo("Fault injection method used", "No");
  TestReportAddMiscInfo("Resource usage evaluation", "No");
  TestReportAddMiscInfo("Priority", "No");
  TestReportAddMiscInfo("Safety relevant", "No");
  
  AddRequirementInfo("Requirement under test", "ARCH_SW_CIL_0220, ARCH_SW_CIL_0226");
  AddRequirementInfo("ARCH_SW_CIL_0220", "If signal is received with value 16, then cycle 20-21(HWA2) shall be requested.");
  AddRequirementInfo("ARCH_SW_CIL_0226", "If signal is received with value 16, then cycle 20-21(HWA2) shall be requested.");
  //***************************************************************************************
    
  testCaseComment("Preconditions");
  testStep("STEP", "Bench Initialization");
  RunPreTs();

    
    testStep("STEP", "Set signal RBTMFL_SP_Lvl_Rq_ST35 to I_C06_RBTM_LVL_RQ_PROFILE16.");
    setSignal(BODY3::RBTMFL_SP_Lvl_Rq_ST35, 16);
    testWaitForTimeout(500);

  
    testStep("STEP", "Set a breakpoint in function CIL_runCANToAppli at line 'cil_TriggerProfiles(CIL_stManagedCycle.u8CurrentRequestedCycle);'.");
    debugger_setRelativeFunctionBpAtLine("CIL_runCANToAppli", 364);
    testWaitForTimeoutSilent(500);
  
    testCaseComment("Action: ARCH_SW_CIL_0220, ARCH_SW_CIL_0226");
    testStep("STEP", "Check if CPU stopped at line 'cil_TriggerProfiles(CIL_stManagedCycle.u8CurrentRequestedCycle);'. --> CPU is Stopped");
    debugger_isCPUStoppedAtFunction("CIL_runCANToAppli");
    ////EvalManStepEqual("Expected Test Result", debugger_result, "CPU is Stopped");
  
  
    debugger_deleteAllBP();
  
    
    testStep("STEP", "Set a breakpoint in function cil_TriggerProfile at line '(void)Rte_Read_prrEnableCycle20_b8CycleValidity(&u8CycleValidityStatus);' and press run.");
    debugger_setRelativeFunctionBpAtLine("cil_TriggerProfiles", 487);
  
    debugger_run();
  
    testCaseComment("Action: ARCH_SW_CIL_0220, ARCH_SW_CIL_0226");
    testStep("STEP", "Check if CPU stopped at line '(void)Rte_Read_prrEnableCycle20_b8CycleValidity(&u8CycleValidityStatus);' and delete breakpoint. --> CPU is Stopped");
    debugger_isCPUStoppedAtFunction("cil_TriggerProfiles");
    ////EvalManStepEqual("Expected Test Result", debugger_result, "CPU is Stopped");
 

  testCaseComment("Postcondition");
  testStep("STEP", "Return ECU to default values");
  setSignal(BODY3::RBTMFL_SP_Lvl_Rq_ST35, 0);
  RunPostTs(); 
}


testcase SW_IT_CIL_PresfAccelReset_NotExcd_03() 
{
  //***********************************Test report header*********************************
  testReportAddMiscInfoBlock("AUTOLIV ELECTRONICS document");
  TestReportAddMiscInfo("Nightly test", "No");
  TestReportAddMiscInfo("Test type", "Requirement-Based test");
  TestReportAddMiscInfo("Regression Test", "No");
  TestReportAddMiscInfo("Fault injection method used", "No");
  TestReportAddMiscInfo("Resource usage evaluation", "No");
  TestReportAddMiscInfo("Priority", "No");
  TestReportAddMiscInfo("Safety relevant", "No");
  
  AddRequirementInfo("Requirement under test", "ARCH_SW_CIL_0255, ARCH_SW_CIL_0115");
  AddRequirementInfo("ARCH_SW_CIL_0255", "If PresfAccelReset_NotExcd_ST3 is '2' - Acceleration low (Release Allowed) for at lest NVP_u8Haptic1AccelerationTimeout * 10 ms than smooth release shall be executed (after each LEVEL 2 – hwa 1 cycle request on PRESAFE source configured with next cycle).");
  AddRequirementInfo("ARCH_SW_CIL_0115", "If PresfAccelReset_NotExcd_ST3 is '2' - Acceleration low (Release Allowed) for at lest NVP_u8PRESAFEAccelerationTimeout * 10 ms than smooth release shall be executed (after each PRESAFE cycle request on PRESAFE source (LEVEL 2 – HWA 1 is an exception) configured with next cycle).");
  //***************************************************************************************
  
  testCaseComment("Preconditions");
  testStep("STEP", "Bench Initialization");
  RunPreTs();
    
    
    testStep("STEP", "Set a breakpoint in function CIL_runCANToAppli at line 'cil_ManageInputSignals();'.");
    debugger_setRelativeFunctionBpAtLine("CIL_runCANToAppli", 14);
    
    testStep("STEP", "Check if CPU stopped at line 'cil_ManageInputSignals();'. --> CPU is Stopped");
    debugger_isCPUStoppedAtFunction("CIL_runCANToAppli");
    ////EvalManStepEqual("Expected Test Result", debugger_result, "CPU is Stopped");
  
  
    debugger_deleteAllBP();
    
    
    testStep("STEP", "Set a breakpoint in function cil_ManageInputSignals() at line 'cil_ManageInhibitConditions();' and run.");
    debugger_setRelativeFunctionBpAtLine("cil_ManageInputSignals", 255);
  
    debugger_run();
  
    testStep("STEP", "Check if CPU stopped at line 'cil_ManageInhibitConditions();'. --> CPU is Stopped");
    debugger_isCPUStoppedAtFunction("cil_ManageInputSignals");
    ////EvalManStepEqual("Expected Test Result", debugger_result, "CPU is Stopped");
  
  
    debugger_deleteAllBP();
  
  
    testStep("STEP", "Set a breakpoint in function cil_ManageInhibitConditions() at line 'cil_u8AccelerationTimeout = ((uint16)(NVP_BLOCK_ID_CYCLE_DELAYS_MB_RamBlockData.NVP_u8Haptic1AccelerationTimeout));'.");
    debugger_setRelativeFunctionBpAtLine("cil_ManageInhibitConditions", 119);
    
    testStep("STEP", "Set signal Presf_Lvl_ST3 to I_C04_PRESF_LVL_V2_LVL2.");
    setSignal(BODY3::Presf_Lvl_ST3, I_C04_PRESF_LVL_V2_LVL2);       
    
    debugger_run();
    testWaitForTimeoutSilent(250);
  
    testCaseComment("Action: ARCH_SW_CIL_0255");
    testStep("STEP", "Check if CPU stopped at line 'cil_u8AccelerationTimeout = ((uint16)(NVP_BLOCK_ID_CYCLE_DELAYS_MB_RamBlockData.NVP_u8Haptic1AccelerationTimeout));;'. --> CPU is Stopped");
    debugger_isCPUStoppedAtFunction("cil_ManageInhibitConditions");
    ////EvalManStepEqual("Expected Test Result", debugger_result, "CPU is Stopped");
  
  
    debugger_deleteAllBP();
  
  
    testStep("STEP", "Set a breakpoint in function cil_ManageInhibitConditions() at line 'CIL_SET_INHIB_MASK_OFF (KU8_CIL_AccLowInhibition);'.");
    debugger_setRelativeFunctionBpAtLine("cil_ManageInhibitConditions", 143);
    
    debugger_run();
  
    testCaseComment("Action: ARCH_SW_CIL_0255");
    testStep("STEP", "Check if CPU stopped at line 'CIL_SET_INHIB_MASK_OFF (KU8_CIL_AccLowInhibition);'. --> CPU is Stopped");
    debugger_isCPUStoppedAtFunction("cil_ManageInhibitConditions");
    ////EvalManStepEqual("Expected Test Result", debugger_result, "CPU is Stopped");
  
  
    testCaseComment("Action: ARCH_SW_CIL_0255, ARCH_SW_CIL_0115");
    testStep("STEP", "Evaluate if variable cil_u8AccLowCounter is equal to 0x1F. --> 0x1F");
    result = debugger_readGlobalVariable("uint8", "cil_u8AccLowCounter,,app.elf", 0);
    EvalManStepEqual("Expected Test Result", result, 0x1F);
  
  
  testCaseComment("Postcondition");
  testStep("STEP", "Return ECU to default values");
  setSignal(BODY3::Presf_Lvl_ST3, I_C04_PRESF_LVL_V2_NOLVL);
  RunPostTs(); 
}



testcase SW_IT_CIL_PresfAccelReset_NotExcd_02() 
{
  //***********************************Test report header*********************************
  testReportAddMiscInfoBlock("AUTOLIV ELECTRONICS document");
  TestReportAddMiscInfo("Nightly test", "No");
  TestReportAddMiscInfo("Test type", "Requirement-Based test");
  TestReportAddMiscInfo("Regression Test", "No");
  TestReportAddMiscInfo("Fault injection method used", "No");
  TestReportAddMiscInfo("Resource usage evaluation", "No");
  TestReportAddMiscInfo("Priority", "No");
  TestReportAddMiscInfo("Safety relevant", "No");
  
  AddRequirementInfo("Requirement under test", "ARCH_SW_CIL_0257, ARCH_SW_CIL_0239");
  AddRequirementInfo("ARCH_SW_CIL_0257", "If PresfAccelReset_NotExcd_ST3 is '2' - Acceleration low (Release Allowed) for at lest NVP_u8BSR1AccelerationTimeout * 10 ms than smooth release shall be executed (after each BSR 1 ALGO cycle request configured with next cycle).");
  AddRequirementInfo("ARCH_SW_CIL_0239", "When signal BltSlckDec_Md_XX_Stat_ST3 is trasitioning from OFF to ON then cycle 26 (BSR1) shall be executed after NVP_u8AfterMd * 5 time.");
  //***************************************************************************************
  
  testCaseComment("Preconditions");
  testStep("STEP", "Bench Initialization");
  RunPreTs();
  
  
    testStep("STEP", "Set signal BltSlckDec_Md_Rq_HU_ST3 to I_C02_OFF_ON_OFF.");
    setSignal(BODY3::BltSlckDec_Md_Rq_HU_ST3, 0);  
    
  
    testStep("STEP", "Set a breakpoint in function CIL_runCANToAppli at line 'cil_ManageInputSignals();'.");
    debugger_setRelativeFunctionBpAtLine("CIL_runCANToAppli", 14);
    
    testStep("STEP", "Check if CPU stopped at line 'cil_ManageInputSignals();'. --> CPU is Stopped");
    debugger_isCPUStoppedAtFunction("CIL_runCANToAppli");
    ////EvalManStepEqual("Expected Test Result", debugger_result, "CPU is Stopped");
  
  
    debugger_deleteAllBP();
    
    
    testStep("STEP", "Set a breakpoint in function cil_ManageInputSignals() at line 'cil_ManageInhibitConditions();' and run.");
    debugger_setRelativeFunctionBpAtLine("cil_ManageInputSignals", 255);
  
    debugger_run();
  
    testStep("STEP", "Check if CPU stopped at line 'cil_ManageInhibitConditions();'. --> CPU is Stopped");
    debugger_isCPUStoppedAtFunction("cil_ManageInputSignals");
    ////EvalManStepEqual("Expected Test Result", debugger_result, "CPU is Stopped");
  
  
    debugger_deleteAllBP();
  
  
    testStep("STEP", "Set a breakpoint in function cil_ManageInhibitConditions() at line 'cil_u8AccelerationTimeout = ((uint16)(NVP_BLOCK_ID_CYCLE_DELAYS_MB_RamBlockData.NVP_u8BSR1AccelerationTimeout));'.");
    debugger_setRelativeFunctionBpAtLine("cil_ManageInhibitConditions", 123);
    
    testStep("STEP", "Set signal BltSlckDec_Md_Rq_HU_ST3 to I_C02_OFF_ON_ON.");
    setSignal(BODY3::BltSlckDec_Md_Rq_HU_ST3, 1);
  
    debugger_run();
    testWaitForTimeoutSilent(250);
  
    testCaseComment("Action: ARCH_SW_CIL_0257");
    testStep("STEP", "Check if CPU stopped at line 'cil_u8AccelerationTimeout = ((uint16)(NVP_BLOCK_ID_CYCLE_DELAYS_MB_RamBlockData.NVP_u8BSR1AccelerationTimeout));'. --> CPU is Stopped");
    debugger_isCPUStoppedAtFunction("cil_ManageInhibitConditions");
    ////EvalManStepEqual("Expected Test Result", debugger_result, "CPU is Stopped");
  
  
    testStep("STEP", "Set a breakpoint in function cil_ManageInhibitConditions() at line 'CIL_SET_INHIB_MASK_OFF (KU8_CIL_AccLowInhibition);'.");
    debugger_setRelativeFunctionBpAtLine("cil_ManageInhibitConditions", 143);
    
    debugger_run();
  
    testCaseComment("Action: ARCH_SW_CIL_0257");
    testStep("STEP", "Check if CPU stopped at line 'CIL_SET_INHIB_MASK_OFF (KU8_CIL_AccLowInhibition);'. --> CPU is Stopped");
    debugger_isCPUStoppedAtFunction("cil_ManageInhibitConditions");
    ////EvalManStepEqual("Expected Test Result", debugger_result, "CPU is Stopped");
  
  
    testCaseComment("Action: ARCH_SW_CIL_0257");
    testStep("STEP", "Evaluate if variable cil_u8AccLowCounter is equal to 0x1F. --> 0x1F");
    result = debugger_readGlobalVariable("uint8", "cil_u8AccLowCounter,,app.elf", 0);
    EvalManStepEqual("Expected Test Result", result, 0x1F);
  
  
  testCaseComment("Postcondition");
  testStep("STEP", "Return ECU to default values");
  RunPostTs(); 
}


testcase SW_IT_CIL_PresfAccelReset_NotExcd_01() 
{
  //***********************************Test report header*********************************
  testReportAddMiscInfoBlock("AUTOLIV ELECTRONICS document");
  TestReportAddMiscInfo("Nightly test", "No");
  TestReportAddMiscInfo("Test type", "Requirement-Based test");
  TestReportAddMiscInfo("Regression Test", "No");
  TestReportAddMiscInfo("Fault injection method used", "No");
  TestReportAddMiscInfo("Resource usage evaluation", "No");
  TestReportAddMiscInfo("Priority", "No");
  TestReportAddMiscInfo("Safety relevant", "No");
  
  AddRequirementInfo("Requirement under test", "ARCH_SW_CIL_0256");
  AddRequirementInfo("ARCH_SW_CIL_0256", "If PresfAccelReset_NotExcd_ST3 is '2' - Acceleration low (Release Allowed) for at lest NVP_u8APIAccelerationTimeout * 10 ms than smooth release shall be executed (after each cycle request on API source configured with next cycle).");
  //***************************************************************************************
  
  testCaseComment("Preconditions");
  testStep("STEP", "Bench Initialization");
  RunPreTs();
  
    
    testStep("STEP", "Set a breakpoint in function CIL_runCANToAppli at line 'cil_ManageInputSignals();'.");
    debugger_setRelativeFunctionBpAtLine("CIL_runCANToAppli", 14);
    
    testStep("STEP", "Check if CPU stopped at line 'cil_ManageInputSignals();'. --> CPU is Stopped");
    debugger_isCPUStoppedAtFunction("CIL_runCANToAppli");
    ////EvalManStepEqual("Expected Test Result", debugger_result, "CPU is Stopped");
  
  
    debugger_deleteAllBP();
  
    
    testStep("STEP", "Set a breakpoint in function cil_ManageInputSignals() at line 'cil_ManageInhibitConditions();' and run.");
    debugger_setRelativeFunctionBpAtLine("cil_ManageInputSignals", 255);
  
    debugger_run();
  
    testStep("STEP", "Check if CPU stopped at line 'cil_ManageInhibitConditions();'. --> CPU is Stopped");
    debugger_isCPUStoppedAtFunction("cil_ManageInputSignals");
    ////EvalManStepEqual("Expected Test Result", debugger_result, "CPU is Stopped");
  
  
    debugger_deleteAllBP();
  
  
    testStep("STEP", "Set a breakpoint in function cil_ManageInhibitConditions() at line 'cil_u8AccelerationTimeout = ((uint16)(NVP_BLOCK_ID_CYCLE_DELAYS_MB_RamBlockData.NVP_u8APIAccelerationTimeout));'.");
    debugger_setRelativeFunctionBpAtLine("cil_ManageInhibitConditions", 111);
    
    testStep("STEP", "Set signal Presf_Lvl_ST3 to I_C06_RBTM_LVL_RQ_PROFILE9.");
    setSignal(BODY3::RBTMFL_SP_Lvl_Rq_ST35, 19);
  
    debugger_run();
    testWaitForTimeoutSilent(500);
  
    testStep("STEP", "Check if CPU stopped at line 'cil_u8AccelerationTimeout = ((uint16)(NVP_BLOCK_ID_CYCLE_DELAYS_MB_RamBlockData.NVP_u8APIAccelerationTimeout));'. --> CPU is Stopped");
debugger_isCPUStoppedAtFunction("cil_ManageInhibitConditions");    ////EvalManStepEqual("Expected Test Result", debugger_result, "CPU is Stopped");
  
    debugger_deleteAllBP();
    
  
    testStep("STEP", "Set a breakpoint in function cil_ManageInhibitConditions() at line 'CIL_SET_INHIB_MASK_OFF (KU8_CIL_AccLowInhibition);'.");
    debugger_setRelativeFunctionBpAtLine("cil_ManageInhibitConditions", 143);
    
    debugger_run();
  
    testCaseComment("Action: ARCH_SW_CIL_0256");
    testStep("STEP", "Check if CPU stopped at line 'CIL_SET_INHIB_MASK_OFF (KU8_CIL_AccLowInhibition);'. --> CPU is Stopped");
    debugger_isCPUStoppedAtFunction("cil_ManageInhibitConditions");    ////EvalManStepEqual("Expected Test Result", debugger_result, "CPU is Stopped");
  
  
    testCaseComment("Action: ARCH_SW_CIL_0256");
    testStep("STEP", "Evaluate if variable cil_u8AccLowCounter is equal to 0x1F. --> 0x1F");
    result = debugger_readGlobalVariable("uint8", "cil_u8AccLowCounter,,app.elf", 0);
    EvalManStepEqual("Expected Test Result", result, 0x1F);
    
  
  testCaseComment("Postcondition");
  testStep("STEP", "Return ECU to default values");
  setSignal(BODY3::RBTMFL_SP_Lvl_Rq_ST35, 0);
  RunPostTs(); 
}


testcase SW_IT_CIL_PresafeHWA_04() 
{
  //***********************************Test report header*********************************
  testReportAddMiscInfoBlock("AUTOLIV ELECTRONICS document");
  TestReportAddMiscInfo("Nightly test", "No");
  TestReportAddMiscInfo("Test type", "Requirement-Based test");
  TestReportAddMiscInfo("Regression Test", "No");
  TestReportAddMiscInfo("Fault injection method used", "No");
  TestReportAddMiscInfo("Resource usage evaluation", "No");
  TestReportAddMiscInfo("Priority", "No");
  TestReportAddMiscInfo("Safety relevant", "No");
  
  AddRequirementInfo("Requirement under test", "ARCH_SW_CIL_0234");
  AddRequirementInfo("ARCH_SW_CIL_0234", "If PRE-SAFE18 – HAPTIC4 (cycle 24 or cycle 25)  (and his next cycle ) is executed then RBTM _FL/FR Actv_Lvl_ST35 should be 0x12 = “HAPTIC4” no matter the source of the request: API interface, diagnostic.");
  //***************************************************************************************
  
  testCaseComment("Preconditions");
  testStep("STEP", "Bench Initialization");
  RunPreTs();
  
  
    testStep("STEP", "Set signal RBTMFL_SP_Lvl_Rq_ST35 to I_C06_RBTM_LVL_RQ_PROFILE18.");
    setSignal(BODY3::RBTMFL_SP_Lvl_Rq_ST35, 18);
  
  
    testStep("STEP", "Set a breakpoint in function CIL_runAppliToCAN().");
    debugger_setRelativeFunctionBpAtLine("CIL_runAppliToCAN", 0);
  
    testStep("STEP", "Check if CPU stopped in function CIL_runAppliToCAN(). --> CPU is Stopped");
    debugger_isCPUStoppedAtFunction("CIL_runAppliToCAN");    ////EvalManStepEqual("Expected Test Result", debugger_result, "CPU is Stopped");
  
  
    debugger_deleteAllBP();
  
    
    testStep("STEP", "Set a breakpoint in function cil_ManageActiveLevelSignal() at line 'CIL_u8Actv_Lvl = I_C06_RBTM_LVL_STAT_PROFILE18;' under 'case KU8_CIL_HWA40_CYCLE:'.");
    debugger_setBpAtLine("s:\\Components\\Application\\Autoliv\\CIL\\Implementation\\src\\CIL_AppliToCAN.c\\", 594);
  
    debugger_run();
  
    testCaseComment("Action: ARCH_SW_CIL_0234");
    testStep("STEP", "Check if CPU stopped  at line 'CIL_u8Actv_Lvl = I_C06_RBTM_LVL_STAT_PROFILE18;' under 'case KU8_CIL_HWA40_CYCLE:'. --> CPU is Stopped");
    debugger_isCPUStoppedAtFunction("cil_ManageActiveLevelSignal");
    ////EvalManStepEqual("Expected Test Result", debugger_result, "CPU is Stopped");
  
    debugger_deleteAllBP();
    debugger_run();
  
    
    testCaseComment("Action: ARCH_SW_CIL_0234");
    testStep("STEP", "Evaluate if signal RBTMFL_Actv_Lvl_ST35 is equal with I_C06_RBTM_LVL_STAT_PROFILE18. --> I_C06_RBTM_LVL_STAT_PROFILE18");
    EvalManStepEqual("Expected Test Result", $RBTMFL_Actv_Lvl_ST35.raw64, 18);
  
  
  testCaseComment("Postcondition");
  testStep("STEP", "Return ECU to default values");
  setSignal(BODY3::RBTMFL_SP_Lvl_Rq_ST35, 0);
  RunPostTs(); 
}


testcase SW_IT_CIL_PresafeHWA_03() 
{
  //***********************************Test report header*********************************
  testReportAddMiscInfoBlock("AUTOLIV ELECTRONICS document");
  TestReportAddMiscInfo("Nightly test", "No");
  TestReportAddMiscInfo("Test type", "Requirement-Based test");
  TestReportAddMiscInfo("Regression Test", "No");
  TestReportAddMiscInfo("Fault injection method used", "No");
  TestReportAddMiscInfo("Resource usage evaluation", "No");
  TestReportAddMiscInfo("Priority", "No");
  TestReportAddMiscInfo("Safety relevant", "No");
  
  AddRequirementInfo("Requirement under test", "ARCH_SW_CIL_0233");
  AddRequirementInfo("ARCH_SW_CIL_0233", "If PRE-SAFE17 – HAPTIC3 (cycle 22 or cycle 23)  (and his next cycle ) is executed then RBTM _FL/FR Actv_Lvl_ST35 should be 0x11 = “HAPTIC3” no matter the source of the request: API interface, diagnostic.");
  //***************************************************************************************
  
  testCaseComment("Preconditions");
  testStep("STEP", "Bench Initialization");
  RunPreTs();
  
  
    testStep("STEP", "Set signal RBTMFL_SP_Lvl_Rq_ST35 to I_C06_RBTM_LVL_RQ_PROFILE17.");
    setSignal(BODY3::RBTMFL_SP_Lvl_Rq_ST35, 17);
  
    testStep("STEP", "Set a breakpoint in function CIL_runAppliToCAN().");
    debugger_setRelativeFunctionBpAtLine("CIL_runAppliToCAN", 0);
  
    testStep("STEP", "Check if CPU stopped in function CIL_runAppliToCAN(). --> CPU is Stopped");
    debugger_isCPUStoppedAtFunction("CIL_runAppliToCAN");    ////EvalManStepEqual("Expected Test Result", debugger_result, "CPU is Stopped");
  
    debugger_deleteAllBP();
  
    
    testStep("STEP", "Set a breakpoint in function cil_ManageActiveLevelSignal() at line 'CIL_u8Actv_Lvl = I_C06_RBTM_LVL_STAT_PROFILE17;' under 'case KU8_CIL_HWA30_CYCLE:'.");
    debugger_setBpAtLine("s:\\Components\\Application\\Autoliv\\CIL\\Implementation\\src\\CIL_AppliToCAN.c\\", 589);
  
    debugger_run();
  
    testCaseComment("Action: ARCH_SW_CIL_0233");
    testStep("STEP", "Check if CPU stopped  at line 'CIL_u8Actv_Lvl = I_C06_RBTM_LVL_STAT_PROFILE17;' under 'case KU8_CIL_HWA30_CYCLE:'. --> CPU is Stopped");
    debugger_isCPUStoppedAtFunction("cil_ManageActiveLevelSignal");
    ////EvalManStepEqual("Expected Test Result", debugger_result, "CPU is Stopped");
  
  
    debugger_deleteAllBP();
    debugger_run();
  
  
    testCaseComment("Action: ARCH_SW_CIL_0233");
    testStep("STEP", "Evaluate if signal RBTMFL_Actv_Lvl_ST35 is equal with I_C06_RBTM_LVL_STAT_PROFILE17. --> I_C06_RBTM_LVL_STAT_PROFILE17");
    EvalManStepEqual("Expected Test Result", $RBTMFL_Actv_Lvl_ST35.raw64, 17);
  
  
  testCaseComment("Postcondition");
  testStep("STEP", "Return ECU to default values");
  setSignal(BODY3::RBTMFL_SP_Lvl_Rq_ST35, 0);
  RunPostTs(); 
}


testcase SW_IT_CIL_PresafeHWA_02() 
{
  //***********************************Test report header*********************************
  testReportAddMiscInfoBlock("AUTOLIV ELECTRONICS document");
  TestReportAddMiscInfo("Nightly test", "No");
  TestReportAddMiscInfo("Test type", "Requirement-Based test");
  TestReportAddMiscInfo("Regression Test", "No");
  TestReportAddMiscInfo("Fault injection method used", "No");
  TestReportAddMiscInfo("Resource usage evaluation", "No");
  TestReportAddMiscInfo("Priority", "No");
  TestReportAddMiscInfo("Safety relevant", "No");
  
  AddRequirementInfo("Requirement under test", "ARCH_SW_CIL_0232");
  AddRequirementInfo("ARCH_SW_CIL_0232", "If PRE-SAFE16 - HAPTIC2(cycle 20 or cycle 21)  (and his next cycle ) is executed then RBTM _FL/FR Actv_Lvl_ST35 should be 0x10 = “HAPTIC2” no matter the source of the request: API interface, diagnostic.");
  //***************************************************************************************
  
  testCaseComment("Preconditions");
  testStep("STEP", "Bench Initialization");
  RunPreTs();
  
  
    testStep("STEP", "Set signal RBTMFL_SP_Lvl_Rq_ST35 to I_C06_RBTM_LVL_RQ_PROFILE16.");
    setSignal(BODY3::RBTMFL_SP_Lvl_Rq_ST35, 16);
  
    testStep("STEP", "Set a breakpoint in function CIL_runAppliToCAN().");
    debugger_setRelativeFunctionBpAtLine("CIL_runAppliToCAN", 0);
  
    testStep("STEP", "Check if CPU stopped in function CIL_runAppliToCAN(). --> CPU is Stopped");
    debugger_isCPUStoppedAtFunction("CIL_runAppliToCAN");    ////EvalManStepEqual("Expected Test Result", debugger_result, "CPU is Stopped");
  
  
    debugger_deleteAllBP();
  
    
    testStep("STEP", "Set a breakpoint in function cil_ManageActiveLevelSignal() at line 'CIL_u8Actv_Lvl = I_C06_RBTM_LVL_STAT_PROFILE16;'.");
    debugger_setBpAtLine("s:\\Components\\Application\\Autoliv\\CIL\\Implementation\\src\\CIL_AppliToCAN.c\\", 553);
  
    debugger_run();
  
    testCaseComment("Action: ARCH_SW_CIL_0232");
    testStep("STEP", "Check if CPU stopped  at line 'CIL_u8Actv_Lvl = I_C06_RBTM_LVL_STAT_PROFILE16;' under 'case KU8_CIL_HWA20_CYCLE:'. --> CPU is Stopped");
    debugger_isCPUStoppedAtFunction("cil_ManageActiveLevelSignal");
    ////EvalManStepEqual("Expected Test Result", debugger_result, "CPU is Stopped");
  
    debugger_deleteAllBP();
    debugger_run();
    
    testCaseComment("Action: ARCH_SW_CIL_0232");
    testStep("STEP", "Evaluate if signal RBTMFL_Actv_Lvl_ST35 is equal with I_C06_RBTM_LVL_STAT_PROFILE16. --> I_C06_RBTM_LVL_STAT_PROFILE16");
    EvalManStepEqual("Expected Test Result", $RBTMFL_Actv_Lvl_ST35.raw64, 16);
  
  
  testCaseComment("Postcondition");
  testStep("STEP", "Return ECU to default values");
  setSignal(BODY3::RBTMFL_SP_Lvl_Rq_ST35, 0);
  RunPostTs(); 
}


testcase SW_IT_CIL_BltSlckRed_03() 
{
  //***********************************Test report header*********************************
  testReportAddMiscInfoBlock("AUTOLIV ELECTRONICS document");
  TestReportAddMiscInfo("Nightly test", "No");
  TestReportAddMiscInfo("Test type", "Requirement-Based test");
  TestReportAddMiscInfo("Regression Test", "No");
  TestReportAddMiscInfo("Fault injection method used", "No");
  TestReportAddMiscInfo("Resource usage evaluation", "No");
  TestReportAddMiscInfo("Priority", "No");
  TestReportAddMiscInfo("Safety relevant", "No");
  
  AddRequirementInfo("Requirement under test", "ARCH_SW_CIL_0236");
  AddRequirementInfo("ARCH_SW_CIL_0236", "If BSR3(cycle 28) is executed (and his next cycle) then RBTM _FL/FR Actv_Lvl_ST35 should be 0x15 = “BSR3” no matter the source of the request: API interface, diagnostic.");
  //***************************************************************************************
  
  testCaseComment("Preconditions");
  testStep("STEP", "Bench Initialization");
  RunPreTs();
  
    
    testStep("STEP", "Set a breakpoint in function cil_TriggerProfile() at line 'if( (KU8_TRUE == u8CycleValidityStatus)'.");
    debugger_setRelativeFunctionBpAtLine("cil_TriggerProfiles", 638);
  
    testStep("STEP", "Set signal RBTMFL_SP_Lvl_Rq_ST35 to I_C06_RBTM_LVL_RQ_PROFILE21.");
    setSignal(BODY3::RBTMFL_SP_Lvl_Rq_ST35, 21);
    testWaitForTimeoutSilent(500);
  
    testStep("STEP", "Check if CPU stopped in function CIL_runAppliToCAN(). --> CPU is Stopped");
    debugger_isCPUStoppedAtFunction("CIL_runAppliToCAN");    ////EvalManStepEqual("Expected Test Result", debugger_result, "CPU is Stopped");
    
  
    debugger_writeLocalVariable("u8CycleValidityStatus", 0xAA);
    debugger_deleteAllBP();
  
    
    testStep("STEP", "Set a breakpoint in function CIL_runAppliToCAN().");
    debugger_setRelativeFunctionBpAtLine("CIL_runAppliToCAN", 0);
  
    debugger_run();
  
    testStep("STEP", "Check if CPU stopped in function CIL_runAppliToCAN(). --> CPU is Stopped");
    debugger_isCPUStoppedAtFunction("CIL_runAppliToCAN");    ////EvalManStepEqual("Expected Test Result", debugger_result, "CPU is Stopped");
  
  
    debugger_deleteAllBP();
  
    
    testStep("STEP", "Set a breakpoint in function cil_ManageActiveLevelSignal() at line 'CIL_u8Actv_Lvl = I_C06_RBTM_LVL_RQ_PROFILE21;' under 'case KU8_PRECRASH_SEVERITY_LEVEL_BSR_3:'.");
    debugger_setBpAtLine("s:\\Components\\Application\\Autoliv\\CIL\\Implementation\\src\\CIL_AppliToCAN.c\\", 606);
  
    debugger_run();
  
    testCaseComment("Action: ARCH_SW_CIL_0236");
    testStep("STEP", "Check if CPU stopped  at line 'CIL_u8Actv_Lvl = I_C06_RBTM_LVL_RQ_PROFILE21;' under 'case KU8_PRECRASH_SEVERITY_LEVEL_BSR_3:'. --> CPU is Stopped");
    debugger_isCPUStoppedAtFunction("cil_ManageActiveLevelSignal");
    ////EvalManStepEqual("Expected Test Result", debugger_result, "CPU is Stopped");
  
  
    debugger_deleteAllBP();
    debugger_run();
  
  
    testCaseComment("Action: ARCH_SW_CIL_0236");
    testStep("STEP", "Evaluate if signal RBTMFL_Actv_Lvl_ST35 is equal with I_C06_RBTM_LVL_RQ_PROFILE21. --> I_C06_RBTM_LVL_RQ_PROFILE21");
    EvalManStepEqual("Expected Test Result", $RBTMFL_Actv_Lvl_ST35.raw64, 21);
  
  
  testCaseComment("Postcondition");
  testStep("STEP", "Return ECU to default values");
  setSignal(BODY3::RBTMFL_SP_Lvl_Rq_ST35, 0);
  RunPostTs(); 
}



testcase SW_IT_CIL_GetDiagRequestCycle_01() 
{
    //***********************************Test report header*********************************
  testReportAddMiscInfoBlock("AUTOLIV ELECTRONICS document");
  TestReportAddMiscInfo("Nightly test", "No");
  TestReportAddMiscInfo("Test type", "Requirement-Based test");
  TestReportAddMiscInfo("Regression Test", "No");
  TestReportAddMiscInfo("Fault injection method used", "No");
  TestReportAddMiscInfo("Resource usage evaluation", "No");
  TestReportAddMiscInfo("Priority", "No");
  TestReportAddMiscInfo("Safety relevant", "No");
  
  AddRequirementInfo("Requirement under test", "ARCH_SW_CIL_0562");
  AddRequirementInfo("ARCH_SW_CIL_0562", "Call DIA_runGetDiagRequestCycle to read if a profile is requested on diagnostic service.");
  //***************************************************************************************
  
  testCaseComment("Preconditions");
  testStep("STEP", "Bench Initialization");
  RunPreTs();
  
  
    testStep("STEP", "Set signal Presf_Lvl_ST3 to I_C04_PRESF_LVL_V2_NOLVL.");
    setSignal(BODY3::Presf_Lvl_ST3, 0);
  
    testStep("STEP", "Set a breakpoint in function DIA_runGetDiagRequestCycle() at line '( *u8DiagRequestCycle) = Rte_IrvRead_DIA_runGetDiagRequestCycle_u8DiagRequestedCycle();'.");
    debugger_setRelativeFunctionBpAtLine("DIA_runGetDiagRequestCycle", 0);
  
    testCaseComment("Action: ARCH_SW_CIL_0562");
    testStep("STEP", "Check if CPU stopped in function CIL_runAppliToCAN(). --> CPU is Stopped");
    debugger_WaitUntilBPisReached(1000);
  
  
    testCaseComment("Action: ARCH_SW_CIL_0562");
    testStep("STEP", "Evaluate if variable u8DiagRequestCycle is equal to KU8_NO_CYCLE. --> KU8_NO_CYCLE");
    result = debugger_readLocalVariable("*(u8DiagRequestCycle)");
    EvalManStepEqual("Expected Test Result", result, 255);
  
    
  testCaseComment("Postcondition");
  testStep("STEP", "Return ECU to default values");
  RunPostTs(); 
}


testcase SW_IT_CIL_BltSlckRed_02() 
{
  //***********************************Test report header*********************************
  testReportAddMiscInfoBlock("AUTOLIV ELECTRONICS document");
  TestReportAddMiscInfo("Nightly test", "No");
  TestReportAddMiscInfo("Test type", "Requirement-Based test");
  TestReportAddMiscInfo("Regression Test", "No");
  TestReportAddMiscInfo("Fault injection method used", "No");
  TestReportAddMiscInfo("Resource usage evaluation", "No");
  TestReportAddMiscInfo("Priority", "No");
  TestReportAddMiscInfo("Safety relevant", "No");
  
  AddRequirementInfo("Requirement under test", "ARCH_SW_CIL_0235");
  AddRequirementInfo("ARCH_SW_CIL_0235", "If BSR2(cycle 27) is executed (and his next cycle ) then RBTM _FL/FR Actv_Lvl_ST35 should be 0x14 = “BSR2” no matter the source of the request: API interface, diagnostic.");
  //***************************************************************************************
  
  testCaseComment("Preconditions");
  testStep("STEP", "Bench Initialization");

  RunPreTs();
  
    testStep("STEP", "Set signal RBTMFL_SP_Lvl_Rq_ST35 to I_C06_RBTM_LVL_RQ_PROFILE20.");
    setSignal(BODY3::RBTMFL_SP_Lvl_Rq_ST35, 20);
  
    testStep("STEP", "Set a breakpoint in function CIL_runAppliToCAN().");
    debugger_setRelativeFunctionBpAtLine("CIL_runAppliToCAN", 0);
  
    testStep("STEP", "Check if CPU stopped in function CIL_runAppliToCAN(). --> CPU is Stopped");
debugger_isCPUStoppedAtFunction("CIL_runAppliToCAN");    ////EvalManStepEqual("Expected Test Result", debugger_result, "CPU is Stopped");
  
  
    debugger_deleteAllBP();
  
    
    testStep("STEP", "Set a breakpoint in function cil_ManageActiveLevelSignal() at line 'CIL_u8Actv_Lvl = I_C06_RBTM_LVL_RQ_PROFILE20;'.");
    debugger_setBpAtLine("s:\\Components\\Application\\Autoliv\\CIL\\Implementation\\src\\CIL_AppliToCAN.c\\", 602);
  
    debugger_run();
  
    testCaseComment("Action: ARCH_SW_CIL_0235");
    testStep("STEP", "Check if CPU stopped  at line 'CIL_u8Actv_Lvl = I_C06_RBTM_LVL_RQ_PROFILE20;' under 'case KU8_PRECRASH_SEVERITY_LEVEL_BSR_2:'. --> CPU is Stopped");
    debugger_isCPUStoppedAtFunction("cil_ManageActiveLevelSignal");
    ////EvalManStepEqual("Expected Test Result", debugger_result, "CPU is Stopped");
  
    debugger_deleteAllBP();
    debugger_run();
    
    testCaseComment("Action: ARCH_SW_CIL_0235");
    testStep("STEP", "Evaluate if signal RBTMFL_Actv_Lvl_ST35 is equal with 0x14. --> 0x14");
    EvalManStepEqual("Expected Test Result", $RBTMFL_Actv_Lvl_ST35.raw64, 20);
  
  
  testCaseComment("Postcondition");
  testStep("STEP", "Return ECU to default values");
  setSignal(BODY3::RBTMFL_SP_Lvl_Rq_ST35, 0);
  RunPostTs(); 
}


testcase SW_IT_CIL_BltSlckRed_01() 
{
  //***********************************Test report header*********************************
  testReportAddMiscInfoBlock("AUTOLIV ELECTRONICS document");
  TestReportAddMiscInfo("Nightly test", "No");
  TestReportAddMiscInfo("Test type", "Requirement-Based test");
  TestReportAddMiscInfo("Regression Test", "No");
  TestReportAddMiscInfo("Fault injection method used", "No");
  TestReportAddMiscInfo("Resource usage evaluation", "No");
  TestReportAddMiscInfo("Priority", "No");
  TestReportAddMiscInfo("Safety relevant", "No");
  
  AddRequirementInfo("Requirement under test", "ARCH_SW_CIL_0259");
  AddRequirementInfo("ARCH_SW_CIL_0259", "If BSR 1 ALGO is executed and PresfAccelReset_NotExcd_ST3 is not '2' for NVP_u8BSR1AccelerationTimeout * 10 ms than smooth release shall be executed after 60S as an EMERGENCY RELEASE.");
  //***************************************************************************************
    
  testCaseComment("Preconditions");
  testStep("STEP", "Bench Initialization");
  RunPreTs();
  
  
    testStep("STEP", "Set signal PT4_PTCoor_PT_Rdy_ST3 to RDY.");
    setSignal(BODY3::PT4_PTCoor4_ST3::PT4_PTCoor_PT_Rdy_ST3, 1); 
    testWaitForTimeoutSilent(100);
  
    testStep("STEP", "Set signal Bckl_Sw_D_Stat_ST3 to I_C02_BCKL_SW_STAT_NOT.");
    setSignal(BODY3::Bckl_Sw_D_Stat_ST3, 1);
  
    testWaitForTimeout(100);
  
    testStep("STEP", "Set signal Bckl_Sw_D_Stat_ST3 to I_C02_BCKL_SW_STAT_OK.");
    setSignal(BODY3::Bckl_Sw_D_Stat_ST3, 0);
  
    
    testStep("STEP", "Set a breakpoint in function CIL_runCANToAppli at line 'cil_ManageInputSignals();'.");
    debugger_setRelativeFunctionBpAtLine("CIL_runCANToAppli", 5);
    
    testWaitForTimeout(250);
  
    testStep("STEP", "Step in function cil_ManageInputSignals(). --> Stepped in function cil_ManageInputSignals");
    debugger_stepIn();
   
    debugger_deleteAllBP();
  
    testStep("STEP", "Set a breakpoint at line 'cil_u8BSRBeltSlackStarted = KU8_TRUE;'.");
    debugger_setRelativeFunctionBpAtLine("cil_ManageInputSignals", 239);
    
    debugger_run();
  
    testStep("STEP", "Check if CPU stopped in function cil_ManageInputSignals() at line 'cil_u8BSRBeltSlackStarted = KU8_TRUE;'. --> CPU is Stopped");
    debugger_WaitUntilBPisReached(1000);
  
    
    testStep("STEP", "Set signal PresfAccelReset_NotExcd_ST3 to I_C02_NDEF_FALSE_TRUE_ST3_FALSE.");
    setSignal(BODY3::PresfAccelReset_NotExcd_ST3, 1);
    
    debugger_deleteAllBP(); 
    debugger_run();
    Wait(62000);
    
    testCaseComment("Action: ARCH_SW_CIL_0259");
    testStep("STEP", "Evaluate if variable cil_u16EmergencyReleaseCounter is equal to 6001. --> 6001");
    result = debugger_readGlobalVariable("uint16", "cil_u16EmergencyReleaseCounter,,app.elf", 0);
    EvalManStepEqual("Expected Test Result", result, 6001);
  
  
  testCaseComment("Postcondition");
  testStep("STEP", "Return ECU to default values");
  RunPostTs(); 
}


testcase SW_IT_CIL_CheckTimeoutError_07()
{
  //***********************************Test report header*********************************
  testReportAddMiscInfoBlock("AUTOLIV ELECTRONICS document");
  TestReportAddMiscInfo("Nightly test", "No");
  TestReportAddMiscInfo("Test type", "Requirement-Based test");
  TestReportAddMiscInfo("Regression Test", "No");
  TestReportAddMiscInfo("Fault injection method used", "No");
  TestReportAddMiscInfo("Resource usage evaluation", "No");
  TestReportAddMiscInfo("Priority", "No");
  TestReportAddMiscInfo("Safety relevant", "No");
  
  AddRequirementInfo("Requirement under test", "ARCH_SW_CIL_0412");
  AddRequirementInfo("ARCH_SW_CIL_0412", "CIL shall check if timeout is present for DI_OdoSpeedometer_ST3 frame.");
  //***************************************************************************************
    
  testCaseComment("Preconditions");
  testStep("STEP", "Bench Initialization");
  RunPreTs();

  
    testStep("STEP", "Set signal RBTMFL_SP_Lvl_Rq_ST35 to I_C24_KM_0_999999K9_0K1_INVLD_SNA_SNA.");
    setSignal(BODY3::DI_OdoSpeedometer_ST3::Odo_ST3, I_C24_KM_0_999999K9_0K1_INVLD_SNA_SNA);
    testWaitForTimeoutSilent(500);
    
    testStep("STEP", "Set a breakpoint in function CIL_Autotest_CheckTimeoutError_OdoSpeedometer() at line '*pu8TestResult = cil_u8ResultOfAutoTest;'.");
    debugger_setRelativeFunctionBpAtLine("CIL_Autotest_CheckTimeoutError_OdoSpeedometer", 11);
    
    testCaseComment("Action: ARCH_SW_CIL_0412");
    testStep("STEP", "Check if CPU stopped at line '*pu8TestResult = cil_u8ResultOfAutoTest;'. --> CPU is Stopped");
    debugger_WaitUntilBPisReached(1000);
    
  
    testCaseComment("Action: ARCH_SW_CIL_0412");
    testStep("STEP", "Evaluate variable *pu8TestResult. --> KU8_ATM_TEST_OK");
    result = debugger_readLocalVariable("*(pu8TestResult)");
    testWaitForTimeoutSilent(2000);
    EvalManStepEqual("Expected Test Result", result, 1);
  

  testCaseComment("Postcondition");
  testStep("STEP", "Return ECU to default values");
  RunPostTs(); 
}


testcase SW_IT_CIL_CheckImplausibleData_01()
{
  //***********************************Test report header*********************************
  testReportAddMiscInfoBlock("AUTOLIV ELECTRONICS document");
  TestReportAddMiscInfo("Nightly test", "No");
  TestReportAddMiscInfo("Test type", "Requirement-Based test");
  TestReportAddMiscInfo("Regression Test", "No");
  TestReportAddMiscInfo("Fault injection method used", "No");
  TestReportAddMiscInfo("Resource usage evaluation", "No");
  TestReportAddMiscInfo("Priority", "No");
  TestReportAddMiscInfo("Safety relevant", "No");
  
  AddRequirementInfo("Requirement under test", "ARCH_SW_CIL_0417, ARCH_SW_CIL_0414");
  AddRequirementInfo("ARCH_SW_CIL_0417", "CIL shall check if implausible data error is present for API frame.");
  AddRequirementInfo("ARCH_SW_CIL_0414", "CIL shall check if implausible data error is present for Powertrain frame.");
  //***************************************************************************************
    
  testCaseComment("Preconditions");
  testStep("STEP", "Bench Initialization");
  RunPreTs();

    
    testStep("STEP", "Set signal RBTMFL_SP_Lvl_Rq_ST35 to I_C06_RBTM_LVL_RQ_SNA.");
    setSignal(BODY3::RBTMFL_SP_Lvl_Rq_ST35, 63);
    testWaitForTimeout(500);
    
    testStep("STEP", "Set a breakpoint in function CIL_Autotest_CheckImplausibleData_API() at line '*pu8TestResult = cil_u8ResultOfAutoTest;'.");
    debugger_setRelativeFunctionBpAtLine("CIL_Autotest_CheckImplausibleData_API", 17);
    
    testCaseComment("Action: ARCH_SW_CIL_0417");
    testStep("STEP", "Check if CPU stopped at line '*pu8TestResult = cil_u8ResultOfAutoTest;'. --> CPU is Stopped");
    debugger_WaitUntilBPisReached(1000);
    
    testCaseComment("Action: ARCH_SW_CIL_0417");
    testStep("STEP", "Evaluate variable *pu8TestResult. --> KU8_ATM_TEST_NOK");
    result = debugger_readLocalVariable("*(pu8TestResult)");
    testWaitForTimeoutSilent(2000);
    EvalManStepEqual("Expected Test Result", result, 2);

  
    debugger_deleteAllBP();
    debugger_reset();
    debugger_run();
    
    
    testStep("STEP", "Set signal PT4_PTCoor_PT_Rdy_ST3 to I_C02_PT_RDY_V2_PT_RDY.");
    setSignal(BODY3::PT4_PTCoor_PT_Rdy_ST3, I_C02_PT_RDY_V2_PT_RDY);
    testWaitForTimeout(500);
    
    testStep("STEP", "Set a breakpoint in function CIL_Autotest_CheckImplausibleData_PowertrainDrv() at line '*pu8TestResult = cil_u8ResultOfAutoTest;'.");
    debugger_setRelativeFunctionBpAtLine("CIL_Autotest_CheckImplausibleData_PowertrainDrv", 11);
    
    testCaseComment("Action: ARCH_SW_CIL_0414");
    testStep("STEP", "Check if CPU stopped at line *pu8TestResult = cil_u8ResultOfAutoTest;. --> CPU is Stopped");
    debugger_WaitUntilBPisReached(1000);
  
    
    testCaseComment("Action: ARCH_SW_CIL_0414");
    testStep("STEP", "Evaluate variable *pu8TestResult. --> KU8_ATM_TEST_OK");
    result = debugger_readLocalVariable("*(pu8TestResult)");
    testWaitForTimeoutSilent(2000);
    EvalManStepEqual("Expected Test Result", result, 1);
  

  testCaseComment("Postcondition");
  testStep("STEP", "Return ECU to default values");
  setSignal(BODY3::RBTMFL_SP_Lvl_Rq_ST35, 0);
  RunPostTs(); 
}



testcase SW_IT_CIL_CANToAppli_02()
{
  //***********************************Test report header*********************************
  testReportAddMiscInfoBlock("AUTOLIV ELECTRONICS document");
  TestReportAddMiscInfo("Nightly test", "No");
  TestReportAddMiscInfo("Test type", "Requirement-Based test");
  TestReportAddMiscInfo("Regression Test", "No");
  TestReportAddMiscInfo("Fault injection method used", "No");
  TestReportAddMiscInfo("Resource usage evaluation", "No");
  TestReportAddMiscInfo("Priority", "No");
  TestReportAddMiscInfo("Safety relevant", "No");
  
  AddRequirementInfo("Requirement under test", "ARCH_SW_CIL_0258");
  AddRequirementInfo("ARCH_SW_CIL_0258", "CIL component should ensure that if a profile is requested on PRE_SAFE or API and it is executed completely (maximum duration REACHED) and the request is still active on signal the profile will be RESTARTED until signal change to NO action or another profile.");
  //***************************************************************************************
    
  testCaseComment("Preconditions");
  testStep("STEP", "Bench Initialization");

  RunPreTs();

    
    testStep("STEP", "Set signal Presf_Lvl_ST3 to I_C04_PRESF_LVL_V2_LVL1.");
    setSignal(BODY3::Presf_Lvl_ST3, 1);
    testWaitForTimeout(500);
    
    testStep("STEP", "Set a breakpoint in function CIL_runCANToAppli at line 'cil_TriggerProfiles(CIL_stManagedCycle.u8CurrentRequestedCycle);'.");
    debugger_setRelativeFunctionBpAtLine("CIL_runCANToAppli", 364);
  
    testStep("STEP", "Check if CPU stopped at line 'cil_TriggerProfiles(CIL_stManagedCycle.u8CurrentRequestedCycle);'. --> CPU is Stopped");
debugger_isCPUStoppedAtFunction("CIL_runCANToAppli");    ////EvalManStepEqual("Expected Test Result", debugger_result, "CPU is Stopped");
  
    debugger_deleteAllBP();
  
  
    testStep("STEP", "Set a breakpoint in function cil_TriggerProfile at line 'case I_C04_PRESF_LVL_V2_LVL1:' and press run.");
    debugger_setRelativeFunctionBpAtLine("cil_TriggerProfiles", 107);
  
    debugger_run();
  
    testCaseComment("Action: ARCH_SW_CIL_0258");
    testStep("STEP", "Check if CPU stopped at line 'case I_C04_PRESF_LVL_V2_LVL1:' and delete breakpoint. --> CPU is Stopped");
debugger_isCPUStoppedAtFunction("cil_TriggerProfiles");    ////EvalManStepEqual("Expected Test Result", debugger_result, "CPU is Stopped");
  
    debugger_deleteAllBP();
  
  
    testStep("STEP", "Set a breakpoint at line 'cil_RequestTensioning(KU8_PRECRASH_SEVERITY_LEVEL_1);' and press run.");
    debugger_setRelativeFunctionBpAtLine("cil_TriggerProfiles", 118);
  
    debugger_run();
  
    testCaseComment("Action: ARCH_SW_CIL_0258");
    testStep("STEP", "Check if CPU stopped at line 'cil_RequestTensioning(KU8_PRECRASH_SEVERITY_LEVEL_1);' and press run. --> CPU is Stopped");
debugger_isCPUStoppedAtFunction("cil_TriggerProfiles");    ////EvalManStepEqual("Expected Test Result", debugger_result, "CPU is Stopped");
  
    debugger_deleteAllBP();
    debugger_run();
    Wait(1000);  
  
    testStep("STEP", "Set a breakpoint at line 'case I_C04_PRESF_LVL_V2_LVL1:'.");
    debugger_setRelativeFunctionBpAtLine("cil_TriggerProfiles", 107);
  
    testCaseComment("Action: ARCH_SW_CIL_0258");
    testStep("STEP", "Check if CPU stopped at line 'case I_C04_PRESF_LVL_V2_LVL1:'. --> CPU is Stopped");
debugger_isCPUStoppedAtFunction("cil_TriggerProfiles");    ////EvalManStepEqual("Expected Test Result", debugger_result, "CPU is Stopped");
   

  testCaseComment("Postcondition");
  testStep("STEP", "Return ECU to default values");
  
  setSignal(BODY3::Presf_Lvl_ST3, I_C04_PRESF_LVL_V2_NOLVL);
  
  RunPostTs(); 
}


testcase SW_IT_CIL_HWARepetition_02()
{
  //***********************************Test report header*********************************
  testReportAddMiscInfoBlock("AUTOLIV ELECTRONICS document");
  TestReportAddMiscInfo("Nightly test", "No");
  TestReportAddMiscInfo("Test type", "Requirement-Based test");
  TestReportAddMiscInfo("Regression Test", "No");
  TestReportAddMiscInfo("Fault injection method used", "No");
  TestReportAddMiscInfo("Resource usage evaluation", "No");
  TestReportAddMiscInfo("Priority", "No");
  TestReportAddMiscInfo("Safety relevant", "No");
  
  AddRequirementInfo("Requirement under test", "ARCH_SW_CIL_0252, ARCH_SW_CIL_0253, ARCH_SW_CIL_0254");
  AddRequirementInfo("ARCH_SW_CIL_0252", "CIL component shall ensure repetition of vibration phase (cycle 21) of HWA 2 for NVP_u16DurationHaptic2.");
  AddRequirementInfo("ARCH_SW_CIL_0253", "CIL component shall ensure repetition of vibration phase (cycle 23) of HWA 3 for NVP_u16DurationHaptic3.");
  AddRequirementInfo("ARCH_SW_CIL_0254", "CIL component shall ensure repetition of vibration phase (cycle 25) of HWA 4 for NVP_u16DurationHaptic4.");
  //***************************************************************************************
    
  testCaseComment("Preconditions");
  testStep("STEP", "Bench Initialization");

  RunPreTs();

    
    testStep("STEP", "Set signal RBTMFL_SP_Lvl_Rq_ST35 to I_C06_RBTM_LVL_RQ_PROFILE16.");
    setSignal(BODY3::RBTMFL_SP_Lvl_Rq_ST35, 16);
    testWaitForTimeout(500);
    
    testStep("STEP", "Set a breakpoint in function CIL_runCANToAppli at line 'cil_TriggerProfiles(CIL_stManagedCycle.u8CurrentRequestedCycle);'.");
    debugger_setRelativeFunctionBpAtLine("CIL_runCANToAppli", 364);
  
    testStep("STEP", "Check if CPU stopped at line 'cil_TriggerProfiles(CIL_stManagedCycle.u8CurrentRequestedCycle);'. --> CPU is Stopped");
debugger_isCPUStoppedAtFunction("CIL_runCANToAppli");    ////EvalManStepEqual("Expected Test Result", debugger_result, "CPU is Stopped");
  
  
    debugger_deleteAllBP();
  
  
    testStep("STEP", "Set a breakpoint in function cil_ManageHapticRepetition at line 'CIL_u16HWARepetitionTime = ((uint16)(NVP_BLOCK_ID_HAPTIC_CONFIG_MB_RamBlockData.NVP_u16DurationHaptic2)/KU16_TEN);'.");
    debugger_setBpAtLine("s:\\Components\\Application\\Autoliv\\CIL\\Implementation\\src\\CIL_CANToAppli.c", 1674);
    
    debugger_run();
    testWaitForTimeout(1000);
  
    testStep("STEP", "Check if CPU stopped  in function cil_ManageHapticRepetition at line 'CIL_u16HWARepetitionTime = ((uint16)(NVP_BLOCK_ID_HAPTIC_CONFIG_MB_RamBlockData.NVP_u16DurationHaptic2)/KU16_TEN);'. --> CPU is Stopped");
    debugger_isCPUStoppedAtFunction("cil_ManageHapticRepetition");
    ////EvalManStepEqual("Expected Test Result", debugger_result, "CPU is Stopped");
      
    
    testCaseComment("Action: ARCH_SW_CIL_0252");
    testStep("STEP", "Evaluate variable NVP_u16DurationHaptic2'. --> 1000");
    result = debugger_readGlobalVariable("uint16", "NVP_BLOCK_ID_HAPTIC_CONFIG_MB_RamBlockData,,app.elf", 1);
    EvalManStepEqual("Expected Test Result", result, 0x3e8);

    
    debugger_deleteAllBP();
  
  
    testStep("STEP", "Set a breakpoint in function cil_TriggerProfiles at line '(void)Rte_Read_prrEnableCycle21_b8CycleValidity(&u8CycleValidityStatus);'.");
    debugger_setRelativeFunctionBpAtLine("cil_TriggerProfiles", 495);
    
    debugger_run();
    
    testCaseComment("Action: ARCH_SW_CIL_0252");
    testStep("STEP", "Check if CPU stopped at line '(void)Rte_Read_prrEnableCycle21_b8CycleValidity(&u8CycleValidityStatus);'. --> CPU is Stopped");
    debugger_isCPUStoppedAtFunction("cil_TriggerProfiles");    ////EvalManStepEqual("Expected Test Result", debugger_result, "CPU is Stopped");
    
    debugger_deleteAllBP();
    setSignal(BODY3::RBTMFL_SP_Lvl_Rq_ST35, 0);
    debugger_run();
  
  
    testStep("STEP", "Set signal RBTMFL_SP_Lvl_Rq_ST35 to I_C06_RBTM_LVL_RQ_PROFILE17.");
    setSignal(BODY3::RBTMFL_SP_Lvl_Rq_ST35, 17);
    testWaitForTimeout(500);
  
  
    debugger_deleteAllBP();
  
  
    testStep("STEP", "Set a breakpoint in function cil_ManageHapticRepetition at line 'CIL_u16HWARepetitionTime = ((uint16)(NVP_BLOCK_ID_HAPTIC_CONFIG_MB_RamBlockData.NVP_u16DurationHaptic3)/KU16_TEN);'.");
    debugger_setBpAtLine("s:\\Components\\Application\\Autoliv\\CIL\\Implementation\\src\\CIL_CANToAppli.c", 1679);
    
    debugger_run();
    testWaitForTimeout(1000);
  
    testStep("STEP", "Check if CPU stopped  in function cil_ManageHapticRepetition at line 'CIL_u16HWARepetitionTime = ((uint16)(NVP_BLOCK_ID_HAPTIC_CONFIG_MB_RamBlockData.NVP_u16DurationHaptic2)/KU16_TEN);'. --> CPU is Stopped");
    debugger_isCPUStoppedAtFunction("cil_ManageHapticRepetition");
    ////EvalManStepEqual("Expected Test Result", debugger_result, "CPU is Stopped");
  
  
    testStep("STEP", "Set a breakpoint in function cil_TriggerProfiles at line '(void)Rte_Read_prrEnableCycle23_b8CycleValidity(&u8CycleValidityStatus);'.");
    debugger_setRelativeFunctionBpAtLine("cil_TriggerProfiles", 529);
  
    debugger_run();
  
    testCaseComment("Action: ARCH_SW_CIL_0253");
    testStep("STEP", "Check if CPU stopped at line '(void)Rte_Read_prrEnableCycle21_b8CycleValidity(&u8CycleValidityStatus);'. --> CPU is Stopped");
    debugger_isCPUStoppedAtFunction("cil_TriggerProfiles");    ////EvalManStepEqual("Expected Test Result", debugger_result, "CPU is Stopped");
    
    testCaseComment("Action: ARCH_SW_CIL_0253");
    testStep("STEP", "Evaluate variable NVP_u16DurationHaptic3'. --> 1000");
    result = debugger_readGlobalVariable("uint16", "NVP_BLOCK_ID_HAPTIC_CONFIG_MB_RamBlockData,,app.elf", 2);
    EvalManStepEqual("Expected Test Result", result, 0x3e8);
    
    debugger_deleteAllBP();
    setSignal(BODY3::RBTMFL_SP_Lvl_Rq_ST35, 0);
    debugger_run();
    
  
    testStep("STEP", "Set signal RBTMFL_SP_Lvl_Rq_ST35 to I_C06_RBTM_LVL_RQ_PROFILE18.");
    setSignal(BODY3::RBTMFL_SP_Lvl_Rq_ST35, 18);
    testWaitForTimeout(500);
  
  
    debugger_deleteAllBP();
  
  
    testStep("STEP", "Set a breakpoint in function cil_ManageHapticRepetition at line 'CIL_u16HWARepetitionTime = ((uint16)(NVP_BLOCK_ID_HAPTIC_CONFIG_MB_RamBlockData.NVP_u16DurationHaptic2)/KU16_TEN);'.");
    debugger_setBpAtLine("s:\\Components\\Application\\Autoliv\\CIL\\Implementation\\src\\CIL_CANToAppli.c", 1684);
    
    debugger_run();
    testWaitForTimeout(1000);
  
    testStep("STEP", "Check if CPU stopped  in function cil_ManageHapticRepetition at line 'CIL_u16HWARepetitionTime = ((uint16)(NVP_BLOCK_ID_HAPTIC_CONFIG_MB_RamBlockData.NVP_u16DurationHaptic2)/KU16_TEN);'. --> CPU is Stopped");
    debugger_isCPUStoppedAtFunction("cil_ManageHapticRepetition");
    ////EvalManStepEqual("Expected Test Result", debugger_result, "CPU is Stopped");
  
  
    debugger_deleteAllBP();
  
  
    testStep("STEP", "Set a breakpoint in function cil_TriggerProfiles at line '(void)Rte_Read_prrEnableCycle25_b8CycleValidity(&u8CycleValidityStatus);'.");
    debugger_setRelativeFunctionBpAtLine("cil_TriggerProfiles", 563);
  
    debugger_run();
  
    testCaseComment("Action: ARCH_SW_CIL_0254");
    testStep("STEP", "Check if CPU stopped at line '(void)Rte_Read_prrEnableCycle25_b8CycleValidity(&u8CycleValidityStatus);'. --> CPU is Stopped");
    debugger_isCPUStoppedAtFunction("cil_TriggerProfiles");    ////EvalManStepEqual("Expected Test Result", debugger_result, "CPU is Stopped");
    
    testCaseComment("Action: ARCH_SW_CIL_0254");
    testStep("STEP", "Evaluate variable NVP_u16DurationHaptic3'. --> 1000");
    result = debugger_readGlobalVariable("uint16", "NVP_BLOCK_ID_HAPTIC_CONFIG_MB_RamBlockData,,app.elf", 2);
    EvalManStepEqual("Expected Test Result", result, 0x3e8);


  testCaseComment("Postcondition");
  testStep("STEP", "Return ECU to default values");
  setSignal(BODY3::RBTMFL_SP_Lvl_Rq_ST35, 0);
  RunPostTs(); 
}




testcase SW_IT_CIL_FctPrecond_Stat_01()
{
 //***********************************Test report header*********************************
  testReportAddMiscInfoBlock("AUTOLIV ELECTRONICS document");
  TestReportAddMiscInfo("Nightly test", "No");
  TestReportAddMiscInfo("Test type", "Requirement-Based test");
  TestReportAddMiscInfo("Regression Test", "No");
  TestReportAddMiscInfo("Fault injection method used", "No");
  TestReportAddMiscInfo("Resource usage evaluation", "No");
  TestReportAddMiscInfo("Priority", "No");
  TestReportAddMiscInfo("Safety relevant", "No");
  
  AddRequirementInfo("Requirement under test", "ARCH_SW_CIL_0112");
  AddRequirementInfo("ARCH_SW_CIL_0112", "Bit 1 from signal RBTMxy_SP_FctPrecond_Stat_ST35 shall be set to 1 if Belt Handover_extended_TRUE.");
  //***************************************************************************************

  testCaseComment("Preconditions");
  testStep("STEP", "Bench Initialization");
  RunPreTs();
  
  
    testStep("STEP", "Set signal BeltHdOvr_FL_Stat_ST3 from frame BeltHdOvr_FL_State_ST3 to I_C02_BELTHDOVR_STAT_EXTEND.");
    setSignal(BODY3::BeltHdOvr_FL_State_ST3::BeltHdOvr_FL_Stat_ST3, 2);
    testWaitForTimeout(500);
    
    testStep("STEP", "Set a breakpoint in function CIL_runAppliToCAN() at line 'cil_ManageFctPrecondSignal();'.");
    debugger_setRelativeFunctionBpAtLine("CIL_runAppliToCAN", 33);
    
    testStep("STEP", "Step in function cil_ManageFctPrecondSignal(). --> 	Stepped in function cil_ManageFctPrecondSignal,,app.elf");
    debugger_stepIn();
    
    
    testStep("STEP", "Set a breakpoint in function cil_ManageFctPrecondSignal() at line 'CIL_SET_FCT_COND_MASK_ON(c10_RBTM_Fct_Precond_Seatbelt_Handover_extended_BflMask);' and press run.");
    debugger_setRelativeFunctionBpAtLine("cil_ManageFctPrecondSignal", 25);
    
    debugger_run();
    
    testStep("STEP", "Check if CPU stopped at line 'CIL_SET_FCT_COND_MASK_ON(c10_RBTM_Fct_Precond_Seatbelt_Handover_extended_BflMask);'. --> CPU is Stopped");
    debugger_WaitUntilBPisReached(1000);
    
    
    testCaseComment("Action: ARCH_SW_CIL_0112");
    testStep("STEP", "Evaluate if signal RBTMFL_SP_FctPrecond_Stat_ST35 is equal to KU8_ONE. --> KU8_ONE");
    EvalManStepEqual("Expected Test Result", $RBTMFL_SP_FctPrecond_Stat_ST35.raw64, 0x1);

  
  testCaseComment("Postcondition");
  testStep("STEP", "Return ECU to default values");
  setSignal(BODY3::BeltHdOvr_FL_Stat_ST3, 0);
  RunPostTs();
}



testcase SW_IT_CIL_SBeltTens_SP_Lvl_ST3_01()
{
 //***********************************Test report header*********************************
  testReportAddMiscInfoBlock("AUTOLIV ELECTRONICS document");
  TestReportAddMiscInfo("Nightly test", "No");
  TestReportAddMiscInfo("Test type", "Requirement-Based test");
  TestReportAddMiscInfo("Regression Test", "No");
  TestReportAddMiscInfo("Fault injection method used", "No");
  TestReportAddMiscInfo("Resource usage evaluation", "No");
  TestReportAddMiscInfo("Priority", "No");
  TestReportAddMiscInfo("Safety relevant", "No");
  
  AddRequirementInfo("Requirement under test", "ARCH_SW_CIL_0116, ARCH_SW_CIL_0052, ARCH_SW_CIL_0059");
  AddRequirementInfo("ARCH_SW_CIL_0116", "If Signal RBTMFL_SP_Lvl_Rq_ST35 is different than 0 than next cycle release for previous API requested profiles is inhibitted");
  AddRequirementInfo("ARCH_SW_CIL_0052", "If signal is received with value 1, then tensioning cycle 0 shall be requested.");
  AddRequirementInfo("ARCH_SW_CIL_0059", "If signal is received with value 1, then tensioning cycle 0 shall be requested.");
  //***************************************************************************************

  testCaseComment("Preconditions");
  testStep("STEP", "Bench Initialization");

  RunPreTs();

    
    testStep("STEP", "Set signal RBTMFL_SP_Lvl_Rq_ST35 from frame SBeltTens_SP_Lvl_ST3 to KU8_ONE.");
    setSignal(BODY3::SBeltTens_SP_Lvl_ST3::RBTMFL_SP_Lvl_Rq_ST35, 1);
    testWaitForTimeoutSilent(500);
    
    testStep("STEP", "Set a breakpoint in fucntion CIL_runCANToAppli().");
    debugger_setRelativeFunctionBpAtLine("CIL_runCANToAppli", 0);
  
    testWaitForTimeoutSilent(500);
  
    testStep("STEP", "Check if CPU stopped at function CIL_runCANToAppli(). --> CPU is Stopped");
    debugger_isCPUStoppedAtFunction("CIL_runCANToAppli");    ////EvalManStepEqual("Expected Test Result", debugger_result,  "CPU is Stopped");
  
    testStep("STEP", "Set a breakpoint at the last line of the function cil_ManageInputSignals and press run.");
    debugger_setBpAtLine("s:\\Components\\Application\\Autoliv\\CIL\\Implementation\\src\\CIL_CANToAppli.c", 1640);
    
    debugger_run();
  
    testStep("STEP", "Check if CPU stopped at the last line of the function cil_ManageInputSignals. --> CPU is Stopped");
    debugger_isCPUStoppedAtFunction("cil_ManageInputSignals");
    ////EvalManStepEqual("Expected Test Result", debugger_result,  "CPU is Stopped");
  
    testWaitForTimeoutSilent(500);
  
    testCaseComment("Action: ARCH_SW_CIL_0116, ARCH_SW_CIL_0052, ARCH_SW_CIL_0059");
    testStep("STEP", "Read variable cil_u8APIActivationRequest. --> KU8_ONE");
    result = debugger_readGlobalVariable("uint8", "cil_u8APIActivationRequest,,app.elf", 0);
    EvalManStepEqual("Expected Test Result", result,  1);

    debugger_deleteAllBP();
    debugger_run();
    
    testStep("STEP", "Set signal RBTMFL_SP_Lvl_Rq_ST35 from frame SBeltTens_SP_Lvl_ST3 to KU8_ZERO.");
    setSignal(BODY3::SBeltTens_SP_Lvl_ST3::RBTMFL_SP_Lvl_Rq_ST35, 0);
    testWaitForTimeout(500);
    
    testStep("STEP", "Set a breakpoint at the function cil_ManageInhibitConditions.");
    debugger_setRelativeFunctionBpAtLine("cil_ManageInhibitConditions", 341);
  
    testWaitForTimeoutSilent(500);
  
    testCaseComment("Action: ARCH_SW_CIL_0116");
    testStep("STEP", "Check if CPU stopped at function cil_ManageInhibitConditions. --> CPU is Stopped");
    debugger_isCPUStoppedAtFunction("cil_ManageInhibitConditions");    ////EvalManStepEqual("Expected Test Result", debugger_result,  "CPU is Stopped");
  
  
  debugger_deleteAllBP();
  setSignal(BODY3::SBeltTens_SP_Lvl_ST3::RBTMFL_SP_Lvl_Rq_ST35, 0);
  debugger_run();
  RunPostTs();
}


testcase SW_IT_CIL_BeltHdOvr_State_ST3_01()
{
 //***********************************Test report header*********************************
  testReportAddMiscInfoBlock("AUTOLIV ELECTRONICS document");
  TestReportAddMiscInfo("Nightly test", "No");
  TestReportAddMiscInfo("Test type", "Requirement-Based test");
  TestReportAddMiscInfo("Regression Test", "No");
  TestReportAddMiscInfo("Fault injection method used", "No");
  TestReportAddMiscInfo("Resource usage evaluation", "No");
  TestReportAddMiscInfo("Priority", "No");
  TestReportAddMiscInfo("Safety relevant", "No");
  
  AddRequirementInfo("Requirement under test", "ARCH_SW_CIL_0185");
  AddRequirementInfo("ARCH_SW_CIL_0185", "If values for this signal are different than 0x00= RETRACT (Belt hand over retracted).Then all BSR cycles are inhibitted/aborted if signal is enabled in the coding.");
  //***************************************************************************************
    
  testCaseComment("Preconditions");
  testStep("STEP", "Bench Initialization");
  RunPreTs();
    
  
    testStep("STEP", "Set signal BeltHdOvr_FL_Stat_ST3 from frame BeltHdOvr_FL_State_ST3 to I_C02_BELTHDOVR_STAT_OUT_OF_END.");
    setSignal(BODY3::BeltHdOvr_FL_State_ST3::BeltHdOvr_FL_Stat_ST3, 1);
    testWaitForTimeout(1000);
    
    testStep("STEP", "Set a breakpoint in fucntion CIL_runCANToAppli().");
    debugger_setRelativeFunctionBpAtLine("CIL_runCANToAppli", 0);
  
    testStep("STEP", "Check if CPU stopped at function CIL_runCANToAppli(). --> CPU is Stopped");
    debugger_isCPUStoppedAtFunction("CIL_runCANToAppli");    ////EvalManStepEqual("Expected Test Result", debugger_result,  "CPU is Stopped");
  
    testStep("STEP", "Set a breakpoint in function cil_ManageInputSignals at line 'cil_ManageInhibitConditions();'.");
//    debugger_setBpAtLine("s:\\Components\\Application\\Autoliv\\CIL\\Implementation\\src\\CIL_CANToAppli.c", 1496);
    debugger_setRelativeFunctionBpAtLine("cil_ManageInputSignals", 250);
    debugger_run();
  
    testStep("STEP", "Step in function cil_ManageInhibitConditions();. --> cil_ManageInhibitConditions,,app.elf");
    debugger_stepIn();
    //EvalManStepEqual("Expected Test Result", debugger_result, "Stepped in function cil_ManageInhibitConditions,,app.elf");
    
    testStep("STEP", "Set a breakpoint at line 'CIL_SET_INHIB_MASK_ON (KU8_CIL_DTCInhibitionOfBSR);'.");
    debugger_setRelativeFunctionBpAtLine("cil_ManageInhibitConditions", 263);
    
    debugger_run();
  
    testCaseComment("Action: ARCH_SW_CIL_0185");
    testStep("STEP", "Check if CPU stoped at line 'CIL_SET_INHIB_MASK_ON (KU8_CIL_DTCInhibitionOfBSR);'. --> CPU is Stopped");
    debugger_isCPUStoppedAtFunction("cil_ManageInhibitConditions");    ////EvalManStepEqual("Expected Test Result", debugger_result,  "CPU is Stopped");
 

  testCaseComment("Postcondition");
  testStep("STEP", "Return ECU to default values");
  setSignal(BODY3::Presf_Lvl_ST3, I_C04_PRESF_LVL_V2_NOLVL);
  RunPostTs(); 
}


testcase SW_IT_CIL_TriggerProfiles_01()
{
  //***********************************Test report header*********************************
  testReportAddMiscInfoBlock("AUTOLIV ELECTRONICS document");
  TestReportAddMiscInfo("Nightly test", "No");
  TestReportAddMiscInfo("Test type", "Requirement-Based test");
  TestReportAddMiscInfo("Regression Test", "No");
  TestReportAddMiscInfo("Fault injection method used", "No");
  TestReportAddMiscInfo("Resource usage evaluation", "No");
  TestReportAddMiscInfo("Priority", "No");
  TestReportAddMiscInfo("Safety relevant", "No");
  
  AddRequirementInfo("Requirement under test", "ARCH_SW_CIL_0022");
  AddRequirementInfo("ARCH_SW_CIL_0022", "If signal is received with value 1, then tensioning cycle 0 shall be requested.");
  //***************************************************************************************
    
  testCaseComment("Preconditions");
  testStep("STEP", "Bench Initialization");
  RunPreTs();
   
  
    testStep("STEP", "Set signal Presf_Lvl_ST3 to I_C04_PRESF_LVL_V2_LVL1.");
    setSignal(BODY3::Presf_Lvl_ST3, I_C04_PRESF_LVL_V2_LVL1);
    testWaitForTimeout(500);
  
    testStep("STEP", "Set a breakpoint in fucntion CIL_runCANToAppli().");
    debugger_setRelativeFunctionBpAtLine("CIL_runCANToAppli", 0);
  
    testStep("STEP", "Check if CPU stopped at function CIL_runCANToAppli(). --> CPU is Stopped");
    debugger_isCPUStoppedAtFunction("CIL_runCANToAppli");    ////EvalManStepEqual("Expected Test Result", debugger_result,  "CPU is Stopped");
  
    debugger_deleteAllBP();
    debugger_run();
    
    testStep("STEP", "Set a breakpoint in function cil_TriggerProfiles.");
    debugger_setRelativeFunctionBpAtLine("cil_TriggerProfiles", 0);
    
    debugger_deleteAllBP();
  
    testStep("STEP", "Set a breakpoint in function cil_RequestTensioning.");
    debugger_setBpAtLine("s:\\Components\\Application\\Autoliv\\CIL\\Implementation\\src\\CIL_CANToAppli.c", 1671);
      
    debugger_deleteAllBP();
    debugger_reset();
    debugger_run();
    
    testCaseComment("Action: ARCH_SW_CIL_0022");
    testStep("STEP", "Evaluate variable Rte_CIL_prrCrashSeverityLevel_u8PreCrashSeverityLevel. --> KU8_PRECRASH_SEVERITY_LEVEL_1 (0x0)");
    result = debugger_readGlobalVariable("uint8", "Rte_CIL_prrCrashSeverityLevel_u8PreCrashSeverityLevel,,app.elf", 0);
    EvalManStepEqual("Expected Test Result", result, 0x0);
  
  
  testCaseComment("Postcondition");
  testStep("STEP", "Return ECU to default values");
  
  debugger_deleteAllBP();
  setSignal(BODY3::Presf_Lvl_ST3, I_C04_PRESF_LVL_V2_NOLVL);
  debugger_run();
  RunPostTs(); 
}


testcase SW_IT_CIL_TriggerProfiles_06() 
{
  //***********************************Test report header*********************************
  testReportAddMiscInfoBlock("AUTOLIV ELECTRONICS document");
  TestReportAddMiscInfo("Nightly test", "No");
  TestReportAddMiscInfo("Test type", "Requirement-Based test");
  TestReportAddMiscInfo("Regression Test", "No");
  TestReportAddMiscInfo("Fault injection method used", "No");
  TestReportAddMiscInfo("Resource usage evaluation", "No");
  TestReportAddMiscInfo("Priority", "No");
  TestReportAddMiscInfo("Safety relevant", "No");
  
  AddRequirementInfo("Requirement under test", "ARCH_SW_CIL_0119");
  AddRequirementInfo("ARCH_SW_CIL_0119", "If signal is received with value 6, then tensioning cycle 4 shall be requested.");
  //***************************************************************************************
    
  testCaseComment("Preconditions");
  testStep("STEP", "Bench Initialization");
  RunPreTs();

  
    testStep("STEP", "Set signal Presf_Lvl_ST3 to I_C04_PRESF_LVL_V2_LVL6.");
    setSignal(BODY3::Presf_Lvl_ST3, I_C04_PRESF_LVL_V2_LVL6);
    testWaitForTimeout(500);
    
    testStep("STEP", "Set a breakpoint in function CIL_runCANToAppli at line 'cil_TriggerProfiles(CIL_stManagedCycle.u8CurrentRequestedCycle);'.");
    debugger_setRelativeFunctionBpAtLine("CIL_runCANToAppli", 364);

    testStep("STEP", "Check if CPU stopped in function CIL_runCANToAppli at line 'cil_TriggerProfiles(CIL_stManagedCycle.u8CurrentRequestedCycle);'. --> CPU is Stopped");
    debugger_isCPUStoppedAtFunction("CIL_runCANToAppli");    ////EvalManStepEqual("Expected Test Result", debugger_result,  "CPU is Stopped");
    
  
    debugger_deleteAllBP();
 
  
    testStep("STEP", "Set a breakpoint in function cil_TriggerProfiles at line '(void)Rte_Read_prrEnableCycle4_b8CycleValidity(&u8CycleValidityStatus);' under case I_C04_PRESF_LVL_V2_LVL6.");
    debugger_setRelativeFunctionBpAtLine("cil_TriggerProfiles", 225);
      
    debugger_run();
  
    testCaseComment("Action: ARCH_SW_CIL_0119");
    testStep("STEP", "Check if CPU stopped in function cil_TriggerProfiles at line '(void)Rte_Read_prrEnableCycle4_b8CycleValidity(&u8CycleValidityStatus);' under case I_C04_PRESF_LVL_V2_LVL6. --> CPU is Stopped");
    debugger_isCPUStoppedAtFunction("cil_TriggerProfiles");    ////EvalManStepEqual("Expected Test Result", debugger_result,  "CPU is Stopped");

  
  testCaseComment("Postcondition");
  testStep("STEP", "Return ECU to default values");
  setSignal(BODY3::Presf_Lvl_ST3, I_C04_PRESF_LVL_V2_NOLVL);
  debugger_run();
  RunPostTs();
}


testcase SW_IT_CIL_TriggerProfiles_21()
{
  //***********************************Test report header*********************************
  testReportAddMiscInfoBlock("AUTOLIV ELECTRONICS document");
  TestReportAddMiscInfo("Nightly test", "No");
  TestReportAddMiscInfo("Test type", "Requirement-Based test");
  TestReportAddMiscInfo("Regression Test", "No");
  TestReportAddMiscInfo("Fault injection method used", "No");
  TestReportAddMiscInfo("Resource usage evaluation", "No");
  TestReportAddMiscInfo("Priority", "No");
  TestReportAddMiscInfo("Safety relevant", "No");
  
  AddRequirementInfo("Requirement under test", "ARCH_SW_CIL_0120");
  AddRequirementInfo("ARCH_SW_CIL_0120", "If signal is received with value 7, then tensioning cycle 5 shall be requested.");
  //***************************************************************************************
    
  testCaseComment("Preconditions");
  testStep("STEP", "Bench Initialization");
  RunPreTs();

  
    testStep("STEP", "Set signal Presf_Lvl_ST3 to I_C04_PRESF_LVL_V2_LVL7 (0x7).");
    setSignal(BODY3::Presf_Lvl_ST3, I_C04_PRESF_LVL_V2_LVL7);
    testWaitForTimeout(500);
     
    testStep("STEP", "Set a breakpoint in function CIL_runCANToAppli at line 'cil_TriggerProfiles(CIL_stManagedCycle.u8CurrentRequestedCycle);'."); 
    debugger_setRelativeFunctionBpAtLine("CIL_runCANToAppli", 364);
    
    testStep("STEP", "Check if CPU stopped at line 'cil_TriggerProfiles(CIL_stManagedCycle.u8CurrentRequestedCycle);'. --> CPU is Stopped");
    debugger_isCPUStoppedAtFunction("CIL_runCANToAppli");    ////EvalManStepEqual("Expected Test Result", debugger_result,  "CPU is Stopped");
  
  
    debugger_deleteAllBP();
    debugger_setRelativeFunctionBpAtLine("cil_TriggerProfiles", 265);
    debugger_run();
    debugger_writeLocalVariable("u32AECGroupStatus", 0);
    
  
    debugger_deleteAllBP();

    
    testStep("STEP", "Set a breakpoint in function cil_TriggerProfiles at line 'cil_RequestTensioning(KU8_PRECRASH_SEVERITY_LEVEL_6);' under case I_C04_PRESF_LVL_V2_LVL7.");
    debugger_setRelativeFunctionBpAtLine("cil_TriggerProfiles", 272);

    debugger_run();
  
    testStep("STEP", "Check if CPU stopped in function cil_TriggerProfiles at line 'cil_RequestTensioning(KU8_PRECRASH_SEVERITY_LEVEL_6);' under case I_C04_PRESF_LVL_V2_LVL7. --> CPU is Stopped");
    debugger_isCPUStoppedAtFunction("cil_TriggerProfiles");    ////EvalManStepEqual("Expected Test Result", debugger_result,  "CPU is Stopped");
    
  
    debugger_deleteAllBP();

    
    testStep("STEP", "Set a breakpoint at the end of the function cil_RequestTensioning.");
    debugger_setRelativeFunctionBpAtLine("cil_RequestTensioning", 93);
    
    debugger_run();
  
    testCaseComment("Action: ARCH_SW_CIL_0120");
    testStep("STEP", "Check if CPU stopped at the end of the function cil_RequestTensioning. --> CPU is Stopped");
    debugger_isCPUStoppedAtFunction("cil_RequestTensioning");    ////EvalManStepEqual("Expected Test Result", debugger_result,  "CPU is Stopped");

  
  testCaseComment("Postcondition");
  testStep("STEP", "Return ECU to default values");
  setSignal(BODY3::Presf_Lvl_ST3, I_C04_PRESF_LVL_V2_NOLVL);
  RunPostTs(); 
}


testcase SW_IT_CIL_ManageAbortingConditions_01()
{
  //***********************************Test report header*********************************
  testReportAddMiscInfoBlock("AUTOLIV ELECTRONICS document");
  TestReportAddMiscInfo("Nightly test", "No");
  TestReportAddMiscInfo("Test type", "Requirement-Based test");
  TestReportAddMiscInfo("Regression Test", "No");
  TestReportAddMiscInfo("Fault injection method used", "No");
  TestReportAddMiscInfo("Resource usage evaluation", "No");
  TestReportAddMiscInfo("Priority", "No");
  TestReportAddMiscInfo("Safety relevant", "No");
  
  AddRequirementInfo("Requirement under test", "ARCH_SW_CIL_0122");
  AddRequirementInfo("ARCH_SW_CIL_0122", "SNA value for this signal is 0x0F, and for this no cycle should de played and already played cycles on PRE-safe should be aborted.");
  //***************************************************************************************
    
  testCaseComment("Preconditions");
  testStep("STEP", "Bench Initialization");

  RunPreTs();
  
  
    testStep("STEP", "Set signal Presf_Lvl_ST3 to I_C04_PRESF_LVL_V2_SNA (0x0F).");
    setSignal(BODY3::PresfAct_Adj_ST3::Presf_Lvl_ST3, I_C04_PRESF_LVL_V2_SNA);
    testWaitForTimeout(500);
    
    testStep("STEP", "Set a breakpoint in function cil_ManageAbortingConditions at line 'if(I_C04_PRESF_LVL_V2_SNA == cil_stPresfActAdjFrame.Presf_Lvl_ST3)'.");
    debugger_setRelativeFunctionBpAtLine("cil_ManageAbortingConditions", 142);
    
    testCaseComment("Action: ARCH_SW_CIL_0122");
    testStep("STEP", "Check if CPU stopped at line 'if(I_C04_PRESF_LVL_V2_SNA == cil_stPresfActAdjFrame.Presf_Lvl_ST3)'. --> CPU is Stopped");
    debugger_isCPUStoppedAtFunction("cil_ManageAbortingConditions");    ////EvalManStepEqual("Expected Test Result", debugger_result,  "CPU is Stopped");
  
    testStep("STEP", "Set a breakpoint at line 'CIL_SET_ABORT_MASK_ON (KU8_CIL_PresafeSNAAborting);'.");
    debugger_setRelativeFunctionBpAtLine("cil_ManageAbortingConditions", 144);
    
    debugger_run();
  
    testCaseComment("Action: ARCH_SW_CIL_0122");
    testStep("STEP", "Check if CPU stopped at line 'CIL_SET_ABORT_MASK_ON (KU8_CIL_PresafeSNAAborting);'. --> CPU is Stopped");
    debugger_isCPUStoppedAtFunction("cil_ManageAbortingConditions");    ////EvalManStepEqual("Expected Test Result", debugger_result,  "CPU is Stopped");

  
  testCaseComment("Postcondition");
  testStep("STEP", "Return ECU to default values");
  
  debugger_deleteAllBP();
  setSignal(BODY3::PresfAct_Adj_ST3::Presf_Lvl_ST3, I_C04_PRESF_LVL_V2_NOLVL);
  debugger_run();
  RunPostTs();
}


testcase SW_IT_CIL_PresfAct_TensSupp_Rq_ST3_01()
{
  //***********************************Test report header*********************************
  testReportAddMiscInfoBlock("AUTOLIV ELECTRONICS document");
  TestReportAddMiscInfo("Nightly test", "No");
  TestReportAddMiscInfo("Test type", "Requirement-Based test");
  TestReportAddMiscInfo("Regression Test", "No");
  TestReportAddMiscInfo("Fault injection method used", "No");
  TestReportAddMiscInfo("Resource usage evaluation", "No");
  TestReportAddMiscInfo("Priority", "No");
  TestReportAddMiscInfo("Safety relevant", "No");
  
  AddRequirementInfo("Requirement under test", "ARCH_SW_CIL_0182");
  AddRequirementInfo("ARCH_SW_CIL_0182", "Value for PresfAct_TensSupp_Rq_ST3 SNA is 7 and should not inhibit anything.");
  //***************************************************************************************
    
  testCaseComment("Preconditions");
  testStep("STEP", "Bench Initialization");
  RunPreTs();

  
    testStep("STEP", "Set signal PresfAct_TensSupp_Rq_ST3 to 7.");
    setSignal(BODY3::PresfAct_TensSupp_Rq_ST3, 7);
    testWaitForTimeout(500);
  
  
    testStep("STEP", "Set a breakpoint in function CIL_ComNotification_PresfAct_Adj_Pr5_ST3_2joar1a41xrgjqab60epnbplm_25141edc_Rx().");
    debugger_setRelativeFunctionBpAtLine("CIL_ComNotification_PresfAct_Adj_Pr5_ST3_2joar1a41xrgjqab60epnbplm_25141edc_Rx", 4);
  
    testStep("STEP", "Check if CPU stopped in function CIL_ComNotification_PresfAct_Adj_Pr5_ST3_2joar1a41xrgjqab60epnbplm_25141edc_Rx(). --> CPU is Stopped");
    debugger_WaitUntilBPisReached(1000);
  
  
    testCaseComment("Action: ARCH_SW_CIL_0182");
    testStep("STEP", "Read variable cil_stPresfActAdjFrame.PresfAct_TensSupp_Rq_ST3 --> 7.");
    result= debugger_readGlobalVariable("uint8", "cil_stPresfActAdjFrame,,app.elf", 10);
    EvalManStepEqual("Expected Test Result", result, 0x7);
  
  
    testStep("STEP", "Set a breakpoint in function cil_ManageInhibitConditions() at line 'if(I_C03_NO_LT_RT_BOTH_LEFT == cil_stPresfActAdjFrame.PresfAct_TensSupp_Rq_ST3)'.");
    debugger_setRelativeFunctionBpAtLine("cil_ManageInhibitConditions", 67);
  
    debugger_run();
  
    testStep("STEP", "Check if CPU stopped at line 'if(I_C03_NO_LT_RT_BOTH_LEFT == cil_stPresfActAdjFrame.PresfAct_TensSupp_Rq_ST3)'. --> CPU is Stopped");
    debugger_WaitUntilBPisReached(1000);
  
  
    debugger_deleteAllBP();
  
  
    testStep("STEP", "Set a breakpoint at line 'CIL_SET_INHIB_MASK_ON (KU8_CIL_TensSuppInhibition);'.");
    debugger_setRelativeFunctionBpAtLine("cil_ManageInhibitConditions", 70);
    
    debugger_run();
  
    testCaseComment("Action: ARCH_SW_CIL_0182");
    testStep("STEP", "Check if CPU stopped at line 'CIL_SET_INHIB_MASK_ON (KU8_CIL_TensSuppInhibition);'. --> CPU is Running");
    debugger_WaitUntilBPisReached(1000);
  

  testCaseComment("Postcondition");
  testStep("STEP", "Return ECU to default values");
  setSignal(BODY3::PresfAct_Adj_ST3::Presf_Lvl_ST3, I_C04_PRESF_LVL_V2_NOLVL);
  RunPostTs();
}


testcase SW_IT_CIL_PresfAccelReset_NotExcd_ST3_02()
{
  //***********************************Test report header*********************************
  testReportAddMiscInfoBlock("AUTOLIV ELECTRONICS document");
  TestReportAddMiscInfo("Nightly test", "No");
  TestReportAddMiscInfo("Test type", "Requirement-Based test");
  TestReportAddMiscInfo("Regression Test", "No");
  TestReportAddMiscInfo("Fault injection method used", "No");
  TestReportAddMiscInfo("Resource usage evaluation", "No");
  TestReportAddMiscInfo("Priority", "No");
  TestReportAddMiscInfo("Safety relevant", "No");
  
  AddRequirementInfo("Requirement under test", "ARCH_SW_CIL_0117");
  AddRequirementInfo("ARCH_SW_CIL_0117", "If value for PresfAccelReset_NotExcd_ST3 is 3 = SNA then value will be interpreted as 2 , as Release allowed.");
  //***************************************************************************************
    
  testCaseComment("Preconditions");
  testStep("STEP", "Bench Initialization");

  RunPreTs();
 
  
    testStep("STEP", "Set signal PresfAccelReset_NotExcd_ST3 to 0x3.");
    setSignal(BODY3::PresfAct_Adj_ST3::PresfAccelReset_NotExcd_ST3, 0x3);
    testWaitForTimeout(500);
    
    testStep("STEP", "Set a breakpoint in function cil_ManageInhibitConditions() at line 'if( (KU8_TWO == cil_stPresfActAdjFrame.PresfAccelReset_NotExcd_ST3)'.");
    debugger_setRelativeFunctionBpAtLine("cil_ManageInhibitConditions", 132);
    
    testCaseComment("Action: ARCH_SW_CIL_0117");
    testStep("STEP", "Check if CPU stopped at line 'if( (KU8_TWO == cil_stPresfActAdjFrame.PresfAccelReset_NotExcd_ST3)'. --> CPU is Stopped");
debugger_isCPUStoppedAtFunction("cil_ManageInhibitConditions");    ////EvalManStepEqual("Expected Test Result", debugger_result,  "CPU is Stopped");
  
    testCaseComment("Action: ARCH_SW_CIL_0117");
    testStep("STEP", "Read variable cil_stPresfActAdjFrame.PresfAccelReset_NotExcd_ST3 --> KU8_THREE.");
    result = debugger_readGlobalVariable("uint8", "cil_stPresfActAdjFrame,,app.elf", 7);
    EvalManStepEqual("Expected Test Result", result, 0x3);

  
  testCaseComment("Postcondition");
  testStep("STEP", "Return ECU to default values");
  RunPostTs();
}


testcase SW_IT_CIL_TriggerProfiles_NOLVL_01()
{
  //***********************************Test report header*********************************
  testReportAddMiscInfoBlock("AUTOLIV ELECTRONICS document");
  TestReportAddMiscInfo("Nightly test", "No");
  TestReportAddMiscInfo("Test type", "Requirement-Based test");
  TestReportAddMiscInfo("Regression Test", "No");
  TestReportAddMiscInfo("Fault injection method used", "No");
  TestReportAddMiscInfo("Resource usage evaluation", "No");
  TestReportAddMiscInfo("Priority", "No");
  TestReportAddMiscInfo("Safety relevant", "No");
  
  AddRequirementInfo("Requirement under test", "ARCH_SW_CIL_0057");
  AddRequirementInfo("ARCH_SW_CIL_0057", "If any other value than the ones mentioned above is received for signal RBTMFL_SP_Lvl_Rq_ST35 then no cycle should be requested.");
  //***************************************************************************************
    
  testCaseComment("Preconditions");
  testStep("STEP", "Bench Initialization");
  
  RunPreTs();

  
    testStep("STEP", "Set signal RBTMFL_SP_Lvl_Rq_ST35 to I_C04_PRESF_LVL_V2_NOLVL.");
    setSignal(BODY3::RBTMFL_SP_Lvl_Rq_ST35, 0);
    testWaitForTimeout(500);
    
    testStep("STEP", "Set a breakpoint in function CIL_runCANToAppli at line 'cil_TriggerProfiles(CIL_stManagedCycle.u8CurrentRequestedCycle);'.");
    debugger_setRelativeFunctionBpAtLine("CIL_runCANToAppli", 364);
    
    testStep("STEP", "Check if CPU stopped in function CIL_runCANToAppli at line 'cil_TriggerProfiles(CIL_stManagedCycle.u8CurrentRequestedCycle);'. --> CPU is Stopped");
debugger_isCPUStoppedAtFunction("CIL_runCANToAppli");    ////EvalManStepEqual("Expected Test Result", debugger_result,  "CPU is Stopped");
  
    debugger_deleteAllBP();
    debugger_run();
    
    testStep("STEP", "Set a breakpoint in function cil_TriggerProfiles at line 'case KU8_NO_CYCLE:'.");
    debugger_setRelativeFunctionBpAtLine("cil_TriggerProfiles", 19);
    
    testCaseComment("Action: ARCH_SW_CIL_0057");
    testStep("STEP", "Check if CPU stopped at line 'case KU8_NO_CYCLE:'. --> CPU is Stopped");
debugger_isCPUStoppedAtFunction("cil_TriggerProfiles");    ////EvalManStepEqual("Expected Test Result", debugger_result,  "CPU is Stopped");

  
  testCaseComment("Postcondition");
  testStep("STEP", "Return ECU to default values");
  RunPostTs(); 
}


testcase SW_IT_CIL_Com_ReceiveSignalGroupArray_01()
{
  //***********************************Test report header*********************************
  testReportAddMiscInfoBlock("AUTOLIV ELECTRONICS document");
  TestReportAddMiscInfo("Nightly test", "No");
  TestReportAddMiscInfo("Test type", "Requirement-Based test");
  TestReportAddMiscInfo("Regression Test", "No");
  TestReportAddMiscInfo("Fault injection method used", "No");
  TestReportAddMiscInfo("Resource usage evaluation", "No");
  TestReportAddMiscInfo("Priority", "No");
  TestReportAddMiscInfo("Safety relevant", "No");
  
  AddRequirementInfo("Requirement under test", "ARCH_SW_CIL_0351");
  AddRequirementInfo("ARCH_SW_CIL_0351", "Com_ReceiveSignalGroupArray shall be called to read signals group.");
  //***************************************************************************************
    
  testCaseComment("Preconditions");
  testStep("STEP", "Bench Initialization");
  RunPreTs();
  
  
    testStep("STEP", "Set signal Presf_Lvl_ST3 to I_C04_PRESF_LVL_V2_LVL1 (0x1).");
    setSignal(BODY3::Presf_Lvl_ST3, I_C04_PRESF_LVL_V2_LVL1);
    testWaitForTimeout(500);
    
    testStep("STEP", "Set a breakpoint in the function Com_ReceiveSignalGroupArray.");
    debugger_setRelativeFunctionBpAtLine("Com_ReceiveSignalGroupArray", 68);

    debugger_run();
    
    testCaseComment("Action: ARCH_SW_CIL_0351");
    testStep("STEP", "Check if CPU stopped in function Com_ReceiveSignalGroupArray(). --> CPU is Stopped");
    debugger_WaitUntilBPisReached(1000);
  
    testCaseComment("Action: ARCH_SW_CIL_0351");
    testStep("STEP", "Check if variable retVal is equal to E_OK. --> E_OK (0x0)");
    result = debugger_readLocalVariable("retVal");
    EvalManStepEqual("Expected Test Result", result, 0x0);
  
  
    debugger_deleteAllBP();
    setSignal(BODY3::Presf_Lvl_ST3, I_C04_PRESF_LVL_V2_NOLVL);
    debugger_run();
  
  
  testCaseComment("Postcondition");
  testStep("STEP", "Return ECU to default values");
  RunPostTs(); 
}


testcase SW_IT_CIL_isCarCrashDetected_01()
{
  //***********************************Test report header*********************************
  testReportAddMiscInfoBlock("AUTOLIV ELECTRONICS document");
  TestReportAddMiscInfo("Nightly test", "No");
  TestReportAddMiscInfo("Test type", "Requirement-Based test");
  TestReportAddMiscInfo("Regression Test", "No");
  TestReportAddMiscInfo("Fault injection method used", "No");
  TestReportAddMiscInfo("Resource usage evaluation", "No");
  TestReportAddMiscInfo("Priority", "No");
  TestReportAddMiscInfo("Safety relevant", "No");
  
  AddRequirementInfo("Requirement under test", "ARCH_SW_CIL_0354");
  AddRequirementInfo("ARCH_SW_CIL_0354", "Write Rte_CIL_psrCustomerSpecific_b8IsCarCrashDetected to start the tensioning cycle requested.");
  //***************************************************************************************
    
  testCaseComment("Preconditions");
  testStep("STEP", "Bench Initialization");

  RunPreTs();
  
    
    testStep("STEP", "Set signal Presf_Lvl_ST3 to I_C04_PRESF_LVL_V2_LVL1 (0x1).");
    setSignal(BODY3::Presf_Lvl_ST3, I_C04_PRESF_LVL_V2_LVL1);
    testWaitForTimeout(500);
    
    testStep("STEP", "Set a breakpoint in function CIL_runCANToAppli() at line 'cil_TriggerProfiles(CIL_stManagedCycle.u8CurrentRequestedCycle);'.");
    debugger_setRelativeFunctionBpAtLine("CIL_runCANToAppli", 364);
  
    testStep("STEP", "Check if CPU stopped at line 'cil_TriggerProfiles(CIL_stManagedCycle.u8CurrentRequestedCycle);'. --> CPU is Stopped");
debugger_isCPUStoppedAtFunction("CIL_runCANToAppli");    ////EvalManStepEqual("Expected Test Result", debugger_result,  "CPU is Stopped");
  
  
    debugger_deleteAllBP();
    debugger_run();
  
    
    testStep("STEP", "Set a breakpoint in function cil_TriggerProfiles() at line '(void)Rte_Write_psrCustomerSpecific_b8IsCarCrashDetected(KU8_FALSE);'.");
    debugger_setRelativeFunctionBpAtLine("cil_TriggerProfiles", 9);
    
    debugger_run();
    debugger_run();
    
    testCaseComment("Action: ARCH_SW_CIL_0354");
    testStep("STEP", "Check if CPU stopped at line '(void)Rte_Write_psrCustomerSpecific_b8IsCarCrashDetected(KU8_FALSE);'. --> CPU is Stopped");
debugger_isCPUStoppedAtFunction("cil_TriggerProfiles");    ////EvalManStepEqual("Expected Test Result", debugger_result,  "CPU is Stopped");
  
    testCaseComment("Action: ARCH_SW_CIL_0354");
    testStep("STEP", "Read variable Rte_CIL_psrCustomerSpecific_b8IsCarCrashDetected. --> KU8_FALSE (0x55)");
    result = debugger_readGlobalVariable("uint8", "Rte_CIL_psrCustomerSpecific_b8IsCarCrashDetected,,app.elf", 0);
    EvalManStepEqual("Expected Test Result", result, 0x55);
    
    
  testCaseComment("Postcondition");
  testStep("STEP", "Return ECU to default values");
  
  debugger_deleteAllBP();
  setSignal(BODY3::Presf_Lvl_ST3, I_C04_PRESF_LVL_V2_NOLVL);
  debugger_run();
  RunPostTs();
}


testcase SW_IT_CIL_PreCrashRequestEnable_01()
{
  //***********************************Test report header*********************************
  testReportAddMiscInfoBlock("AUTOLIV ELECTRONICS document");
  TestReportAddMiscInfo("Nightly test", "No");
  TestReportAddMiscInfo("Test type", "Requirement-Based test");
  TestReportAddMiscInfo("Regression Test", "No");
  TestReportAddMiscInfo("Fault injection method used", "No");
  TestReportAddMiscInfo("Resource usage evaluation", "No");
  TestReportAddMiscInfo("Priority", "No");
  TestReportAddMiscInfo("Safety relevant", "No");
  
  AddRequirementInfo("Requirement under test", "ARCH_SW_CIL_0355");
  AddRequirementInfo("ARCH_SW_CIL_0355", "Write Rte_CIL_psrCustomerSpecific_b8PreCrashRequestEnable to start the tensioning cycle requested.");
  //***************************************************************************************
    
  testCaseComment("Preconditions");
  testStep("STEP", "Bench Initialization");

  RunPreTs();
  
  
    testStep("STEP", "Set signal Presf_Lvl_ST3 to I_C04_PRESF_LVL_V2_LVL1 (0x1).");
    setSignal(BODY3::Presf_Lvl_ST3, I_C04_PRESF_LVL_V2_LVL1);
    testWaitForTimeout(500);
    
    testStep("STEP", "Set a breakpoint in function CIL_runCANToAppli() at line 'cil_TriggerProfiles(CIL_stManagedCycle.u8CurrentRequestedCycle);'.");
    debugger_setRelativeFunctionBpAtLine("CIL_runCANToAppli", 364);
  
    testStep("STEP", "Check if CPU stopped at line 'cil_TriggerProfiles(CIL_stManagedCycle.u8CurrentRequestedCycle);'. --> CPU is Stopped");
debugger_isCPUStoppedAtFunction("CIL_runCANToAppli");    ////EvalManStepEqual("Expected Test Result", debugger_result,  "CPU is Stopped");
  
  
    debugger_deleteAllBP();
    debugger_run();
  
    
    testStep("STEP", "Set a breakpoint in function cil_TriggerProfiles() after line '(void)Rte_Write_psrCustomerSpecific_b8PreCrashRequestEnable(KU8_TRUE);'.");
    debugger_setRelativeFunctionBpAtLine("cil_TriggerProfiles", 13);
    
    debugger_run();
    testWaitForTimeout(500);
    
    testCaseComment("Action: ARCH_SW_CIL_0355");
    testStep("STEP", "Check if CPU stopped after line '(void)Rte_Write_psrCustomerSpecific_b8PreCrashRequestEnable(KU8_TRUE);'. --> CPU is Stopped");
debugger_isCPUStoppedAtFunction("cil_TriggerProfiles");    ////EvalManStepEqual("Expected Test Result", debugger_result,  "CPU is Stopped");
  
    testCaseComment("Action: ARCH_SW_CIL_0355");
    testStep("STEP", "Read variable Rte_CIL_psrCustomerSpecific_b8PreCrashRequestEnable --> KU8_TRUE (0xAA).");
    result = debugger_readGlobalVariable("uint8", "Rte_CIL_psrCustomerSpecific_b8PreCrashRequestEnable,,app.elf", 0);
    EvalManStepEqual("Expected Test Result", result, 0xaa);
    
    
  testCaseComment("Postcondition");
  testStep("STEP", "Return ECU to default values");
  setSignal(BODY3::Presf_Lvl_ST3, I_C04_PRESF_LVL_V2_NOLVL);
  RunPostTs();
}


testcase SW_IT_CIL_CycleValidity_01()
{
  //***********************************Test report header*********************************
  testReportAddMiscInfoBlock("AUTOLIV ELECTRONICS document");
  TestReportAddMiscInfo("Nightly test", "No");
  TestReportAddMiscInfo("Test type", "Requirement-Based test");
  TestReportAddMiscInfo("Regression Test", "No");
  TestReportAddMiscInfo("Fault injection method used", "No");
  TestReportAddMiscInfo("Resource usage evaluation", "No");
  TestReportAddMiscInfo("Priority", "No");
  TestReportAddMiscInfo("Safety relevant", "No");
  
  AddRequirementInfo("Requirement under test", "ARCH_SW_CIL_0356");
  AddRequirementInfo("ARCH_SW_CIL_0356", "Read Rte_MMG_psrEnableCycleX_b8CycleValidity to check validity of each the cycle.");
  //***************************************************************************************
    
  testCaseComment("Preconditions");
  testStep("STEP", "Bench Initialization");

  RunPreTs();
  
    
    testStep("STEP", "Set signal Presf_Lvl_ST3 to I_C04_PRESF_LVL_V2_LVL1 (0x1).");
    setSignal(BODY3::Presf_Lvl_ST3, I_C04_PRESF_LVL_V2_LVL1);
    testWaitForTimeout(500);
    
    testStep("STEP", "Set a breakpoint in function CIL_runCANToAppli() at line 'cil_TriggerProfiles(CIL_stManagedCycle.u8CurrentRequestedCycle);'.");
    debugger_setRelativeFunctionBpAtLine("CIL_runCANToAppli", 364);
  
    testStep("STEP", "Check if CPU stopped at line 'cil_TriggerProfiles(CIL_stManagedCycle.u8CurrentRequestedCycle);'.");
debugger_isCPUStoppedAtFunction("CIL_runCANToAppli");    ////EvalManStepEqual("Expected Test Result", debugger_result,  "CPU is Stopped");
    
  
    debugger_deleteAllBP();
    debugger_run();
  
    
    testStep("STEP", "Set a breakpoint in function cil_TriggerProfiles() at line '(void)Rte_Read_prrEnableCycle0_b8CycleValidity(&u8CycleValidityStatus);' under case I_C04_PRESF_LVL_V2_LVL1.");
    debugger_setRelativeFunctionBpAtLine("cil_TriggerProfiles", 111);
    
    debugger_run();
    testWaitForTimeout(500);
    
    testCaseComment("Action: ARCH_SW_CIL_0356");
    testStep("STEP", "Check if CPU stopped at line '(void)Rte_Read_prrEnableCycle0_b8CycleValidity(&u8CycleValidityStatus);'.  --> CPU is Stopped");
debugger_isCPUStoppedAtFunction("cil_TriggerProfiles");    ////EvalManStepEqual("Expected Test Result", debugger_result,  "CPU is Stopped");
  
    testCaseComment("Action: ARCH_SW_CIL_0356");
    testStep("STEP", "Read variable Rte_MMG_psrEnableCycle0_b8CycleValidity --> KU8_TRUE.");
    result = debugger_readGlobalVariable("uint8", "Rte_MMG_psrEnableCycle0_b8CycleValidity,,app.elf", 0);
    EvalManStepEqual("Expected Test Result", result, 0xaa);
    
  
  testCaseComment("Postcondition");
  testStep("STEP", "Return ECU to default values");
  setSignal(BODY3::Presf_Lvl_ST3, I_C04_PRESF_LVL_V2_NOLVL);
  RunPostTs();
}


testcase SW_IT_CIL_psrBuckleDoorSwitch_01()
{
  //***********************************Test report header*********************************
  testReportAddMiscInfoBlock("AUTOLIV ELECTRONICS document");
  TestReportAddMiscInfo("Nightly test", "No");
  TestReportAddMiscInfo("Test type", "Requirement-Based test");
  TestReportAddMiscInfo("Regression Test", "No");
  TestReportAddMiscInfo("Fault injection method used", "No");
  TestReportAddMiscInfo("Resource usage evaluation", "No");
  TestReportAddMiscInfo("Priority", "No");
  TestReportAddMiscInfo("Safety relevant", "No");
  
  AddRequirementInfo("Requirement under test", "ARCH_SW_CIL_0357");
  AddRequirementInfo("ARCH_SW_CIL_0357", "Write Rte_Write_psrBuckleDoorSwitch_u8BuckleSwitch to transmit to application status of buckle switch.");
  //***************************************************************************************
    
  testCaseComment("Preconditions");
  testStep("STEP", "Bench Initialization");

  RunPreTs();
  
  
    testStep("STEP", "Set signal Presf_Lvl_ST3 to I_C04_PRESF_LVL_V2_LVL1 (0x1).");
    setSignal(BODY3::Presf_Lvl_ST3, I_C04_PRESF_LVL_V2_LVL1);
    testWaitForTimeoutSilent(500);
  
    testStep("STEP", "Set a breakpoint in the function CIL_runCANToAppli at line '(void)Rte_Write_psrBuckleDoorSwitch_u8BuckleSwitch(KU8_BUCKLE_SWITCH_OPENED)'.");
    debugger_setRelativeFunctionBpAtLine("CIL_runCANToAppli", 317);
  
    testCaseComment("Action: ARCH_SW_CIL_0357");
    testStep("STEP", "Check if CPU stopped at line '(void)Rte_Write_psrBuckleDoorSwitch_u8BuckleSwitch(KU8_BUCKLE_SWITCH_OPENED);'.  --> CPU is Stopped");
debugger_isCPUStoppedAtFunction("CIL_runCANToAppli");    ////EvalManStepEqual("Expected Test Result", debugger_result,  "CPU is Stopped");
  
    testCaseComment("Action: ARCH_SW_CIL_0357");
    testStep("STEP", "Read variable Rte_CIL_psrBuckleDoorSwitch_u8BuckleSwitch --> KU8_BUCKLE_SWITCH_OPENED (0xAA).");
    result = debugger_readGlobalVariable("uint8", "Rte_CIL_psrBuckleDoorSwitch_u8BuckleSwitch,,app.elf", 0);
    EvalManStepEqual("Expected Test Result", result, 0xAA);
    
    
  testCaseComment("Postcondition");
  testStep("STEP", "Return ECU to default values");
  setSignal(BODY3::Presf_Lvl_ST3, I_C04_PRESF_LVL_V2_NOLVL);
  RunPostTs();
}


testcase SW_IT_CIL_psrCustomerSpecific_01()
{
  //***********************************Test report header*********************************
  testReportAddMiscInfoBlock("AUTOLIV ELECTRONICS document");
  TestReportAddMiscInfo("Nightly test", "No");
  TestReportAddMiscInfo("Test type", "Requirement-Based test");
  TestReportAddMiscInfo("Regression Test", "No");
  TestReportAddMiscInfo("Fault injection method used", "No");
  TestReportAddMiscInfo("Resource usage evaluation", "No");
  TestReportAddMiscInfo("Priority", "No");
  TestReportAddMiscInfo("Safety relevant", "No");
  
  AddRequirementInfo("Requirement under test", "ARCH_SW_CIL_0305");
  AddRequirementInfo("ARCH_SW_CIL_0305", "Rte_Write_psrCustomerSpecific_u8TriggerRequest Will be writen by CIL in order to inform about Source of the cycle Request.");
  //***************************************************************************************
    
  testCaseComment("Preconditions");
  testStep("STEP", "Bench Initialization");
  
  RunPreTs();
  
  
    testStep("STEP", "Set signal Presf_Lvl_ST3 to I_C04_PRESF_LVL_V2_LVL2 (0x2).");
    setSignal(BODY3::Presf_Lvl_ST3, I_C04_PRESF_LVL_V2_LVL2);
    testWaitForTimeoutSilent(500);
  
    result = debugger_readGlobalVariable("uint8", "Rte_CIL_psrCustomerSpecific_u8HapticRequest,,app.elf", 0);
  
    testStep("STEP", "Set a breakpoint in function CIL_runCANToAppli() at line 'cil_TriggerProfiles(CIL_stManagedCycle.u8CurrentRequestedCycle);'.");
    debugger_setRelativeFunctionBpAtLine("CIL_runCANToAppli", 364);
  
    testStep("STEP", "Check if CPU stopped at line 'cil_TriggerProfiles(CIL_stManagedCycle.u8CurrentRequestedCycle);'.");
debugger_isCPUStoppedAtFunction("CIL_runCANToAppli");    ////EvalManStepEqual("Expected Test Result", debugger_result,  "CPU is Stopped");
  
  
    debugger_deleteAllBP();
    debugger_run();


    testStep("STEP", "Set a breakpoint in function cil_TriggerProfiles() after line '(void)Rte_Write_psrCustomerSpecific_u8HapticRequest(KU8_HAPTIC_REQUEST_0);'.");
    debugger_setRelativeFunctionBpAtLine("cil_TriggerProfiles", 148);
  
    testCaseComment("Action: ARCH_SW_CIL_0305");
    testStep("STEP", "Check if CPU stopped after line '(void)Rte_Write_psrCustomerSpecific_u8HapticRequest(KU8_HAPTIC_REQUEST_0);'.  --> CPU is Stopped");
debugger_isCPUStoppedAtFunction("cil_TriggerProfiles");    ////EvalManStepEqual("Expected Test Result", debugger_result,  "CPU is Stopped");
  
    testCaseComment("Action: ARCH_SW_CIL_0305");
    testStep("STEP", "Read variable Rte_CIL_psrCustomerSpecific_u8HapticRequest --> KU8_HAPTIC_REQUEST_0 (0x0).");
    EvalManStepEqual("Expected Test Result", result, 0);
  
  
  testCaseComment("Postcondition");
  testStep("STEP", "Return ECU to default values");
  setSignal(BODY3::Presf_Lvl_ST3, I_C04_PRESF_LVL_V2_NOLVL);
  RunPostTs();
}


testcase SW_IT_CIL_prrStepNumber_01()
{
  //***********************************Test report header*********************************
  testReportAddMiscInfoBlock("AUTOLIV ELECTRONICS document");
  TestReportAddMiscInfo("Nightly test", "No");
  TestReportAddMiscInfo("Test type", "Requirement-Based test");
  TestReportAddMiscInfo("Regression Test", "No");
  TestReportAddMiscInfo("Fault injection method used", "No");
  TestReportAddMiscInfo("Resource usage evaluation", "No");
  TestReportAddMiscInfo("Priority", "No");
  TestReportAddMiscInfo("Safety relevant", "No");
  
  AddRequirementInfo("Requirement under test", "ARCH_SW_CIL_0304");
  AddRequirementInfo("ARCH_SW_CIL_0304", "Read Rte_Read_prrStepNumber_u8StepNumber shall be read to get executed cycle number.");
  //***************************************************************************************
    
  testCaseComment("Preconditions");
  testStep("STEP", "Bench Initialization");
  RunPreTs();
    
  
    testStep("STEP", "Set signal RBTMFL_SP_Lvl_Rq_ST35 to I_C06_RBTM_LVL_RQ_PROFILE25.");
    setSignal(BODY3::RBTMFL_SP_Lvl_Rq_ST35, 25);
    testWaitForTimeout(500);
    
    
    testStep("STEP", "Set a breakpoint in function CIL_runCANToAppli() at line 'cil_TriggerProfiles(CIL_stManagedCycle.u8CurrentRequestedCycle);'.");
    debugger_setRelativeFunctionBpAtLine("CIL_runCANToAppli", 364);
  
    testStep("STEP", "Check if CPU stopped at line 'cil_TriggerProfiles(CIL_stManagedCycle.u8CurrentRequestedCycle);'.");
    debugger_WaitUntilBPisReached(1000);
    
    
    debugger_deleteAllBP();
    
    
    testStep("STEP", "Set a breakpoint in function cil_TriggerProfiles at line 'case I_C06_RBTM_LVL_RQ_PROFILE25:'.");
    debugger_setRelativeFunctionBpAtLine("cil_TriggerProfiles", 726);
  
    debugger_run();
  
    testStep("STEP", "Check if CPU stopped at line 'case I_C06_RBTM_LVL_RQ_PROFILE25:'.");
    debugger_WaitUntilBPisReached(1000);
    
  
    debugger_deleteAllBP();
  
  
    testStep("STEP", "Set a breakpoint in function cil_RequestTensioning() at line '(void)Rte_Read_prrStepNumber_u8StepNumber(&u8ExecutedStep);'.");
    debugger_setBpAtLine("s:\\Components\\Application\\Autoliv\\CIL\\Implementation\\src\\CIL_CANToAppli.c", 1911);
    
    debugger_run();
  
    testCaseComment("Action: ARCH_SW_CIL_0304");
    testStep("STEP", "Check if CPU stopped in function cil_RequestTensioning() at line '(void)Rte_Read_prrStepNumber_u8StepNumber(&u8ExecutedStep);'. --> CPU is Stopped");
    debugger_WaitUntilBPisReached(1000);
    
  
    testCaseComment("Action: ARCH_SW_CIL_0304");
    testStep("STEP", "Evaluate if variable Rte_BFE_psrExecutedStep_u8StepNumber is equal to KU8_TWO. --> KU8_TWO");
    result = debugger_readGlobalVariable("uint8", "Rte_BFE_psrExecutedStep_u8StepNumber,,app.elf", 0);
    EvalManStepEqual("Expected Test Result", result, 2);
    

  testCaseComment("Postcondition");
  testStep("STEP", "Return ECU to default values");
  setSignal(BODY3::RBTMFL_SP_Lvl_Rq_ST35, I_C04_PRESF_LVL_V2_NOLVL);
  RunPostTs();
}



testcase SW_IT_CIL_TriggerPreSafeRequestStatus_01()
{
  //***********************************Test report header*********************************
  testReportAddMiscInfoBlock("AUTOLIV ELECTRONICS document");
  TestReportAddMiscInfo("Nightly test", "No");
  TestReportAddMiscInfo("Test type", "Requirement-Based test");
  TestReportAddMiscInfo("Regression Test", "No");
  TestReportAddMiscInfo("Fault injection method used", "No");
  TestReportAddMiscInfo("Resource usage evaluation", "No");
  TestReportAddMiscInfo("Priority", "No");
  TestReportAddMiscInfo("Safety relevant", "No");
  
  AddRequirementInfo("Requirement under test", "ARCH_SW_CIL_0561");
  AddRequirementInfo("ARCH_SW_CIL_0561", "Read Rte_DIA_psePresafeDisplay_b8TriggerPreSafeRequestStatus shall be read to get if Presafe display 0302 is requested and 3s have passed.");
  //***************************************************************************************
    
  testCaseComment("Preconditions");
  testStep("STEP", "Bench Initialization");

  RunPreTs();
    
    testStep("STEP", "Set signal Presf_Lvl_ST3 to I_C04_PRESF_LVL_V2_LVL1 (0x1).");
    setSignal(BODY3::Presf_Lvl_ST3, I_C04_PRESF_LVL_V2_LVL1);
    testWaitForTimeoutSilent(500);  
  
    testStep("STEP", "Set a breakpoint in function CIL_runAppliToCAN().");
    debugger_setRelativeFunctionBpAtLine("CIL_runAppliToCAN", 0);

    testStep("STEP", "Check if CPU stopped in function CIL_runAppliToCAN().");
debugger_isCPUStoppedAtFunction("CIL_runAppliToCAN");    ////EvalManStepEqual("Expected Test Result", debugger_result,  "CPU is Stopped");
    debugger_deleteAllBP();
    
  
    testStep("STEP", "Set a breakpoint in function cil_ManagePresfDisplay() at line '(void)Rte_Read_prrPresafeDisplay_b8TriggerPreSafeRequestStatus(&u8PresafeDisplay);'.");
    debugger_setBpAtLine("s:\\Components\\Application\\Autoliv\\CIL\\Implementation\\src\\CIL_AppliToCAN.c", 194); 
    
    debugger_run();
  
    testCaseComment("Action: ARCH_SW_CIL_0561");
    testStep("STEP", "Check if CPU stopped at line '(void)Rte_Read_prrPresafeDisplay_b8TriggerPreSafeRequestStatus(&u8PresafeDisplay);'.");
    debugger_isCPUStoppedAtFunction("cil_ManagePresfDisplay");
    ////EvalManStepEqual("Expected Test Result", debugger_result,  "CPU is Stopped");
  
  
    testCaseComment("Action: ARCH_SW_CIL_0561");
    testStep("STEP", "Evaluate if signal RBTM_FL_Disp_Rq_ST3 is equal to variable Rte_DIA_psePresafeDisplay_b8TriggerPreSafeRequestStatus. --> 0x55");
    result = debugger_readGlobalVariable("uint8", "Rte_DIA_psePresafeDisplay_b8TriggerPreSafeRequestStatus,,app.elf", 0);
    EvalManStepEqual("Expected Test Result", result, 0x55);
  
  
  testCaseComment("Postcondition");
  testStep("STEP", "Return ECU to default values");
  setSignal(BODY3::Presf_Lvl_ST3, I_C04_PRESF_LVL_V2_NOLVL);
  RunPostTs();
}


testcase SW_IT_CIL_FctPrecond_01()
{
  //***********************************Test report header*********************************
  testReportAddMiscInfoBlock("AUTOLIV ELECTRONICS document");
  TestReportAddMiscInfo("Nightly test", "No");
  TestReportAddMiscInfo("Test type", "Requirement-Based test");
  TestReportAddMiscInfo("Regression Test", "No");
  TestReportAddMiscInfo("Fault injection method used", "No");
  TestReportAddMiscInfo("Resource usage evaluation", "No");
  TestReportAddMiscInfo("Priority", "No");
  TestReportAddMiscInfo("Safety relevant", "No");
  
  AddRequirementInfo("Requirement under test", "ARCH_SW_CIL_0111");
  AddRequirementInfo("ARCH_SW_CIL_0111", "Bit 6 from signal RBTMxy_SP_FctPrecond_Stat_ST35 shall be set to 1 if profile requested is not implemented or if EOL high limit or EOL comfort limit or EOL MAX limit has been reched.");
  //***************************************************************************************
    
  testCaseComment("Preconditions");
  testStep("STEP", "Bench Initialization");
  RunPreTs();
  
 
    testStep("STEP", "Set a breakpoint in function EOL_Autotest_CheckProductEndOfLifeMaxForce().");
    debugger_setRelativeFunctionBpAtLine("EOL_Autotest_CheckProductEndOfLifeMaxForce", 3);
  
    testStep("STEP", "Check if CPU stopped in function EOL_Autotest_CheckProductEndOfLifeMaxForce(). --> CPU is Stopped");
    debugger_WaitUntilBPisReached(1000);
  
    testStep("STEP", "Set variable NVP_BLOCK_ID_EXECUTION_COUNTERS_RamBlockData.NVP_au32ExecutedCycleCounters[KU8_EOL_MAX_FORCE_LEVEL] to NVP_u32MaxForceEOLThrs.");
    debugger_writeGlobalVariable("uint32", "NVP_BLOCK_ID_EXECUTION_COUNTERS_RamBlockData.NVP_au32ExecutedCycleCounters[3]", 0, 50);
  
  
    debugger_deleteAllBP();    
  
  
    testStep("STEP", "Set RBTMFL_SP_Lvl_Rq_ST35 Presf_Lvl_ST3 to I_C06_RBTM_LVL_RQ_PROFILE10.");
    setSignal(BODY3::RBTMFL_SP_Lvl_Rq_ST35, 10);
  
  
    testStep("STEP", "Set a breakpoint in function CIL_runAppliToCAN().");
    debugger_setRelativeFunctionBpAtLine("CIL_runAppliToCAN", 0);
 
    debugger_run();
    testWaitForTimeoutSilent(500);
  
    testStep("STEP", "Check if CPU stopped in function CIL_runAppliToCAN(). --> CPU is Stopped");
    debugger_WaitUntilBPisReached(1000);
  
  
    debugger_deleteAllBP();
  
  
    testStep("STEP", "Set a breakpoint in function cil_ManageFctPrecondSignal() at line 'CIL_SET_FCT_COND_MASK_ON(c10_RBTM_Fct_Precond_Profile_not_available_BflMask);' and press run.");
    debugger_setRelativeFunctionBpAtLine("CIL_runAppliToCAN", 88);
  
    debugger_run();
  
    testStep("STEP", "Check if CPU stopped in function cil_ManageFctPrecondSignal() at line 'CIL_SET_FCT_COND_MASK_ON(c10_RBTM_Fct_Precond_Profile_not_available_BflMask);)'. --> CPU is Stopped");
    debugger_WaitUntilBPisReached(1000);
  
    
    debugger_deleteAllBP();
    debugger_run();
    testWaitForTimeoutSilent(1000);
 
  
    testCaseComment("Action: ARCH_SW_CIL_0111");
    testStep("STEP", "Evaluate if bit 6 of signal RBTMFL_SP_FctPrecond_Stat_ST35 is equal to KU8_ONE (TRUE). --> bit 6 of signal RBTMFL_SP_FctPrecond_Stat_ST35 is equal to KU8_ONE");
    EvalManStepEqual("Expected Test Result", $RBTMFL_SP_FctPrecond_Stat_ST35.raw64,  0x40);
  
  
  testCaseComment("Postcondition");
  testStep("STEP", "Return ECU to default values");
  setSignal(BODY3::RBTMFL_SP_Lvl_Rq_ST35, 0);
  RunPostTs();
}


testcase SW_IT_CIL_FctPrecond_02()
{
  //***********************************Test report header*********************************
  testReportAddMiscInfoBlock("AUTOLIV ELECTRONICS document");
  TestReportAddMiscInfo("Nightly test", "No");
  TestReportAddMiscInfo("Test type", "Requirement-Based test");
  TestReportAddMiscInfo("Regression Test", "No");
  TestReportAddMiscInfo("Fault injection method used", "No");
  TestReportAddMiscInfo("Resource usage evaluation", "No");
  TestReportAddMiscInfo("Priority", "No");
  TestReportAddMiscInfo("Safety relevant", "No");
  
  AddRequirementInfo("Requirement under test", "ARCH_SW_CIL_0109");
  AddRequirementInfo("ARCH_SW_CIL_0109", "Bit 4 from signal RBTMxy_SP_FctPrecond_Stat_ST35 shall be set to 1 if DTC: B210E00 - The power supply is too high OR B210D00 - The power supply is too low OR B228B16 - Terminal 30 measurement undervoltage OR B228B17 -Terminal 30 measurement is set.");
  //***************************************************************************************
    
  testCaseComment("Preconditions");
  testStep("STEP", "Bench Initialization");
  RunPreTs();
  
  
//    testStep("STEP", "Set voltage to 9V.");
//    SetVoltage(9);
  
    testStep("STEP", "Set a breakpoint in function CIL_runAppliToCAN().");
    debugger_setRelativeFunctionBpAtLine("CIL_runAppliToCAN", 0);

    testStep("STEP", "Check if CPU stopped in function CIL_runAppliToCAN(). --> CPU is Stopped");
    debugger_WaitUntilBPisReached(1000);
    
  
    debugger_deleteAllBP();
  
  
    testStep("STEP", "Set a breakpoint in function cil_ManageFctPrecondSignal() at line 'CIL_SET_FCT_COND_MASK_ON(c10_RBTM_Fct_Precond_Under_overvoltage_BflMask);' and press run.");
    debugger_setRelativeFunctionBpAtLine("cil_ManageFctPrecondSignal", 54);
  
    debugger_run();
  
    testStep("STEP", "Check if CPU stopped in function cil_ManageFctPrecondSignal() at line 'CIL_SET_FCT_COND_MASK_ON(c10_RBTM_Fct_Precond_Under_overvoltage_BflMask);'.");
    debugger_WaitUntilBPisReached(1000);
  
  
    testCaseComment("Action: ARCH_SW_CIL_0109");
    testStep("STEP", "Evaluate if variable cil_u16Fct_Precond is equal to 0x10. --> 0x10");
    result = debugger_readGlobalVariable("uint8", "cil_u16Fct_Precond,,app.elf", 0);
    EvalManStepEqual("Expected Test Result", result, 0x10);
  
    testCaseComment("Action: ARCH_SW_CIL_0109");
    testStep("STEP", "Evaluate if signal RBTMFL_SP_FctPrecond_Stat_ST35 is equal to 0x10. --> 0x10");
    EvalManStepEqual("Expected Test Result", $RBTMFL_SP_FctPrecond_Stat_ST35.raw64, 0x10);
  
  
//    testStep("STEP", "Set voltage to 14V.");
//    SetVoltage(14);
  
  testCaseComment("Postcondition");
  testStep("STEP", "Return ECU to default values");
  RunPostTs(); 
}


testcase SW_IT_CIL_FctPrecond_03()
{
  //***********************************Test report header*********************************
  testReportAddMiscInfoBlock("AUTOLIV ELECTRONICS document");
  TestReportAddMiscInfo("Nightly test", "No");
  TestReportAddMiscInfo("Test type", "Requirement-Based test");
  TestReportAddMiscInfo("Regression Test", "No");
  TestReportAddMiscInfo("Fault injection method used", "No");
  TestReportAddMiscInfo("Resource usage evaluation", "No");
  TestReportAddMiscInfo("Priority", "No");
  TestReportAddMiscInfo("Safety relevant", "No");
  
  AddRequirementInfo("Requirement under test", "ARCH_SW_CIL_0110");
  AddRequirementInfo("ARCH_SW_CIL_0110", "Bit 5 from signal RBTMxy_SP_FctPrecond_Stat_ST35 shall be set to 1 if DTC: U012287 - Communication with control unit ''Traction system'' has a malfunction OR U041608 - Implausible data received from control unit Traction system OR U042708- Implausible data received from the electronic ignition lock OR	U015187 - Communication with the supplemental restraint system (SRS) has a malfunction OR	U045208 - Implausible data were received from the supplemental restraint system is set.");
  //***************************************************************************************
    
  testCaseComment("Preconditions");
  testStep("STEP", "Bench Initialization");
  RunPreTs();
  
    
    testStep("STEP", "Set signal RBTMFL_SP_Lvl_Rq_ST35 to I_C06_RBTM_LVL_RQ_SNA.");
    setSignal(BODY3::RBTMFL_SP_Lvl_Rq_ST35, 63);
    testWaitForTimeoutSilent(500);
  
  
    testStep("STEP", "Set a breakpoint in function CIL_runAppliToCAN().");
    debugger_setRelativeFunctionBpAtLine("CIL_runAppliToCAN", 0);

    testStep("STEP", "Check if CPU stopped in function CIL_runAppliToCAN(). --> CPU is Stopped");
debugger_isCPUStoppedAtFunction("CIL_runAppliToCAN");    ////EvalManStepEqual("Expected Test Result", debugger_result,  "CPU is Stopped");
  
  
    debugger_deleteAllBP();
  
    
    testStep("STEP", "Set a breakpoint in function cil_ManageFctPrecondSignal() at line '(KU32_ZERO != (u32AECGroupStatus & KU32_AEC_GROUP_MASK_IMPLAUSIBLE_DATA_BUCKLE_ORC))' and press run.");
    debugger_setRelativeFunctionBpAtLine("cil_ManageFctPrecondSignal", 63);
    
    debugger_run();
  
    testStep("STEP", "Check if CPU stopped in function cil_ManageFctPrecondSignal() at line '(KU32_ZERO != (u32AECGroupStatus & KU32_AEC_GROUP_MASK_IMPLAUSIBLE_DATA_BUCKLE_ORC))'.");
debugger_isCPUStoppedAtFunction("cil_ManageFctPrecondSignal");    ////EvalManStepEqual("Expected Test Result", debugger_result,  "CPU is Stopped");
  
  
    debugger_deleteAllBP();
  
  
    testStep("STEP", "Set a breakpoint in function cil_ManageFctPrecondSignal() at line 'CIL_SET_FCT_COND_MASK_ON(c10_RBTM_Fct_Precond_Communication_error_BflMask);' and press run.");
    debugger_setRelativeFunctionBpAtLine("cil_ManageFctPrecondSignal", 72); 
    
    debugger_run();
  
    testCaseComment("Action: ARCH_SW_CIL_0110");
    testStep("STEP", "Check if CPU stopped in function cil_ManageFctPrecondSignal() at line 'CIL_SET_FCT_COND_MASK_ON(c10_RBTM_Fct_Precond_Communication_error_BflMask);'. --> CPU is Stopped");
debugger_isCPUStoppedAtFunction("cil_ManageFctPrecondSignal");    ////EvalManStepEqual("Expected Test Result", debugger_result,  "CPU is Stopped");
  
    testCaseComment("Action: ARCH_SW_CIL_0110");
    testStep("STEP", "Evaluate if signal RBTMFL_SP_FctPrecond_Stat_ST35 is equal to 0x20. --> 0x20");
    EvalManStepEqual("Expected Test Result", $RBTMFL_SP_FctPrecond_Stat_ST35.raw64, 0x20);
  
  
  testCaseComment("Postcondition");
  testStep("STEP", "Return ECU to default values");
  RunPostTs();
}


testcase SW_IT_CIL_Com_SendSignal_01()
{
  //***********************************Test report header*********************************
  testReportAddMiscInfoBlock("AUTOLIV ELECTRONICS document");
  TestReportAddMiscInfo("Nightly test", "No");
  TestReportAddMiscInfo("Test type", "Requirement-Based test");
  TestReportAddMiscInfo("Regression Test", "No");
  TestReportAddMiscInfo("Fault injection method used", "No");
  TestReportAddMiscInfo("Resource usage evaluation", "No");
  TestReportAddMiscInfo("Priority", "No");
  TestReportAddMiscInfo("Safety relevant", "No");
  
  AddRequirementInfo("Requirement under test", "ARCH_SW_CIL_0558");
  AddRequirementInfo("ARCH_SW_CIL_0558", "Com_SendSignal shall be called to ensure signal IfActive Transmission Type.");
  //***************************************************************************************
    
  testCaseComment("Preconditions");
  testStep("STEP", "Bench Initialization");

  RunPreTs();
  
  
    testStep("STEP", "Set a breakpoint in function CIL_runAppliToCAN().");
    debugger_setRelativeFunctionBpAtLine("CIL_runAppliToCAN", 0);

    testStep("STEP", "Check if CPU stopped in function CIL_runAppliToCAN(). --> CPU is Stopped");
debugger_isCPUStoppedAtFunction("CIL_runAppliToCAN");    ////EvalManStepEqual("Expected Test Result", debugger_result,  "CPU is Stopped");
    debugger_deleteAllBP();
  
    
    testStep("STEP", "Set a breakpoint in function cil_ManageFctPrecondSignal() at line 'if(KU8_CIL_ECU_SIDE_FRONT_LEFT == KU8_CIL_ECU_LOCATION)' and press run.");
    debugger_setBpAtLine("s:\\Components\\Application\\Autoliv\\CIL\\Implementation\\src\\CIL_AppliToCAN.c", 336);

    debugger_run();
  
    testStep("STEP", "Check if CPU stopped at line at line 'if(KU8_CIL_ECU_SIDE_FRONT_LEFT == KU8_CIL_ECU_LOCATION)'.");
    debugger_isCPUStoppedAtFunction("cil_ManageFctPrecondSignal");
    ////EvalManStepEqual("Expected Test Result", debugger_result,  "CPU is Stopped");   
    
    testStep("STEP", "Set a breakpoint in function Rte_Write_CIL_AC_CommunicationInteractionLayer_P_RBTMFL_SP_FctPrecond_Stat_ST35_RBTMFL_SP_FctPrecond_Stat_ST35.");
    debugger_setRelativeFunctionBpAtLine("Rte_Write_CIL_AC_CommunicationInteractionLayer_P_RBTMFL_SP_FctPrecond_Stat_ST35_RBTMFL_SP_FctPrecond_Stat_ST35", 7);
    
    debugger_run();
    
    testCaseComment("Action: ARCH_SW_CIL_0558");
    testStep("STEP", "Check if CPU stopped at line ret |= Com_SendSignal(ComConf_ComSignal_RBTMFL_SP_FctPrecond_Stat_ST35_bbfa2c80_Tx. --> CPU is Stopped");
    debugger_isCPUStoppedAtFunction("Rte_Write_CIL_AC_CommunicationInteractionLayer_P_RBTMFL_SP_FctPrecond_Stat_ST35_RBTMFL_SP_FctPrecond_Stat_ST35"); 
  

  testCaseComment("Postcondition");
  testStep("STEP", "Return ECU to default values");
  RunPostTs(); 
}



testcase SW_IT_CIL_Update_07Cx_Block17_01()
{
  //***********************************Test report header*********************************
  testReportAddMiscInfoBlock("AUTOLIV ELECTRONICS document");
  TestReportAddMiscInfo("Nightly test", "No");
  TestReportAddMiscInfo("Test type", "Requirement-Based test");
  TestReportAddMiscInfo("Regression Test", "No");
  TestReportAddMiscInfo("Fault injection method used", "No");
  TestReportAddMiscInfo("Resource usage evaluation", "No");
  TestReportAddMiscInfo("Priority", "No");
  TestReportAddMiscInfo("Safety relevant", "No");
  
  AddRequirementInfo("Requirement under test", "ARCH_SW_CIL_0769");
  AddRequirementInfo("ARCH_SW_CIL_0769", "PMP_runGetHS1Level_(Ext)* shall be called to get the value of the HS_SW voltage in V.");
  //***************************************************************************************
    
  testCaseComment("Preconditions");
  testStep("STEP", "Bench Initialization");
  RunPreTs();
  
 
    EnterDiagnosticSession("development");
    testStep("STEP", "Activate Measurement Frame block 17.");
    ActivateMeasurementFrame(17);
    
  
    testStep("STEP", "Set a breakpoint in function cil_Update_07Cx_Block17_InfosToSend at line 'Rte_Call_pclHS1_V_Get(&u16VHs1);'.");
    debugger_setRelativeFunctionBpAtLine("cil_Update_07Cx_Block17_InfosToSend", 15);
  
  
    debugger_deleteAllBP();
  
  
    testCaseComment("Action: ARCH_SW_CIL_0769");
    testStep("STEP", "Step in function Rte_Call_pclHS1_V_Get(&u16VHs1);. --> PMP_runGetHS1Level,,app.elf");
    debugger_stepIn();
  
    testStep("STEP", "Check if CPU stopped in function Rte_Call_pclHS1_V_Get(). --> CPU is Stopped");
    debugger_WaitUntilBPisReached(1000);
  
  
    debugger_deleteAllBP();
  
  
    testStep("STEP", "Set a breakpoint at the last line of function PMP_runGetHS1Level() and press run.");
    debugger_setRelativeFunctionBpAtLine("PMP_runGetHS1Level", 18);
    
    debugger_run();
  
    testStep("STEP", "Check if CPU stopped in function PMP_runGetHS1Level(). --> CPU is Stopped");
    debugger_WaitUntilBPisReached(1000);
  
    
    testCaseComment("Action: ARCH_SW_CIL_0769");
    testStep("STEP", "Evaluate if variable pu16Voltage is equal to 0x3233. --> 0x3233");
    result = debugger_readLocalVariable("*(pu16Voltage)");
    EvalManStepEqual("Expected Test Result", result, 0x3233);
    
  
    debugger_deleteAllBP();
    debugger_run();
    ActivateMeasurementFrame(1);
  
  
  testCaseComment("Postcondition");
  testStep("STEP", "Return ECU to default values");
  RunPostTs();
}


// R5.0


testcase SW_IT_CIL_Ign_Stat_ST3_01()
{
  //***********************************Test report header*********************************
  testReportAddMiscInfoBlock("AUTOLIV ELECTRONICS document");
  TestReportAddMiscInfo("Nightly test", "No");
  TestReportAddMiscInfo("Test type", "Requirement-Based test");
  TestReportAddMiscInfo("Regression Test", "No");
  TestReportAddMiscInfo("Fault injection method used", "No");
  TestReportAddMiscInfo("Resource usage evaluation", "No");
  TestReportAddMiscInfo("Priority", "No");
  TestReportAddMiscInfo("Safety relevant", "No");
  
  AddRequirementInfo("Requirement under test", "ARCH_SW_CIL_0005");
  AddRequirementInfo("ARCH_SW_CIL_0005", "Frame Ign_Stat_ST3 shall be manipulated to read all it’s signals and send the values through application.");
  //***************************************************************************************
    
  testCaseComment("Preconditions");
  testStep("STEP", "Bench Initialization");
  RunPreTs();

      
    testStep("STEP", "Set signal ISw_Stat_ST3 from frame Ign_Stat_ST3 to I_C03_ISW_STAT_IGN_ON (0x4).");
    setSignal(BODY3::ISw_Stat_ST3, 4); 
    testWaitForTimeout(500);
  
    testStep("STEP", "Set a breakpoint in function CIL_runCANToAppli().");
    debugger_setRelativeFunctionBpAtLine("CIL_runCANToAppli", 0);

    debugger_run();
  
    testStep("STEP", "Check if CPU stopped in function CIL_runCANToAppli(). --> CPU is Stopped");
debugger_isCPUStoppedAtFunction("CIL_runCANToAppli");    ////EvalManStepEqual("Expected Test Result", debugger_result, "CPU is Stopped");
  
  
    debugger_deleteAllBP();
  
  
    testStep("STEP", "Set a breakpoint in function cil_ManageInputSignals at line 'cil_u8IgnitionSignal = cil_stIgnStatFrame.ISw_Stat_ST3;'.");
    debugger_setRelativeFunctionBpAtLine("cil_ManageInputSignals", 14);
  
    debugger_run();
  
    testStep("STEP", "Check if CPU stopped in function cil_ManageInputSignals at line 'cil_u8IgnitionSignal = cil_stIgnStatFrame.ISw_Stat_ST3;'. --> CPU is Stopped");
debugger_isCPUStoppedAtFunction("cil_ManageInputSignals");    ////EvalManStepEqual("Expected Test Result", debugger_result, "CPU is Stopped");
    
  
    testCaseComment("Action: ARCH_SW_CIL_0005");
    testStep("STEP", "Read variable cil_u8IgnitionSignal --> 0x4.");
    result = debugger_readGlobalVariable("uint8", "cil_u8IgnitionSignal,,app.elf", 0);
    EvalManStepEqual("Expected Test Result", result, 0x4);
    

  testCaseComment("Postcondition");
  testStep("STEP", "Return ECU to default values");
  RunPostTs(); 
}


testcase SW_IT_CIL_Bckl_Sw_FP_Stat_ST3_01()
{
  //***********************************Test report header*********************************
  testReportAddMiscInfoBlock("AUTOLIV ELECTRONICS document");
  TestReportAddMiscInfo("Nightly test", "No");
  TestReportAddMiscInfo("Test type", "Requirement-Based test");
  TestReportAddMiscInfo("Regression Test", "No");
  TestReportAddMiscInfo("Fault injection method used", "No");
  TestReportAddMiscInfo("Resource usage evaluation", "No");
  TestReportAddMiscInfo("Priority", "No");
  TestReportAddMiscInfo("Safety relevant", "No");
  
  AddRequirementInfo("Requirement under test", "ARCH_SW_CIL_0007, ARCH_SW_CIL_0008, ARCH_SW_CIL_0028");
  AddRequirementInfo("ARCH_SW_CIL_0007", "Frame Bckl_Sw_Fx_Stat_ST3 shall be manipulated to read all it’s signals and send the values through application.");
  AddRequirementInfo("ARCH_SW_CIL_0008", "Signal Bckl_Sw_D_Stat_ST3 shall be send though application when it’s needed.");
  AddRequirementInfo("ARCH_SW_CIL_0028", "If value for Bckl_Sw_D_Stat_ST3 is not 0 (is 1,2,3) then cycle request should be inhibitted/aborted.");
  //***************************************************************************************
    
  testCaseComment("Preconditions");
  testStep("STEP", "Bench Initialization");
  RunPreTs();

    
    testStep("STEP", "Set signal Bckl_Sw_D_Stat_ST3 from frame Bckl_Sw_Fx_Stat_ST3 to I_C02_BCKL_SW_STAT_NOT.");
    setSignal(BODY3::Bckl_Sw_Fx_Stat_ST3::Bckl_Sw_D_Stat_ST3, 1);
    testWaitForTimeout(500);
  
  
    testStep("STEP", "Set a breakpoint in function CIL_runCANToAppli().");
    debugger_setRelativeFunctionBpAtLine("CIL_runCANToAppli", 0);
  
    testCaseComment("Action: ARCH_SW_CIL_0008");
    testStep("STEP", "Check if CPU stopped in function CIL_runCANToAppli(). --> CPU is Stopped");
debugger_isCPUStoppedAtFunction("CIL_runCANToAppli");    ////EvalManStepEqual("Expected Test Result", debugger_result, "CPU is Stopped");
  
    
    debugger_deleteAllBP();
    
    
    testStep("STEP", "Set a breakpoint in function cil_ManageInputSignals() at line '	cil_ManageInhibitConditions();'.");
    debugger_setBpAtLine("s:\\Components\\Application\\Autoliv\\CIL\\Implementation\\src\\CIL_CANToAppli.c", 1622);
    
    debugger_run();
  
    testCaseComment("Action: ARCH_SW_CIL_0007");
    testStep("STEP", "Check if CPU stopped in function cil_ManageInputSignals() at line '	cil_ManageInhibitConditions();'. --> CPU is Stopped");
debugger_isCPUStoppedAtFunction("cil_ManageInputSignals");    ////EvalManStepEqual("Expected Test Result", debugger_result,  "CPU is Stopped");
    
  
    debugger_deleteAllBP();
    
  
    testStep("STEP", "Set a breakpoint in function cil_ManageInhibitConditions() at line 'CIL_SET_INHIB_MASK_ON (KU8_CIL_Bckl_Sw_Inhibition);'.");
    debugger_setRelativeFunctionBpAtLine("cil_ManageInhibitConditions", 182);
    
    debugger_run();
  
    testStep("STEP", "Check if CPU stopped at line 'CIL_SET_INHIB_MASK_ON (KU8_CIL_Bckl_Sw_Inhibition);'. --> CPU is Stopped");
debugger_isCPUStoppedAtFunction("cil_ManageInhibitConditions");    ////EvalManStepEqual("Expected Test Result", debugger_result,  "CPU is Stopped");
    
    testCaseComment("Action: ARCH_SW_CIL_0028");
    testStep("STEP", "Evaluate if variable CIL_u16InhibitionStatus is equal to 0x40 --> 0x40.");
    result = debugger_readGlobalVariable("uint8", "CIL_u16InhibitionStatus,,app.elf", 0);
    EvalManStepEqual("Expected Test Result", result, 0x40);
  

  testCaseComment("Postcondition");
  testStep("STEP", "Return ECU to default values");
  RunPostTs(); 
}


testcase SW_IT_CIL_runAppliToCAN_26()
{
    //***********************************Test report header*********************************
  testReportAddMiscInfoBlock("AUTOLIV ELECTRONICS document");
  TestReportAddMiscInfo("Nightly test", "No");
  TestReportAddMiscInfo("Test type", "Requirement-Based test");
  TestReportAddMiscInfo("Regression Test", "No");
  TestReportAddMiscInfo("Fault injection method used", "No");
  TestReportAddMiscInfo("Resource usage evaluation", "No");
  TestReportAddMiscInfo("Priority", "No");
  TestReportAddMiscInfo("Safety relevant", "No");
  
  AddRequirementInfo("Requirement under test", "ARCH_SW_CIL_0010, ARCH_SW_CIL_0065, ARCH_SW_CIL_0066, ARCH_SW_CIL_0067");
  AddRequirementInfo("ARCH_SW_CIL_0010", "Signals from frame RBTM_FL/FR_Stat_ST3 shall be written with information from application.");
  AddRequirementInfo("ARCH_SW_CIL_0065", "Signals from frame RBTM FL/FR_Tens_ST3 shall be written with information from application.");
  AddRequirementInfo("ARCH_SW_CIL_0066", "Signal RBTM _FL/FR Actv_Lvl_ST35 shall be written and send to CAN.");
  AddRequirementInfo("ARCH_SW_CIL_0067", "The signal RBTM _FL/FR Actv_Lvl_ST35 shall be initialized with the value 0x3F(“SNA-Init”).");
  //***************************************************************************************
    
  testCaseComment("Preconditions");
  testStep("STEP", "Bench Initialization");
  RunPreTs();

    result = debugger_readGlobalVariable("uint8", "CIL_u8Actv_Lvl,,app.elf", 0);
  
    testStep("STEP", "Set signal RBTMFL_SP_Lvl_Rq_ST35 to I_C06_RBTM_LVL_STAT_PROFILE18.");
    setSignal(BODY3::RBTMFL_SP_Lvl_Rq_ST35, 18);
    testWaitForTimeout(500);
  
    testStep("STEP", "Set a breakpoint in function CIL_runAppliToCAN().");
    debugger_setRelativeFunctionBpAtLine("CIL_runAppliToCAN", 0);
  
    testStep("STEP", "Check if CPU stopped in function CIL_runAppliToCAN(). --> CPU is Stopped");
debugger_isCPUStoppedAtFunction("CIL_runAppliToCAN");    ////EvalManStepEqual("Expected Test Result", debugger_result, "CPU is Stopped");
  
  
    debugger_deleteAllBP();
  
  
    testStep("STEP", "Set a breakpoint in function cil_ManageActiveLevelSignal() after line 'CIL_u8Actv_Lvl = I_C06_RBTM_LVL_STAT_PROFILE18;'.");
    debugger_setBpAtLine("s:\\Components\\Application\\Autoliv\\CIL\\Implementation\\src\\CIL_AppliToCAN.c", 563);
   
    debugger_run();
    testWaitForTimeout(500);
    
    testStep("STEP", "Check if CPU stopped after line 'CIL_u8Actv_Lvl = I_C06_RBTM_LVL_STAT_PROFILE10;'. --> CPU is Stopped");
    debugger_isCPUStoppedAtFunction("cil_ManageActiveLevelSignal");
    ////EvalManStepEqual("Expected Test Result", debugger_result, "CPU is Stopped");
    
    testCaseComment("Action: ARCH_SW_CIL_0010, ARCH_SW_CIL_0065");
    testStep("STEP", "Evaluate if variable CIL_u8Actv_Lvl is equal to I_C06_RBTM_LVL_STAT_PROFILE18. --> I_C06_RBTM_LVL_STAT_PROFILE18");
    result = debugger_readGlobalVariable("uint8", "CIL_u8Actv_Lvl,,app.elf", 0);
    EvalManStepEqual("Expected Test Result", result, 18);
  
  
    testCaseComment("Action: ARCH_SW_CIL_0066, ARCH_SW_CIL_0067");
    testStep("STEP", "Evaluate if signal RBTMFL_Actv_Lvl_ST35 is equal to I_C06_RBTM_LVL_STAT_PROFILE18. --> I_C06_RBTM_LVL_STAT_PROFILE18");
    EvalManStepEqual("Expected Test Result", $RBTMFL_Actv_Lvl_ST35.raw64, 18);
  
  
  testCaseComment("Postcondition");
  testStep("STEP", "Return ECU to default values");
  setSignal(BODY3::RBTMFL_SP_Lvl_Rq_ST35, 0);
  RunPostTs(); 
}


testcase SW_IT_CIL_Impact3_ST3_01()
{
  //***********************************Test report header*********************************
  testReportAddMiscInfoBlock("AUTOLIV ELECTRONICS document");
  TestReportAddMiscInfo("Nightly test", "No");
  TestReportAddMiscInfo("Test type", "Requirement-Based test");
  TestReportAddMiscInfo("Regression Test", "No");
  TestReportAddMiscInfo("Fault injection method used", "No");
  TestReportAddMiscInfo("Resource usage evaluation", "No");
  TestReportAddMiscInfo("Priority", "No");
  TestReportAddMiscInfo("Safety relevant", "No");
  
  AddRequirementInfo("Requirement under test", "ARCH_SW_CIL_0030, ARCH_SW_CIL_0035");
  AddRequirementInfo("ARCH_SW_CIL_0030", "Frame Impact3_ST3 shall be manipulated to read all it’s signals and send the values through application.");
  AddRequirementInfo("ARCH_SW_CIL_0035", "Signal Impact_X_ST3 shall be send though application when it’s needed.");
  //***************************************************************************************
    
  testCaseComment("Preconditions");
  testStep("STEP", "Bench Initialization");
  RunPreTs();
  
    
    testStep("STEP", "Set signal Impact_X_ST3 from frame Impact3_ST3 to 0x1.");
    setSignal(BODY3::Impact3_ST3::Impact_X_ST3, 1);
    testWaitForTimeout(500);
  
  
    testStep("STEP", "Set a breakpoint in function CIL_runCANToAppli at line 'cil_ManageInputSignals();'.");
    debugger_setRelativeFunctionBpAtLine("CIL_runCANToAppli", 5);
  
    testStep("STEP", "Step in function cil_ManageInputSignals(). --> Stepped in function cil_ManageInputSignals()");
    debugger_stepIn();
    testWaitForTimeoutSilent(500);
    //EvalManStepEqual("Expected Test Result", debugger_result, "Stepped in function cil_ManageInputSignals,,app.elf");
  
  
    debugger_deleteAllBP();
  
    
    testStep("STEP", "Set a breakpoint in function cil_ManageInputSignals() at line 'cil_stInputSignalsPresfRec.bImpactXType= cil_stImpactSignalsStatus3.Impact_X_ST3;'.");
    debugger_setBpAtLine("s:\\Components\\Application\\Autoliv\\CIL\\Implementation\\src\\CIL_CANToAppli.c", 1507);
    
    testStep("STEP", "Check if CPU stopped at line 'cil_stInputSignalsPresfRec.bImpactXType= cil_stImpactSignalsStatus3.Impact_X_ST3;'. --> CPU is Stopped");
    debugger_isCPUStoppedAtFunction("cil_ManageInputSignals");
    ////EvalManStepEqual("Expected Test Result", debugger_result, "CPU is Stopped");
    
    testCaseComment("Action: ARCH_SW_CIL_0030, ARCH_SW_CIL_0035");
    testStep("STEP", "Read variable cil_stInputSignalsPresfRec.bImpactXType --> 0x1.");
    result = debugger_readGlobalVariable("uint8", "cil_stInputSignalsPresfRec,,app.elf", 3);
    EvalManStepEqual("Expected Test Result", result, 0x1);

  
  testCaseComment("Postcondition");
  testStep("STEP", "Return ECU to default values");
  RunPostTs(); 
}


testcase SW_IT_CIL_Impact2_ST3_01()
{
  //***********************************Test report header*********************************
  testReportAddMiscInfoBlock("AUTOLIV ELECTRONICS document");
  TestReportAddMiscInfo("Nightly test", "No");
  TestReportAddMiscInfo("Test type", "Requirement-Based test");
  TestReportAddMiscInfo("Regression Test", "No");
  TestReportAddMiscInfo("Fault injection method used", "No");
  TestReportAddMiscInfo("Resource usage evaluation", "No");
  TestReportAddMiscInfo("Priority", "No");
  TestReportAddMiscInfo("Safety relevant", "No");
  
  AddRequirementInfo("Requirement under test", "ARCH_SW_CIL_0039, ARCH_SW_CIL_0037, ARCH_SW_CIL_0038");
  AddRequirementInfo("ARCH_SW_CIL_0039", "Frame Impact2_ST3 shall be manipulated to read all it’s signals and send the values through application.");
  AddRequirementInfo("ARCH_SW_CIL_0037", "Signal Impact_Y_ST3 shall be removed from application.");
  AddRequirementInfo("ARCH_SW_CIL_0038", "All values for Impact Y shall be ignored.");
  //***************************************************************************************
    
  testCaseComment("Preconditions");
  testStep("STEP", "Bench Initialization");
  RunPreTs();
  
    
    testStep("STEP", "Set signal Impact_Y_ST3 from frame Impact2_ST3 to KU8_ONE.");
    setSignal(BODY3::Impact2_ST3::Impact_Y_ST3, 1);
    testWaitForTimeout(500);

  
    testStep("STEP", "Set a breakpoint in function CIL_ComNotification_ORC_Impact2_Pr5_ST3_b9l09rrslyv7vj3o92j69irnd_2f5ae8ac_Rx().");
    debugger_setRelativeFunctionBpAtLine("CIL_ComNotification_ORC_Impact2_Pr5_ST3_b9l09rrslyv7vj3o92j69irnd_2f5ae8ac_Rx", 0);
 
    testStep("STEP", "Check if CPU stopped at line '(void)Rte_Read_CIL_AC_CommunicationInteractionLayer_IG_ORC_Impact2_Pr5_ST3_ORC_Impact2_Pr5_ST3(&cil_stImpactSignalsStatus2);'. --> CPU is Stopped");
debugger_isCPUStoppedAtFunction("CIL_ComNotification_ORC_Impact2_Pr5_ST3_b9l09rrslyv7vj3o92j69irnd_2f5ae8ac_Rx");    ////EvalManStepEqual("Expected Test Result", debugger_result, "CPU is Stopped");
  
  
    testCaseComment("Action: ARCH_SW_CIL_0039");
    testStep("STEP", "Evaluate if variable cil_stImpactSignalsStatus2 is equla to KU8_ONE --> KU8_ONE.");
    result = debugger_readGlobalVariable("uint8", "cil_stImpactSignalsStatus2,,app.elf", 0);
    EvalManStepEqual("Expected Test Result", result, 1);
  
  
    testStep("STEP", "Set a breakpoint in function CIL_runCANToAppli at line 'cil_ManageInputSignals();'.");
    debugger_setRelativeFunctionBpAtLine("CIL_runCANToAppli", 5);
  
    debugger_run();

    testStep("STEP", "Check if CPU stopped at line 'cil_ManageInputSignals();'. --> CPU is Stopped");
debugger_isCPUStoppedAtFunction("CIL_runCANToAppli");    ////EvalManStepEqual("Expected Test Result", debugger_result, "CPU is Stopped");
  
  
    debugger_deleteAllBP();
  
  
    testStep("STEP", "Set a breakpoint in function cil_ManageInputSignals().");
    debugger_setRelativeFunctionBpAtLine("cil_ManageInputSignals", 0);
  
    debugger_run();
  
    testCaseComment("Action: ARCH_SW_CIL_0037, ARCH_SW_CIL_0038");
    testStep("STEP", "Check if CPU stopped in function cil_ManageInputSignals(). --> CPU is Stopped");
debugger_isCPUStoppedAtFunction("cil_ManageInputSignals");    ////EvalManStepEqual("Expected Test Result", debugger_result, "CPU is Stopped");
  

  testCaseComment("Postcondition");
  testStep("STEP", "Return ECU to default values");
  RunPostTs();
}



testcase SW_IT_CIL_NVP_u16HWARepetition_01()
{
  //***********************************Test report header*********************************
  testReportAddMiscInfoBlock("AUTOLIV ELECTRONICS document");
  TestReportAddMiscInfo("Nightly test", "No");
  TestReportAddMiscInfo("Test type", "Requirement-Based test");
  TestReportAddMiscInfo("Regression Test", "No");
  TestReportAddMiscInfo("Fault injection method used", "No");
  TestReportAddMiscInfo("Resource usage evaluation", "No");
  TestReportAddMiscInfo("Priority", "No");
  TestReportAddMiscInfo("Safety relevant", "No");
  
  AddRequirementInfo("Requirement under test", "ARCH_SW_CIL_0047");
  AddRequirementInfo("ARCH_SW_CIL_0047", "CIL component shall ensure repetition of vibration phase (cycle 19) of HWA 1 for NVP_u16DurationHaptic1.");
  //***************************************************************************************
    
  testCaseComment("Preconditions");
  testStep("STEP", "Bench Initialization");
  RunPreTs();

  
    testStep("STEP", "Set signal Presf_Lvl_ST3 to I_C04_PRESF_LVL_V2_LVL2.");
    setSignal(BODY3::Presf_Lvl_ST3, I_C04_PRESF_LVL_V2_LVL2); 
 
  
    testStep("STEP", "Set a breakpoint in function CIL_runCANToAppli().");
    debugger_setRelativeFunctionBpAtLine("CIL_runCANToAppli", 0);

    testStep("STEP", "Check if CPU stopped in function CIL_runCANToAppli(). --> CPU is Stopped");
debugger_isCPUStoppedAtFunction("CIL_runCANToAppli");    ////EvalManStepEqual("Expected Test Result", debugger_result, "CPU is Stopped");
  
  
    testStep("STEP", "Set a breakpoint in function cil_ManageHapticRepetition at line 'CIL_u16HWARepetitionTime = ((uint16)(NVP_BLOCK_ID_HAPTIC_CONFIG_MB_RamBlockData.NVP_u16DurationHaptic1)/KU16_TEN);'.");
    debugger_setBpAtLine("s:\\Components\\Application\\Autoliv\\CIL\\Implementation\\src\\CIL_CANToAppli.c", 1547);
    
    debugger_run();

    testStep("STEP", "Check if CPU stopped at line 'CIL_u16HWARepetitionTime = ((uint16)(NVP_BLOCK_ID_HAPTIC_CONFIG_MB_RamBlockData.NVP_u16DurationHaptic1)/KU16_TEN);'. --> CPU is Stopped");
    debugger_isCPUStoppedAtFunction("cil_ManageHapticRepetition");
    ////EvalManStepEqual("Expected Test Result", debugger_result, "CPU is Stopped");
  
    debugger_run();
  
    testCaseComment("Action: ARCH_SW_CIL_0047");
    testStep("STEP", "Evaluate if variable CIL_u16HWARepetitionTime is equal to NVP_u16DurationHaptic1 / KU16_TEN --> NVP_u16DurationHaptic1 / KU16_TEN (0x64).");
    result = debugger_readGlobalVariable("uin16", "CIL_u16HWARepetitionTime,,app.elf", 0);
    EvalManStepEqual("Expected Test Result", 0x64, 0x64);


  testCaseComment("Postcondition");
  testStep("STEP", "Return ECU to default values");
  setSignal(BODY3::Presf_Lvl_ST3, I_C04_PRESF_LVL_V2_NOLVL); 
  RunPostTs();
}


testcase SW_IT_CIL_SBeltTens_SP_Lvl_ST3_02()
{
 //***********************************Test report header*********************************
  testReportAddMiscInfoBlock("AUTOLIV ELECTRONICS document");
  TestReportAddMiscInfo("Nightly test", "No");
  TestReportAddMiscInfo("Test type", "Requirement-Based test");
  TestReportAddMiscInfo("Regression Test", "No");
  TestReportAddMiscInfo("Fault injection method used", "No");
  TestReportAddMiscInfo("Resource usage evaluation", "No");
  TestReportAddMiscInfo("Priority", "No");
  TestReportAddMiscInfo("Safety relevant", "No");
  
  AddRequirementInfo("Requirement under test", "ARCH_SW_CIL_0050, ARCH_SW_CIL_0051");
  AddRequirementInfo("ARCH_SW_CIL_0050", "Frame SBeltTens_SP_Lvl_ST3 shall be manipulated to read all it’s signals and send the values through application.");
  AddRequirementInfo("ARCH_SW_CIL_0051", "Signal RBTMFL_SP_Lvl_Rq_ST35 shall be send though application when it’s needed.");
  //***************************************************************************************

  testCaseComment("Preconditions");
  testStep("STEP", "Bench Initialization");
  RunPreTs();
  
    
    testStep("STEP", "Set signal RBTMFL_SP_Lvl_Rq_ST35 from frame SBeltTens_SP_Lvl_ST3 to KU8_ONE.");
    setSignal(BODY3::SBeltTens_SP_Lvl_ST3::RBTMFL_SP_Lvl_Rq_ST35, 1);
    testWaitForTimeout(500);
    
    testStep("STEP", "Set a breakpoint in function CIL_runCANToAppli().");
    debugger_setRelativeFunctionBpAtLine("CIL_runCANToAppli", 0);
    
    testStep("STEP", "Check if CPU stopped in function CIL_runCANToAppli(). --> CPU is Stopped");
debugger_isCPUStoppedAtFunction("CIL_runCANToAppli");    ////EvalManStepEqual("Expected Test Result", debugger_result, "CPU is Stopped");
    
    
    debugger_deleteAllBP();
    
    
    testStep("STEP", "Set a breakpoint at the end of function cil_ManageInputSignals().");
    debugger_setRelativeFunctionBpAtLine("cil_ManageInputSignals", 268);
    
    debugger_run();
    
    testStep("STEP", "Check if CPU stopped at the end of function cil_ManageInputSignals(). --> CPU is Stopped");
debugger_isCPUStoppedAtFunction("cil_ManageInputSignals");    ////EvalManStepEqual("Expected Test Result", debugger_result, "CPU is Stopped");
  
  
    testCaseComment("Action: ARCH_SW_CIL_0050, ARCH_SW_CIL_0051");
    testStep("STEP", "Read variable cil_stAPIInterface.");
    result = debugger_readGlobalVariable("uint8", "cil_stAPIInterface,,app.elf", 0);
    EvalManStepEqual("Expected Test Result", result);
  

  testCaseComment("Postcondition");
  testStep("STEP", "Return ECU to default values");
  setSignal(BODY3::SBeltTens_SP_Lvl_ST3::RBTMFL_SP_Lvl_Rq_ST35, 0);
  RunPostTs();
}



testcase SW_IT_CIL_BeltAdj_01() 
{
  //***********************************Test report header*********************************
  testReportAddMiscInfoBlock("AUTOLIV ELECTRONICS document");
  TestReportAddMiscInfo("Nightly test", "No");
  TestReportAddMiscInfo("Test type", "Requirement-Based test");
  TestReportAddMiscInfo("Regression Test", "No");
  TestReportAddMiscInfo("Fault injection method used", "No");
  TestReportAddMiscInfo("Resource usage evaluation", "No");
  TestReportAddMiscInfo("Priority", "No");
  TestReportAddMiscInfo("Safety relevant", "No");
  
  AddRequirementInfo("Requirement under test", "ARCH_SW_CIL_0014");
  AddRequirementInfo("ARCH_SW_CIL_0014", "Signals from frame BeltAdj_FL/FR_Stat_ST3 shall be written with information from application.");
  //***************************************************************************************
  
  testCaseComment("Preconditions");
  testStep("STEP", "Bench Initialization");
  RunPreTs();
  
  
    testStep("STEP", "Set signal BltSlckDec_Md_Rq_HU_ST3 to I_C02_OFF_ON_OFF.");
    setSignal(BODY3::BltSlckDec_Md_Rq_HU_ST3, 0);
  
    testStep("STEP", "Set a breakpoint in function CIL_runAppliToCAN().");
    debugger_setRelativeFunctionBpAtLine("CIL_runAppliToCAN", 33);
  
    testStep("STEP", "Check if CPU stopped in function CIL_runAppliToCAN(). --> CPU is Stopped");
    debugger_WaitUntilBPisReached(1000);
  
  
    debugger_deleteAllBP();
  
  
    testStep("STEP", "Set a breakpoint in function cil_ManageOutputSignals() at line '(void)Rte_Write_CIL_AC_CommunicationInteractionLayer_IF_BltSlckDec_Md_XX_Stat_ST3_BltSlckDec_Md_XX_Stat_ST3(CIL_u8BltSlckDec_Md);'.");
    debugger_setBpAtLine("s:\\Components\\Application\\Autoliv\\CIL\\Implementation\\src\\CIL_AppliToCAN.c", 677);
  
    debugger_run();
    debugger_deleteAllBP();
    debugger_run();  
  
    testCaseComment("Action: ARCH_SW_CIL_0014");
    testStep("STEP", "Evaluate if signal BeltAdj_FL_Stat_ST3::BltSlckDec_Md_FL_Stat_ST3 is equal to I_C02_OFF_ON_OFF. --> I_C02_OFF_ON_OFF");
    EvalManStepEqual("Expected Test Result", $BeltAdj_FL_Stat_ST3::BltSlckDec_Md_FL_Stat_ST3.raw64, 0);
  
  
  testCaseComment("Postcondition");
  testStep("STEP", "Return ECU to default values");
  RunPostTs(); 
}



testcase SW_IT_CIL_BeltAdj_UI_Set_Rq_ST3_01()
{
 //***********************************Test report header*********************************
  testReportAddMiscInfoBlock("AUTOLIV ELECTRONICS document");
  TestReportAddMiscInfo("Nightly test", "No");
  TestReportAddMiscInfo("Test type", "Requirement-Based test");
  TestReportAddMiscInfo("Regression Test", "No");
  TestReportAddMiscInfo("Fault injection method used", "No");
  TestReportAddMiscInfo("Resource usage evaluation", "No");
  TestReportAddMiscInfo("Priority", "No");
  TestReportAddMiscInfo("Safety relevant", "No");
  
  AddRequirementInfo("Requirement under test", "ARCH_SW_CIL_0094, ARCH_SW_CIL_0095, ARCH_SW_CIL_0096");
  AddRequirementInfo("ARCH_SW_CIL_0094", "Frame BeltAdj_UI_Set_Rq_ST3 shall be manipulated to read all it’s signals and send the values through application.");
  AddRequirementInfo("ARCH_SW_CIL_0095", "Signal PS_Curve_FL_Rq_HU_ST3 shall be send though application when it’s needed(0,1,2,3)");
  AddRequirementInfo("ARCH_SW_CIL_0096", "Signal PS_Curve_FR_Rq_HU_ST3 shall be send though application when it’s needed(0,1,2,3)");
  //***************************************************************************************

  testCaseComment("Preconditions");
  testStep("STEP", "Bench Initialization");
  RunPreTs();
  
  
    testStep("STEP", "Set signal PS_Curve_FL_Rq_HU_ST3 from frame BeltAdj_UI_Set_Rq_ST3 to KU8_ONE.");
    setSignal(BODY3::BeltAdj_UI_Set_Rq_ST3::PS_Curve_FL_Rq_HU_ST3, 1);
    testWaitForTimeout(500);

  
    testStep("STEP", "Set a breakpoint in function CIL_runCANToAppli().");
    debugger_setRelativeFunctionBpAtLine("CIL_runCANToAppli", 0);
    
    testStep("STEP", "Check if CPU stopped in function CIL_runCANToAppli(). --> CPU is Stopped");
    debugger_WaitUntilBPisReached(1000);
  
    
    debugger_deleteAllBP();
  
  
    testStep("STEP", "Set a breakpoint in function cil_ManageInputSignals() at line '(void)Rte_Read_CIL_AC_CommunicationInteractionLayer_R_PS_Curve_FL_Rq_HU_ST3_PS_Curve_FL_Rq_HU_ST3(&CIL_u8PSCurve);'.");
    debugger_setRelativeFunctionBpAtLine("cil_ManageInputSignals", 32);
    
    debugger_run();
  
    testStep("STEP", "Check if CPU stopped in function cil_ManageInputSignals() at line '(void)Rte_Read_CIL_AC_CommunicationInteractionLayer_R_PS_Curve_FL_Rq_HU_ST3_PS_Curve_FL_Rq_HU_ST3(&CIL_u8PSCurve);'. --> CPU is Stopped");
    debugger_WaitUntilBPisReached(1000);
  
    testCaseComment("Action: ARCH_SW_CIL_0094, ARCH_SW_CIL_0095");
    testStep("STEP", "Evaluate if variable CIL_u8PSCurve is equal to KU8_ONE--> KU8_ONE.");
    result = debugger_readGlobalVariable("uint8", "CIL_u8PSCurve,,app.elf", 0);
    EvalManStepEqual("Expected Test Result", result, 1);
    
    
    debugger_deleteAllBP();
    debugger_reset();
    debugger_run();
  
  
    testStep("STEP", "Set signal PS_Curve_FR_Rq_HU_ST3 from frame BeltAdj_UI_Set_Rq_ST3 to KU8_ONE.");
    setSignal(BODY3::BeltAdj_UI_Set_Rq_ST3::PS_Curve_FR_Rq_HU_ST3, 1);
    testWaitForTimeout(500);
  
  
    testStep("STEP", "Set a breakpoint in function CIL_runCANToAppli().");
    debugger_setRelativeFunctionBpAtLine("CIL_runCANToAppli", 0);
    
    testStep("STEP", "Check if CPU stopped in function CIL_runCANToAppli(). --> CPU is Stopped");
    debugger_WaitUntilBPisReached(1000);
  
    
    testStep("STEP", "Set a breakpoint in function cil_ManageInputSignals() at line 'void)Rte_Read_CIL_AC_CommunicationInteractionLayer_R_PS_Curve_FR_Rq_HU_ST3_PS_Curve_FR_Rq_HU_ST3(&CIL_u8PSCurve);'.");
    debugger_setRelativeFunctionBpAtLine("cil_ManageInputSignals", 50);
    
    debugger_run();
  
    testStep("STEP", "Check if CPU stopped in function cil_ManageInputSignals() at line 'void)Rte_Read_CIL_AC_CommunicationInteractionLayer_R_PS_Curve_FR_Rq_HU_ST3_PS_Curve_FR_Rq_HU_ST3(&CIL_u8PSCurve);'. --> CPU is Stopped");
    debugger_WaitUntilBPisReached(1000);

  
    testCaseComment("Action: ARCH_SW_CIL_0094, ARCH_SW_CIL_0096");
    testStep("STEP", "Evaluate if variable CIL_u8PSCurve is equal to KU8_ONE--> KU8_ONE.");
    result = debugger_readGlobalVariable("uint8", "CIL_u8PSCurve,,app.elf", 0);
    EvalManStepEqual("Expected Test Result", result, 1);
  

  testCaseComment("Postcondition");
  testStep("STEP", "Return ECU to default values");
  RunPostTs();
}


testcase SW_IT_CIL_PT4_PTCoor4_ST3_01()
{
 //***********************************Test report header*********************************
  testReportAddMiscInfoBlock("AUTOLIV ELECTRONICS document");
  TestReportAddMiscInfo("Nightly test", "No");
  TestReportAddMiscInfo("Test type", "Requirement-Based test");
  TestReportAddMiscInfo("Regression Test", "No");
  TestReportAddMiscInfo("Fault injection method used", "No");
  TestReportAddMiscInfo("Resource usage evaluation", "No");
  TestReportAddMiscInfo("Priority", "No");
  TestReportAddMiscInfo("Safety relevant", "No");
  
  AddRequirementInfo("Requirement under test", "ARCH_SW_CIL_0150, ARCH_SW_CIL_0151");
  AddRequirementInfo("ARCH_SW_CIL_0150", "Frame PT4_PTCoor4_ST3 shall be manipulated to read all it’s signals and send the values through application.");
  AddRequirementInfo("ARCH_SW_CIL_0151", "Frame PT4_PTCoor4_ST3 shall be manipulated to read all it’s signals and send the values through application.");
  //***************************************************************************************
    
  testCaseComment("Preconditions");
  testStep("STEP", "Bench Initialization");
  RunPreTs();

    
    testStep("STEP", "Set signal PT4_PTCoor_PT_Rdy_ST3 to I_C02_PT_RDY_V2_PT_RDY.");
    setSignal(BODY3::PT4_PTCoor4_ST3::PT4_PTCoor_PT_Rdy_ST3, 1);
    testWaitForTimeout(1000);
  
    testStep("STEP", "Set a breakpoint in function CIL_runCANToAppli() at line 'cil_ManageInputSignals();'.");
    debugger_setRelativeFunctionBpAtLine("CIL_runCANToAppli", 5);
    
    testStep("STEP", "Check if CPU stopped in function CIL_runCANToAppli() at line 'cil_ManageInputSignals();'. --> CPU is Stopped");
debugger_isCPUStoppedAtFunction("CIL_runCANToAppli");    ////EvalManStepEqual("Expected Test Result", debugger_result, "CPU is Stopped");
  
  
    debugger_deleteAllBP();
  
  
    testStep("STEP", "Set a breakpoint in function cil_ManageInputSignals() at line 'cil_ManageInhibitConditions();'.");
    debugger_setRelativeFunctionBpAtLine("CIL_runCANToAppli", 250);
    
    debugger_run();  
    debugger_deleteAllBP();
  
  
    testStep("STEP", "Set a breakpoint in function cil_ManageInhibitConditions() at line 'if(I_C02_PT_RDY_V2_PT_RDY != cil_stPTCoor4Pr5St3.PT4_PTCoor_PT_Rdy_ST3)'.");
    debugger_setRelativeFunctionBpAtLine("cil_ManageInhibitConditions", 235);
    
    debugger_run();
  
    testStep("STEP", "Check if CPU stopped at line 'if(I_C02_PT_RDY_V2_PT_RDY != cil_stPTCoor4Pr5St3.PT4_PTCoor_PT_Rdy_ST3)'. --> CPU is Stopped");
debugger_isCPUStoppedAtFunction("cil_ManageInhibitConditions");    ////EvalManStepEqual("Expected Test Result", debugger_result, "CPU is Stopped");
  
  
    testCaseComment("Action: ARCH_SW_CIL_0150, ARCH_SW_CIL_0151");
    testStep("STEP", "Evaluate if variable cil_stPTCoor4Pr5St3.PT4_PTCoor_PT_Rdy_ST3 is equal to I_C02_PT_RDY_V2_PT_RDY --> I_C02_PT_RDY_V2_PT_RDY (0x1).");
    result = debugger_readGlobalVariable("uint8", "cil_stPTCoor4Pr5St3,,app.elf", 0);
    EvalManStepEqual("Expected Test Result", result, 1);
  

  testCaseComment("Postcondition");
  testStep("STEP", "Return ECU to default values");
  RunPostTs();
}


testcase SW_IT_CIL_PT4_PTCoor_DrvPosn_Stat_ST3_01()
{
 //***********************************Test report header*********************************
  testReportAddMiscInfoBlock("AUTOLIV ELECTRONICS document");
  TestReportAddMiscInfo("Nightly test", "No");
  TestReportAddMiscInfo("Test type", "Requirement-Based test");
  TestReportAddMiscInfo("Regression Test", "No");
  TestReportAddMiscInfo("Fault injection method used", "No");
  TestReportAddMiscInfo("Resource usage evaluation", "No");
  TestReportAddMiscInfo("Priority", "No");
  TestReportAddMiscInfo("Safety relevant", "No");
  
  AddRequirementInfo("Requirement under test", "ARCH_SW_CIL_0153, ARCH_SW_CIL_0154");
  AddRequirementInfo("ARCH_SW_CIL_0153", "Frame PT4_PTCoor_DrvPosn_Stat_ST3 shall be manipulated to read all it’s signals and send the values through application.");
  AddRequirementInfo("ARCH_SW_CIL_0154", "Signal PT4_PTCoor_DrvPosn_Stat_ST3 shall be send through application when it’s needed (1,2,3,4, 15).");
  //***************************************************************************************
    
  testCaseComment("Preconditions");
  testStep("STEP", "Bench Initialization");
  RunPreTs();
      
    testStep("STEP", "Set signal PT4_PTCoor_DrvPosn_Stat_ST3 to I_C04_DRVPOSN_ST3_D.");
    setSignal(BODY3::PT4_PTCoor_DrvPosn_Stat_ST3, 1);
    testWaitForTimeout(1000);
    
    testStep("STEP", "Set a breakpoint in function CIL_runCANToAppli() at line 'cil_ManageInputSignals();'.");
    debugger_setRelativeFunctionBpAtLine("CIL_runCANToAppli", 5);
    
    testStep("STEP", "Check if CPU stopped in function CIL_runCANToAppli() at line 'cil_ManageInputSignals();'. --> CPU is Stopped");
debugger_isCPUStoppedAtFunction("CIL_runCANToAppli");    ////EvalManStepEqual("Expected Test Result", debugger_result, "CPU is Stopped");
  
    debugger_deleteAllBP();
  
    testStep("STEP", "Set a breakpoint in function cil_ManageInputSignals() at line 'cil_ManageInhibitConditions();'.");
    debugger_setRelativeFunctionBpAtLine("CIL_runCANToAppli", 250);
    
    debugger_run();
    debugger_deleteAllBP();
  
    testStep("STEP", "Set a breakpoint in function cil_ManageInhibitConditions() at line '(I_C04_DRVPOSN_ST3_R == cil_stPTCoorDrvPos.PT4_PTCoor_DrvPosn_Stat_ST3) )'.");
    debugger_setRelativeFunctionBpAtLine("cil_ManageInhibitConditions", 274);
    
    debugger_run();
  
    testStep("STEP", "Check if CPU stopped in function cil_ManageInhibitConditions() at line '(I_C04_DRVPOSN_ST3_R == cil_stPTCoorDrvPos.PT4_PTCoor_DrvPosn_Stat_ST3) )'. --> CPU is Stopped");
debugger_isCPUStoppedAtFunction("cil_ManageInhibitConditions");    ////EvalManStepEqual("Expected Test Result", debugger_result, "CPU is Stopped");
  
    
    testCaseComment("Action: ARCH_SW_CIL_0153, ARCH_SW_CIL_0154");
    testStep("STEP", "Evaluate if variable cil_stPTCoorDrvPos.PT4_PTCoor_DrvPosn_Stat_ST3 is equal to I_C04_DRVPOSN_ST3_D --> I_C04_DRVPOSN_ST3_D (0x1).");
    result = debugger_readGlobalVariable("uint8", "cil_stPTCoorDrvPos,,app.elf", 0);
    EvalManStepEqual("Expected Test Result", result, 1);
  

  testCaseComment("Postcondition");
  testStep("STEP", "Return ECU to default values");
  RunPostTs();
}



testcase SW_IT_CIL_BeltHdOvr_State_ST3_02()
{
 //***********************************Test report header*********************************
  testReportAddMiscInfoBlock("AUTOLIV ELECTRONICS document");
  TestReportAddMiscInfo("Nightly test", "No");
  TestReportAddMiscInfo("Test type", "Requirement-Based test");
  TestReportAddMiscInfo("Regression Test", "No");
  TestReportAddMiscInfo("Fault injection method used", "No");
  TestReportAddMiscInfo("Resource usage evaluation", "No");
  TestReportAddMiscInfo("Priority", "No");
  TestReportAddMiscInfo("Safety relevant", "No");
  
  AddRequirementInfo("Requirement under test", "ARCH_SW_CIL_0186");
  AddRequirementInfo("ARCH_SW_CIL_0186", "If values for this signal are different than 0x00= RETRACT (Belt hand over retracted).Then all BSR cycles are inhibitted/aborted if signal is enabled in the coding.");
  //***************************************************************************************
    
  testCaseComment("Preconditions");
  testStep("STEP", "Bench Initialization");

  RunPreTs();
    
  
    testStep("STEP", "Set signal BeltHdOvr_FL_Stat_ST3 from frame BeltHdOvr_FL_State_ST3 to I_C02_BELTHDOVR_STAT_OUT_OF_END.");
    setSignal(BODY3::BeltHdOvr_FL_State_ST3::BeltHdOvr_FL_Stat_ST3, 1);
    testWaitForTimeout(1000);
    
    testStep("STEP", "Set a breakpoint in fucntion CIL_runCANToAppli().");
    debugger_setRelativeFunctionBpAtLine("CIL_runCANToAppli", 0);
  
    testStep("STEP", "Check if CPU stopped at function CIL_runCANToAppli(). --> CPU is Stopped");
debugger_isCPUStoppedAtFunction("CIL_runCANToAppli");    ////EvalManStepEqual("Expected Test Result", debugger_result,  "CPU is Stopped");
  
    testStep("STEP", "Set a breakpoint in function cil_ManageInputSignals at line 'cil_ManageInhibitConditions();'.");
    debugger_setBpAtLine("s:\\Components\\Application\\Autoliv\\CIL\\Implementation\\src\\CIL_CANToAppli.c", 1622);
    
    debugger_run();
  
    testStep("STEP", "Check if CPU stopped in function cil_ManageInputSignals at line 'cil_ManageInhibitConditions();'. --> CPU is Stopped");
debugger_isCPUStoppedAtFunction("cil_ManageInputSignals");    ////EvalManStepEqual("Expected Test Result", debugger_result,  "CPU is Stopped");
    
    
    testStep("STEP", "Set a breakpoint in function cil_ManageInhibitConditions() at line 'CIL_SET_INHIB_MASK_ON (KU8_CIL_DTCInhibitionOfBSR);'.");
    debugger_setRelativeFunctionBpAtLine("cil_ManageInhibitConditions", 217);
    
    debugger_run();
  
    testCaseComment("Action: ARCH_SW_CIL_0186");
    testStep("STEP", "Check if CPU stoped at line 'CIL_SET_INHIB_MASK_ON (KU8_CIL_DTCInhibitionOfBSR);'. --> CPU is Stopped");
debugger_isCPUStoppedAtFunction("cil_ManageInhibitConditions");    ////EvalManStepEqual("Expected Test Result", debugger_result,  "CPU is Stopped");
 

  testCaseComment("Postcondition");
  testStep("STEP", "Return ECU to default values");
  setSignal(BODY3::Presf_Lvl_ST3, I_C04_PRESF_LVL_V2_NOLVL);
  RunPostTs(); 
}



testcase SW_IT_CIL_BeltHdOvr_State_ST3_03()
{
 //***********************************Test report header*********************************
  testReportAddMiscInfoBlock("AUTOLIV ELECTRONICS document");
  TestReportAddMiscInfo("Nightly test", "No");
  TestReportAddMiscInfo("Test type", "Requirement-Based test");
  TestReportAddMiscInfo("Regression Test", "No");
  TestReportAddMiscInfo("Fault injection method used", "No");
  TestReportAddMiscInfo("Resource usage evaluation", "No");
  TestReportAddMiscInfo("Priority", "No");
  TestReportAddMiscInfo("Safety relevant", "No");
  
  AddRequirementInfo("Requirement under test", "ARCH_SW_CIL_0157, ARCH_SW_CIL_0158, ARCH_SW_CIL_0159, ARCH_SW_CIL_0156");
  AddRequirementInfo("ARCH_SW_CIL_0157", "Frame BeltHdOvr_FL_State_ST3 shall be manipulated to read all it’s signals and send the values through application.");
  AddRequirementInfo("ARCH_SW_CIL_0159", "Frame BeltHdOvr_FR_State_ST3 shall be manipulated to read all it’s signals and send the values through application.");
  AddRequirementInfo("ARCH_SW_CIL_0158", "Signal BeltHdOvr_FL_Stat_ST3 shall be send though application when it’s needed (0,1,2,3).");
  //***************************************************************************************
    
  testCaseComment("Preconditions");
  testStep("STEP", "Bench Initialization");
  RunPreTs();

      
    testStep("STEP", "Set signal BeltHdOvr_FL_Stat_ST3 from frame BeltHdOvr_FL_State_ST3 to I_C02_BELTHDOVR_STAT_OUT_OF_END.");
    setSignal(BODY3::BeltHdOvr_FL_State_ST3::BeltHdOvr_FL_Stat_ST3, 1);
    testWaitForTimeout(500);
  
  
    testStep("STEP", "Set a breakpoint in function CIL_runCANToAppli() at line 'cil_ManageInputSignals();'.");
    debugger_setRelativeFunctionBpAtLine("CIL_runCANToAppli", 5);
    
    testStep("STEP", "Check if CPU stopped in function CIL_runCANToAppli() at line 'cil_ManageInputSignals();'. --> CPU is Stopped");
debugger_isCPUStoppedAtFunction("CIL_runCANToAppli");    ////EvalManStepEqual("Expected Test Result", debugger_result, "CPU is Stopped");
  
  
    debugger_deleteAllBP();  
  
  
    testStep("STEP", "Set a breakpoint in function cil_ManageInputSignals at line 'cil_stInputSignalsPresfRec.u8BeltHdOvStat = cil_u8BeltHandover;'.");
    debugger_setRelativeFunctionBpAtLine("cil_ManageInputSignals", 263);
    
    debugger_run();
  
    testStep("STEP", "Check if CPU stopped  in function cil_ManageInputSignals at line 'cil_stInputSignalsPresfRec.u8BeltHdOvStat = cil_u8BeltHandover;'. --> CPU is Stopped");
debugger_isCPUStoppedAtFunction("cil_ManageInputSignals");    ////EvalManStepEqual("Expected Test Result", debugger_result, "CPU is Stopped");
  
  
    testCaseComment("Action: ARCH_SW_CIL_0157, ARCH_SW_CIL_0158");
    testStep("STEP", "Evaluate if variable cil_u8BeltHandover is equal to I_C02_BELTHDOVR_STAT_OUT_OF_END. --> I_C02_BELTHDOVR_STAT_OUT_OF_END (0x1)");
    result = debugger_readGlobalVariable("uint8", "cil_u8BeltHandover,,app.elf", 0);
    EvalManStepEqual("Expected Test Result", result, 0x1);
    
  
    debugger_deleteAllBP();
    debugger_reset();
  
  
    testStep("STEP", "Set signal BeltHdOvr_FR_Stat_ST3 from frame BeltHdOvr_FR_State_ST3 to I_C02_BELTHDOVR_STAT_EXTEND.");
    setSignal(BODY3::BeltHdOvr_FR_State_ST3::BeltHdOvr_FR_Stat_ST3, 2);
    testWaitForTimeout(500);
    
    testStep("STEP", "Set a breakpoint in function cil_ManageInputSignals at line 'cil_stInputSignalsPresfRec.u8BeltHdOvStat = cil_u8BeltHandover;'.");
    debugger_setRelativeFunctionBpAtLine("cil_ManageInputSignals", 263);
    
    debugger_run();
  
    testStep("STEP", "Check if CPU stopped  at line 'cil_stInputSignalsPresfRec.u8BeltHdOvStat = cil_u8BeltHandover;'. --> CPU is Stopped");
debugger_isCPUStoppedAtFunction("cil_ManageInputSignals");    ////EvalManStepEqual("Expected Test Result", debugger_result, "CPU is Stopped");
    
    testCaseComment("Action: ARCH_SW_CIL_0159, ARCH_SW_CIL_0156");
    testStep("STEP", "Evaluate if variable cil_u8BeltHandover is equal to I_C02_BELTHDOVR_STAT_SNA. --> I_C02_BELTHDOVR_STAT_SNA");
    result = debugger_readGlobalVariable("uint8", "cil_u8BeltHandover,,app.elf", 0);
    EvalManStepEqual("Expected Test Result", result, 0x3);
  

  testCaseComment("Postcondition");
  testStep("STEP", "Return ECU to default values");
  RunPostTs();
}


testcase SW_IT_CIL_EVC_CfgList_01_08_Pr5_ST3_01()
{
  //***********************************Test report header*********************************
  testReportAddMiscInfoBlock("AUTOLIV ELECTRONICS document");
  TestReportAddMiscInfo("Nightly test", "No");
  TestReportAddMiscInfo("Test type", "Requirement-Based test");
  TestReportAddMiscInfo("Regression Test", "No");
  TestReportAddMiscInfo("Fault injection method used", "No");
  TestReportAddMiscInfo("Resource usage evaluation", "No");
  TestReportAddMiscInfo("Priority", "No");
  TestReportAddMiscInfo("Safety relevant", "No");
  
  AddRequirementInfo("Requirement under test", "ARCH_SW_CIL_0161");
  AddRequirementInfo("ARCH_SW_CIL_0161", "Frame EVC_CfgList_01_08_Pr5_ST3 shall be manipulated to read all it’s signals and send the values through application.");
  //***************************************************************************************
    
  testCaseComment("Preconditions");
  testStep("STEP", "Bench Initialization");
  RunPreTs();
  
  
    testStep("STEP", "Set signal EVC_CfgList_01_08_Stat_ST3 from frame EVC_CfgList_01_08_Pr5_ST3 to KU8_ONE.");
    setSignal(BODY3::EVC_CfgList_01_08_Pr5_ST3::EVC_CfgList_01_08_Stat_ST3, 1);
    testWaitForTimeout(500);
  
  
    testStep("STEP", "Set a breakpoint in function CIL_runCANToAppli() at line 'cil_ManageInputSignals();'.");
    debugger_setRelativeFunctionBpAtLine("CIL_runCANToAppli", 5);
    
    testStep("STEP", "Check if CPU stopped in function CIL_runCANToAppli() at line 'cil_ManageInputSignals();'. --> CPU is Stopped");
debugger_isCPUStoppedAtFunction("CIL_runCANToAppli");    ////EvalManStepEqual("Expected Test Result", debugger_result, "CPU is Stopped");
    
  
    debugger_deleteAllBP();  
  
  
    testStep("STEP", "Set a breakpoint at the end of function cil_ManageInputSignals().");
    debugger_setRelativeFunctionBpAtLine("cil_ManageInputSignals", 268);
    
    debugger_run();
    
    testStep("STEP", "Check if CPU stopped at the end of function cil_ManageInputSignals(). --> CPU is Stopped");
debugger_isCPUStoppedAtFunction("cil_ManageInputSignals");    ////EvalManStepEqual("Expected Test Result", debugger_result, "CPU is Stopped");
  
  
    testCaseComment("Action: ARCH_SW_CIL_0161");
    testStep("STEP", "Evaluate if variable cil_evcCfgList0108 is equal to KU8_ONE --> KU8_ONE.");
    result = debugger_readGlobalVariable("uint8", "cil_evcCfgList0108,,app.elf", 0);
    EvalManStepEqual("Expected Test Result", result, 0x1);
  

  testCaseComment("Postcondition");
  testStep("STEP", "Return ECU to default values");
  RunPostTs();
}


testcase SW_IT_CIL_Bckl_Sw_Fx_Stat_Pr5_ST3_01()
{
  //***********************************Test report header*********************************
  testReportAddMiscInfoBlock("AUTOLIV ELECTRONICS document");
  TestReportAddMiscInfo("Nightly test", "No");
  TestReportAddMiscInfo("Test type", "Requirement-Based test");
  TestReportAddMiscInfo("Regression Test", "No");
  TestReportAddMiscInfo("Fault injection method used", "No");
  TestReportAddMiscInfo("Resource usage evaluation", "No");
  TestReportAddMiscInfo("Priority", "No");
  TestReportAddMiscInfo("Safety relevant", "No");
  
  AddRequirementInfo("Requirement under test", "ARCH_SW_CIL_0400");
  AddRequirementInfo("ARCH_SW_CIL_0400", "This function shall be called by Com when the signal group for Buckle is received on Can.");
  //***************************************************************************************
    
  testCaseComment("Preconditions");
  testStep("STEP", "Bench Initialization");
  RunPreTs();
  
    
    testStep("STEP", "Set signal Rsrv1_Bckl_Sw_Fx_Stat_ST3 to KU8_ONE.");
    setSignal(BODY3::Rsrv1_Bckl_Sw_Fx_Stat_ST3, 1);
    testWaitForTimeout(500);
    
    testStep("STEP", "Set a breakpoint in function CIL_ComNotification_Bckl_Sw_Fx_Stat_Pr5_ST3_dihag5a55iw4h5qk539fx0kup_4c948f24_Rx().");
    debugger_setRelativeFunctionBpAtLine("CIL_ComNotification_Bckl_Sw_Fx_Stat_Pr5_ST3_dihag5a55iw4h5qk539fx0kup_4c948f24_Rx", 0);
  
    testStep("STEP", "Check if CPU stopped in function CIL_ComNotification_Bckl_Sw_Fx_Stat_Pr5_ST3_dihag5a55iw4h5qk539fx0kup_4c948f24_Rx(). --> CPU is Stopped");
debugger_isCPUStoppedAtFunction("CIL_ComNotification_Bckl_Sw_Fx_Stat_Pr5_ST3_dihag5a55iw4h5qk539fx0kup_4c948f24_Rx");    ////EvalManStepEqual("Expected Test Result", debugger_result, "CPU is Stopped");
    
    testCaseComment("Action: ARCH_SW_CIL_0400");
    testStep("STEP", "Evaluate if variable stBcklSwStatFrame is equal to KU8_ONE --> KU8_ONE.");
    result = debugger_readGlobalVariable("uint8", "stBcklSwStatFrame,,app.elf", 0);
    EvalManStepEqual("Expected Test Result", result, 1);
  

  testCaseComment("Postcondition");
  testStep("STEP", "Return ECU to default values");
  RunPostTs();
}


testcase SW_IT_CIL_Ign_Stat_Pr5_ST3_01()
{
  //***********************************Test report header*********************************
  testReportAddMiscInfoBlock("AUTOLIV ELECTRONICS document");
  TestReportAddMiscInfo("Nightly test", "No");
  TestReportAddMiscInfo("Test type", "Requirement-Based test");
  TestReportAddMiscInfo("Regression Test", "No");
  TestReportAddMiscInfo("Fault injection method used", "No");
  TestReportAddMiscInfo("Resource usage evaluation", "No");
  TestReportAddMiscInfo("Priority", "No");
  TestReportAddMiscInfo("Safety relevant", "No");
  
  AddRequirementInfo("Requirement under test", "ARCH_SW_CIL_0401");
  AddRequirementInfo("ARCH_SW_CIL_0401", "This function shall be called by Com when the signal group for Ignition is received on Can.");
  //***************************************************************************************
    
  testCaseComment("Preconditions");
  testStep("STEP", "Bench Initialization");
  RunPreTs();

    
    testStep("STEP", "Set signal ISw_Stat_ST3 from frame Ign_Stat_ST3 to KU8_ONE.");
    setSignal(BODY3::Ign_Stat_ST3::ISw_Stat_ST3, 1);
    testWaitForTimeout(500);
  
    testStep("STEP", "Set a breakpoint in function CIL_ComNotification_Ign_Stat_Pr5_ST3_csgs1dv6drms80o1i9p49677w_7bdae87d_Rx().");
    debugger_setRelativeFunctionBpAtLine("CIL_ComNotification_Ign_Stat_Pr5_ST3_csgs1dv6drms80o1i9p49677w_7bdae87d_Rx", 0);
  
    testStep("STEP", "Check if CPU stopped in function CIL_ComNotification_Ign_Stat_Pr5_ST3_csgs1dv6drms80o1i9p49677w_7bdae87d_Rx(). --> CPU is Stopped");
debugger_isCPUStoppedAtFunction("CIL_ComNotification_Ign_Stat_Pr5_ST3_csgs1dv6drms80o1i9p49677w_7bdae87d_Rx");    ////EvalManStepEqual("Expected Test Result", debugger_result, "CPU is Stopped");
  
    testCaseComment("Action: ARCH_SW_CIL_0401");
    testStep("STEP", "Evaluate if variable cil_stIgnStatFrame is equal to KU8_ONE --> KU8_ONE.");
    result = debugger_readGlobalVariable("uint8", "cil_stIgnStatFrame,,app.elf", 0);
    EvalManStepEqual("Expected Test Result", result, 0x1);
  

  testCaseComment("Postcondition");
  testStep("STEP", "Return ECU to default values");
  setSignal(BODY3::ISw_Stat_ST3, 4);
  RunPostTs();
}


testcase SW_IT_CIL_ISw_Stat_ST3_01()
{
  //***********************************Test report header*********************************
  testReportAddMiscInfoBlock("AUTOLIV ELECTRONICS document");
  TestReportAddMiscInfo("Nightly test", "No");
  TestReportAddMiscInfo("Test type", "Requirement-Based test");
  TestReportAddMiscInfo("Regression Test", "No");
  TestReportAddMiscInfo("Fault injection method used", "No");
  TestReportAddMiscInfo("Resource usage evaluation", "No");
  TestReportAddMiscInfo("Priority", "No");
  TestReportAddMiscInfo("Safety relevant", "No");
  
  AddRequirementInfo("Requirement under test", "ARCH_SW_CIL_0006");
  AddRequirementInfo("ARCH_SW_CIL_0006", "Signal ISw_Stat_ST3 shall be send though application when it’s needed.");
  //***************************************************************************************
    
  testCaseComment("Preconditions");
  testStep("STEP", "Bench Initialization");
  RunPreTs();

      
    testStep("STEP", "Set signal ISw_Stat_ST3 to I_C03_ISW_STAT_IGN_ON (0x4).");
    setSignal(BODY3::ISw_Stat_ST3, 4); 
    testWaitForTimeout(500);
  
    testStep("STEP", "Set a breakpoint in function CIL_runCANToAppli().");
    debugger_setRelativeFunctionBpAtLine("CIL_runCANToAppli", 0);

    debugger_run();
  
    testStep("STEP", "Check if CPU stopped in function CIL_runCANToAppli(). --> CPU is Stopped");
debugger_isCPUStoppedAtFunction("CIL_runCANToAppli");    ////EvalManStepEqual("Expected Test Result", debugger_result, "CPU is Stopped");
  
  
    debugger_deleteAllBP();
  
  
    testStep("STEP", "Set a breakpoint in function cil_ManageInputSignals at line 'cil_u8IgnitionSignal = cil_stIgnStatFrame.ISw_Stat_ST3;'.");
    debugger_setRelativeFunctionBpAtLine("cil_ManageInputSignals", 14);
  
    debugger_run();
  
    testStep("STEP", "Check if CPU stopped at line 'cil_u8IgnitionSignal = cil_stIgnStatFrame.ISw_Stat_ST3;'. --> CPU is Stopped");
debugger_isCPUStoppedAtFunction("cil_ManageInputSignals");    ////EvalManStepEqual("Expected Test Result", debugger_result, "CPU is Stopped");
    
  
    testCaseComment("Action: ARCH_SW_CIL_0006");
    testStep("STEP", "Evaluate if variable cil_u8IgnitionSignal is equal to I_C03_ISW_STAT_IGN_ON --> I_C03_ISW_STAT_IGN_ON (0x4).");
    result = debugger_readGlobalVariable("uint8", "cil_u8IgnitionSignal,,app.elf", 0);
    EvalManStepEqual("Expected Test Result", result, 0x4);
    

  testCaseComment("Postcondition");
  testStep("STEP", "Return ECU to default values");
  RunPostTs(); 
}


testcase SW_IT_CIL_Impact2_Pr5_ST3_01()
{
  //***********************************Test report header*********************************
  testReportAddMiscInfoBlock("AUTOLIV ELECTRONICS document");
  TestReportAddMiscInfo("Nightly test", "No");
  TestReportAddMiscInfo("Test type", "Requirement-Based test");
  TestReportAddMiscInfo("Regression Test", "No");
  TestReportAddMiscInfo("Fault injection method used", "No");
  TestReportAddMiscInfo("Resource usage evaluation", "No");
  TestReportAddMiscInfo("Priority", "No");
  TestReportAddMiscInfo("Safety relevant", "No");
  
  AddRequirementInfo("Requirement under test", "ARCH_SW_CIL_0402");
  AddRequirementInfo("ARCH_SW_CIL_0402", "This function shall be called by Com when the signal group for Impact2 is received on Can.");
  //***************************************************************************************
    
  testCaseComment("Preconditions");
  testStep("STEP", "Bench Initialization");
  RunPreTs();

    
    testStep("STEP", "Set signal Impact_Y_ST3 to KU8_ONE.");
    setSignal(BODY3::Impact_Y_ST3, 1);
    testWaitForTimeout(500);
    
    testStep("STEP", "Set a breakpoint in function CIL_ComNotification_ORC_Impact2_Pr5_ST3_b9l09rrslyv7vj3o92j69irnd_2f5ae8ac_Rx().");
    debugger_setRelativeFunctionBpAtLine("CIL_ComNotification_ORC_Impact2_Pr5_ST3_b9l09rrslyv7vj3o92j69irnd_2f5ae8ac_Rx", 0);
  
    testStep("STEP", "Check if CPU stopped in function CIL_ComNotification_ORC_Impact2_Pr5_ST3_b9l09rrslyv7vj3o92j69irnd_2f5ae8ac_Rx(). --> CPU is Stopped");
debugger_isCPUStoppedAtFunction("CIL_ComNotification_ORC_Impact2_Pr5_ST3_b9l09rrslyv7vj3o92j69irnd_2f5ae8ac_Rx");    ////EvalManStepEqual("Expected Test Result", debugger_result, "CPU is Stopped");
  
    testCaseComment("Action: ARCH_SW_CIL_0402");
    testStep("STEP", "Evaluate if variable cil_stImpactSignalsStatus2 is equal to KU8_ONE --> KU8_ONE.");
    result = debugger_readGlobalVariable("uint8", "cil_stImpactSignalsStatus2,,app.elf", 0);
    EvalManStepEqual("Expected Test Result", result, 0x1);
  

  testCaseComment("Postcondition");
  testStep("STEP", "Return ECU to default values");
  setSignal(BODY3::Impact_Y_ST3, 0);
  RunPostTs(); 
}


testcase SW_IT_CIL_Impact3_Pr5_ST3_01()
{
  //***********************************Test report header*********************************
  testReportAddMiscInfoBlock("AUTOLIV ELECTRONICS document");
  TestReportAddMiscInfo("Nightly test", "No");
  TestReportAddMiscInfo("Test type", "Requirement-Based test");
  TestReportAddMiscInfo("Regression Test", "No");
  TestReportAddMiscInfo("Fault injection method used", "No");
  TestReportAddMiscInfo("Resource usage evaluation", "No");
  TestReportAddMiscInfo("Priority", "No");
  TestReportAddMiscInfo("Safety relevant", "No");
  
  AddRequirementInfo("Requirement under test", "ARCH_SW_CIL_0403");
  AddRequirementInfo("ARCH_SW_CIL_0403", "This function shall be called by Com when the signal group for Impact3 is received on Can.");
  //***************************************************************************************
    
  testCaseComment("Preconditions");
  testStep("STEP", "Bench Initialization");
  RunPreTs();

    
    testStep("STEP", "Set signal Impact_F1_ST3 to KU8_ONE.");
    setSignal(BODY3::Impact_F1_ST3, 1);
    testWaitForTimeout(1000);
    
    testStep("STEP", "Set a breakpoint in function CIL_ComNotification_ORC_Impact3_Pr5_ST3_c4pqnkonfjwv3uiohsxhe9dwu_1bc89a3a_Rx ().");
    debugger_setRelativeFunctionBpAtLine("CIL_ComNotification_ORC_Impact3_Pr5_ST3_c4pqnkonfjwv3uiohsxhe9dwu_1bc89a3a_Rx", 0);
    
    testStep("STEP", "Check if CPU stopped in function CIL_ComNotification_ORC_Impact3_Pr5_ST3_c4pqnkonfjwv3uiohsxhe9dwu_1bc89a3a_Rx(). --> CPU is Stopped");
debugger_isCPUStoppedAtFunction("CIL_ComNotification_ORC_Impact3_Pr5_ST3_c4pqnkonfjwv3uiohsxhe9dwu_1bc89a3a_Rx");    ////EvalManStepEqual("Expected Test Result", debugger_result, "CPU is Stopped");
  
    testCaseComment("Action: ARCH_SW_CIL_0403");
    testStep("STEP", "Evaluate if variable cil_stImpactSignalsStatus3 is equal to KU8_ONE --> KU8_ONE.");
    result = debugger_readGlobalVariable("uint8", "cil_stImpactSignalsStatus3,,app.elf", 0);
    EvalManStepEqual("Expected Test Result", result, 0x1);
  

  testCaseComment("Postcondition");
  testStep("STEP", "Return ECU to default values");
  setSignal(BODY3::Impact_F1_ST3, 0);
  RunPostTs();
}



testcase SW_IT_CIL_Impact_RO_type2_02()
{
  //***********************************Test report header*********************************
  testReportAddMiscInfoBlock("AUTOLIV ELECTRONICS document");
  TestReportAddMiscInfo("Nightly test", "No");
  TestReportAddMiscInfo("Test type", "Requirement-Based test");
  TestReportAddMiscInfo("Regression Test", "No");
  TestReportAddMiscInfo("Fault injection method used", "No");
  TestReportAddMiscInfo("Resource usage evaluation", "No");
  TestReportAddMiscInfo("Priority", "No");
  TestReportAddMiscInfo("Safety relevant", "No");
  
  AddRequirementInfo("Requirement under test", "ARCH_SW_CIL_0033");
  AddRequirementInfo("ARCH_SW_CIL_0033", "Signal Impact_RO_type2_ST3 shall be send though application when it’s needed.");
  //***************************************************************************************
    
  testCaseComment("Preconditions");
  testStep("STEP", "Bench Initialization");
  RunPreTs();


    testStep("STEP", "Set signal Impact_RO_type2_ST3 to KU8_CIL_TRUE_ImpactRoTrigger.");
    setSignal(BODY3::Impact_RO_type2_ST3, 1); 
    testWaitForTimeout(500);
  
  
    testStep("STEP", "Set a breakpoint in function ComXf_Inv_Com_ORC_Impact3_Pr5_ST3_c4pqnkonfjwv3uiohsxhe9dwu_1bc89a3a_Rx_REC_ORC_Impact3_Pr5_ST3_8q27fswita0fglxxeoewe0y19() at line 'applDataPtr = (P2VAR(uint8, AUTOMATIC, COMXF_APPL_VAR))&(*(dataElement)).Impact_RO_type2_ST3;'.");
    debugger_setRelativeFunctionBpAtLine("ComXf_Inv_Com_ORC_Impact3_Pr5_ST3_c4pqnkonfjwv3uiohsxhe9dwu_1bc89a3a_Rx_REC_ORC_Impact3_Pr5_ST3_8q27fswita0fglxxeoewe0y19", 11);
    
    testCaseComment("Action: ARCH_SW_CIL_0033");
    testStep("STEP", "Check if CPU stopped in function ComXf_Inv_Com_ORC_Impact3_Pr5_ST3_c4pqnkonfjwv3uiohsxhe9dwu_1bc89a3a_Rx_REC_ORC_Impact3_Pr5_ST3_8q27fswita0fglxxeoewe0y19() at line 'applDataPtr = (P2VAR(uint8, AUTOMATIC, COMXF_APPL_VAR))&(*(dataElement)).Impact_RO_type2_ST3;'. --> CPU is Stopped");
debugger_isCPUStoppedAtFunction("ComXf_Inv_Com_ORC_Impact3_Pr5_ST3_c4pqnkonfjwv3uiohsxhe9dwu_1bc89a3a_Rx_REC_ORC_Impact3_Pr5_ST3_8q27fswita0fglxxeoewe0y19");    ////EvalManStepEqual("Expected Test Result", debugger_result, "CPU is Stopped");
    
  
    debugger_deleteAllBP();
  
  
    testStep("STEP", "Set a breakpoint in function CIL_runCANToAppli.");
    debugger_setRelativeFunctionBpAtLine("CIL_runCANToAppli", 0);

    debugger_run();
  
    testStep("STEP", "Check if CPU stopped in function CIL_runCANToAppli. --> CPU is Stopped");
debugger_isCPUStoppedAtFunction("CIL_runCANToAppli");    ////EvalManStepEqual("Expected Test Result", debugger_result, "CPU is Stopped");
  

  testCaseComment("Postcondition");
  testStep("STEP", "Return ECU to default values");
  setSignal(BODY3::Impact_RO_type2_ST3, 0);
  RunPostTs(); 
}



testcase SW_IT_CIL_PresfAct_Adj_Pr5_ST3_01()
{
  //***********************************Test report header*********************************
  testReportAddMiscInfoBlock("AUTOLIV ELECTRONICS document");
  TestReportAddMiscInfo("Nightly test", "No");
  TestReportAddMiscInfo("Test type", "Requirement-Based test");
  TestReportAddMiscInfo("Regression Test", "No");
  TestReportAddMiscInfo("Fault injection method used", "No");
  TestReportAddMiscInfo("Resource usage evaluation", "No");
  TestReportAddMiscInfo("Priority", "No");
  TestReportAddMiscInfo("Safety relevant", "No");
  
  AddRequirementInfo("Requirement under test", "ARCH_SW_CIL_0404");
  AddRequirementInfo("ARCH_SW_CIL_0404", "This function shall be called by Com when the signal group for Presafe is received on Can.");
  //***************************************************************************************
    
  testCaseComment("Preconditions");
  testStep("STEP", "Bench Initialization");
  RunPreTs();
  
    
    testStep("STEP", "Set signal Impact_F1_ST3 to KU8_ONE.");
    setSignal(BODY3::PresfAct_Adj_Rq_ST3, 1);
    testWaitForTimeout(1000);
    
    testStep("STEP", "Set a breakpoint in function CIL_ComNotification_PresfAct_Adj_Pr5_ST3_2joar1a41xrgjqab60epnbplm_25141edc_Rx.");
    debugger_setRelativeFunctionBpAtLine("CIL_ComNotification_PresfAct_Adj_Pr5_ST3_2joar1a41xrgjqab60epnbplm_25141edc_Rx", 0);
    
    testStep("STEP", "Check if CPU stopped in function CIL_ComNotification_PresfAct_Adj_Pr5_ST3_2joar1a41xrgjqab60epnbplm_25141edc_Rx(). --> CPU is Stopped");
debugger_isCPUStoppedAtFunction("CIL_ComNotification_PresfAct_Adj_Pr5_ST3_2joar1a41xrgjqab60epnbplm_25141edc_Rx");    ////EvalManStepEqual("Expected Test Result", debugger_result, "CPU is Stopped");
  
    testCaseComment("Action: ARCH_SW_CIL_0404");
    testStep("STEP", "Evaluate if variable cil_stPresfActAdjFrame is equal to KU8_ONE --> KU8_ONE.");
    result = debugger_readGlobalVariable("uint8", "cil_stPresfActAdjFrame,,app.elf", 0);
    EvalManStepEqual("Expected Test Result", result, 0x1);
    

  testCaseComment("Postcondition");
  testStep("STEP", "Return ECU to default values");
  setSignal(BODY3::PresfAct_Adj_Rq_ST3, 0);
  RunPostTs();
}


testcase SW_IT_CIL_SBeltTens_SP_Lvl_Pr5_ST3_01()
{
  //***********************************Test report header*********************************
  testReportAddMiscInfoBlock("AUTOLIV ELECTRONICS document");
  TestReportAddMiscInfo("Nightly test", "No");
  TestReportAddMiscInfo("Test type", "Requirement-Based test");
  TestReportAddMiscInfo("Regression Test", "No");
  TestReportAddMiscInfo("Fault injection method used", "No");
  TestReportAddMiscInfo("Resource usage evaluation", "No");
  TestReportAddMiscInfo("Priority", "No");
  TestReportAddMiscInfo("Safety relevant", "No");
  
  AddRequirementInfo("Requirement under test", "ARCH_SW_CIL_0405");
  AddRequirementInfo("ARCH_SW_CIL_0405", "This function shall be called by Com when the signal group for API is received on Can.");
  //***************************************************************************************
    
  testCaseComment("Preconditions");
  testStep("STEP", "Bench Initialization");
  RunPreTs();

    
    testStep("STEP", "Set signal RBTMFL_SP_Lvl_Rq_ST35 to I_C06_RBTM_LVL_RQ_PROFILE1.");
    setSignal(BODY3::RBTMFL_SP_Lvl_Rq_ST35, 1);
    testWaitForTimeout(1000);
  

    testStep("STEP", "Set a breakpoint in function CIL_ComNotification_SBeltTens_SP_Lvl_Pr5_ST3_4tqpkri37441o5ht9g9ekmyzh_4719328f_Rx ().");
    debugger_setRelativeFunctionBpAtLine("CIL_ComNotification_SBeltTens_SP_Lvl_Pr5_ST3_4tqpkri37441o5ht9g9ekmyzh_4719328f_Rx", 0);
    
    testCaseComment("Action: ARCH_SW_CIL_0405");
    testStep("STEP", "Check if CPU stopped in function CIL_ComNotification_SBeltTens_SP_Lvl_Pr5_ST3_4tqpkri37441o5ht9g9ekmyzh_4719328f_Rx --> CPU is Stopped");
debugger_isCPUStoppedAtFunction("CIL_ComNotification_SBeltTens_SP_Lvl_Pr5_ST3_4tqpkri37441o5ht9g9ekmyzh_4719328f_Rx");    ////EvalManStepEqual("Expected Test Result", debugger_result,  "CPU is Stopped");
  

  testCaseComment("Postcondition");
  testStep("STEP", "Return ECU to default values");
  setSignal(BODY3::RBTMFL_SP_Lvl_Rq_ST35, 0);
  RunPostTs(); 
}


testcase SW_IT_CIL_PT4_PTCoor4_Pr5_ST3_01()
{
  //***********************************Test report header*********************************
  testReportAddMiscInfoBlock("AUTOLIV ELECTRONICS document");
  TestReportAddMiscInfo("Nightly test", "No");
  TestReportAddMiscInfo("Test type", "Requirement-Based test");
  TestReportAddMiscInfo("Regression Test", "No");
  TestReportAddMiscInfo("Fault injection method used", "No");
  TestReportAddMiscInfo("Resource usage evaluation", "No");
  TestReportAddMiscInfo("Priority", "No");
  TestReportAddMiscInfo("Safety relevant", "No");
  
  AddRequirementInfo("Requirement under test", "ARCH_SW_CIL_0406");
  AddRequirementInfo("ARCH_SW_CIL_0406", "This function shall be called by Com when the signal group for PT Coor 4 is received on Can.");
  //***************************************************************************************
    
  testCaseComment("Preconditions");
  testStep("STEP", "Bench Initialization");
  RunPreTs();

    
    testStep("STEP", "Set signal PT4_PTCoor_PT_Rdy_ST3 to I_C02_PT_RDY_V2_PT_RDY (0x1).");
    setSignal(BODY3::PT4_PTCoor_PT_Rdy_ST3, 1);
    testWaitForTimeout(1000);
    
    testStep("STEP", "Set a breakpoint in function CIL_ComNotification_PT4_PTCoor4_Pr5_ST3_af4fxb1ykieox3itqdfzs0kpb_2277a854_Rx.");
    debugger_setRelativeFunctionBpAtLine("CIL_ComNotification_PT4_PTCoor4_Pr5_ST3_af4fxb1ykieox3itqdfzs0kpb_2277a854_Rx", 0);
  
    testStep("STEP", "Check if CPU stopped in function CIL_ComNotification_PT4_PTCoor4_Pr5_ST3_af4fxb1ykieox3itqdfzs0kpb_2277a854_Rx --> CPU is Stopped");
debugger_isCPUStoppedAtFunction("CIL_ComNotification_PT4_PTCoor4_Pr5_ST3_af4fxb1ykieox3itqdfzs0kpb_2277a854_Rx");    ////EvalManStepEqual("Expected Test Result", debugger_result,  "CPU is Stopped");
    
    testCaseComment("Action: ARCH_SW_CIL_0406");
    testStep("STEP", "Evaluate if variable cil_stPTCoor4Pr5St3 is equal to I_C02_PT_RDY_V2_PT_RDY --> I_C02_PT_RDY_V2_PT_RDY.");
    result = debugger_readGlobalVariable("uint8", "cil_stPTCoor4Pr5St3,,app.elf", 0);
    EvalManStepEqual("Expected Test Result", result, 0x1);
  

  testCaseComment("Postcondition");
  testStep("STEP", "Return ECU to default values");
  setSignal(BODY3::PT4_PTCoor_PT_Rdy_ST3, 0);
  RunPostTs();
}

testcase SW_IT_CIL_BeltHdOvr_FR_Stat_ST3_01()
{
  //***********************************Test report header*********************************
  testReportAddMiscInfoBlock("AUTOLIV ELECTRONICS document");
  TestReportAddMiscInfo("Nightly test", "No");
  TestReportAddMiscInfo("Test type", "Requirement-Based test");
  TestReportAddMiscInfo("Regression Test", "No");
  TestReportAddMiscInfo("Fault injection method used", "No");
  TestReportAddMiscInfo("Resource usage evaluation", "No");
  TestReportAddMiscInfo("Priority", "No");
  TestReportAddMiscInfo("Safety relevant", "No");
  
  AddRequirementInfo("Requirement under test", "ARCH_SW_CIL_0407");
  AddRequirementInfo("ARCH_SW_CIL_0407", "This function shall be called by Com when the signal for Belt Handover Stat Front Right is received on Can.");
  //***************************************************************************************
    
  testCaseComment("Preconditions");
  testStep("STEP", "Bench Initialization");
  RunPreTs();
    
    
    debugger_writeGlobalVariable("uint8", "NVP_stVehicleEquipmentData.VehicleSteeringConfig", 0, 0);
    testWaitForTimeoutSilent(500);
  
    setSignal(BODY3::EVC_List03_StStyle_ST3, 2);
    testWaitForTimeout(100);
    
    testStep("STEP", "Set signal BeltHdOvr_FR_Stat_ST3 to I_C02_BELTHDOVR_STAT_OUT_OF_END.");
    setSignal(BODY3::BeltHdOvr_FR_State_ST3::BeltHdOvr_FR_Stat_ST3, 1);
    testWaitForTimeout(500);
  
    setSignal(BODY3::EVC_List03_StStyle_ST3, 1);
    setSignal(BODY3::BeltHdOvr_FR_State_ST3::BeltHdOvr_FR_Stat_ST3, 0);
    
    
    testStep("STEP", "Set a breakpoint in function CIL_ComNotification_BeltHdOvr_FR_Stat_ST3_0eefd507_Rx().");
    debugger_setRelativeFunctionBpAtLine("CIL_ComNotification_BeltHdOvr_FR_Stat_ST3_0eefd507_Rx", 0);
  
    testWaitForTimeout(1000);
  
    testStep("STEP", "Check if CPU stopped in function CIL_ComNotification_BeltHdOvr_FR_Stat_ST3_0eefd507_Rx. --> CPU is Stopped");
    debugger_WaitUntilBPisReached(1000);
  
  
    testCaseComment("Action: ARCH_SW_CIL_0407");
    testStep("STEP", "Evaluate if variable cil_u8BeltHandover is equal to KU8_ZERO. --> KU8_ZERO");
    result = debugger_readGlobalVariable("uint8", "cil_u8BeltHandover,,app.elf", 0);
    EvalManStepEqual("Expected Test Result", result, 0);
  

  testCaseComment("Postcondition");
  testStep("STEP", "Return ECU to default values");
  RunPostTs();
}


testcase SW_IT_CIL_BeltHdOvr_FL_Stat_ST3_01()
{
  //***********************************Test report header*********************************
  testReportAddMiscInfoBlock("AUTOLIV ELECTRONICS document");
  TestReportAddMiscInfo("Nightly test", "No");
  TestReportAddMiscInfo("Test type", "Requirement-Based test");
  TestReportAddMiscInfo("Regression Test", "No");
  TestReportAddMiscInfo("Fault injection method used", "No");
  TestReportAddMiscInfo("Resource usage evaluation", "No");
  TestReportAddMiscInfo("Priority", "No");
  TestReportAddMiscInfo("Safety relevant", "No");
  
  AddRequirementInfo("Requirement under test", "ARCH_SW_CIL_0408");
  AddRequirementInfo("ARCH_SW_CIL_0408", "This function shall be called by Com when the signal for Belt Handover Stat Front Left is received on Can.");
  //***************************************************************************************
    
  testCaseComment("Preconditions");
  testStep("STEP", "Bench Initialization");
  RunPreTs();
  
    
    testStep("STEP", "Set signal BeltHdOvr_FL_Stat_ST3 to I_C02_BELTHDOVR_STAT_OUT_OF_END (0x1).");
    setSignal(BODY3::BeltHdOvr_FL_State_ST3::BeltHdOvr_FL_Stat_ST3, 1);
    testWaitForTimeout(1000);
    
    testStep("STEP", "Set a breakpoint in function CIL_ComNotification_BeltHdOvr_FL_Stat_ST3_3489841d_Rx ().");
    debugger_setRelativeFunctionBpAtLine("CIL_ComNotification_BeltHdOvr_FL_Stat_ST3_3489841d_Rx", 0);
  
    testStep("STEP", "Check if CPU stopped in function CIL_ComNotification_BeltHdOvr_FL_Stat_ST3_3489841d_Rx(). --> CPU is Stopped");
debugger_isCPUStoppedAtFunction("CIL_ComNotification_BeltHdOvr_FL_Stat_ST3_3489841d_Rx");    ////EvalManStepEqual("Expected Test Result", debugger_result,  "CPU is Stopped");
  
    testCaseComment("Action: ARCH_SW_CIL_0408");
    testStep("STEP", "Evaluate if variable cil_u8BeltHandover is equal to I_C02_BELTHDOVR_STAT_OUT_OF_END --> I_C02_BELTHDOVR_STAT_OUT_OF_END.");
    result = debugger_readGlobalVariable("uint8", "cil_u8BeltHandover,,app.elf", 0);
    EvalManStepEqual("Expected Test Result", result, 0x1);
  

  testCaseComment("Postcondition");
  testStep("STEP", "Return ECU to default values");
  setSignal(BODY3::BeltHdOvr_FL_State_ST3::BeltHdOvr_FL_Stat_ST3, 0);
  RunPostTs();
}


testcase SW_IT_CIL_EVC_CfgList_01_08_Pr5_ST3_02()
{
  //***********************************Test report header*********************************
  testReportAddMiscInfoBlock("AUTOLIV ELECTRONICS document");
  TestReportAddMiscInfo("Nightly test", "No");
  TestReportAddMiscInfo("Test type", "Requirement-Based test");
  TestReportAddMiscInfo("Regression Test", "No");
  TestReportAddMiscInfo("Fault injection method used", "No");
  TestReportAddMiscInfo("Resource usage evaluation", "No");
  TestReportAddMiscInfo("Priority", "No");
  TestReportAddMiscInfo("Safety relevant", "No");
  
  AddRequirementInfo("Requirement under test", "ARCH_SW_CIL_0409");
  AddRequirementInfo("ARCH_SW_CIL_0409", "This function shall be called by Com when the signal group for EVC Config List 01-08 is received on Can.");
  //***************************************************************************************
    
  testCaseComment("Preconditions");
  testStep("STEP", "Bench Initialization");
  RunPreTs();

      
    testStep("STEP", "Set signal EVC_CfgList_01_08_Stat_ST3 to KU8_ONE.");
    setSignal(BODY3::EVC_CfgList_01_08_Stat_ST3, 1);
    testWaitForTimeout(500);
    
    testStep("STEP", "Set a breakpoint in function CIL_ComNotification_EVC_CfgList_01_08_Pr5_ST3_co3q1mwsf7pwxo2ix5jryc04x_3a43a00a_Rx().");
    debugger_setRelativeFunctionBpAtLine("CIL_ComNotification_EVC_CfgList_01_08_Pr5_ST3_co3q1mwsf7pwxo2ix5jryc04x_3a43a00a_Rx", 0);
    testWaitForTimeout(500);
  
    testStep("STEP", "Check if CPU stopped in function CIL_ComNotification_EVC_CfgList_01_08_Pr5_ST3_co3q1mwsf7pwxo2ix5jryc04x_3a43a00a_Rx(). --> CPU is Stopped");
debugger_isCPUStoppedAtFunction("CIL_ComNotification_EVC_CfgList_01_08_Pr5_ST3_co3q1mwsf7pwxo2ix5jryc04x_3a43a00a_Rx");    ////EvalManStepEqual("Expected Test Result", debugger_result,  "CPU is Stopped");
  
    testCaseComment("Action: ARCH_SW_CIL_0409");
    testStep("STEP", "Evaluate if variable cil_evcCfgList0108 is equal to KU8_ONE. --> KU8_ONE");
    result = debugger_readGlobalVariable("uint8", "cil_evcCfgList0108,,app.elf", 0);
    EvalManStepEqual("Expected Test Result", result, 0x1);
  

  testCaseComment("Postcondition");
  testStep("STEP", "Return ECU to default values");
  setSignal(BODY3::EVC_CfgList_01_08_Stat_ST3, 0);
  RunPostTs(); 
}


testcase SW_IT_CIL_TriggerProfiles_23()
{
  //***********************************Test report header*********************************
  testReportAddMiscInfoBlock("AUTOLIV ELECTRONICS document");
  TestReportAddMiscInfo("Nightly test", "No");
  TestReportAddMiscInfo("Test type", "Requirement-Based test");
  TestReportAddMiscInfo("Regression Test", "No");
  TestReportAddMiscInfo("Fault injection method used", "No");
  TestReportAddMiscInfo("Resource usage evaluation", "No");
  TestReportAddMiscInfo("Priority", "No");
  TestReportAddMiscInfo("Safety relevant", "No");
  
  AddRequirementInfo("Requirement under test", "ARCH_SW_CIL_0001, ARCH_SW_CIL_0002, ARCH_SW_CIL_0022");
  AddRequirementInfo("ARCH_SW_CIL_0022", "If signal is received with value 1, then tensioning cycle 0 shall be requested.");
  AddRequirementInfo("ARCH_SW_CIL_0001", "Frame PresfAct_Adj_ST3 shall be manipulated to read all it’s signals and send the values through application.");
  AddRequirementInfo("ARCH_SW_CIL_0002", "Signal Presf_Lvl_ST3 shall be send though application when it’s needed.");
  //***************************************************************************************
    
  testCaseComment("Preconditions");
  testStep("STEP", "Bench Initialization");
  RunPreTs();
  
  
    testStep("STEP", "Set signal Presf_Lvl_ST3 to from frame PresfAct_Adj_ST3 to I_C04_PRESF_LVL_V2_LVL1.");
    setSignal(BODY3::PresfAct_Adj_ST3::Presf_Lvl_ST3, I_C04_PRESF_LVL_V2_LVL1);
    testWaitForTimeout(500);
    
    testStep("STEP", "Set a breakpoint in function CIL_runCANToAppli at line 'cil_TriggerProfiles(CIL_stManagedCycle.u8CurrentRequestedCycle);'.");
    debugger_setRelativeFunctionBpAtLine("CIL_runCANToAppli", 364);
  
    testStep("STEP", "Check if CPU stopped at line 'cil_TriggerProfiles(CIL_stManagedCycle.u8CurrentRequestedCycle);'. --> CPU is Stopped");
debugger_isCPUStoppedAtFunction("CIL_runCANToAppli");    ////EvalManStepEqual("Expected Test Result", debugger_result,  "CPU is Stopped");
      
    debugger_deleteAllBP();
    
    testStep("STEP", "Set a breakpoint in function cil_TriggerProfiles() at line '(void)Rte_Read_prrEnableCycle0_b8CycleValidity(&u8CycleValidityStatus);' under case I_C04_PRESF_LVL_V2_LVL1.");
    debugger_setRelativeFunctionBpAtLine("cil_TriggerProfiles", 111);
    
    debugger_run();
    
    testCaseComment("Action: ARCH_SW_CIL_0022");
    testStep("STEP", "Check if CPU stopped at line '(void)Rte_Read_prrEnableCycle0_b8CycleValidity(&u8CycleValidityStatus);' under case I_C04_PRESF_LVL_V2_LVL1. --> CPU is Stopped");
debugger_isCPUStoppedAtFunction("cil_TriggerProfiles");    ////EvalManStepEqual("Expected Test Result", debugger_result,  "CPU is Stopped");
      
    debugger_deleteAllBP();
    debugger_reset();
    debugger_run();
    
    testCaseComment("Action: ARCH_SW_CIL_0001, ARCH_SW_CIL_0002");
    testStep("STEP", "Check if variable Rte_CIL_prrCrashSeverityLevel_u8PreCrashSeverityLevel is KU8_PRECRASH_SEVERITY_LEVEL_1 --> KU8_PRECRASH_SEVERITY_LEVEL_1.");
    result = debugger_readGlobalVariable("uint8", "Rte_CIL_prrCrashSeverityLevel_u8PreCrashSeverityLevel,,app.elf", 0);
    EvalManStepEqual("Expected Test Result", result, 0);
    

  testCaseComment("Postcondition");
  testStep("STEP", "Return ECU to default values");
  setSignal(BODY3::Presf_Lvl_ST3, I_C04_PRESF_LVL_V2_NOLVL);
  RunPostTs(); 
}


testcase SW_IT_CIL_TriggerProfiles_02()
{
  //***********************************Test report header*********************************
  testReportAddMiscInfoBlock("AUTOLIV ELECTRONICS document");
  TestReportAddMiscInfo("Nightly test", "No");
  TestReportAddMiscInfo("Test type", "Requirement-Based test");
  TestReportAddMiscInfo("Regression Test", "No");
  TestReportAddMiscInfo("Fault injection method used", "No");
  TestReportAddMiscInfo("Resource usage evaluation", "No");
  TestReportAddMiscInfo("Priority", "No");
  TestReportAddMiscInfo("Safety relevant", "No");
  
  AddRequirementInfo("Requirement under test", "ARCH_SW_CIL_0023, ARCH_SW_CIL_0060, ARCH_SW_CIL_0053, ARCH_SW_CIL_0113");
  AddRequirementInfo("ARCH_SW_CIL_0023", "If signal is received with value 2, then cycle 18,19(HWA) shall be requested.");
  AddRequirementInfo("ARCH_SW_CIL_0060", "If signal is received with value 2, then cycle 18(HWA) shall be requested.");
  AddRequirementInfo("ARCH_SW_CIL_0053", "If signal is received with value 2, then cycle 18,19(HWA) shall be requested.");
  //***************************************************************************************
    
  testCaseComment("Preconditions");
  testStep("STEP", "Bench Initialization");
  RunPreTs();

  
    testStep("STEP", "Set signal Presf_Lvl_ST3 to I_C04_PRESF_LVL_V2_LVL2 (0x2).");
    setSignal(BODY3::Presf_Lvl_ST3, I_C04_PRESF_LVL_V2_LVL2);
    testWaitForTimeout(500);
    
    testStep("STEP", "Set a breakpoint in function CIL_runCANToAppli at line 'cil_TriggerProfiles(CIL_stManagedCycle.u8CurrentRequestedCycle);'.");
    debugger_setRelativeFunctionBpAtLine("CIL_runCANToAppli", 364);
  
    testStep("STEP", "Check if CPU stopped at line 'cil_TriggerProfiles(CIL_stManagedCycle.u8CurrentRequestedCycle);'. --> CPU is Stopped");
debugger_isCPUStoppedAtFunction("CIL_runCANToAppli");    ////EvalManStepEqual("Expected Test Result", debugger_result,  "CPU is Stopped");
      
    debugger_deleteAllBP();
  
    testStep("STEP", "Set a breakpoint in the function cil_TriggerProfiles() after line '(void)Rte_Read_prrEnableCycle18_b8CycleValidity(&u8CycleValidityStatus);' under case I_C04_PRESF_LVL_V2_LVL2.");
    debugger_setRelativeFunctionBpAtLine("cil_TriggerProfiles", 133);
  
    debugger_run();
  
    testCaseComment("Action: ARCH_SW_CIL_0023, ARCH_SW_CIL_0060, ARCH_SW_CIL_0053, ARCH_SW_CIL_0113");
    testStep("STEP", "Check if CPU stopped after line '(void)Rte_Read_prrEnableCycle18_b8CycleValidity(&u8CycleValidityStatus);' under case I_C04_PRESF_LVL_V2_LVL2. --> CPU is Stopped");
debugger_isCPUStoppedAtFunction("cil_TriggerProfiles");    ////EvalManStepEqual("Expected Test Result", debugger_result,  "CPU is Stopped");
  

  testCaseComment("Postcondition");
  testStep("STEP", "Return ECU to default values");
  setSignal(BODY3::Presf_Lvl_ST3, I_C04_PRESF_LVL_V2_NOLVL);
  RunPostTs(); 
}

testcase SW_IT_CIL_TriggerProfiles_03()
{
  //***********************************Test report header*********************************
  testReportAddMiscInfoBlock("AUTOLIV ELECTRONICS document");
  TestReportAddMiscInfo("Nightly test", "No");
  TestReportAddMiscInfo("Test type", "Requirement-Based test");
  TestReportAddMiscInfo("Regression Test", "No");
  TestReportAddMiscInfo("Fault injection method used", "No");
  TestReportAddMiscInfo("Resource usage evaluation", "No");
  TestReportAddMiscInfo("Priority", "No");
  TestReportAddMiscInfo("Safety relevant", "No");
  
  AddRequirementInfo("Requirement under test", "ARCH_SW_CIL_0042, ARCH_SW_CIL_0061, ARCH_SW_CIL_0054, ARCH_SW_CIL_0189");
  AddRequirementInfo("ARCH_SW_CIL_0042", "If signal is received with value 3, then tensioning cycle 1 shall be requested.");
  AddRequirementInfo("ARCH_SW_CIL_0061", "If signal is received with value 3, then tensioning cycle 1 shall be requested.");
  AddRequirementInfo("ARCH_SW_CIL_0054", "If signal is received with value 3, then tensioning cycle 1 shall be requested.");
  //***************************************************************************************
    
  testCaseComment("Preconditions");
  testStep("STEP", "Bench Initialization");
  RunPreTs();

  
    testStep("STEP", "Set signal Presf_Lvl_ST3 to I_C04_PRESF_LVL_V2_LVL3.");
    setSignal(BODY3::Presf_Lvl_ST3, I_C04_PRESF_LVL_V2_LVL3);
    testWaitForTimeout(1000);
    
  
    testStep("STEP", "Set a breakpoint in function CIL_runCANToAppli at line 'cil_TriggerProfiles(CIL_stManagedCycle.u8CurrentRequestedCycle);'.");
    debugger_setRelativeFunctionBpAtLine("CIL_runCANToAppli", 364);
  
    testStep("STEP", "Check if CPU stopped at line 'cil_TriggerProfiles(CIL_stManagedCycle.u8CurrentRequestedCycle);'. --> CPU is Stopped");
    debugger_WaitUntilBPisReached(1000);
  
  
    debugger_deleteAllBP();
  
  
    testStep("STEP", "Set a breakpoint in function cil_TriggerProfiles() at line '(void)Rte_Read_prrEnableCycle1_b8CycleValidity(&u8CycleValidityStatus);' under case I_C04_PRESF_LVL_V2_LVL3.");
    debugger_setRelativeFunctionBpAtLine("cil_TriggerProfiles", 166);
    
    debugger_run();
    
    testCaseComment("Action: ARCH_SW_CIL_0042, ARCH_SW_CIL_0061, ARCH_SW_CIL_0054, ARCH_SW_CIL_0189");
    testStep("STEP", "Check if CPU stopped at line '(void)Rte_Read_prrEnableCycle1_b8CycleValidity(&u8CycleValidityStatus);' under case I_C04_PRESF_LVL_V2_LVL3. --> CPU is Stopped");
    debugger_WaitUntilBPisReached(1000);
      
  
    debugger_deleteAllBP();
    debugger_run();
    
    
    testCaseComment("Action: ARCH_SW_CIL_0042, ARCH_SW_CIL_0061, ARCH_SW_CIL_0054");
    testStep("STEP", "Check if variable Rte_CIL_prrCrashSeverityLevel_u8PreCrashSeverityLevel is KU8_PRECRASH_SEVERITY_LEVEL_2 --> KU8_PRECRASH_SEVERITY_LEVEL_2 (0x1).");
    result = debugger_readGlobalVariable("uint8", "Rte_CIL_prrCrashSeverityLevel_u8PreCrashSeverityLevel,,app.elf", 0);
    EvalManStepEqual("Expected Test Result", result, 0x1);
    
    
  testCaseComment("Postcondition");
  testStep("STEP", "Return ECU to default values");
  setSignal(BODY3::Presf_Lvl_ST3, I_C04_PRESF_LVL_V2_NOLVL);
  RunPostTs(); 
}


testcase SW_IT_CIL_TriggerProfiles_04()
{
  //***********************************Test report header*********************************
  testReportAddMiscInfoBlock("AUTOLIV ELECTRONICS document");
  TestReportAddMiscInfo("Nightly test", "No");
  TestReportAddMiscInfo("Test type", "Requirement-Based test");
  TestReportAddMiscInfo("Regression Test", "No");
  TestReportAddMiscInfo("Fault injection method used", "No");
  TestReportAddMiscInfo("Resource usage evaluation", "No");
  TestReportAddMiscInfo("Priority", "No");
  TestReportAddMiscInfo("Safety relevant", "No");
  
  AddRequirementInfo("Requirement under test", "ARCH_SW_CIL_0043, ARCH_SW_CIL_0062, ARCH_SW_CIL_0055");
  AddRequirementInfo("ARCH_SW_CIL_0043", "If signal is received with value 4, then tensioning cycle 2 shall be requested.");
  AddRequirementInfo("ARCH_SW_CIL_0055", "If signal is received with value 4, then tensioning cycle 2 shall be requested.");
  AddRequirementInfo("ARCH_SW_CIL_0062", "If signal is received with value 4, then tensioning cycle 2 shall be requested.");
  //***************************************************************************************
    
  testCaseComment("Preconditions");
  testStep("STEP", "Bench Initialization");
  RunPreTs();

  
    testStep("STEP", "Set signal Presf_Lvl_ST3 to I_C04_PRESF_LVL_V2_LVL4.");
    setSignal(BODY3::Presf_Lvl_ST3, I_C04_PRESF_LVL_V2_LVL4);
    testWaitForTimeout(500);
  
    
    testStep("STEP", "Set a breakpoint in function CIL_runCANToAppli at line 'cil_TriggerProfiles(CIL_stManagedCycle.u8CurrentRequestedCycle);'.");
    debugger_setRelativeFunctionBpAtLine("CIL_runCANToAppli", 364);
  
    testStep("STEP", "Check if CPU stopped at line 'cil_TriggerProfiles(CIL_stManagedCycle.u8CurrentRequestedCycle);'. --> CPU is Stopped");
    debugger_WaitUntilBPisReached(1000);
  
  
    debugger_deleteAllBP();
  
  
    testStep("STEP", "Set a breakpoint in function cil_TriggerProfiles() at line '(void)Rte_Read_prrEnableCycle2_b8CycleValidity(&u8CycleValidityStatus);' under case I_C04_PRESF_LVL_V2_LVL4.");
    debugger_setRelativeFunctionBpAtLine("cil_TriggerProfiles", 184);
    
    debugger_run();
    
    testCaseComment("Action: ARCH_SW_CIL_0043, ARCH_SW_CIL_0055, ARCH_SW_CIL_0062");
    testStep("STEP", "Check if CPU stopped at line '(void)Rte_Read_prrEnableCycle2_b8CycleValidity(&u8CycleValidityStatus);' under case I_C04_PRESF_LVL_V2_LVL4. --> CPU is Stopped");
    debugger_WaitUntilBPisReached(1000);
    
    
    debugger_deleteAllBP();
    debugger_run();
    
    
    testCaseComment("Action: ARCH_SW_CIL_0043, ARCH_SW_CIL_0055, ARCH_SW_CIL_0062");
    testStep("STEP", "Check if variable Rte_CIL_prrCrashSeverityLevel_u8PreCrashSeverityLevel is KU8_PRECRASH_SEVERITY_LEVEL_3. --> KU8_PRECRASH_SEVERITY_LEVEL_3 (0x2)");
    result = debugger_readGlobalVariable("uint8", "Rte_CIL_prrCrashSeverityLevel_u8PreCrashSeverityLevel,,app.elf", 0);
    EvalManStepEqual("Expected Test Result", result, 0x2);


  testCaseComment("Postcondition");
  testStep("STEP", "Return ECU to default values");
  setSignal(BODY3::Presf_Lvl_ST3, I_C04_PRESF_LVL_V2_NOLVL);
  RunPostTs(); 
}


testcase SW_IT_CIL_TriggerProfiles_05()
{
  //***********************************Test report header*********************************
  testReportAddMiscInfoBlock("AUTOLIV ELECTRONICS document");
  TestReportAddMiscInfo("Nightly test", "No");
  TestReportAddMiscInfo("Test type", "Requirement-Based test");
  TestReportAddMiscInfo("Regression Test", "No");
  TestReportAddMiscInfo("Fault injection method used", "No");
  TestReportAddMiscInfo("Resource usage evaluation", "No");
  TestReportAddMiscInfo("Priority", "No");
  TestReportAddMiscInfo("Safety relevant", "No");
  
  AddRequirementInfo("Requirement under test", "ARCH_SW_CIL_0044, ARCH_SW_CIL_0063, ARCH_SW_CIL_0079, ARCH_SW_CIL_0056");
  AddRequirementInfo("ARCH_SW_CIL_0044", "If signal is received with value 5, then tensioning cycle 3 shall be requested.");
  AddRequirementInfo("ARCH_SW_CIL_0063", "If signal is received with value 5, then tensioning cycle 3 shall be requested.");
  AddRequirementInfo("ARCH_SW_CIL_0056", "If signal is received with value 5, then tensioning cycle 3 shall be requested.");
  //***************************************************************************************
    
  testCaseComment("Preconditions");
  testStep("STEP", "Bench Initialization");
  RunPreTs();
  
  
    testStep("STEP", "Set signal Presf_Lvl_ST3 to I_C04_PRESF_LVL_V2_LVL5 (0x5).");
    setSignal(BODY3::Presf_Lvl_ST3, I_C04_PRESF_LVL_V2_LVL5);
    testWaitForTimeout(500);
    
  
    testStep("STEP", "Set a breakpoint in function CIL_runCANToAppli at line cil_TriggerProfiles(CIL_stManagedCycle.u8CurrentRequestedCycle);.");
    debugger_setRelativeFunctionBpAtLine("CIL_runCANToAppli", 364);
    
    testStep("STEP", "Check if CPU stopped at line 'cil_TriggerProfiles(CIL_stManagedCycle.u8CurrentRequestedCycle);'. --> CPU is Stopped");
    debugger_WaitUntilBPisReached(1000);
  
  
    debugger_deleteAllBP();
    
  
    testStep("STEP", "Set a breakpoint in function cil_TriggerProfiles() under case I_C04_PRESF_LVL_V2_LVL5.");
    debugger_setRelativeFunctionBpAtLine("cil_TriggerProfiles", 209);
    
    debugger_run();
  
    testCaseComment("Action: ARCH_SW_CIL_0044, ARCH_SW_CIL_0063, ARCH_SW_CIL_0056");
    testStep("STEP", "Check if CPU stopped in function cil_TriggerProfiles() under case I_C04_PRESF_LVL_V2_LVL5. --> CPU is Stopped");
    debugger_WaitUntilBPisReached(1000);
  
  
    debugger_deleteAllBP();
    
  
    testStep("STEP", "Set a breakpoint at the end of the function cil_RequestTensioning().");
    debugger_setBpAtLine("s:\\Components\\Application\\Autoliv\\CIL\\Implementation\\src\\CIL_CANToAppli.c", 1980);
    
    debugger_run();
    
    testCaseComment("Action: ARCH_SW_CIL_0079");
    testStep("STEP", "Check if CPU stopped at the end of function cil_RequestTensioning. --> CPU is Stopped");
    debugger_WaitUntilBPisReached(1000);
    
  
    debugger_deleteAllBP();
    debugger_run();
  
  
    testCaseComment("Action: ARCH_SW_CIL_0044, ARCH_SW_CIL_0063, ARCH_SW_CIL_0056");
    testStep("STEP", "Check if variable Rte_CIL_prrCrashSeverityLevel_u8PreCrashSeverityLevel is KU8_PRECRASH_SEVERITY_LEVEL_4. --> KU8_PRECRASH_SEVERITY_LEVEL_4 (0x3)");
    result = debugger_readGlobalVariable("uint8", "Rte_CIL_prrCrashSeverityLevel_u8PreCrashSeverityLevel,,app.elf", 0);
    EvalManStepEqual("Expected Test Result", result, 0x3);
  

  testCaseComment("Postcondition");
  testStep("STEP", "Return ECU to default values");
  setSignal(BODY3::Presf_Lvl_ST3, I_C04_PRESF_LVL_V2_NOLVL);
  RunPostTs(); 
}


testcase SW_IT_CIL_TriggerProfiles_22()
{
  //***********************************Test report header*********************************
  testReportAddMiscInfoBlock("AUTOLIV ELECTRONICS document");
  TestReportAddMiscInfo("Nightly test", "No");
  TestReportAddMiscInfo("Test type", "Requirement-Based test");
  TestReportAddMiscInfo("Regression Test", "No");
  TestReportAddMiscInfo("Fault injection method used", "No");
  TestReportAddMiscInfo("Resource usage evaluation", "No");
  TestReportAddMiscInfo("Priority", "No");
  TestReportAddMiscInfo("Safety relevant", "No");
  
  AddRequirementInfo("Requirement under test", " ARCH_SW_CIL_0137, ARCH_SW_CIL_0124, ARCH_SW_CIL_0188");
  AddRequirementInfo("ARCH_SW_CIL_0137", "If signal is received with value 6, then tensioning cycle 4 shall be requested.");
  AddRequirementInfo("ARCH_SW_CIL_0124", "If signal is received with value 6, then tensioning cycle 4 shall be requested.");
  //***************************************************************************************
    
  testCaseComment("Preconditions");
  testStep("STEP", "Bench Initialization");
  RunPreTs();

  
    testStep("STEP", "Set signal Presf_Lvl_ST3 to I_C04_PRESF_LVL_V2_LVL6.");
    setSignal(BODY3::Presf_Lvl_ST3, I_C04_PRESF_LVL_V2_LVL6);
    testWaitForTimeout(500);
  
  
    testStep("STEP", "Set a breakpoint in function CIL_runCANToAppli at line cil_TriggerProfiles(CIL_stManagedCycle.u8CurrentRequestedCycle);.");
    debugger_setRelativeFunctionBpAtLine("CIL_runCANToAppli", 364);
    
    testStep("STEP", "Check if CPU stopped at line 'cil_TriggerProfiles(CIL_stManagedCycle.u8CurrentRequestedCycle);'. --> CPU is Stopped");
debugger_isCPUStoppedAtFunction("CIL_runCANToAppli");    ////EvalManStepEqual("Expected Test Result", debugger_result,  "CPU is Stopped");
  
  
    debugger_deleteAllBP();
    
  
    testStep("STEP", "Set a breakpoint in function cil_TriggerProfiles() under case I_C04_PRESF_LVL_V2_LVL6 at line '(void)Rte_Read_prrEnableCycle4_b8CycleValidity(&u8CycleValidityStatus);'.");
    debugger_setRelativeFunctionBpAtLine("cil_TriggerProfiles", 230);
    
    debugger_run();
  
    testCaseComment("Action: ARCH_SW_CIL_0124, ARCH_SW_CIL_0137, ARCH_SW_CIL_0188");
    testStep("STEP", "Check if CPU stopped in function cil_TriggerProfiles() under case I_C04_PRESF_LVL_V2_LVL6 at line '(void)Rte_Read_prrEnableCycle4_b8CycleValidity(&u8CycleValidityStatus);'. --> CPU is Stopped");
debugger_isCPUStoppedAtFunction("cil_TriggerProfiles");    ////EvalManStepEqual("Expected Test Result", debugger_result,  "CPU is Stopped");
    

  testCaseComment("Postcondition");
  testStep("STEP", "Return ECU to default values");
  setSignal(BODY3::Presf_Lvl_ST3, I_C04_PRESF_LVL_V2_NOLVL);
  RunPostTs(); 
}


testcase SW_IT_CIL_TriggerProfiles_07()
{
  //***********************************Test report header*********************************
  testReportAddMiscInfoBlock("AUTOLIV ELECTRONICS document");
  TestReportAddMiscInfo("Nightly test", "No");
  TestReportAddMiscInfo("Test type", "Requirement-Based test");
  TestReportAddMiscInfo("Regression Test", "No");
  TestReportAddMiscInfo("Fault injection method used", "No");
  TestReportAddMiscInfo("Resource usage evaluation", "No");
  TestReportAddMiscInfo("Priority", "No");
  TestReportAddMiscInfo("Safety relevant", "No");
  
  AddRequirementInfo("Requirement under test", "ARCH_SW_CIL_0125, ARCH_SW_CIL_0138, ARCH_SW_CIL_0352");
  AddRequirementInfo("ARCH_SW_CIL_0125", "If signal is received with value 7, then tensioning cycle 5 shall be requested.");
  AddRequirementInfo("ARCH_SW_CIL_0138", "If signal is received with value 7, then tensioning cycle 5 shall be requested.");
  AddRequirementInfo("ARCH_SW_CIL_0352", "Write Rte_CIL_prrCrashSeverityLevel_u8PreCrashSeverityLevel to determine the tensioning cycle requested.");
  //***************************************************************************************
    
  testCaseComment("Preconditions");
  testStep("STEP", "Bench Initialization");
  RunPreTs();

  
    testStep("STEP", "Set signal Presf_Lvl_ST3 to I_C04_PRESF_LVL_V2_LVL7.");
    setSignal(BODY3::Presf_Lvl_ST3, I_C04_PRESF_LVL_V2_LVL7);
 
    
    testStep("STEP", "Set a breakpoint in function CIL_runCANToAppli().");
    debugger_setRelativeFunctionBpAtLine("CIL_runCANToAppli", 0);
    
    testWaitForTimeout(500);
  
    testStep("STEP", "Check if CPU stopped in function CIL_runCANToAppli(). --> CPU is Stopped");
debugger_isCPUStoppedAtFunction("CIL_runCANToAppli");    ////EvalManStepEqual("Expected Test Result", debugger_result,  "CPU is Stopped");
  
  
    debugger_deleteAllBP();
    
    
    testStep("STEP", "Set a breakpoint in function cil_TriggerProfiles() under case I_C04_PRESF_LVL_V2_LVL7 at line '(void)Rte_Read_prrEnableCycle5_b8CycleValidity(&u8CycleValidityStatus);'.");
    debugger_setRelativeFunctionBpAtLine("cil_TriggerProfiles", 263);
    
    debugger_run();
    
    testCaseComment("Action: ARCH_SW_CIL_0138, ARCH_SW_CIL_0125");
    testStep("STEP", "Check if CPU stopped in function cil_TriggerProfiles() under case I_C04_PRESF_LVL_V2_LVL7 at line '(void)Rte_Read_prrEnableCycle5_b8CycleValidity(&u8CycleValidityStatus);'. --> CPU is Stopped");
debugger_isCPUStoppedAtFunction("cil_TriggerProfiles");    ////EvalManStepEqual("Expected Test Result", debugger_result,  "CPU is Stopped");
      
  
    debugger_deleteAllBP();
    
    
    testStep("STEP", "Set a breakpoint in function cil_RequestTensioning() at line '(void)Rte_Write_prrCrashSeverityLevel_u8PreCrashSeverityLevel(u8Level);' at the end of the function.");
    debugger_setRelativeFunctionBpAtLine("cil_RequestTensioning", 89);
    
    debugger_run();
    
    testCaseComment("Action: ARCH_SW_CIL_0352");
    testStep("STEP", "Check if CPU stopped in function cil_RequestTensioning() at line '(void)Rte_Write_prrCrashSeverityLevel_u8PreCrashSeverityLevel(u8Level);' at the end of the function. --> CPU is Stopped");
debugger_isCPUStoppedAtFunction("");    ////EvalManStepEqual("Expected Test Result", debugger_result,  "CPU is Stopped");
  
  
  testCaseComment("Postcondition");
  testStep("STEP", "Return ECU to default values");
  setSignal(BODY3::Presf_Lvl_ST3, I_C04_PRESF_LVL_V2_NOLVL);  
  RunPostTs(); 
}


testcase SW_IT_CIL_TriggerProfiles_08()
{
  //***********************************Test report header*********************************
  testReportAddMiscInfoBlock("AUTOLIV ELECTRONICS document");
  TestReportAddMiscInfo("Nightly test", "No");
  TestReportAddMiscInfo("Test type", "Requirement-Based test");
  TestReportAddMiscInfo("Regression Test", "No");
  TestReportAddMiscInfo("Fault injection method used", "No");
  TestReportAddMiscInfo("Resource usage evaluation", "No");
  TestReportAddMiscInfo("Priority", "No");
  TestReportAddMiscInfo("Safety relevant", "No");
  
  AddRequirementInfo("Requirement under test", "ARCH_SW_CIL_0121, ARCH_SW_CIL_0126, ARCH_SW_CIL_0139, ARCH_SW_CIL_0353, ARCH_SW_CIL_0184");
  AddRequirementInfo("ARCH_SW_CIL_0121", "If signal is received with value 8, then tensioning cycle 6 shall be requested.");
  AddRequirementInfo("ARCH_SW_CIL_0126", "If signal is received with value 8, then tensioning cycle 6 shall be requested.");
  AddRequirementInfo("ARCH_SW_CIL_0139", "If signal is received with value 8, then tensioning cycle 6 shall be requested.");
  AddRequirementInfo("ARCH_SW_CIL_0353", "Write Rte_CIL_psrCarAcceleration_b8IsCarAccelerationLow to permit the release cycle to be executed.");
  //***************************************************************************************
    
  testCaseComment("Preconditions");
  testStep("STEP", "Bench Initialization");
  RunPreTs();

    
    testStep("STEP", "Set a breakpoint in function CIL_runCANToAppli at line cil_TriggerProfiles(CIL_stManagedCycle.u8CurrentRequestedCycle);.");
    debugger_setRelativeFunctionBpAtLine("CIL_runCANToAppli", 364);
  
    testStep("STEP", "Set signal Presf_Lvl_ST3 to I_C04_PRESF_LVL_V2_LVL8.");
    setSignal(BODY3::Presf_Lvl_ST3, I_C04_PRESF_LVL_V2_LVL8);
    testWaitForTimeout(500);
    
    testStep("STEP", "Check if CPU stopped at line 'cil_TriggerProfiles(CIL_stManagedCycle.u8CurrentRequestedCycle);'. --> CPU is Stopped");
    debugger_WaitUntilBPisReached(1000);
  
  
    debugger_deleteAllBP();
    
  
    testStep("STEP", "Set a breakpoint in function cil_TriggerProfiles() under case I_C04_PRESF_LVL_V2_LVL8 at line '(void)Rte_Read_prrEnableCycle6_b8CycleValidity(&u8CycleValidityStatus);'.");
    debugger_setRelativeFunctionBpAtLine("cil_TriggerProfiles", 302);
    
    debugger_run();
  
    testCaseComment("Action: ARCH_SW_CIL_0121, ARCH_SW_CIL_0126, ARCH_SW_CIL_0139");
    testStep("STEP", "Check if CPU stopped in function cil_TriggerProfiles() under case I_C04_PRESF_LVL_V2_LVL8 at line '(void)Rte_Read_prrEnableCycle6_b8CycleValidity(&u8CycleValidityStatus);'. --> CPU is Stopped");
    debugger_WaitUntilBPisReached(1000);
  
  
    debugger_deleteAllBP();
    
  
    testStep("STEP", "Set a breakpoint at the end of the function cil_RequestTensioning().");
    debugger_setBpAtLine("s:\\Components\\Application\\Autoliv\\CIL\\Implementation\\src\\CIL_CANToAppli.c", 1980);
    
    debugger_run();
    
    testStep("STEP", "Check if CPU stopped at the end of function cil_RequestTensioning. --> CPU is Stopped");
    debugger_WaitUntilBPisReached(1000);
    
  
    debugger_deleteAllBP();
    debugger_run();
  
  
    testCaseComment("Action: ARCH_SW_CIL_0353, ARCH_SW_CIL_0184");
    testStep("STEP", "Check if variable Rte_CIL_psrCarAcceleration_b8IsCarAccelerationLow is KU8_FALSE --> KU8_FALSE.");
    result = debugger_readGlobalVariable("uint8", "Rte_CIL_psrCarAcceleration_b8IsCarAccelerationLow,,app.elf", 0);
    EvalManStepEqual("Expected Test Result", result, 85);
  

  testCaseComment("Postcondition");
  testStep("STEP", "Return ECU to default values");
  setSignal(BODY3::Presf_Lvl_ST3, I_C04_PRESF_LVL_V2_NOLVL);
  RunPostTs(); 
}


testcase SW_IT_CIL_TriggerProfiles_09()
{
  //***********************************Test report header*********************************
  testReportAddMiscInfoBlock("AUTOLIV ELECTRONICS document");
  TestReportAddMiscInfo("Nightly test", "No");
  TestReportAddMiscInfo("Test type", "Requirement-Based test");
  TestReportAddMiscInfo("Regression Test", "No");
  TestReportAddMiscInfo("Fault injection method used", "No");
  TestReportAddMiscInfo("Resource usage evaluation", "No");
  TestReportAddMiscInfo("Priority", "No");
  TestReportAddMiscInfo("Safety relevant", "No");
  
  AddRequirementInfo("Requirement under test", "ARCH_SW_CIL_0024");
  AddRequirementInfo("ARCH_SW_CIL_0024", "If any other value than 1,2,3,4,5,6,7,8 is received for signal Presf_Lvl_ST3 then no cycle should be requested.");
  //***************************************************************************************
    
  testCaseComment("Preconditions");
  testStep("STEP", "Bench Initialization");
  RunPreTs();
    
  
    testStep("STEP", "Set signal Presf_Lvl_ST3 to value I_C04_PRESF_LVL_V2_NOLVL.");
    setSignal(BODY3::Presf_Lvl_ST3, I_C04_PRESF_LVL_V2_NOLVL);
    testWaitForTimeout(500);
  
  
    testStep("STEP", "Set a breakpoint in function CIL_runCANToAppli at line cil_TriggerProfiles(CIL_stManagedCycle.u8CurrentRequestedCycle);.");
    debugger_setRelativeFunctionBpAtLine("CIL_runCANToAppli", 364);
    
    testStep("STEP", "Check if CPU stopped at line 'cil_TriggerProfiles(CIL_stManagedCycle.u8CurrentRequestedCycle);'. --> CPU is Stopped");
debugger_isCPUStoppedAtFunction("CIL_runCANToAppli");    ////EvalManStepEqual("Expected Test Result", debugger_result,  "CPU is Stopped");
  
  
    debugger_deleteAllBP();
  
    
    testStep("STEP", "Set a breakpoint in function cil_TriggerProfiles() under case KU8_NO_CYCLE.");
    debugger_setRelativeFunctionBpAtLine("cil_TriggerProfiles", 21);
  
    debugger_run();
  
    testCaseComment("Action: ARCH_SW_CIL_0024");
    testStep("STEP", "Check if CPU stopped in function cil_TriggerProfiles() under case KU8_NO_CYCLE. --> CPU is Stopped");
debugger_isCPUStoppedAtFunction("cil_TriggerProfiles");    ////EvalManStepEqual("Expected Test Result", debugger_result,  "CPU is Stopped");
  

  testCaseComment("Postcondition");
  testStep("STEP", "Return ECU to default values");
  RunPostTs();
}


testcase SW_IT_CIL_Presf_Enbl_ST3_01()
{
  //***********************************Test report header*********************************
  testReportAddMiscInfoBlock("AUTOLIV ELECTRONICS document");
  TestReportAddMiscInfo("Nightly test", "No");
  TestReportAddMiscInfo("Test type", "Requirement-Based test");
  TestReportAddMiscInfo("Regression Test", "No");
  TestReportAddMiscInfo("Fault injection method used", "No");
  TestReportAddMiscInfo("Resource usage evaluation", "No");
  TestReportAddMiscInfo("Priority", "No");
  TestReportAddMiscInfo("Safety relevant", "No");
  
  AddRequirementInfo("Requirement under test", "ARCH_SW_CIL_0025, ARCH_SW_CIL_0003");
  AddRequirementInfo("ARCH_SW_CIL_0025", "If value for Signal Presf_Enbl_ST3 is not 1 (is 0 or 3) then cycle request coming from PRE-SAFE or ORC should be inhibitted/aborted ");
  AddRequirementInfo("ARCH_SW_CIL_0003", "Signal Presf_Enbl_ST3 shall be send though application when it’s needed.");
  //***************************************************************************************
    
  testCaseComment("Preconditions");
  testStep("STEP", "Bench Initialization");
  RunPreTs();
  
    testStep("STEP", "Set signal Presf_Enbl_ST3 to KU8_ZERO.");
    setSignal(BODY3::PresfAct_Adj_ST3::Presf_Enbl_ST3, 0x0);
    testWaitForTimeoutSilent(500);
  
    
    testStep("STEP", "Set a breakpoint in function CIL_runCANToAppli at line 'cil_ManageInputSignals();'.");
    debugger_setRelativeFunctionBpAtLine("CIL_runCANToAppli", 5);
  
    testStep("STEP", "Check if CPU stopped in function CIL_runCANToAppli at line 'cil_ManageInputSignals();'. --> CPU is Stopped");
debugger_isCPUStoppedAtFunction("CIL_runCANToAppli");    ////EvalManStepEqual("Expected Test Result", debugger_result,  "CPU is Stopped");
    
  
    debugger_deleteAllBP();
  
  
    testStep("STEP", "Set a breakpoint in function cil_ManageInhibitConditions() at line 'CIL_SET_INHIB_MASK_OFF (KU8_CIL_PresfEnableInhibition);'.");
    debugger_setRelativeFunctionBpAtLine("cil_ManageInhibitConditions", 50);
    
    debugger_run();
  
    testCaseComment("Action: ARCH_SW_CIL_0025");
    testStep("STEP", "Check if CPU stopped in function cil_ManageInhibitConditions() at line 'CIL_SET_INHIB_MASK_OFF (KU8_CIL_PresfEnableInhibition);'. --> CPU is Stopped");
debugger_isCPUStoppedAtFunction("cil_ManageInhibitConditions");    ////EvalManStepEqual("Expected Test Result", debugger_result,  "CPU is Stopped");
    
    testCaseComment("Action: ARCH_SW_CIL_0003");
    testStep("STEP", "Evaluate if variable cil_stPresfActAdjFrame.Presf_Enbl_ST3 is equal to KU8_ZERO --> KU8_ZERO.");
    result = debugger_readGlobalVariable("uint8", "cil_stPresfActAdjFrame,,app.elf", 3);
    EvalManStepEqual("Expected Test Result", result, 0x0);


  testCaseComment("Postcondition");
  testStep("STEP", "Return ECU to default values");
  RunPostTs();
}


testcase SW_IT_CIL_PresfAct_TensSupp_Rq_ST3_03()
{
  //***********************************Test report header*********************************
  testReportAddMiscInfoBlock("AUTOLIV ELECTRONICS document");
  TestReportAddMiscInfo("Nightly test", "No");
  TestReportAddMiscInfo("Test type", "Requirement-Based test");
  TestReportAddMiscInfo("Regression Test", "No");
  TestReportAddMiscInfo("Fault injection method used", "No");
  TestReportAddMiscInfo("Resource usage evaluation", "No");
  TestReportAddMiscInfo("Priority", "No");
  TestReportAddMiscInfo("Safety relevant", "No");
  
  AddRequirementInfo("Requirement under test", "ARCH_SW_CIL_0048");
  AddRequirementInfo("ARCH_SW_CIL_0048", "Signal PresfAct_TensSupp_Rq_ST3 shall be send though application when it’s needed.");
  //***************************************************************************************
    
  testCaseComment("Preconditions");
  testStep("STEP", "Bench Initialization");
  RunPreTs();

  
    testStep("STEP", "Set signal PresfAct_TensSupp_Rq_ST3 to value 7.");
    setSignal(BODY3::PresfAct_TensSupp_Rq_ST3, 7);
    testWaitForTimeout(500);
  
    testStep("STEP", "Set a breakpoint in function CIL_ComNotification_PresfAct_Adj_Pr5_ST3_2joar1a41xrgjqab60epnbplm_25141edc_Rx().");
    debugger_setRelativeFunctionBpAtLine("CIL_ComNotification_PresfAct_Adj_Pr5_ST3_2joar1a41xrgjqab60epnbplm_25141edc_Rx", 0);
  
    testStep("STEP", "Check if CPU stopped in function CIL_ComNotification_PresfAct_Adj_Pr5_ST3_2joar1a41xrgjqab60epnbplm_25141edc_Rx(). --> CPU is Stopped");
debugger_isCPUStoppedAtFunction("CIL_ComNotification_PresfAct_Adj_Pr5_ST3_2joar1a41xrgjqab60epnbplm_25141edc_Rx");    ////EvalManStepEqual("Expected Test Result", debugger_result,  "CPU is Stopped");
  
    
    debugger_deleteAllBP();
  
        
    testStep("STEP", "Set a breakpoint in function CIL_runCANToAppli at line 'cil_ManageInputSignals();'.");
    debugger_setRelativeFunctionBpAtLine("CIL_runCANToAppli", 5);
  
    debugger_run();
  
    testStep("STEP", "Check if CPU stopped in function CIL_runCANToAppli at line 'cil_ManageInputSignals();'. --> CPU is Stopped");
debugger_isCPUStoppedAtFunction("CIL_runCANToAppli");    ////EvalManStepEqual("Expected Test Result", debugger_result,  "CPU is Stopped");
  
    debugger_deleteAllBP();
    debugger_run();
  
    testCaseComment("Action: ARCH_SW_CIL_0048");
    testStep("STEP", "Read variable cil_stPresfActAdjFrame.PresfAct_TensSupp_Rq_ST3 --> 0x7.");
    result = debugger_readGlobalVariable("uint8", "cil_stPresfActAdjFrame,,app.elf", 10);
    EvalManStepEqual("Expected Test Result", result, 0x7);
  

  testCaseComment("Postcondition");
  testStep("STEP", "Return ECU to default values");
  RunPostTs();
}


testcase SW_IT_CIL_PresfAct_TensSupp_Rq_ST3_02()
{
  //***********************************Test report header*********************************
  testReportAddMiscInfoBlock("AUTOLIV ELECTRONICS document");
  TestReportAddMiscInfo("Nightly test", "No");
  TestReportAddMiscInfo("Test type", "Requirement-Based test");
  TestReportAddMiscInfo("Regression Test", "No");
  TestReportAddMiscInfo("Fault injection method used", "No");
  TestReportAddMiscInfo("Resource usage evaluation", "No");
  TestReportAddMiscInfo("Priority", "No");
  TestReportAddMiscInfo("Safety relevant", "No");
  
  AddRequirementInfo("Requirement under test", "ARCH_SW_CIL_0049");
  AddRequirementInfo("ARCH_SW_CIL_0049", "If value for PresfAct_TensSupp_Rq_ST3 is not 0 on ECU’s current side (is 1,2,3) then cycle request coming from PRE-SAFE or ORC should be inhibitted/aborted.");
  //***************************************************************************************
    
  testCaseComment("Preconditions");
  testStep("STEP", "Bench Initialization");
  RunPreTs();
  
  
    testStep("STEP", "Set signal PresfAct_TensSupp_Rq_ST3 to value 2.");
    setSignal(BODY3::PresfAct_Adj_ST3::PresfAct_TensSupp_Rq_ST3, 0x2);
    testWaitForTimeout(500);
    
    testStep("STEP", "Set a breakpoint in function CIL_runCANToAppli at line 'cil_ManageInputSignals();'.");
    debugger_setRelativeFunctionBpAtLine("CIL_runCANToAppli", 5);
  
    testStep("STEP", "Check if CPU stopped in function CIL_runCANToAppli at line 'cil_ManageInputSignals();'. --> CPU is Stopped");
debugger_isCPUStoppedAtFunction("CIL_runCANToAppli");    ////EvalManStepEqual("Expected Test Result", debugger_result,  "CPU is Stopped");
  
  
    debugger_deleteAllBP();
    
  
    testStep("STEP", "Set a breakpoint in function cil_ManageAbortingConditions at line 'CIL_SET_ABORT_MASK_ON (KU8_CIL_TensSuppAborting);'.");
    debugger_setRelativeFunctionBpAtLine("cil_ManageAbortingConditions", 54);
    
    debugger_run();
  
    testCaseComment("Action: ARCH_SW_CIL_0049");
    testStep("STEP", "Check if CPU stopped in function cil_ManageAbortingConditions at line 'CIL_SET_ABORT_MASK_ON (KU8_CIL_TensSuppAborting);'. --> CPU is Stopped");
debugger_isCPUStoppedAtFunction("cil_ManageAbortingConditions");    ////EvalManStepEqual("Expected Test Result", debugger_result,  "CPU is Stopped");
  

  testCaseComment("Postcondition");
  testStep("STEP", "Return ECU to default values");
  RunPostTs();
}


testcase SW_IT_CIL_PresfAccelReset_NotExcd_ST3_01()
{
  //***********************************Test report header*********************************
  testReportAddMiscInfoBlock("AUTOLIV ELECTRONICS document");
  TestReportAddMiscInfo("Nightly test", "No");
  TestReportAddMiscInfo("Test type", "Requirement-Based test");
  TestReportAddMiscInfo("Regression Test", "No");
  TestReportAddMiscInfo("Fault injection method used", "No");
  TestReportAddMiscInfo("Resource usage evaluation", "No");
  TestReportAddMiscInfo("Priority", "No");
  TestReportAddMiscInfo("Safety relevant", "No");
  
  AddRequirementInfo("Requirement under test", "ARCH_SW_CIL_0004, ARCH_SW_CIL_0026");
  AddRequirementInfo("ARCH_SW_CIL_0004", "Signal PresfAccelReset_NotExcd_ST3 shall be send though application when it’s needed.");
  AddRequirementInfo("ARCH_SW_CIL_0026", "If value for PresfAccelReset_NotExcd_ST3 is not 2 (is 0 or ,1) the the release cycle will not be executed.");
  //***************************************************************************************
    
  testCaseComment("Preconditions");
  testStep("STEP", "Bench Initialization");
  RunPreTs();

  
    testStep("STEP", "Set signal PresfAccelReset_NotExcd_ST3 to KU8_ONE.");
    setSignal(BODY3::PresfAct_Adj_ST3::PresfAccelReset_NotExcd_ST3, 0x1);
    testWaitForTimeout(500);
    
    testStep("STEP", "Set a breakpoint in function CIL_runCANToAppli at line 'cil_ManageInputSignals();'.");
    debugger_setRelativeFunctionBpAtLine("CIL_runCANToAppli", 5);
  
    testStep("STEP", "Check if CPU stopped in function CIL_runCANToAppli at line 'cil_ManageInputSignals();'. --> CPU is Stopped");
debugger_isCPUStoppedAtFunction("CIL_runCANToAppli");    ////EvalManStepEqual("Expected Test Result", debugger_result,  "CPU is Stopped");
  
    
    debugger_deleteAllBP();
  
  
    testStep("STEP", "Set a breakpoint in function cil_ManageInhibitConditions at line 'CIL_SET_INHIB_MASK_ON (KU8_CIL_AccLowInhibition);'.");
    debugger_setRelativeFunctionBpAtLine("cil_ManageInhibitConditions", 138);
    
    debugger_run();
    testWaitForTimeout(500);
  
    testCaseComment("Action: ARCH_SW_CIL_0026");
    testStep("STEP", "Check if CPU stopped in function cil_ManageInhibitConditions at line 'CIL_SET_INHIB_MASK_ON (KU8_CIL_AccLowInhibition);'. --> CPU is Stopped");
debugger_isCPUStoppedAtFunction("cil_ManageInhibitConditions");    ////EvalManStepEqual("Expected Test Result", debugger_result,  "CPU is Stopped");
  
    testCaseComment("Action: ARCH_SW_CIL_0004");
    testStep("STEP", "Read variable cil_stPresfActAdjFrame.PresfAccelReset_NotExcd_ST3 --> KU8_ONE.");
    result = debugger_readGlobalVariable("uint8", "cil_stPresfActAdjFrame,,app.elf", 7);
    EvalManStepEqual("Expected Test Result", result, 0x1);
  

  testCaseComment("Postcondition");
  testStep("STEP", "Return ECU to default values");
  RunPostTs(); 
}



testcase SW_IT_CIL_PresfAccelReset_NotExcd_ST3_03()
{
  //***********************************Test report header*********************************
  testReportAddMiscInfoBlock("AUTOLIV ELECTRONICS document");
  TestReportAddMiscInfo("Nightly test", "No");
  TestReportAddMiscInfo("Test type", "Requirement-Based test");
  TestReportAddMiscInfo("Regression Test", "No");
  TestReportAddMiscInfo("Fault injection method used", "No");
  TestReportAddMiscInfo("Resource usage evaluation", "No");
  TestReportAddMiscInfo("Priority", "No");
  TestReportAddMiscInfo("Safety relevant", "No");
  
  AddRequirementInfo("Requirement under test", "ARCH_SW_CIL_0118");
  AddRequirementInfo("ARCH_SW_CIL_0118", "If timeout is present for Presafe frame then value for PresfAccelReset_NotExcd_ST3 will be interpreted as 2 , as Release allowed.");
  //***************************************************************************************
    
  testCaseComment("Preconditions");
  testStep("STEP", "Bench Initialization");
  RunPreTs();
 
  
    testStep("STEP", "Set signal PresfAccelReset_NotExcd_ST3 to 0x3.");
    setSignal(BODY3::PresfAct_Adj_ST3::PresfAccelReset_NotExcd_ST3, 0x3);
    testWaitForTimeout(500);
  
  
    testStep("STEP", "Set a breakpoint in function CIL_runCANToAppli at line 'cil_ManageInputSignals();'.");
    debugger_setRelativeFunctionBpAtLine("CIL_runCANToAppli", 5);
  
    testStep("STEP", "Check if CPU stopped in function CIL_runCANToAppli at line 'cil_ManageInputSignals();'. --> CPU is Stopped");
debugger_isCPUStoppedAtFunction("CIL_runCANToAppli");    ////EvalManStepEqual("Expected Test Result", debugger_result,  "CPU is Stopped");
  
    
    debugger_deleteAllBP();
  
    
    testStep("STEP", "Set a breakpoint in function cil_ManageInhibitConditions() at line 'if( (KU8_TWO == cil_stPresfActAdjFrame.PresfAccelReset_NotExcd_ST3)'.");
    debugger_setRelativeFunctionBpAtLine("cil_ManageInhibitConditions", 132);
    
    debugger_run();
  
    testCaseComment("Action: ARCH_SW_CIL_0118");
    testStep("STEP", "Check if CPU stopped in function cil_ManageInhibitConditions() at line 'if( (KU8_TWO == cil_stPresfActAdjFrame.PresfAccelReset_NotExcd_ST3)'. --> CPU is Stopped");
debugger_isCPUStoppedAtFunction("cil_ManageInhibitConditions");    ////EvalManStepEqual("Expected Test Result", debugger_result,  "CPU is Stopped");

  
    testCaseComment("Action: ARCH_SW_CIL_0118");
    testStep("STEP", "Read variable cil_stPresfActAdjFrame.PresfAccelReset_NotExcd_ST3 --> KU8_THREE.");
    result = debugger_readGlobalVariable("uint8", "cil_stPresfActAdjFrame,,app.elf", 7);
    EvalManStepEqual("Expected Test Result", result, 0x3);

  
  testCaseComment("Postcondition");
  testStep("STEP", "Return ECU to default values");
  RunPostTs();
}



testcase SW_IT_CIL_ISw_Stat_ST3_02()
{
  //***********************************Test report header*********************************
  testReportAddMiscInfoBlock("AUTOLIV ELECTRONICS document");
  TestReportAddMiscInfo("Nightly test", "No");
  TestReportAddMiscInfo("Test type", "Requirement-Based test");
  TestReportAddMiscInfo("Regression Test", "No");
  TestReportAddMiscInfo("Fault injection method used", "No");
  TestReportAddMiscInfo("Resource usage evaluation", "No");
  TestReportAddMiscInfo("Priority", "No");
  TestReportAddMiscInfo("Safety relevant", "No");
  
  AddRequirementInfo("Requirement under test", "ARCH_SW_CIL_0027, ARCH_SW_CIL_0123");
  AddRequirementInfo("ARCH_SW_CIL_0027", "If value for ISw_Stat_ST3 is not 4 (is  0,1,2,5 or 7 ) then cycle request should be inhibitted/aborted.");
  AddRequirementInfo("ARCH_SW_CIL_0123", "A NEW IGNITION RUN CYCLE happens when trasiition from any value to 0 – IGN_LOCK;");
  //***************************************************************************************
    
  testCaseComment("Preconditions");
  testStep("STEP", "Bench Initialization");
  RunPreTs();

    
    testStep("STEP", "Set signal ISw_Stat_ST3 from frame Ign_Stat_ST3 to 0x0.");
    setSignal(BODY3::ISw_Stat_ST3, 0x0);
    testWaitForTimeout(500);  
  
  
    testStep("STEP", "Set a breakpoint in function CIL_runCANToAppli at line 'cil_ManageInputSignals();'.");
    debugger_setRelativeFunctionBpAtLine("CIL_runCANToAppli", 5);
  
    testStep("STEP", "Check if CPU stopped in function CIL_runCANToAppli at line 'cil_ManageInputSignals();'. --> CPU is Stopped");
    debugger_isCPUStoppedAtFunction("CIL_runCANToAppli");  
  
    
    debugger_deleteAllBP();
  
  
    testStep("STEP", "Set a breakpoint in function cil_ManageAbortingConditions().");
    debugger_setRelativeFunctionBpAtLine("cil_ManageAbortingConditions", 0);
    
    debugger_run();
      
    testCaseComment("Action: ARCH_SW_CIL_0027");
    testStep("STEP", "Check if CPU stopped in function cil_ManageAbortingConditions(). --> CPU is Stopped");
    debugger_isCPUStoppedAtFunction("cil_ManageAbortingConditions");
  
    testCaseComment("Action: ARCH_SW_CIL_0123");
    testStep("STEP", "Read variable cil_u8IgnitionSignal --> KU8_ZERO.");
    result = debugger_readGlobalVariable("uint8", "cil_u8IgnitionSignal,,app.elf", 0);
    EvalManStepEqual("Expected Test Result", result, 0);
  

  testCaseComment("Postcondition");
  testStep("STEP", "Return ECU to default values");
  setSignal(BODY3::ISw_Stat_ST3, 4);
  RunPostTs(); 
}


testcase SW_IT_CIL_Bckl_Sw_D_Stat_ST3_01()
{
  //***********************************Test report header*********************************
  testReportAddMiscInfoBlock("AUTOLIV ELECTRONICS document");
  TestReportAddMiscInfo("Nightly test", "No");
  TestReportAddMiscInfo("Test type", "Requirement-Based test");
  TestReportAddMiscInfo("Regression Test", "No");
  TestReportAddMiscInfo("Fault injection method used", "No");
  TestReportAddMiscInfo("Resource usage evaluation", "No");
  TestReportAddMiscInfo("Priority", "No");
  TestReportAddMiscInfo("Safety relevant", "No");
  
  AddRequirementInfo("Requirement under test", "ARCH_SW_CIL_0078");
  AddRequirementInfo("ARCH_SW_CIL_0078", "If value for Bckl_Sw_D_Stat_ST3 is trasitioning from 1 to 0 and BSR is being executed than any profile activation on API-interface request will be inhibited for NVP_u8AfterBuckle* 5 time.");
  //***************************************************************************************
    
  testCaseComment("Preconditions");
  testStep("STEP", "Bench Initialization");
  RunPreTs();
 
  
    testStep("STEP", "Set signal PT4_PTCoor_PT_Rdy_ST3 to RDY (0x1).");
    setSignal(BODY3::PT4_PTCoor4_ST3::PT4_PTCoor_PT_Rdy_ST3, 1);
    testWaitForTimeoutSilent(100);
  
    testStep("STEP", "Set signal Bckl_Sw_D_Stat_ST3 to I_C02_BCKL_SW_STAT_NOT.");
    setSignal(BODY3::Bckl_Sw_D_Stat_ST3, 1);
    testWaitForTimeoutSilent(500);
  
    testStep("STEP", "Set signal Bckl_Sw_D_Stat_ST3 to I_C02_BCKL_SW_STAT_OK.");
    setSignal(BODY3::Bckl_Sw_D_Stat_ST3, 0);
    
  
    debugger_deleteAllBP();
    
  
    testStep("STEP", "Set a breakpoint in function CIL_runCANToAppli at line '(void)Rte_Write_psrCustomerSpecific_u8TriggerRequest(KU8_ONE);' under 'if(KU16_ZERO == (CIL_u16InhibitionStatus & KU16_CIL_BSR_INHIB_MASK) )'.");
    debugger_setRelativeFunctionBpAtLine("CIL_runCANToAppli", 426);
  
    debugger_run();  
  
    testCaseComment("Action: ARCH_SW_CIL_0078");
    testStep("STEP", "Check if CPU stopped in function CIL_runCANToAppli at line '(void)Rte_Write_psrCustomerSpecific_u8TriggerRequest(KU8_ONE);' under 'if(KU16_ZERO == (CIL_u16InhibitionStatus & KU16_CIL_BSR_INHIB_MASK) )'. --> CPU is Stopped");
    debugger_WaitUntilBPisReached(1000);
  
  
    debugger_deleteAllBP();
    
  
    testStep("STEP", "Set a breakpoint in function cil_ManageInputSignals() at line 'cil_ManageInhibitConditions();'.");
    debugger_setRelativeFunctionBpAtLine("cil_ManageInputSignals", 260);
  
    debugger_run();  
  
    testStep("STEP", "Check if CPU stopped in function cil_ManageInputSignals() at line 'cil_ManageInhibitConditions();'. --> CPU is Stopped");
    debugger_WaitUntilBPisReached(1000);


    debugger_deleteAllBP();
    
  
    testStep("STEP", "Set a breakpoint in function cil_ManageInhibitConditions() at line 'CIL_SET_INHIB_MASK_OFF (KU8_CIL_DelayBuckleSwitch);'.");
    debugger_setRelativeFunctionBpAtLine("cil_ManageInhibitConditions", 306);
  
    debugger_run();  
  
    testCaseComment("Action: ARCH_SW_CIL_0078");
    testStep("STEP", "Check if CPU stopped in function cil_ManageInputSignals() at line 'CIL_SET_INHIB_MASK_OFF (KU8_CIL_DelayBuckleSwitch);'. --> CPU is Stopped");
    debugger_WaitUntilBPisReached(1000);
  
    testWaitForTimeoutSilent(11000);
  
    testCaseComment("Action: ARCH_SW_CIL_0078");
    testStep("STEP", "Evaluate if variable cil_u16BuckleSwitchDelayCounter is equal to KU16_CIL_AFTER_BUCKLE_DELAY + KU8_ONE. --> KU16_CIL_AFTER_BUCKLE_DELAY + KU8_ONE");
    result = debugger_readGlobalVariable("uint8", "cil_u16BuckleSwitchDelayCounter,,app.elf", 0);
    EvalManStepEqual("Expected test result", result, 101);
  
  
  testCaseComment("Postcondition");
  testStep("STEP", "Return ECU to default values");
  RunPostTs(); 
}


testcase SW_IT_CIL_Bckl_Sw_FP_Stat_ST3_03()
{
  //***********************************Test report header*********************************
  testReportAddMiscInfoBlock("AUTOLIV ELECTRONICS document");
  TestReportAddMiscInfo("Nightly test", "No");
  TestReportAddMiscInfo("Test type", "Requirement-Based test");
  TestReportAddMiscInfo("Regression Test", "No");
  TestReportAddMiscInfo("Fault injection method used", "No");
  TestReportAddMiscInfo("Resource usage evaluation", "No");
  TestReportAddMiscInfo("Priority", "No");
  TestReportAddMiscInfo("Safety relevant", "No");
  
  AddRequirementInfo("Requirement under test", "ARCH_SW_CIL_0009, ARCH_SW_CIL_0029");
  AddRequirementInfo("ARCH_SW_CIL_0009", "Signal Bckl_Sw_FP_Stat_ST3 shall be send though application when it’s needed.");
  AddRequirementInfo("ARCH_SW_CIL_0029", "If value for Bckl_Sw_FP_Stat_ST3 is not 0 (is  1,2,3) then cycle request should be inhibitted/aborted.");
  //***************************************************************************************
    
  testCaseComment("Preconditions");
  testStep("STEP", "Bench Initialization");
  RunPreTs();

    
    testStep("STEP", "Set signal Bckl_Sw_FP_Stat_ST3 to 0x1.");
    setSignal(BODY3::Bckl_Sw_FP_Stat_ST3, 0x1);
    testWaitForTimeout(1000);
    
    
    testStep("STEP", "Set a breakpoint in function CIL_runCANToAppli at line 'cil_ManageInputSignals();'.");
    debugger_setRelativeFunctionBpAtLine("CIL_runCANToAppli", 5);
  
    testStep("STEP", "Check if CPU stopped in function CIL_runCANToAppli at line 'cil_ManageInputSignals();'. --> CPU is Stopped");
debugger_isCPUStoppedAtFunction("CIL_runCANToAppli");    ////EvalManStepEqual("Expected Test Result", debugger_result,  "CPU is Stopped");
  
  
    testCaseComment("Action: ARCH_SW_CIL_0009");
    testStep("STEP", "Read variable stBcklSwStatFrame.Bckl_Sw_FP_Stat_ST3 --> KU8_ONE.");
    result = debugger_readGlobalVariable("uint8", "stBcklSwStatFrame,,app.elf", 2);
    EvalManStepEqual("Expected Test Result", result, 1);
  
  
    debugger_deleteAllBP();
  
  
    testStep("STEP", "Set a breakpoint in function cil_ManageInhibitConditions().");
    debugger_setRelativeFunctionBpAtLine("cil_ManageInhibitConditions", 0);
    
    debugger_run();
  
    testCaseComment("Action: ARCH_SW_CIL_0029");
    testStep("STEP", "Check if CPU stopped in function cil_ManageInhibitConditions(). --> CPU is Stopped");
debugger_isCPUStoppedAtFunction("cil_ManageInhibitConditions");    ////EvalManStepEqual("Expected Test Result", debugger_result,  "CPU is Stopped");
  

  testCaseComment("Postcondition");
  testStep("STEP", "Return ECU to default values");
  RunPostTs();
}


testcase SW_IT_CIL_Bckl_Sw_FP_Stat_ST3_02() // TO DO > ARCH_SW_CIL_0077 is modified
{
  //***********************************Test report header*********************************
  testReportAddMiscInfoBlock("AUTOLIV ELECTRONICS document");
  TestReportAddMiscInfo("Nightly test", "No");
  TestReportAddMiscInfo("Test type", "Requirement-Based test");
  TestReportAddMiscInfo("Regression Test", "No");
  TestReportAddMiscInfo("Fault injection method used", "No");
  TestReportAddMiscInfo("Resource usage evaluation", "No");
  TestReportAddMiscInfo("Priority", "No");
  TestReportAddMiscInfo("Safety relevant", "No");
  
  AddRequirementInfo("Requirement under test", "ARCH_SW_CIL_0046, ARCH_SW_CIL_0077");
  AddRequirementInfo("ARCH_SW_CIL_0046", "If value for Bckl_Sw_FP_Stat_ST3 is transitioning from 1 to 0 then cycle 26 (BSR1) shall be executed after NVP_u8AfterBuckle* 5 time.");
  AddRequirementInfo("ARCH_SW_CIL_0077", "If value for Bckl_Sw_FP_Stat_ST3 is trasitioning from 1 to 0 and BSR is being executed than any profile activation on API-interface request will be inhibited for NVP_u8AfterBuckle* 5 time.");
  //***************************************************************************************
    
  testCaseComment("Preconditions");
  testStep("STEP", "Bench Initialization");
  RunPreTs();

  
    testStep("STEP", "Set a breakpoint in function cil_ManageInputSignals() at line 'if (KU8_ONE == NVP_stVehicleEquipmentData.VehicleSteeringConfig)'.");
    debugger_setRelativeFunctionBpAtLine("cil_ManageInputSignals", 159);
  
    testStep("STEP", "Set variable NVP_stVehicleEquipmentData.VehicleSteeringConfig to KU8_ZERO.");
    debugger_writeGlobalVariable("uint8", "NVP_stVehicleEquipmentData.VehicleSteeringConfig", 0, 0);
    testWaitForTimeoutSilent(1000);
  
    
    debugger_deleteAllBP();
    debugger_run();
  
  
    testStep("STEP", "Set signal EVC_List03_StStyle_ST3 to RHD (0x2).");
    setSignal(BODY3::EVC_List03_StStyle_ST3, 2);
    testWaitForTimeoutSilent(100);
    
    testStep("STEP", "Set signal PT4_PTCoor_PT_Rdy_ST3 to RDY (0x1).");
    setSignal(BODY3::PT4_PTCoor4_ST3::PT4_PTCoor_PT_Rdy_ST3, 1);
    testWaitForTimeoutSilent(100);
  
    testStep("STEP", "Set signal Bckl_Sw_FP_Stat_ST3 to I_C02_BCKL_SW_STAT_NOT.");
    setSignal(BODY3::Bckl_Sw_FP_Stat_ST3, 1);
    
    testStep("STEP", "Set a breakpoint in function cil_ManageInhibitConditions() at line 'CIL_SET_INHIB_MASK_OFF (KU8_CIL_DelayBuckleSwitch);'.");
    debugger_setRelativeFunctionBpAtLine("cil_ManageInhibitConditions", 306);
    testWaitForTimeoutSilent(500);
  
    testStep("STEP", "Set signal Bckl_Sw_FP_Stat_ST3 to I_C02_BCKL_SW_STAT_OK.");
    setSignal(BODY3::Bckl_Sw_FP_Stat_ST3, 0);

    
    testStep("STEP", "Check if CPU stopped in function cil_ManageInhibitConditions() at line 'CIL_SET_INHIB_MASK_OFF (KU8_CIL_DelayBuckleSwitch);'. --> CPU is Stopped");
    debugger_WaitUntilBPisReached(11000);
    

    testCaseComment("Action: ARCH_SW_CIL_0046, ARCH_SW_CIL_0077");
    testStep("STEP", "Evaluate if variable cil_u16BuckleSwitchDelayCounter is equal to (KU16_CIL_AFTER_BUCKLE_DELAY + 1). --> cil_u16BuckleSwitchDelayCounter is equal to (KU16_CIL_AFTER_BUCKLE_DELAY + 1)");
    result = debugger_readGlobalVariable("uint16", "cil_u16BuckleSwitchDelayCounter,,app.elf", 0);
    EvalManStepEqual("Expected Test Result", result, 101);
  
  
    testWaitForTimeoutSilent(1000);
    debugger_deleteAllBP();
  
  
    testStep("STEP", "Set a breakpoint in function cil_TriggerProfiles() at line 'void)Rte_Read_prrEnableCycle26_b8CycleValidity(&u8CycleValidityStatus);' under 'case I_C06_RBTM_LVL_RQ_PROFILE19:'.");
    debugger_setRelativeFunctionBpAtLine("cil_TriggerProfiles", 601);
        
    debugger_run();
  
    testCaseComment("Action: ARCH_SW_CIL_0046");
    testStep("STEP", "Check if CPU stopped in function cil_TriggerProfiles() at line 'void)Rte_Read_prrEnableCycle26_b8CycleValidity(&u8CycleValidityStatus);' under 'case I_C06_RBTM_LVL_RQ_PROFILE19:'. --> CPU is Stopped");
    debugger_WaitUntilBPisReached(1000);

  
  testCaseComment("Postcondition");
  testStep("STEP", "Return ECU to default values");
  RunPostTs(); 
}



testcase SW_IT_CIL_Impact_RO_type1_ST3_01()
{
  //***********************************Test report header*********************************
  testReportAddMiscInfoBlock("AUTOLIV ELECTRONICS document");
  TestReportAddMiscInfo("Nightly test", "No");
  TestReportAddMiscInfo("Test type", "Requirement-Based test");
  TestReportAddMiscInfo("Regression Test", "No");
  TestReportAddMiscInfo("Fault injection method used", "No");
  TestReportAddMiscInfo("Resource usage evaluation", "No");
  TestReportAddMiscInfo("Priority", "No");
  TestReportAddMiscInfo("Safety relevant", "No");
  
  AddRequirementInfo("Requirement under test", "ARCH_SW_CIL_0031, ARCH_SW_CIL_0032, ARCH_SW_CIL_0181");
  AddRequirementInfo("ARCH_SW_CIL_0031", "Signal Impact_RO_type1_ST3 shall be send though application when it’s needed.");
  AddRequirementInfo("ARCH_SW_CIL_0032", "If value for Impact_RO_type1_ST3 is 1 than ORC PRE-SAFE 8 (cycle 6) should be executed.");
  AddRequirementInfo("ARCH_SW_CIL_0181", "After ORC Request no profile will be executed until a new ignition cycle happens.");
  //***************************************************************************************
  
  testCaseComment("Preconditions");
  testStep("STEP", "Bench Initialization");
  RunPreTs();
  
    
    testStep("STEP", "Set a breakpoint in function EOL_Autotest_CheckProductEndOfLifeMaxForce().");
    debugger_setRelativeFunctionBpAtLine("EOL_Autotest_CheckProductEndOfLifeMaxForce", 3);
  
    testStep("STEP", "Check if CPU stopped in function EOL_Autotest_CheckProductEndOfLifeMaxForce(). --> CPU is Stopped");
debugger_isCPUStoppedAtFunction("EOL_Autotest_CheckProductEndOfLifeMaxForce");    ////EvalManStepEqual("Expected Test Result", debugger_result, "CPU is Stopped");
  
    testStep("STEP", "Set variable NVP_BLOCK_ID_EXECUTION_COUNTERS_RamBlockData.NVP_au32ExecutedCycleCounters[KU8_EOL_MAX_FORCE_LEVEL] to NVP_u32MaxForceEOLThrs.");
    debugger_writeGlobalVariable("uint32", "NVP_BLOCK_ID_EXECUTION_COUNTERS_RamBlockData,,app.elf", 3, 50);
    debugger_deleteAllBP();    
    
  
    testStep("STEP", "Set signal Impact_RO_type1_ST3 to KU8_CIL_TRUE_ImpactRoTrigger.");
    setSignal(BODY3::Impact_RO_type1_ST3, 1); 
    testWaitForTimeout(500);
  
  
    testStep("STEP", "Set a breakpoint in function cil_ManageInputSignals() at line 'cil_u8ORC1ActivationRequest = I_C04_PRESF_LVL_V2_LVL8;'.");
    debugger_setRelativeFunctionBpAtLine("cil_ManageInputSignals", 116);

    debugger_run();
  
    testCaseComment("Action: ARCH_SW_CIL_0032, ARCH_SW_CIL_0181");
    testStep("STEP", "Check if CPU stopped at line 'cil_u8ORC1ActivationRequest = I_C04_PRESF_LVL_V2_LVL8;'. --> CPU is Stopped");
debugger_isCPUStoppedAtFunction("cil_ManageInputSignals");    ////EvalManStepEqual("Expected Test Result", debugger_result, "CPU is Stopped");
    
    debugger_deleteAllBP();
  
  
    testStep("STEP", "Set a breakpoint in function CIL_runCANToAppli at line 'cil_TriggerProfiles(CIL_stManagedCycle.u8CurrentRequestedCycle);'.");
    debugger_setRelativeFunctionBpAtLine("CIL_runCANToAppli", 364);

    debugger_run();
  
    testStep("STEP", "Check if CPU stopped at line 'cil_TriggerProfiles(CIL_stManagedCycle.u8CurrentRequestedCycle);'. --> CPU is Stopped");
debugger_isCPUStoppedAtFunction("CIL_runCANToAppli");    ////EvalManStepEqual("Expected Test Result", debugger_result, "CPU is Stopped");

    debugger_deleteAllBP();
  
  
    testStep("STEP", "Set a breakpoint in function cil_TriggerProfile at line '(void)Rte_Read_prrEnableCycle6_b8CycleValidity(&u8CycleValidityStatus);' and press run.");
    debugger_setRelativeFunctionBpAtLine("cil_TriggerProfiles", 302);
  
    debugger_run();
  
    
    testCaseComment("Action: ARCH_SW_CIL_0031");
    testStep("STEP", "Check if CPU stopped at line '(void)Rte_Read_prrEnableCycle6_b8CycleValidity(&u8CycleValidityStatus);'. --> CPU is Stopped");
debugger_isCPUStoppedAtFunction("cil_TriggerProfiles");    ////EvalManStepEqual("Expected Test Result", debugger_result, "CPU is Stopped");
  
  
  testCaseComment("Postcondition");
  testStep("STEP", "Return ECU to default values");
  setSignal(BODY3::Impact_RO_type1_ST3, 0);
  RunPostTs(); 
}


testcase SW_IT_CIL_Impact_RO_type2_ST3_01()
{
  //***********************************Test report header*********************************
  testReportAddMiscInfoBlock("AUTOLIV ELECTRONICS document");
  TestReportAddMiscInfo("Nightly test", "No");
  TestReportAddMiscInfo("Test type", "Requirement-Based test");
  TestReportAddMiscInfo("Regression Test", "No");
  TestReportAddMiscInfo("Fault injection method used", "No");
  TestReportAddMiscInfo("Resource usage evaluation", "No");
  TestReportAddMiscInfo("Priority", "No");
  TestReportAddMiscInfo("Safety relevant", "No");
  
  AddRequirementInfo("Requirement under test", "ARCH_SW_CIL_0034");
  AddRequirementInfo("ARCH_SW_CIL_0034", "If value for Impact_RO_type2_ST3 is 1 then ORC PRE-SAFE 8 (cycle 6) should be executed.");
  //***************************************************************************************
  
  testCaseComment("Preconditions");
  testStep("STEP", "Bench Initialization");
  RunPreTs(); 
  
  
    testStep("STEP", "Set a breakpoint in function CIL_runCANToAppli at line 'cil_TriggerProfiles(CIL_stManagedCycle.u8CurrentRequestedCycle);'.");
    debugger_setRelativeFunctionBpAtLine("CIL_runCANToAppli", 364);
    
      
    testStep("STEP", "Set signal Impact_RO_type2_ST3 to KU8_CIL_TRUE_ImpactRoTrigger.");
    setSignal(BODY3::Impact_RO_type2_ST3, 1); 
    testWaitForTimeout(500);
  
  
    testStep("STEP", "Check if CPU stopped at line 'cil_TriggerProfiles(CIL_stManagedCycle.u8CurrentRequestedCycle);'. --> CPU is Stopped");
debugger_isCPUStoppedAtFunction("CIL_runCANToAppli");    ////EvalManStepEqual("Expected Test Result", debugger_result, "CPU is Stopped");

  
    debugger_deleteAllBP();
  
  
    testStep("STEP", "Set a breakpoint in function cil_TriggerProfile at line '(void)Rte_Read_prrEnableCycle6_b8CycleValidity(&u8CycleValidityStatus);' under case I_C04_PRESF_LVL_V2_LVL8, and press run.");
    debugger_setRelativeFunctionBpAtLine("cil_TriggerProfiles", 302);
  
    debugger_run();
  
    testCaseComment("Action: ARCH_SW_CIL_0034");
    testStep("STEP", "Check if CPU stopped in function cil_TriggerProfile at line '(void)Rte_Read_prrEnableCycle6_b8CycleValidity(&u8CycleValidityStatus);' under case I_C04_PRESF_LVL_V2_LVL8. --> CPU is Stopped");
debugger_isCPUStoppedAtFunction("cil_TriggerProfile");    ////EvalManStepEqual("Expected Test Result", debugger_result, "CPU is Stopped");
  

  testCaseComment("Postcondition");
  testStep("STEP", "Return ECU to default values");
  setSignal(BODY3::Impact_RO_type2_ST3, 0); 
  RunPostTs(); 
}


testcase SW_IT_CIL_Impact_X_ST3_01()
{
  //***********************************Test report header*********************************
  testReportAddMiscInfoBlock("AUTOLIV ELECTRONICS document");
  TestReportAddMiscInfo("Nightly test", "No");
  TestReportAddMiscInfo("Test type", "Requirement-Based test");
  TestReportAddMiscInfo("Regression Test", "No");
  TestReportAddMiscInfo("Fault injection method used", "No");
  TestReportAddMiscInfo("Resource usage evaluation", "No");
  TestReportAddMiscInfo("Priority", "No");
  TestReportAddMiscInfo("Safety relevant", "No");
  
  AddRequirementInfo("Requirement under test", "ARCH_SW_CIL_0036, ARCH_SW_CIL_0183, ARCH_SW_CIL_2941");
  AddRequirementInfo("ARCH_SW_CIL_0036", "If Impact_X_ST3 is 1 then CRASH occurs and all profiles(including release) are aborted/inhibited until a new ignition cycle.");
  AddRequirementInfo("ARCH_SW_CIL_2941", "If release profile is aborted then it will be restarted when abortion conditions disappear.");
  AddRequirementInfo("ARCH_SW_CIL_0183", "After ORC Request no profile will be executed until a new ignition cycle happens.");
  //***************************************************************************************
  
  testCaseComment("Preconditions");
  testStep("STEP", "Bench Initialization");
  RunPreTs();

    
    testStep("STEP", "Set a breakpoint in function cil_ManageInputSignals() at line 'cil_stInputSignalsPresfRec.bImpactXType= cil_stImpactSignalsStatus3.Impact_X_ST3;'.");
    debugger_setRelativeFunctionBpAtLine("cil_ManageInputSignals", 262);
  
    testStep("STEP", "Set signal Impact_X_ST3 from frame Impact3_ST3 to KU8_ONE.");
    setSignal(BODY3::Impact3_ST3::Impact_X_ST3, 1);
    testWaitForTimeout(500);
  
    testStep("STEP", "Check if CPU stopped in function cil_ManageInputSignals() at line 'cil_stInputSignalsPresfRec.bImpactXType= cil_stImpactSignalsStatus3.Impact_X_ST3;'. --> CPU is Stopped");
debugger_isCPUStoppedAtFunction("cil_ManageInputSignals");    ////EvalManStepEqual("Expected Test Result", debugger_result,  "CPU is Stopped");
  
    
    debugger_deleteAllBP();

  
    testStep("STEP", "Set a breakpoint in function cil_ManageAbortingConditions at line 'CIL_SET_ABORT_MASK_ON (KU8_CIL_AbortingOfImpactX);'.");
    debugger_setRelativeFunctionBpAtLine("cil_ManageAbortingConditions", 130);
  
    debugger_run();
    
    testCaseComment("Action: ARCH_SW_CIL_0036, ARCH_SW_CIL_2941");
    testStep("STEP", "Check if CPU stopped in function cil_ManageAbortingConditions at line 'CIL_SET_ABORT_MASK_ON (KU8_CIL_AbortingOfImpactX);'. --> CPU is Stopped");
debugger_isCPUStoppedAtFunction("cil_ManageAbortingConditions");    ////EvalManStepEqual("Expected Test Result", debugger_result,  "CPU is Stopped");
  
    
    debugger_deleteAllBP();
  
  
    setSignal(BODY3::Impact3_ST3::Impact_X_ST3, 0);
  
    testStep("STEP", "Set signal Presf_Lvl_ST3 to I_C04_PRESF_LVL_V2_LVL3.");
    setSignal(BODY3::Presf_Lvl_ST3, I_C04_PRESF_LVL_V2_LVL3);
    testWaitForTimeout(500);
  
  
    testStep("STEP", "Set a breakpoint in function cil_TriggerProfiles() at line '(void)Rte_Read_prrEnableCycle1_b8CycleValidity(&u8CycleValidityStatus);' under case I_C04_PRESF_LVL_V2_LVL3.");
    debugger_setRelativeFunctionBpAtLine("cil_TriggerProfiles", 161);
    
    debugger_run();
    
    testCaseComment("Action: ARCH_SW_CIL_0183");
    testStep("STEP", "Check if CPU stopped at line '(void)Rte_Read_prrEnableCycle1_b8CycleValidity(&u8CycleValidityStatus);' under case I_C04_PRESF_LVL_V2_LVL3. --> CPU is Running");
debugger_isCPUStoppedAtFunction("cil_TriggerProfiles");    //EvalManStepEqual("Expected Test Result", debugger_result,  "CPU is Running");
  
    
    debugger_deleteAllBP();
  
  
    testStep("STEP", "Set a breakpoint in function cil_TriggerProfiles() at line '(void)Rte_Read_prrEnableCycle1_b8CycleValidity(&u8CycleValidityStatus);' under case I_C04_PRESF_LVL_V2_LVL3.");
    debugger_setRelativeFunctionBpAtLine("cil_TriggerProfiles", 161);
  
  
    testStep("STEP", "Set signal ISw_Stat_ST3 to I_C03_ISW_STAT_IGN_OFF and afterwards to I_C03_ISW_STAT_IGN_ON.");
    setSignal(BODY3::ISw_Stat_ST3, 0);
    testWaitForTimeout(100);
    setSignal(BODY3::ISw_Stat_ST3, 4);
  
    testStep("STEP", "Set signal Presf_Lvl_ST3 to I_C04_PRESF_LVL_V2_LVL3.");
    setSignal(BODY3::Presf_Lvl_ST3, I_C04_PRESF_LVL_V2_LVL3);
  
    debugger_run();
    testWaitForTimeout(500);
    
    testCaseComment("Action:ARCH_SW_CIL_0183");
    testStep("STEP", "Check if CPU stopped at line '(void)Rte_Read_prrEnableCycle1_b8CycleValidity(&u8CycleValidityStatus);' under case I_C04_PRESF_LVL_V2_LVL3. --> CPU is Stopped");
    debugger_isCPUStoppedAtFunction("cil_TriggerProfiles");
    ////EvalManStepEqual("Expected Test Result", debugger_result,  "CPU is Stopped");
  

  testCaseComment("Postcondition");
  testStep("STEP", "Return ECU to default values");
  setSignal(BODY3::Presf_Lvl_ST3, I_C04_PRESF_LVL_V2_NOLVL);
  RunPostTs(); 
}


testcase SW_IT_CIL_TriggerProfiles_10()
{
  //***********************************Test report header*********************************
  testReportAddMiscInfoBlock("AUTOLIV ELECTRONICS document");
  TestReportAddMiscInfo("Nightly test", "No");
  TestReportAddMiscInfo("Test type", "Requirement-Based test");
  TestReportAddMiscInfo("Regression Test", "No");
  TestReportAddMiscInfo("Fault injection method used", "No");
  TestReportAddMiscInfo("Resource usage evaluation", "No");
  TestReportAddMiscInfo("Priority", "No");
  TestReportAddMiscInfo("Safety relevant", "No");
  
  AddRequirementInfo("Requirement under test", "ARCH_SW_CIL_0127, ARCH_SW_CIL_0140, ARCH_SW_CIL_0190");
  AddRequirementInfo("ARCH_SW_CIL_0127", "If signal is received with value 9, then tensioning cycle 7 shall be requested.");
  AddRequirementInfo("ARCH_SW_CIL_0140", "If signal is received with value 9, then tensioning cycle 7 shall be requested.");
  //***************************************************************************************
    
  testCaseComment("Preconditions");
  testStep("STEP", "Bench Initialization");
  RunPreTs();

  
    testStep("STEP", "Set a breakpoint in function CIL_runCANToAppli at line cil_TriggerProfiles(CIL_stManagedCycle.u8CurrentRequestedCycle);.");
    debugger_setRelativeFunctionBpAtLine("CIL_runCANToAppli", 364);
  
    testStep("STEP", "Set signal RBTMFL_SP_Lvl_Rq_ST35 to I_C06_RBTM_LVL_RQ_PROFILE9.");
    setSignal(BODY3::RBTMFL_SP_Lvl_Rq_ST35, 9);
    testWaitForTimeout(500);
    
    testStep("STEP", "Check if CPU stopped at line 'cil_TriggerProfiles(CIL_stManagedCycle.u8CurrentRequestedCycle);'. --> CPU is Stopped");
debugger_isCPUStoppedAtFunction("CIL_runCANToAppli");    ////EvalManStepEqual("Expected Test Result", debugger_result,  "CPU is Stopped");
  
  
    debugger_deleteAllBP();
  
    
    testStep("STEP", "Set a breakpoint in function cil_TriggerProfiles under case I_C06_RBTM_LVL_RQ_PROFILE9 at line '(void)Rte_Read_prrEnableCycle7_b8CycleValidity(&u8CycleValidityStatus);'.");
    debugger_setRelativeFunctionBpAtLine("cil_TriggerProfiles", 354);
    
    debugger_run();
  
    testCaseComment("Action: ARCH_SW_CIL_0127, ARCH_SW_CIL_0140, ARCH_SW_CIL_0190");
    testStep("STEP", "Check if CPU stopped in function cil_TriggerProfiles under case I_C06_RBTM_LVL_RQ_PROFILE9 at line '(void)Rte_Read_prrEnableCycle7_b8CycleValidity(&u8CycleValidityStatus);'. --> CPU is Stopped");
debugger_isCPUStoppedAtFunction("cil_TriggerProfiles");    ////EvalManStepEqual("Expected Test Result", debugger_result,  "CPU is Stopped");
    

  testCaseComment("Postcondition");
  testStep("STEP", "Return ECU to default values");
  setSignal(BODY3::RBTMFL_SP_Lvl_Rq_ST35, 0x0);
  RunPostTs();
}


testcase SW_IT_CIL_TriggerProfiles_11()
{
  //***********************************Test report header*********************************
  testReportAddMiscInfoBlock("AUTOLIV ELECTRONICS document");
  TestReportAddMiscInfo("Nightly test", "No");
  TestReportAddMiscInfo("Test type", "Requirement-Based test");
  TestReportAddMiscInfo("Regression Test", "No");
  TestReportAddMiscInfo("Fault injection method used", "No");
  TestReportAddMiscInfo("Resource usage evaluation", "No");
  TestReportAddMiscInfo("Priority", "No");
  TestReportAddMiscInfo("Safety relevant", "No");
  
  AddRequirementInfo("Requirement under test", "ARCH_SW_CIL_0128, ARCH_SW_CIL_0141");
  AddRequirementInfo("ARCH_SW_CIL_0128", "If signal is received with value 10, then tensioning cycle 8 shall be requested.");
  AddRequirementInfo("ARCH_SW_CIL_0141", "If signal is received with value 10, then tensioning cycle 8 shall be requested.");
  //***************************************************************************************
    
  testCaseComment("Preconditions");
  testStep("STEP", "Bench Initialization");
  RunPreTs();

  
    testStep("STEP", "Set a breakpoint in function CIL_runCANToAppli at line cil_TriggerProfiles(CIL_stManagedCycle.u8CurrentRequestedCycle);.");
    debugger_setRelativeFunctionBpAtLine("CIL_runCANToAppli", 364);
  
    testStep("STEP", "Set signal RBTMFL_SP_Lvl_Rq_ST35 to I_C06_RBTM_LVL_RQ_PROFILE10.");
    setSignal(BODY3::RBTMFL_SP_Lvl_Rq_ST35, 0xA);
    testWaitForTimeout(500);
    
    testStep("STEP", "Check if CPU stopped at line 'cil_TriggerProfiles(CIL_stManagedCycle.u8CurrentRequestedCycle);'. --> CPU is Stopped");
    debugger_WaitUntilBPisReached(1000);
    
  
    debugger_deleteAllBP();
    
    
    testStep("STEP", "Set a breakpoint in function cil_TriggerProfiles at line 'case I_C06_RBTM_LVL_RQ_PROFILE10:'.");
    debugger_setRelativeFunctionBpAtLine("cil_TriggerProfiles", 373);
    
    debugger_run();
    
    testStep("STEP", "Check if CPU stopped at line 'case I_C06_RBTM_LVL_RQ_PROFILE10:'. --> CPU is Stopped");
    debugger_WaitUntilBPisReached(1000);
  
  
    debugger_deleteAllBP();
    
  
    testStep("STEP", "Set a breakpoint at the end of the function cil_RequestTensioning().");
    debugger_setBpAtLine("s:\\Components\\Application\\Autoliv\\CIL\\Implementation\\src\\CIL_CANToAppli.c", 1980); 
    
    debugger_run();
    
    testCaseComment("Action: ARCH_SW_CIL_0128");
    testStep("STEP", "Check if CPU stopped in function cil_RequestTensioning. --> CPU is Stopped");
    debugger_WaitUntilBPisReached(1000);
  
    
    debugger_deleteAllBP();
    debugger_run();
  
  
    testCaseComment("Action: ARCH_SW_CIL_0128, ARCH_SW_CIL_0141");
    testStep("STEP", "Check if variable Rte_CIL_prrCrashSeverityLevel_u8PreCrashSeverityLevel is KU8_PRECRASH_SEVERITY_LEVEL_9 --> KU8_PRECRASH_SEVERITY_LEVEL_9.");
    result = debugger_readGlobalVariable("uint8", "Rte_CIL_prrCrashSeverityLevel_u8PreCrashSeverityLevel,,app.elf", 0);
    EvalManStepEqual("Expected Test Result", result, 8);
  

  testCaseComment("Postcondition");
  testStep("STEP", "Return ECU to default values");
  setSignal(BODY3::RBTMFL_SP_Lvl_Rq_ST35, 0x0);
  RunPostTs();
}


testcase SW_IT_CIL_TriggerProfiles_12()
{
  //***********************************Test report header*********************************
  testReportAddMiscInfoBlock("AUTOLIV ELECTRONICS document");
  TestReportAddMiscInfo("Nightly test", "No");
  TestReportAddMiscInfo("Test type", "Requirement-Based test");
  TestReportAddMiscInfo("Regression Test", "No");
  TestReportAddMiscInfo("Fault injection method used", "No");
  TestReportAddMiscInfo("Resource usage evaluation", "No");
  TestReportAddMiscInfo("Priority", "No");
  TestReportAddMiscInfo("Safety relevant", "No");
  
  AddRequirementInfo("Requirement under test", "ARCH_SW_CIL_0129, ARCH_SW_CIL_0142");
  AddRequirementInfo("ARCH_SW_CIL_0129", "If signal is received with value 11, then tensioning cycle 9 shall be requested.");
  AddRequirementInfo("ARCH_SW_CIL_0142", "If signal is received with value 11, then tensioning cycle 9 shall be requested.");
  //***************************************************************************************
    
  testCaseComment("Preconditions");
  testStep("STEP", "Bench Initialization");
  RunPreTs();

    
    testStep("STEP", "Set a breakpoint in function CIL_runCANToAppli at line cil_TriggerProfiles(CIL_stManagedCycle.u8CurrentRequestedCycle);.");
    debugger_setRelativeFunctionBpAtLine("CIL_runCANToAppli", 364);
  
    testStep("STEP", "Set signal RBTMFL_SP_Lvl_Rq_ST35 to I_C06_RBTM_LVL_RQ_PROFILE11.");
    setSignal(BODY3::RBTMFL_SP_Lvl_Rq_ST35, 0xB);
    testWaitForTimeout(500);
  
    testStep("STEP", "Check if CPU stopped at line 'cil_TriggerProfiles(CIL_stManagedCycle.u8CurrentRequestedCycle);'. --> CPU is Stopped");
debugger_isCPUStoppedAtFunction("CIL_runCANToAppli");    ////EvalManStepEqual("Expected Test Result", debugger_result,  "CPU is Stopped");
    
  
    debugger_deleteAllBP();

    
    testStep("STEP", "Set a breakpoint in function cil_TriggerProfiles under case I_C06_RBTM_LVL_RQ_PROFILE11.");
    debugger_setRelativeFunctionBpAtLine("cil_TriggerProfiles", 389);
    
    debugger_run();
  
    testStep("STEP", "Check if CPU stopped under case I_C06_RBTM_LVL_RQ_PROFILE11. --> CPU is Stopped");
debugger_isCPUStoppedAtFunction("cil_TriggerProfiles");    ////EvalManStepEqual("Expected Test Result", debugger_result,  "CPU is Stopped");
  
  
    testStep("STEP", "Set a breakpoint at the end of the function cil_RequestTensioning.");
    debugger_setBpAtLine("s:\\Components\\Application\\Autoliv\\CIL\\Implementation\\src\\CIL_CANToAppli.c", 1980); 
    
    debugger_run();
  
    testCaseComment("Action: ARCH_SW_CIL_0129");
    testStep("STEP", "Check if CPU stopped at the end of the function cil_RequestTensioning. --> CPU is Stopped");
    debugger_isCPUStoppedAtFunction("cil_RequestTensioning");
    ////EvalManStepEqual("Expected Test Result", debugger_result,  "CPU is Stopped");
  
  
    debugger_deleteAllBP();
    debugger_run();
  
  
    testCaseComment("Action: ARCH_SW_CIL_0129, ARCH_SW_CIL_0142");
    testStep("STEP", "Check if variable Rte_CIL_prrCrashSeverityLevel_u8PreCrashSeverityLevel is KU8_PRECRASH_SEVERITY_LEVEL_10. --> KU8_PRECRASH_SEVERITY_LEVEL_10 (0x9)");
    result = debugger_readGlobalVariable("uint8", "Rte_CIL_prrCrashSeverityLevel_u8PreCrashSeverityLevel,,app.elf", 0);
    EvalManStepEqual("Expected Test Result", result, 9);

  
  testCaseComment("Postcondition");
  testStep("STEP", "Return ECU to default values");
  setSignal(BODY3::RBTMFL_SP_Lvl_Rq_ST35, 0);
  RunPostTs(); 
}


testcase SW_IT_CIL_TriggerProfiles_13()
{
  //***********************************Test report header*********************************
  testReportAddMiscInfoBlock("AUTOLIV ELECTRONICS document");
  TestReportAddMiscInfo("Nightly test", "No");
  TestReportAddMiscInfo("Test type", "Requirement-Based test");
  TestReportAddMiscInfo("Regression Test", "No");
  TestReportAddMiscInfo("Fault injection method used", "No");
  TestReportAddMiscInfo("Resource usage evaluation", "No");
  TestReportAddMiscInfo("Priority", "No");
  TestReportAddMiscInfo("Safety relevant", "No");
  
  AddRequirementInfo("Requirement under test", "ARCH_SW_CIL_0130, ARCH_SW_CIL_0143");
  AddRequirementInfo("ARCH_SW_CIL_0130", "If signal is received with value 12, then tensioning cycle 10 shall be requested.");
  AddRequirementInfo("ARCH_SW_CIL_0143", "If signal is received with value 12, then tensioning cycle 10 shall be requested.");
  //***************************************************************************************
    
  testCaseComment("Preconditions");
  testStep("STEP", "Bench Initialization");
  RunPreTs();
  
    
    testStep("STEP", "Set a breakpoint in function CIL_runCANToAppli at line cil_TriggerProfiles(CIL_stManagedCycle.u8CurrentRequestedCycle);.");
    debugger_setRelativeFunctionBpAtLine("CIL_runCANToAppli", 364);
    
    testStep("STEP", "Set signal RBTMFL_SP_Lvl_Rq_ST35 to I_C06_RBTM_LVL_RQ_PROFILE12.");
    setSignal(BODY3::RBTMFL_SP_Lvl_Rq_ST35, 0xC);
    testWaitForTimeout(500);
  
    testStep("STEP", "Check if CPU stopped at line 'cil_TriggerProfiles(CIL_stManagedCycle.u8CurrentRequestedCycle);'. --> CPU is Stopped");
    debugger_WaitUntilBPisReached(1000);
  
  
    debugger_deleteAllBP();

    
    testStep("STEP", "Set a breakpoint in function cil_TriggerProfiles under case I_C06_RBTM_LVL_RQ_PROFILE12 at line '(void)Rte_Read_prrEnableCycle10_b8CycleValidity(&u8CycleValidityStatus);'.");
    debugger_setRelativeFunctionBpAtLine("cil_TriggerProfiles", 411);
    
    debugger_run();
    
    testCaseComment("Action: ARCH_SW_CIL_0130, ARCH_SW_CIL_0143");
    testStep("STEP", "Check if CPU stopped in function cil_TriggerProfiles under case I_C06_RBTM_LVL_RQ_PROFILE12 at line '(void)Rte_Read_prrEnableCycle10_b8CycleValidity(&u8CycleValidityStatus);'. --> CPU is Stopped");
    debugger_WaitUntilBPisReached(1000);
  
  
    debugger_deleteAllBP();

    
    testStep("STEP", "Set a breakpoint at the end of the function cil_RequestTensioning.");
    debugger_setBpAtLine("s:\\Components\\Application\\Autoliv\\CIL\\Implementation\\src\\CIL_CANToAppli.c", 1980); 
    
    debugger_run();
  
    testCaseComment("Action: ARCH_SW_CIL_0130");
    testStep("STEP", "Check if CPU stopped at the end of the function cil_RequestTensioning. --> CPU is Stopped");
    debugger_WaitUntilBPisReached(1000);
  
  
    debugger_deleteAllBP();
    debugger_run();
  
  
    testCaseComment("Action: ARCH_SW_CIL_0130, ARCH_SW_CIL_0143");
    testStep("STEP", "Check if variable Rte_CIL_prrCrashSeverityLevel_u8PreCrashSeverityLevel is KU8_PRECRASH_SEVERITY_LEVEL_11. --> KU8_PRECRASH_SEVERITY_LEVEL_11 (0xA)");
    result = debugger_readGlobalVariable("uint8", "Rte_CIL_prrCrashSeverityLevel_u8PreCrashSeverityLevel,,app.elf", 0);
    EvalManStepEqual("Expected Test Result", result, 0xA);
  

  testCaseComment("Postcondition");
  testStep("STEP", "Return ECU to default values");
  setSignal(BODY3::RBTMFL_SP_Lvl_Rq_ST35, 0x0);
  RunPostTs(); 
}


testcase SW_IT_CIL_TriggerProfiles_14()
{
  //***********************************Test report header*********************************
  testReportAddMiscInfoBlock("AUTOLIV ELECTRONICS document");
  TestReportAddMiscInfo("Nightly test", "No");
  TestReportAddMiscInfo("Test type", "Requirement-Based test");
  TestReportAddMiscInfo("Regression Test", "No");
  TestReportAddMiscInfo("Fault injection method used", "No");
  TestReportAddMiscInfo("Resource usage evaluation", "No");
  TestReportAddMiscInfo("Priority", "No");
  TestReportAddMiscInfo("Safety relevant", "No");
  
  AddRequirementInfo("Requirement under test", "ARCH_SW_CIL_0131, ARCH_SW_CIL_0144");
  AddRequirementInfo("ARCH_SW_CIL_0131", "If signal is received with value 13, then tensioning cycle 11 shall be requested.");
  AddRequirementInfo("ARCH_SW_CIL_0144", "If signal is received with value 13, then tensioning cycle 11 shall be requested.");
  //***************************************************************************************
    
  testCaseComment("Preconditions");
  testStep("STEP", "Bench Initialization");
  RunPreTs();

  
    testStep("STEP", "Set signal RBTMFL_SP_Lvl_Rq_ST35 to I_C06_RBTM_LVL_RQ_PROFILE13.");
    setSignal(BODY3::RBTMFL_SP_Lvl_Rq_ST35, 0xD);
    testWaitForTimeout(500);
    
    testStep("STEP", "Set a breakpoint in function CIL_runCANToAppli at line cil_TriggerProfiles(CIL_stManagedCycle.u8CurrentRequestedCycle);.");
    debugger_setRelativeFunctionBpAtLine("CIL_runCANToAppli", 364);
    
  
    debugger_deleteAllBP();
  
  
    testStep("STEP", "Set a breakpoint in function cil_TriggerProfiles under 'case I_C06_RBTM_LVL_RQ_PROFILE13'.");
    debugger_setRelativeFunctionBpAtLine("cil_TriggerProfiles", 432);
  
    debugger_run();
    
    testStep("STEP", "Check if CPU stopped in function cil_TriggerProfiles under 'case I_C06_RBTM_LVL_RQ_PROFILE13'. --> CPU is Stopped");  
    debugger_WaitUntilBPisReached(1000);
  
  
    debugger_deleteAllBP();
  
  
    testStep("STEP", "Set a breakpoint at the end of the function cil_RequestTensioning.");
    debugger_setBpAtLine("s:\\Components\\Application\\Autoliv\\CIL\\Implementation\\src\\CIL_CANToAppli.c", 1980); 
    
    debugger_run();
  
    testCaseComment("Action: ARCH_SW_CIL_0131");
    testStep("STEP", "Check if CPU stopped in function cil_RequestTensioning. --> CPU is Stopped");
    debugger_WaitUntilBPisReached(1000);
    
  
    debugger_deleteAllBP();
    debugger_run();
  
  
    testCaseComment("Action: ARCH_SW_CIL_0131, ARCH_SW_CIL_0144");
    testStep("STEP", "Check if variable Rte_CIL_prrCrashSeverityLevel_u8PreCrashSeverityLevel is KU8_PRECRASH_SEVERITY_LEVEL_12 --> KU8_PRECRASH_SEVERITY_LEVEL_12.");
    result = debugger_readGlobalVariable("uint8", "Rte_CIL_prrCrashSeverityLevel_u8PreCrashSeverityLevel,,app.elf", 0);
    EvalManStepEqual("Expected Test Result", result, 0xB);
  

  testCaseComment("Postcondition");
  testStep("STEP", "Return ECU to default values");
  setSignal(BODY3::RBTMFL_SP_Lvl_Rq_ST35, 0x0);
  RunPostTs(); 
}


testcase SW_IT_CIL_TriggerProfiles_15()
{
  //***********************************Test report header*********************************
  testReportAddMiscInfoBlock("AUTOLIV ELECTRONICS document");
  TestReportAddMiscInfo("Nightly test", "No");
  TestReportAddMiscInfo("Test type", "Requirement-Based test");
  TestReportAddMiscInfo("Regression Test", "No");
  TestReportAddMiscInfo("Fault injection method used", "No");
  TestReportAddMiscInfo("Resource usage evaluation", "No");
  TestReportAddMiscInfo("Priority", "No");
  TestReportAddMiscInfo("Safety relevant", "No");
  
  AddRequirementInfo("Requirement under test", "ARCH_SW_CIL_0132, ARCH_SW_CIL_0145");
  AddRequirementInfo("ARCH_SW_CIL_0132", "If signal is received with value 14, then tensioning cycle 12 shall be requested.");
  AddRequirementInfo("ARCH_SW_CIL_0145", "If signal is received with value 14, then tensioning cycle 12 shall be requested.");
  //***************************************************************************************
    
  testCaseComment("Preconditions");
  testStep("STEP", "Bench Initialization");
  RunPreTs();
  
    
    testStep("STEP", "Set a breakpoint in function CIL_runCANToAppli at line cil_TriggerProfiles(CIL_stManagedCycle.u8CurrentRequestedCycle);.");
    debugger_setRelativeFunctionBpAtLine("CIL_runCANToAppli", 364);
    
    testStep("STEP", "Set signal RBTMFL_SP_Lvl_Rq_ST35 to I_C06_RBTM_LVL_RQ_PROFILE14.");
    setSignal(BODY3::RBTMFL_SP_Lvl_Rq_ST35, 0xE);
    testWaitForTimeout(500);
  
    testStep("STEP", "Check if CPU stopped at line 'cil_TriggerProfiles(CIL_stManagedCycle.u8CurrentRequestedCycle);'. --> CPU is Stopped");
    debugger_isCPUStoppedAtFunction("CIL_runCANToAppli");
  
  
    debugger_deleteAllBP();

    
    testStep("STEP", "Set a breakpoint in function cil_TriggerProfiles at line '(void)Rte_Read_prrEnableCycle12_b8CycleValidity(&u8CycleValidityStatus);' under case I_C06_RBTM_LVL_RQ_PROFILE14.");
    debugger_setRelativeFunctionBpAtLine("cil_TriggerProfiles", 449);
    
    debugger_run();
  
    testStep("STEP", "Check if CPU stopped at line '(void)Rte_Read_prrEnableCycle12_b8CycleValidity(&u8CycleValidityStatus);' under case I_C06_RBTM_LVL_RQ_PROFILE14. --> CPU is Stopped");
    debugger_isCPUStoppedAtFunction("cil_TriggerProfiles");
  
  
    testStep("STEP", "Set a breakpoint at the end of the function cil_RequestTensioning.");
    debugger_setBpAtLine("s:\\Components\\Application\\Autoliv\\CIL\\Implementation\\src\\CIL_CANToAppli.c", 1980); 
    
    testCaseComment("Action: ARCH_SW_CIL_0132");
    testStep("STEP", "Check if CPU stopped at the end of function cil_RequestTensioning(). --> CPU is Stopped");
    debugger_isCPUStoppedAtFunction("cil_RequestTensioning");
    
  
    debugger_deleteAllBP();
    debugger_run();
  
  
    testCaseComment("Action: ARCH_SW_CIL_0132, ARCH_SW_CIL_0145");
    testStep("STEP", "Check if variable Rte_CIL_prrCrashSeverityLevel_u8PreCrashSeverityLevel is KU8_PRECRASH_SEVERITY_LEVEL_13 --> KU8_PRECRASH_SEVERITY_LEVEL_13.");
    result = debugger_readGlobalVariable("uint8", "Rte_CIL_prrCrashSeverityLevel_u8PreCrashSeverityLevel,,app.elf", 0);
    EvalManStepEqual("Expected Test Result", result, 0xC);
    

  testCaseComment("Postcondition");
  testStep("STEP", "Return ECU to default values");
  setSignal(BODY3::RBTMFL_SP_Lvl_Rq_ST35, 0x0);
  RunPostTs(); 
}


testcase SW_IT_CIL_TriggerProfiles_16()
{
  //***********************************Test report header*********************************
  testReportAddMiscInfoBlock("AUTOLIV ELECTRONICS document");
  TestReportAddMiscInfo("Nightly test", "No");
  TestReportAddMiscInfo("Test type", "Requirement-Based test");
  TestReportAddMiscInfo("Regression Test", "No");
  TestReportAddMiscInfo("Fault injection method used", "No");
  TestReportAddMiscInfo("Resource usage evaluation", "No");
  TestReportAddMiscInfo("Priority", "No");
  TestReportAddMiscInfo("Safety relevant", "No");
  
  AddRequirementInfo("Requirement under test", "ARCH_SW_CIL_0133, ARCH_SW_CIL_0146, ARCH_SW_CIL_0058");
  AddRequirementInfo("ARCH_SW_CIL_0133", "If signal is received with value 15, then tensioning cycle 13 shall be requested.");
  AddRequirementInfo("ARCH_SW_CIL_0146", "If signal is received with value 15, then tensioning cycle 13 shall be requested.");
  AddRequirementInfo("ARCH_SW_CIL_0058", "Signal RBTMFR_SP_Lvl_Rq_ST35 shall be send though application when it’s needed.");
  //***************************************************************************************
    
  testCaseComment("Preconditions");
  testStep("STEP", "Bench Initialization");
  RunPreTs();

  
    testStep("STEP", "Set signal RBTMFL_SP_Lvl_Rq_ST35 to I_C06_RBTM_LVL_RQ_PROFILE15.");
    setSignal(BODY3::RBTMFL_SP_Lvl_Rq_ST35, 0xF);
    testWaitForTimeout(500);
    
    testStep("STEP", "Set a breakpoint in function CIL_runCANToAppli at line cil_TriggerProfiles(CIL_stManagedCycle.u8CurrentRequestedCycle);.");
    debugger_setRelativeFunctionBpAtLine("CIL_runCANToAppli", 364);
    
  
    debugger_deleteAllBP();
    
    
    testStep("STEP", "Set a breakpoint in function cil_TriggerProfiles under case I_C06_RBTM_LVL_RQ_PROFILE15:.");
    debugger_setRelativeFunctionBpAtLine("cil_TriggerProfiles", 470);
  
    debugger_run();
    
    testStep("STEP", "Check if CPU stopped in function cil_TriggerProfiles under case I_C06_RBTM_LVL_RQ_PROFILE15:. --> CPU is Stopped");
    debugger_WaitUntilBPisReached(1000);
  
  
    debugger_deleteAllBP();
  
    
    testStep("STEP", "Set a breakpoint at the end of the function cil_RequestTensioning.");
    debugger_setBpAtLine("s:\\Components\\Application\\Autoliv\\CIL\\Implementation\\src\\CIL_CANToAppli.c", 1980); 
    
    testCaseComment("Action: ARCH_SW_CIL_0133, ARCH_SW_CIL_0146");
    testStep("STEP", "Check if CPU stopped at the end of the function cil_RequestTensioning. --> CPU is Stopped");
    debugger_WaitUntilBPisReached(1000);
    
  
    debugger_deleteAllBP();
    debugger_run();
    
  
    testCaseComment("Action: ARCH_SW_CIL_0133, ARCH_SW_CIL_0058, ARCH_SW_CIL_0146");
    testStep("STEP", "Check if variable Rte_CIL_prrCrashSeverityLevel_u8PreCrashSeverityLevel is KU8_PRECRASH_SEVERITY_LEVEL_14 --> KU8_PRECRASH_SEVERITY_LEVEL_14.");
    result = debugger_readGlobalVariable("uint8", "Rte_CIL_prrCrashSeverityLevel_u8PreCrashSeverityLevel,,app.elf", 0);
    EvalManStepEqual("Expected Test Result", result, 0xD);
  

  testCaseComment("Postcondition");
  testStep("STEP", "Return ECU to default values");
  setSignal(BODY3::RBTMFL_SP_Lvl_Rq_ST35, 0x0);
  RunPostTs();
}


testcase SW_IT_CIL_TriggerProfiles_17()
{
  //***********************************Test report header*********************************
  testReportAddMiscInfoBlock("AUTOLIV ELECTRONICS document");
  TestReportAddMiscInfo("Nightly test", "No");
  TestReportAddMiscInfo("Test type", "Requirement-Based test");
  TestReportAddMiscInfo("Regression Test", "No");
  TestReportAddMiscInfo("Fault injection method used", "No");
  TestReportAddMiscInfo("Resource usage evaluation", "No");
  TestReportAddMiscInfo("Priority", "No");
  TestReportAddMiscInfo("Safety relevant", "No");
  
  AddRequirementInfo("Requirement under test", "ARCH_SW_CIL_0092, ARCH_SW_CIL_0093");
  AddRequirementInfo("ARCH_SW_CIL_0092", "If signal is received with value 22, then tensioning Presafe curve 1, cycle 14, shall be requested.");
  AddRequirementInfo("ARCH_SW_CIL_0093", "If signal is received with value 22, then tensioning Presafe curve 1, cycle 14, shall be requested.");
  //***************************************************************************************
    
  testCaseComment("Preconditions");
  testStep("STEP", "Bench Initialization");
  RunPreTs();

    
    testStep("STEP", "Set a breakpoint in function CIL_runCANToAppli at line cil_TriggerProfiles(CIL_stManagedCycle.u8CurrentRequestedCycle);.");
    debugger_setRelativeFunctionBpAtLine("CIL_runCANToAppli", 364);
  
    testStep("STEP", "Set signal RBTMFL_SP_Lvl_Rq_ST35 to I_C06_RBTM_LVL_RQ_PROFILE22.");
    setSignal(BODY3::RBTMFL_SP_Lvl_Rq_ST35, 22);
    testWaitForTimeout(500);
  
    testStep("STEP", "Check if CPU stopped at line 'cil_TriggerProfiles(CIL_stManagedCycle.u8CurrentRequestedCycle);'. --> CPU is Stopped");
debugger_isCPUStoppedAtFunction("CIL_runCANToAppli");    ////EvalManStepEqual("Expected Test Result", debugger_result,  "CPU is Stopped");

  
    debugger_deleteAllBP();

    
    testStep("STEP", "Set a breakpoint in function cil_TriggerProfiles at line '(void)Rte_Read_prrEnableCycle14_b8CycleValidity(&u8CycleValidityStatus);' under case I_C06_RBTM_LVL_RQ_PROFILE22.");
    debugger_setRelativeFunctionBpAtLine("cil_TriggerProfiles", 653);
    
    debugger_run();  
  
    testStep("STEP", "Check if CPU stopped at line '(void)Rte_Read_prrEnableCycle14_b8CycleValidity(&u8CycleValidityStatus);' under case I_C06_RBTM_LVL_RQ_PROFILE22. --> CPU is Stopped");
debugger_isCPUStoppedAtFunction("cil_TriggerProfiles");    ////EvalManStepEqual("Expected Test Result", debugger_result,  "CPU is Stopped");

  
    debugger_deleteAllBP();

      
    testStep("STEP", "Set a breakpoint at the end of the function cil_RequestTensioning.");
    debugger_setBpAtLine("s:\\Components\\Application\\Autoliv\\CIL\\Implementation\\src\\CIL_CANToAppli.c", 1980); 
    
    debugger_run();  
  
    testCaseComment("Action: ARCH_SW_CIL_0092, ARCH_SW_CIL_0093");
    testStep("STEP", "Check if CPU stopped at the end of the function cil_RequestTensioning. --> CPU is Stopped");
    debugger_isCPUStoppedAtFunction("cil_RequestTensioning");
    ////EvalManStepEqual("Expected Test Result", debugger_result,  "CPU is Stopped");
    
  
    debugger_deleteAllBP();
    debugger_run();
  
    
    testCaseComment("Action: ARCH_SW_CIL_0092, ARCH_SW_CIL_0093");
    testStep("STEP", "Check if variable Rte_CIL_prrCrashSeverityLevel_u8PreCrashSeverityLevel is KU8_PRECRASH_SEVERITY_LEVEL_15 --> KU8_PRECRASH_SEVERITY_LEVEL_15.");
    result = debugger_readGlobalVariable("uint8", "Rte_CIL_prrCrashSeverityLevel_u8PreCrashSeverityLevel,,app.elf", 0);
    EvalManStepEqual("Expected Test Result", result, 0xE);
    

  testCaseComment("Postcondition");
  testStep("STEP", "Return ECU to default values");
  setSignal(BODY3::RBTMFL_SP_Lvl_Rq_ST35, 0);
  RunPostTs();
}


testcase SW_IT_CIL_TriggerProfiles_18()
{
  //***********************************Test report header*********************************
  testReportAddMiscInfoBlock("AUTOLIV ELECTRONICS document");
  TestReportAddMiscInfo("Nightly test", "No");
  TestReportAddMiscInfo("Test type", "Requirement-Based test");
  TestReportAddMiscInfo("Regression Test", "No");
  TestReportAddMiscInfo("Fault injection method used", "No");
  TestReportAddMiscInfo("Resource usage evaluation", "No");
  TestReportAddMiscInfo("Priority", "No");
  TestReportAddMiscInfo("Safety relevant", "No");
  
  AddRequirementInfo("Requirement under test", "ARCH_SW_CIL_0134, ARCH_SW_CIL_0147");
  AddRequirementInfo("ARCH_SW_CIL_0134", "If signal is received with value 23, then tensioning Presafe curve 2, cycle 15, shall be requested.");
  AddRequirementInfo("ARCH_SW_CIL_0147", "If signal is received with value 23, then tensioning Presafe curve 2, cycle 15, shall be requested.");
  //***************************************************************************************
    
  testCaseComment("Preconditions");
  testStep("STEP", "Bench Initialization");
  RunPreTs();

  
    testStep("STEP", "Set signal RBTMFL_SP_Lvl_Rq_ST35 to I_C06_RBTM_LVL_RQ_PROFILE23.");
    setSignal(BODY3::RBTMFL_SP_Lvl_Rq_ST35, 23);
    testWaitForTimeout(500);
    
    testStep("STEP", "Set a breakpoint in function CIL_runCANToAppli at line cil_TriggerProfiles(CIL_stManagedCycle.u8CurrentRequestedCycle);.");
    debugger_setRelativeFunctionBpAtLine("CIL_runCANToAppli", 364);
    
  
    debugger_deleteAllBP();
  
    
    testStep("STEP", "Set a breakpoint in function cil_TriggerProfiles under case I_C06_RBTM_LVL_RQ_PROFILE23 at line '(void)Rte_Read_prrEnableCycle15_b8CycleValidity(&u8CycleValidityStatus);'.");
    debugger_setRelativeFunctionBpAtLine("cil_TriggerProfiles", 676);
    
    debugger_run();
  
    testCaseComment("Action: ARCH_SW_CIL_0134, ARCH_SW_CIL_0147");
    testStep("STEP", "Check if CPU stopped in function cil_TriggerProfiles under case I_C06_RBTM_LVL_RQ_PROFILE23 at line '(void)Rte_Read_prrEnableCycle15_b8CycleValidity(&u8CycleValidityStatus);'. --> CPU is Stopped");
debugger_isCPUStoppedAtFunction("cil_TriggerProfiles");    ////EvalManStepEqual("Expected Test Result", debugger_result,  "CPU is Stopped");
    

  testCaseComment("Postcondition");
  testStep("STEP", "Return ECU to default values");
  setSignal(BODY3::RBTMFL_SP_Lvl_Rq_ST35, 0);
  RunPostTs(); 
}


testcase SW_IT_CIL_TriggerProfiles_19()
{
  //***********************************Test report header*********************************
  testReportAddMiscInfoBlock("AUTOLIV ELECTRONICS document");
  TestReportAddMiscInfo("Nightly test", "No");
  TestReportAddMiscInfo("Test type", "Requirement-Based test");
  TestReportAddMiscInfo("Regression Test", "No");
  TestReportAddMiscInfo("Fault injection method used", "No");
  TestReportAddMiscInfo("Resource usage evaluation", "No");
  TestReportAddMiscInfo("Priority", "No");
  TestReportAddMiscInfo("Safety relevant", "No");
  
  AddRequirementInfo("Requirement under test", "ARCH_SW_CIL_0135, ARCH_SW_CIL_0148");
  AddRequirementInfo("ARCH_SW_CIL_0135", "If signal is received with value 24, then tensioning Presafe curve 3, cycle 16, shall be requested.");
  AddRequirementInfo("ARCH_SW_CIL_0148", "If signal is received with value 24, then tensioning Presafe curve 3, cycle 16, shall be requested.");
  //***************************************************************************************
    
  testCaseComment("Preconditions");
  testStep("STEP", "Bench Initialization");
  RunPreTs();
  
    
    testStep("STEP", "Set a breakpoint in function CIL_runCANToAppli at line cil_TriggerProfiles(CIL_stManagedCycle.u8CurrentRequestedCycle);.");
    debugger_setRelativeFunctionBpAtLine("CIL_runCANToAppli", 364);
  
    testStep("STEP", "Set signal RBTMFL_SP_Lvl_Rq_ST35 to I_C06_RBTM_LVL_RQ_PROFILE24.");
    setSignal(BODY3::RBTMFL_SP_Lvl_Rq_ST35, 24);
    testWaitForTimeout(500);
  
    testStep("STEP", "Check if CPU stopped at line 'cil_TriggerProfiles(CIL_stManagedCycle.u8CurrentRequestedCycle);'. --> CPU is Stopped");
debugger_isCPUStoppedAtFunction("CIL_runCANToAppli");    ////EvalManStepEqual("Expected Test Result", debugger_result,  "CPU is Stopped");
  
  
    debugger_deleteAllBP();
    
    
    testStep("STEP", "Set a breakpoint in function cil_TriggerProfiles under case I_C06_RBTM_LVL_RQ_PROFILE24 at line '(void)Rte_Read_prrEnableCycle16_b8CycleValidity(&u8CycleValidityStatus);'.");
    debugger_setRelativeFunctionBpAtLine("cil_TriggerProfiles", 705);
  
    debugger_run();
  
    testCaseComment("Action: ARCH_SW_CIL_0135, ARCH_SW_CIL_0148");
    testStep("STEP", "Check if CPU stopped in function cil_TriggerProfiles under case I_C06_RBTM_LVL_RQ_PROFILE24 at line '(void)Rte_Read_prrEnableCycle16_b8CycleValidity(&u8CycleValidityStatus);'. --> CPU is Stopped");
debugger_isCPUStoppedAtFunction("cil_TriggerProfiles");    ////EvalManStepEqual("Expected Test Result", debugger_result,  "CPU is Stopped");
  
  
    debugger_deleteAllBP();

      
    testStep("STEP", "Set a breakpoint at the end of the function cil_RequestTensioning.");
    debugger_setBpAtLine("s:\\Components\\Application\\Autoliv\\CIL\\Implementation\\src\\CIL_CANToAppli.c", 1980); 
    
    debugger_run();  
  
    testCaseComment("Action: ARCH_SW_CIL_0135, ARCH_SW_CIL_0148");
    testStep("STEP", "Check if CPU stopped at the end of the function cil_RequestTensioning. --> CPU is Stopped");
    debugger_isCPUStoppedAtFunction("cil_RequestTensioning");
    ////EvalManStepEqual("Expected Test Result", debugger_result,  "CPU is Stopped");
    
  
    debugger_deleteAllBP();
    debugger_run();
  
    
    testCaseComment("Action: ARCH_SW_CIL_0135, ARCH_SW_CIL_0148");
    testStep("STEP", "Check if variable Rte_CIL_prrCrashSeverityLevel_u8PreCrashSeverityLevel is KU8_PRECRASH_SEVERITY_LEVEL_17 --> KU8_PRECRASH_SEVERITY_LEVEL_17.");
    result = debugger_readGlobalVariable("uint8", "Rte_CIL_prrCrashSeverityLevel_u8PreCrashSeverityLevel,,app.elf", 0);
    EvalManStepEqual("Expected Test Result", result, 0x10);
  

  testCaseComment("Postcondition");
  testStep("STEP", "Return ECU to default values");
  setSignal(BODY3::RBTMFL_SP_Lvl_Rq_ST35, 0);
  RunPostTs();
}


testcase SW_IT_CIL_TriggerProfiles_20()
{
  //***********************************Test report header*********************************
  testReportAddMiscInfoBlock("AUTOLIV ELECTRONICS document");
  TestReportAddMiscInfo("Nightly test", "No");
  TestReportAddMiscInfo("Test type", "Requirement-Based test");
  TestReportAddMiscInfo("Regression Test", "No");
  TestReportAddMiscInfo("Fault injection method used", "No");
  TestReportAddMiscInfo("Resource usage evaluation", "No");
  TestReportAddMiscInfo("Priority", "No");
  TestReportAddMiscInfo("Safety relevant", "No");
  
  AddRequirementInfo("Requirement under test", "ARCH_SW_CIL_0136, ARCH_SW_CIL_0149");
  AddRequirementInfo("ARCH_SW_CIL_0136", "If signal is received with value 25, then tensioning Presafe curve 4, cycle 17, shall be requested.");
  AddRequirementInfo("ARCH_SW_CIL_0149", "If signal is received with value 25, then tensioning Presafe curve 4, cycle 17, shall be requested.");
  //***************************************************************************************
    
  testCaseComment("Preconditions");
  testStep("STEP", "Bench Initialization");
  RunPreTs();

    
    testStep("STEP", "Set a breakpoint in function CIL_runCANToAppli at line cil_TriggerProfiles(CIL_stManagedCycle.u8CurrentRequestedCycle);.");
    debugger_setRelativeFunctionBpAtLine("CIL_runCANToAppli", 364);
    
    testStep("STEP", "Set signal RBTMFL_SP_Lvl_Rq_ST35 to I_C06_RBTM_LVL_RQ_PROFILE25.");
    setSignal(BODY3::RBTMFL_SP_Lvl_Rq_ST35, 25);
    testWaitForTimeout(500);
  
    testStep("STEP", "Check if CPU stopped at line 'cil_TriggerProfiles(CIL_stManagedCycle.u8CurrentRequestedCycle);'. --> CPU is Stopped");
debugger_isCPUStoppedAtFunction("CIL_runCANToAppli");    ////EvalManStepEqual("Expected Test Result", debugger_result,  "CPU is Stopped");
  
  
    debugger_deleteAllBP();

    
    testStep("STEP", "Set a breakpoint in function cil_TriggerProfiles under case I_C06_RBTM_LVL_RQ_PROFILE25: at line '(void)Rte_Read_prrEnableCycle17_b8CycleValidity(&u8CycleValidityStatus);'.");
    debugger_setRelativeFunctionBpAtLine("cil_TriggerProfiles", 729);
    
    debugger_run();
    
    testCaseComment("Action: ARCH_SW_CIL_0136, ARCH_SW_CIL_0149");
    testStep("STEP", "Check if CPU stopped in function cil_TriggerProfiles under case I_C06_RBTM_LVL_RQ_PROFILE25: at line '(void)Rte_Read_prrEnableCycle17_b8CycleValidity(&u8CycleValidityStatus);'. --> CPU is Stopped");
debugger_isCPUStoppedAtFunction("cil_TriggerProfiles");    ////EvalManStepEqual("Expected Test Result", debugger_result,  "CPU is Stopped");
    
  
    debugger_deleteAllBP();

      
    testStep("STEP", "Set a breakpoint at the end of the function cil_RequestTensioning().");
    debugger_setBpAtLine("s:\\Components\\Application\\Autoliv\\CIL\\Implementation\\src\\CIL_CANToAppli.c", 1980); 
    
    debugger_run();  
  
    testCaseComment("Action: ARCH_SW_CIL_0136, ARCH_SW_CIL_0149");
    testStep("STEP", "Check if CPU stopped at the end of the function cil_RequestTensioning. --> CPU is Stopped");
    debugger_isCPUStoppedAtFunction("cil_RequestTensioning");
    ////EvalManStepEqual("Expected Test Result", debugger_result,  "CPU is Stopped");
    
  
    debugger_deleteAllBP();
    debugger_run();
  
    
    testCaseComment("Action:  ARCH_SW_CIL_0136, ARCH_SW_CIL_0149");
    testStep("STEP", "Check if variable Rte_CIL_prrCrashSeverityLevel_u8PreCrashSeverityLevel is KU8_PRECRASH_SEVERITY_LEVEL_18 --> KU8_PRECRASH_SEVERITY_LEVEL_18.");
    result = debugger_readGlobalVariable("uint8", "Rte_CIL_prrCrashSeverityLevel_u8PreCrashSeverityLevel,,app.elf", 0);
    EvalManStepEqual("Expected Test Result", result, 0x11);

  
  testCaseComment("Postcondition");
  testStep("STEP", "Return ECU to default values");
  setSignal(BODY3::RBTMFL_SP_Lvl_Rq_ST35, I_C04_PRESF_LVL_V2_NOLVL);
  RunPostTs();
}


testcase SW_IT_CIL_TriggerProfiles_NOLVL_03()
{
  //***********************************Test report header*********************************
  testReportAddMiscInfoBlock("AUTOLIV ELECTRONICS document");
  TestReportAddMiscInfo("Nightly test", "No");
  TestReportAddMiscInfo("Test type", "Requirement-Based test");
  TestReportAddMiscInfo("Regression Test", "No");
  TestReportAddMiscInfo("Fault injection method used", "No");
  TestReportAddMiscInfo("Resource usage evaluation", "No");
  TestReportAddMiscInfo("Priority", "No");
  TestReportAddMiscInfo("Safety relevant", "No");
  
  AddRequirementInfo("Requirement under test", "ARCH_SW_CIL_0080");
  AddRequirementInfo("ARCH_SW_CIL_0080", "A requested cycle will end if RBTMFL_SP_Lvl_Rq_ST35 signal is received on CAN with value 0.");
  //***************************************************************************************
    
  testCaseComment("Preconditions");
  testStep("STEP", "Bench Initialization");
  RunPreTs();
  
  
    testStep("STEP", "Set signal RBTMFL_SP_Lvl_Rq_ST35 to I_C04_PRESF_LVL_V2_NOLVL.");
    setSignal(BODY3::RBTMFL_SP_Lvl_Rq_ST35, 0);
    testWaitForTimeout(500);
    
    testStep("STEP", "Set a breakpoint in function CIL_runCANToAppli at line cil_TriggerProfiles(CIL_stManagedCycle.u8CurrentRequestedCycle);.");
    debugger_setRelativeFunctionBpAtLine("CIL_runCANToAppli", 364);
  
    testStep("STEP", "Check if CPU stopped in function cil_TriggerProfiles at line cil_TriggerProfiles(CIL_stManagedCycle.u8CurrentRequestedCycle);. --> CPU is Stopped");
debugger_isCPUStoppedAtFunction("cil_TriggerProfiles");    ////EvalManStepEqual("Expected Test Result", debugger_result,  "CPU is Stopped");
    
  
    debugger_deleteAllBP();
    
    
    testStep("STEP", "Set a breakpoint in function cil_TriggerProfiles at case KU8_NO_CYCLE.");
    debugger_setRelativeFunctionBpAtLine("cil_TriggerProfiles", 19);
    
    debugger_run();
  
    testCaseComment("Action: ARCH_SW_CIL_0080");
    testStep("STEP", "Check if CPU stopped in function cil_TriggerProfiles at case KU8_NO_CYCLE. --> CPU is Stopped");
debugger_isCPUStoppedAtFunction("cil_TriggerProfiles");    ////EvalManStepEqual("Expected Test Result", debugger_result,  "CPU is Stopped");
  
    
  testCaseComment("Postcondition");
  testStep("STEP", "Return ECU to default values");
  RunPostTs();
}


testcase SW_IT_CIL_TriggerProfiles_NOLVL_02()
{
  //***********************************Test report header*********************************
  testReportAddMiscInfoBlock("AUTOLIV ELECTRONICS document");
  TestReportAddMiscInfo("Nightly test", "No");
  TestReportAddMiscInfo("Test type", "Requirement-Based test");
  TestReportAddMiscInfo("Regression Test", "No");
  TestReportAddMiscInfo("Fault injection method used", "No");
  TestReportAddMiscInfo("Resource usage evaluation", "No");
  TestReportAddMiscInfo("Priority", "No");
  TestReportAddMiscInfo("Safety relevant", "No");
  
  AddRequirementInfo("Requirement under test", "ARCH_SW_CIL_0064, ARCH_SW_CIL_0081");
  AddRequirementInfo("ARCH_SW_CIL_0064", "If any other value than 1,2,3,4,5 and 22 is received for signal RBTMFR_SP_Lvl_Rq_ST35 then no cycle should be requested.");
  AddRequirementInfo("ARCH_SW_CIL_0081", "A requested cycle will end if RBTMFR_SP_Lvl_Rq_ST35 signal is received on CAN with value 0.");
  //***************************************************************************************
    
  testCaseComment("Preconditions");
  testStep("STEP", "Bench Initialization");
  RunPreTs();
  
  
    testStep("STEP", "Set signal RBTMFR_SP_Lvl_Rq_ST35 to I_C04_PRESF_LVL_V2_NOLVL.");
    setSignal(BODY3::RBTMFR_SP_Lvl_Rq_ST35, 0);
    testWaitForTimeout(500);
    
    testStep("STEP", "Set a breakpoint in function CIL_runCANToAppli at line cil_TriggerProfiles(CIL_stManagedCycle.u8CurrentRequestedCycle);.");
    debugger_setRelativeFunctionBpAtLine("CIL_runCANToAppli", 364);
  
    testStep("STEP", "Check if CPU stopped in function cil_TriggerProfiles at line cil_TriggerProfiles(CIL_stManagedCycle.u8CurrentRequestedCycle);. --> CPU is Stopped");
debugger_isCPUStoppedAtFunction("cil_TriggerProfiles");    ////EvalManStepEqual("Expected Test Result", debugger_result,  "CPU is Stopped");
    
  
    debugger_deleteAllBP();
    
    
    testStep("STEP", "Set a breakpoint in function cil_TriggerProfiles at case KU8_NO_CYCLE.");
    debugger_setRelativeFunctionBpAtLine("cil_TriggerProfiles", 19);
    
    debugger_run();
  
    testCaseComment("Action: ARCH_SW_CIL_0064, ARCH_SW_CIL_0081");
    testStep("STEP", "Check if CPU stopped in function cil_TriggerProfiles at case KU8_NO_CYCLE. --> CPU is Stopped");
debugger_isCPUStoppedAtFunction("cil_TriggerProfiles");    ////EvalManStepEqual("Expected Test Result", debugger_result,  "CPU is Stopped");
  

  testCaseComment("Postcondition");
  testStep("STEP", "Return ECU to default values");
  RunPostTs(); 
}


testcase SW_IT_CIL_Presf_Enbl_ST3_02()
{
  //***********************************Test report header*********************************
  testReportAddMiscInfoBlock("AUTOLIV ELECTRONICS document");
  TestReportAddMiscInfo("Nightly test", "No");
  TestReportAddMiscInfo("Test type", "Requirement-Based test");
  TestReportAddMiscInfo("Regression Test", "No");
  TestReportAddMiscInfo("Fault injection method used", "No");
  TestReportAddMiscInfo("Resource usage evaluation", "No");
  TestReportAddMiscInfo("Priority", "No");
  TestReportAddMiscInfo("Safety relevant", "No");
  
  AddRequirementInfo("Requirement under test", "ARCH_SW_CIL_0114");
  AddRequirementInfo("ARCH_SW_CIL_0114", "If Presf_Enbl_ST3 is different than 0 (disable) than next cycle release for previous presafe requested profiles is inhibitted.");
  //***************************************************************************************
    
  testCaseComment("Preconditions");
  testStep("STEP", "Bench Initialization");
  RunPreTs();

  
    testStep("STEP", "Set signal Presf_Enbl_ST3 to I_C02_FALSE_TRUE_SNA_TRUE.");
    setSignal(BODY3::PresfAct_Adj_ST3::Presf_Enbl_ST3, 1);
    testWaitForTimeout(500);
  
  
    testStep("STEP", "Set a breakpoint in function CIL_runCANToAppli at line 'cil_ManageInputSignals();'.");
    debugger_setRelativeFunctionBpAtLine("CIL_runCANToAppli", 5);
  
    testStep("STEP", "Check if CPU stopped in function CIL_runCANToAppli at line 'cil_ManageInputSignals();'. --> CPU is Stopped");
debugger_isCPUStoppedAtFunction("CIL_runCANToAppli");    ////EvalManStepEqual("Expected Test Result", debugger_result,  "CPU is Stopped");
    
  
    debugger_deleteAllBP();
  
    
    testStep("STEP", "Set a breakpoint in function cil_ManageInhibitConditions at line 'CIL_SET_INHIB_MASK_OFF (KU8_CIL_PresfEnableInhibition);'.");
    debugger_setRelativeFunctionBpAtLine("cil_ManageInhibitConditions", 50);
    
    debugger_run();
  
    testCaseComment("Action: ARCH_SW_CIL_0114");
    testStep("STEP", "Check if CPU stopped in function cil_ManageInhibitConditions at line 'CIL_SET_INHIB_MASK_OFF (KU8_CIL_PresfEnableInhibition);'. --> CPU is Stopped");
debugger_isCPUStoppedAtFunction("cil_ManageInhibitConditions");    ////EvalManStepEqual("Expected Test Result", debugger_result,  "CPU is Stopped");
  

  testCaseComment("Postcondition");
  testStep("STEP", "Return ECU to default values");
  RunPostTs();
}



testcase SW_IT_CIL_PresfAccelReset_NotExcd_ST3_04()
{
  //***********************************Test report header*********************************
  testReportAddMiscInfoBlock("AUTOLIV ELECTRONICS document");
  TestReportAddMiscInfo("Nightly test", "No");
  TestReportAddMiscInfo("Test type", "Requirement-Based test");
  TestReportAddMiscInfo("Regression Test", "No");
  TestReportAddMiscInfo("Fault injection method used", "No");
  TestReportAddMiscInfo("Resource usage evaluation", "No");
  TestReportAddMiscInfo("Priority", "No");
  TestReportAddMiscInfo("Safety relevant", "No");
  
  AddRequirementInfo("Requirement under test", "ARCH_SW_CIL_0115");
  AddRequirementInfo("ARCH_SW_CIL_0115", "If PresfAccelReset_NotExcd_ST3 is 2 - Acceleration low(Release Allowed) for at leat 300ms than smooth release shall be executed.(after eachy cycle configured).");
  //***************************************************************************************
    
  testCaseComment("Preconditions");
  testStep("STEP", "Bench Initialization");
  RunPreTs();

  
    testStep("STEP", "Set signal PresfAccelReset_NotExcd_ST3 to I_C04_PRESF_LVL_V2_LVL2.");
    setSignal(BODY3::PresfAct_Adj_ST3::PresfAccelReset_NotExcd_ST3, I_C04_PRESF_LVL_V2_LVL2);
    testWaitForTimeout(300);
  
    
    testStep("STEP", "Set a breakpoint in function CIL_runCANToAppli at line 'cil_ManageInputSignals();'.");
    debugger_setRelativeFunctionBpAtLine("CIL_runCANToAppli", 5);
  
    testStep("STEP", "Check if CPU stopped in function CIL_runCANToAppli at line 'cil_ManageInputSignals();'. --> CPU is Stopped");
debugger_isCPUStoppedAtFunction("CIL_runCANToAppli");    ////EvalManStepEqual("Expected Test Result", debugger_result,  "CPU is Stopped");
    
  
    debugger_deleteAllBP();
  
    
    testStep("STEP", "Set a breakpoint in function cil_ManageInhibitConditions at line 'if( (KU8_TWO == cil_stPresfActAdjFrame.PresfAccelReset_NotExcd_ST3)'.");
    debugger_setRelativeFunctionBpAtLine("cil_ManageInhibitConditions", 132);
    
    debugger_run();
  
    testCaseComment("Action: ARCH_SW_CIL_0115");
    testStep("STEP", "Read variable cil_stPresfActAdjFrame.PresfAccelReset_NotExcd_ST3 --> I_C04_PRESF_LVL_V2_LVL2.");
    result = debugger_readGlobalVariable("uint8", "cil_stPresfActAdjFrame,,app.elf", 7);
    EvalManStepEqual("Expected Test Result", result, 0x2);
    
    testCaseComment("Action: ARCH_SW_CIL_0115");
    testStep("STEP", "Check if CPU stopped in the statement 'if( (KU8_TWO == cil_stPresfActAdjFrame.PresfAccelReset_NotExcd_ST3)'. --> CPU is Stopped");
    debugger_isCPUStoppedAtFunction("cil_ManageInhibitConditions");
    ////EvalManStepEqual("Expected Test Result", debugger_result,  "CPU is Stopped");
    
  
  testCaseComment("Postcondition");
  testStep("STEP", "Return ECU to default values");
  setSignal(BODY3::PresfAct_Adj_ST3::PresfAccelReset_NotExcd_ST3, 0);
  RunPostTs();
}


testcase SW_IT_CIL_PT4_PTCoor_EngStartPN14_01()
{
  //***********************************Test report header*********************************
  testReportAddMiscInfoBlock("AUTOLIV ELECTRONICS document");
  TestReportAddMiscInfo("Nightly test", "No");
  TestReportAddMiscInfo("Test type", "Requirement-Based test");
  TestReportAddMiscInfo("Regression Test", "No");
  TestReportAddMiscInfo("Fault injection method used", "No");
  TestReportAddMiscInfo("Resource usage evaluation", "No");
  TestReportAddMiscInfo("Priority", "No");
  TestReportAddMiscInfo("Safety relevant", "No");
  
  AddRequirementInfo("Requirement under test", "ARCH_SW_CIL_0001, ARCH_SW_CIL_0152");
  AddRequirementInfo("ARCH_SW_CIL_0001", "Signal PT4_PTCoor_EngStartPN14_Stat_ST3 shall be send though application when it’s needed (0,1,2,3,7).");
  AddRequirementInfo("ARCH_SW_CIL_0152", "Signal PT4_PTCoor_EngStartPN14_Stat_ST3 shall be send though application when it’s needed (0,1,2,3,7).");
  //***************************************************************************************
  
  testCaseComment("Preconditions");
  testStep("STEP", "Bench Initialization");
  RunPreTs();

    testStep("STEP", "Set signal PT4_PTCoor_EngStartPN14_Stat_ST3 to value 2.");
    setSignal(BODY3::PT4_PTCoor_EngStartPN14_Stat_ST3, 2);
    testWaitForTimeout(500);
  
    testStep("STEP", "Set a breakpoint in function CIL_ComNotification_PT4_PTCoor4_Pr5_ST3_af4fxb1ykieox3itqdfzs0kpb_2277a854_Rx().");
    debugger_setRelativeFunctionBpAtLine("CIL_ComNotification_PT4_PTCoor4_Pr5_ST3_af4fxb1ykieox3itqdfzs0kpb_2277a854_Rx", 0);
  
    testStep("STEP", "Check if CPU stopped in function CIL_ComNotification_PT4_PTCoor4_Pr5_ST3_af4fxb1ykieox3itqdfzs0kpb_2277a854_Rx();'. --> CPU is Stopped");
debugger_isCPUStoppedAtFunction("CIL_ComNotification_PT4_PTCoor4_Pr5_ST3_af4fxb1ykieox3itqdfzs0kpb_2277a854_Rx");    ////EvalManStepEqual("Expected Test Result", debugger_result,  "CPU is Stopped");
  
    testWaitForTimeout(500);
    
    testCaseComment("Action: ARCH_SW_CIL_0001, ARCH_SW_CIL_0152");
    testStep("STEP", "Read variable cil_stPTCoor4Pr5St3 --> KU8_ZERO.");
    result = debugger_readGlobalVariable("uint8", "cil_stPTCoor4Pr5St3,,app.elf", 0);
    EvalManStepEqual("Expected Test Result", result, 0);
  
  testCaseComment("Postcondition");
  testStep("STEP", "Return ECU to default values");
  RunPostTs();
}


testcase SW_IT_CIL_psrCustomerSpecific_02()
{
  //***********************************Test report header*********************************
  testReportAddMiscInfoBlock("AUTOLIV ELECTRONICS document");
  TestReportAddMiscInfo("Nightly test", "No");
  TestReportAddMiscInfo("Test type", "Requirement-Based test");
  TestReportAddMiscInfo("Regression Test", "No");
  TestReportAddMiscInfo("Fault injection method used", "No");
  TestReportAddMiscInfo("Resource usage evaluation", "No");
  TestReportAddMiscInfo("Priority", "No");
  TestReportAddMiscInfo("Safety relevant", "No");
  
  AddRequirementInfo("Requirement under test", "ARCH_SW_CIL_0358");
  AddRequirementInfo("ARCH_SW_CIL_0358", "Write Rte_Write_psrCustomerSpecific_u8HapticRequest to transmit to application the haptic request.");
  //***************************************************************************************
  
  testCaseComment("Preconditions");
  testStep("STEP", "Bench Initialization");
  RunPreTs();
    
    
    testStep("STEP", "Set signal Presf_Lvl_ST3 to I_C04_PRESF_LVL_V2_LVL2.");
    setSignal(BODY3::Presf_Lvl_ST3, I_C04_PRESF_LVL_V2_LVL2);
    testWaitForTimeout(500);
    
    testStep("STEP", "Set a breakpoint in the function CIL_runCANToAppli at line 'cil_TriggerProfiles(CIL_stManagedCycle.u8CurrentRequestedCycle);'.");
    debugger_setRelativeFunctionBpAtLine("CIL_runCANToAppli", 450);
    
    testStep("STEP", "Check if CPU stopped at line cil_TriggerProfiles(CIL_stManagedCycle.u8CurrentRequestedCycle);. --> CPU is Stopped");
    debugger_WaitUntilBPisReached(1000);
    
    
    debugger_deleteAllBP();
    
    
    testStep("STEP", "Set a breakpoint in function cil_TriggerProfiles at line '(void)Rte_Write_psrCustomerSpecific_u8HapticRequest(KU8_HAPTIC_REQUEST_0);'.");
    debugger_setRelativeFunctionBpAtLine("cil_TriggerProfiles", 151);
    
    debugger_run();
    
    testCaseComment("Action: ARCH_SW_CIL_0358");
    testStep("STEP", "Check if CPU stopped in function cil_TriggerProfiles at line (void)Rte_Write_psrCustomerSpecific_u8HapticRequest(KU8_HAPTIC_REQUEST_0);. --> CPU is Stopped");
    debugger_WaitUntilBPisReached(1000);
    
    
    testCaseComment("Action: ARCH_SW_CIL_0358");
    testStep("STEP", "Read variable Rte_CIL_psrCustomerSpecific_u8HapticRequest --> KU8_HAPTIC_REQUEST_0.");
    result = debugger_readGlobalVariable("uint8", "Rte_CIL_psrCustomerSpecific_u8HapticRequest,,app.elf", 0);
    EvalManStepEqual("Expected Test Result", result, 0);
    
    
  testCaseComment("Postcondition");
  testStep("STEP", "Return ECU to default values");
  setSignal(BODY3::Presf_Lvl_ST3, 0x0);
  RunPostTs();
}


testcase SW_IT_CIL_stVehicleEquipmentData_01()
{
  //***********************************Test report header*********************************
  testReportAddMiscInfoBlock("AUTOLIV ELECTRONICS document");
  TestReportAddMiscInfo("Nightly test", "No");
  TestReportAddMiscInfo("Test type", "Requirement-Based test");
  TestReportAddMiscInfo("Regression Test", "No");
  TestReportAddMiscInfo("Fault injection method used", "No");
  TestReportAddMiscInfo("Resource usage evaluation", "No");
  TestReportAddMiscInfo("Priority", "No");
  TestReportAddMiscInfo("Safety relevant", "No");
  
  AddRequirementInfo("Requirement under test", "ARCH_SW_CIL_0364, ARCH_SW_CIL_0365, ARCH_SW_CIL_0301, ARCH_SW_CIL_0300");
  AddRequirementInfo("ARCH_SW_CIL_0364", "NVP_stVehicleEquipmentData shall be read to get the coding configuration.");
  AddRequirementInfo("ARCH_SW_CIL_0365", "NVP_stVehicleEquipmentData shall be read to get the coding configuration.");
  AddRequirementInfo("ARCH_SW_CIL_0301", "Coding enable or Vehicle Equipment are read from NVP: NVP_stVehicleEquipmentData.");
  //***************************************************************************************
    
  testCaseComment("Preconditions");
  testStep("STEP", "Bench Initialization");
  RunPreTs();

  
    testStep("STEP", "Set a breakpoint in the function CIL_runCANToAppli() at line 'cil_ManageInputSignals();'.");
    debugger_setRelativeFunctionBpAtLine("CIL_runCANToAppli", 5);
    
    testStep("STEP", "Check if CPU stopped in function CIL_runCANToAppli() at line 'cil_ManageInputSignals();'.");
    debugger_isCPUStoppedAtFunction("CIL_runCANToAppli");
    
  
    testStep("STEP", "Step in function cil_ManageInputSignals().");
    debugger_stepIn();
    
    
    debugger_deleteAllBP();
    
    
    testStep("STEP", "Set a breakpoint in the function cil_ManageInputSignals() at line 'cil_ManageInhibitConditions();'.");
    debugger_setRelativeFunctionBpAtLine("cil_ManageInputSignals", 250);
    
    debugger_run();
  
    testStep("STEP", "Check if CPU stopped in function cil_ManageInputSignals() at line 'cil_ManageInhibitConditions();'.");
    debugger_isCPUStoppedAtFunction("cil_ManageInputSignals");
  
    
    testStep("STEP", "Set a breakpoint in the function cil_ManageInhibitConditions at line 'KU8_ZERO != NVP_stVehicleEquipmentData.PreSafeFuncActivation'.");
    debugger_setRelativeFunctionBpAtLine("cil_ManageInhibitConditions", 210);

    debugger_run();
    
    testCaseComment("Action: ARCH_SW_CIL_0364, ARCH_SW_CIL_0365");
    testStep("STEP", "Read variable (NVP_stVehicleEquipmentData).PreSafeCycleActivation --> 0x0.");
    result = debugger_readGlobalVariable("uint8", "NVP_stVehicleEquipmentData,,app.elf", 8);
    EvalManStepEqual("Expected Test Result", result, 0x0);
    
    testCaseComment("Action: ARCH_SW_CIL_0364, ARCH_SW_CIL_0301");
    testStep("STEP", "Read variable (NVP_stVehicleEquipmentData).ORCPreSafe8Activation --> 0x0.");
    result = debugger_readGlobalVariable("uint8", "NVP_stVehicleEquipmentData,,app.elf", 9);
    EvalManStepEqual("Expected Test Result", result, 0x0);
    
    testCaseComment("Action: ARCH_SW_CIL_0364, ARCH_SW_CIL_0300");
    testStep("STEP", "Read variable (NVP_stVehicleEquipmentData).BSRActivation --> 0x0.");
    result = debugger_readGlobalVariable("uint8", "NVP_stVehicleEquipmentData,,app.elf", 1);
    EvalManStepEqual("Expected Test Result", result, 0x0);
    
    testCaseComment("Action: ARCH_SW_CIL_0364");
    testStep("STEP", "Read variable (NVP_stVehicleEquipmentData).BltHandOverAvailabiliy --> 0x0.");
    result = debugger_readGlobalVariable("uint8", "NVP_stVehicleEquipmentData,,app.elf", 2);
    EvalManStepEqual("Expected Test Result", result, 0x0);
    
    testCaseComment("Action: ARCH_SW_CIL_0364");
    testStep("STEP", "Read variable (NVP_stVehicleEquipmentData).APIActivation --> 0x0.");
    result = debugger_readGlobalVariable("uint8", "NVP_stVehicleEquipmentData,,app.elf", 6);
    EvalManStepEqual("Expected Test Result", result, 0x0);
  

  testCaseComment("Postcondition");
  testStep("STEP", "Return ECU to default values");
  RunPostTs(); 
}


testcase SW_IT_CIL_psrPreSafeLv_01()
{
  //***********************************Test report header*********************************
  testReportAddMiscInfoBlock("AUTOLIV ELECTRONICS document");
  TestReportAddMiscInfo("Nightly test", "No");
  TestReportAddMiscInfo("Test type", "Requirement-Based test");
  TestReportAddMiscInfo("Regression Test", "No");
  TestReportAddMiscInfo("Fault injection method used", "No");
  TestReportAddMiscInfo("Resource usage evaluation", "No");
  TestReportAddMiscInfo("Priority", "No");
  TestReportAddMiscInfo("Safety relevant", "No");
  
  AddRequirementInfo("Requirement under test", "ARCH_SW_CIL_0302");
  AddRequirementInfo("ARCH_SW_CIL_0302", "Rte_Write_psrPreSafeLvl_u8PreSafeLvl Will be wriiten by CIL in order to inform about the Presafe LEVEL Request (signal Presf_Lvl).");
  //***************************************************************************************
    
  testCaseComment("Preconditions");
  testStep("STEP", "Bench Initialization");
  RunPreTs();


    testCaseComment("Action: ARCH_SW_CIL_0302");
    testStep("STEP", "Read variable cil_stPresfActAdjFrame.Presf_Lvl_ST3 --> KU8_ZERO.");
    result = debugger_readGlobalVariable("uint8", "cil_stPresfActAdjFrame,,app.elf", 2);
    EvalManStepEqual("Expected Test Result", result, 0);
    
    testStep("STEP", "Set signal Presf_Lvl_ST3 to I_C04_PRESF_LVL_V2_LVL1 (0x2).");
    setSignal(BODY3::Presf_Lvl_ST3, I_C04_PRESF_LVL_V2_LVL2);
    testWaitForTimeout(500);
  
  
    testStep("STEP", "Set a breakpoint in the function CIL_runCANToAppli() at line 'cil_ManageInputSignals();'.");
    debugger_setRelativeFunctionBpAtLine("CIL_runCANToAppli", 5);
    
    testStep("STEP", "Check if CPU stopped in function CIL_runCANToAppli() at line 'cil_ManageInputSignals();'.");
    debugger_isCPUStoppedAtFunction("CIL_runCANToAppli");
  
  
    testStep("STEP", "Step in function cil_ManageInputSignals.");
    debugger_stepIn();
    
  
    debugger_deleteAllBP();
  
  
    testStep("STEP", "Set a breakpoint in function cil_ManageInputSignals() at line 'Rte_Write_psrPreSafeLvl_u8PreSafeLvl(cil_stPresfActAdjFrame.Presf_Lvl_ST3);'.");
    debugger_setRelativeFunctionBpAtLine("cil_ManageInputSignals", 267);
    
    debugger_run();
  
    testStep("STEP", "Check if CPU stopped in function cil_ManageInputSignals() at line 'Rte_Write_psrPreSafeLvl_u8PreSafeLvl(cil_stPresfActAdjFrame.Presf_Lvl_ST3);'. --> CPU is Stopped");
    debugger_isCPUStoppedAtFunction("cil_ManageInputSignals");
  
    
    testCaseComment("Action: ARCH_SW_CIL_0302");
    testStep("STEP", "Read variable cil_stPresfActAdjFrame.Presf_Lvl_ST3 --> I_C04_PRESF_LVL_V2_LVL2.");
    result = debugger_readGlobalVariable("uint8", "cil_stPresfActAdjFrame,,app.elf", 5);
    EvalManStepEqual("Expected Test Result", result, 2);
  

  testCaseComment("Postcondition");
  testStep("STEP", "Return ECU to default values");
  setSignal(BODY3::Presf_Lvl_ST3, I_C04_PRESF_LVL_V2_NOLVL);
  RunPostTs();
}



testcase SW_IT_CIL_psrExecutedCycle_01()
{
  //***********************************Test report header*********************************
  testReportAddMiscInfoBlock("AUTOLIV ELECTRONICS document");
  TestReportAddMiscInfo("Nightly test", "No");
  TestReportAddMiscInfo("Test type", "Requirement-Based test");
  TestReportAddMiscInfo("Regression Test", "No");
  TestReportAddMiscInfo("Fault injection method used", "No");
  TestReportAddMiscInfo("Resource usage evaluation", "No");
  TestReportAddMiscInfo("Priority", "No");
  TestReportAddMiscInfo("Safety relevant", "No");
  
  AddRequirementInfo("Requirement under test", "ARCH_SW_CIL_0303, ARCH_SW_CIL_0559");
  AddRequirementInfo("ARCH_SW_CIL_0303", "Read Rte_BFE_psrExecutedCycle_u8CycleNumber shall be read to get executed cycle number.");
  AddRequirementInfo("ARCH_SW_CIL_0559", "Read Rte_BFE_psrExecutedCycle_u8CycleNumber shall be read to get executed cycle number.");
  //***************************************************************************************
    
  testCaseComment("Preconditions");
  testStep("STEP", "Bench Initialization");
  RunPreTs();

    testStep("STEP", "Set signal RBTMFL_SP_Lvl_Rq_ST35 to I_C06_RBTM_LVL_RQ_PROFILE20.");
    setSignal(BODY3::RBTMFL_SP_Lvl_Rq_ST35, 20);

    testStep("STEP", "Set a breakpoint in the function CIL_runCANToAppli() at line 'cil_ManageInputSignals();'.");
    debugger_setRelativeFunctionBpAtLine("CIL_runCANToAppli", 5);
    
    testStep("STEP", "Check if CPU stopped in function CIL_runCANToAppli() at line 'cil_ManageInputSignals();'.");
    debugger_isCPUStoppedAtFunction("CIL_runCANToAppli");
    
    testStep("STEP", "Step in function cil_ManageInputSignals.");
    debugger_stepIn();
    
  
    debugger_deleteAllBP();
  
  
    testStep("STEP", "Set a breakpoint in the function cil_ManageInhibitConditions() at line '(void)Rte_Read_prrCycleNumber_u8CycleNumber(&u8ExecutedCycle);'.");
    debugger_setRelativeFunctionBpAtLine("cil_ManageInhibitConditions", 153);
    
    debugger_run();
  
    testCaseComment("Action: ARCH_SW_CIL_0303, ARCH_SW_CIL_0559");
    testStep("STEP", "Check if CPU stopped in function CIL_runCANToAppli() at line '(void)Rte_Read_prrCycleNumber_u8CycleNumber(&u8ExecutedCycle);'.");
    debugger_isCPUStoppedAtFunction("CIL_runCANToAppli");


  testCaseComment("Postcondition");
  testStep("STEP", "Return ECU to default values");
  setSignal(BODY3::RBTMFL_SP_Lvl_Rq_ST35, 0);
  RunPostTs();
}


testcase SW_IT_CIL_runAppliToCAN_01()
{
  //***********************************Test report header*********************************
  testReportAddMiscInfoBlock("AUTOLIV ELECTRONICS document");
  TestReportAddMiscInfo("Nightly test", "No");
  TestReportAddMiscInfo("Test type", "Requirement-Based test");
  TestReportAddMiscInfo("Regression Test", "No");
  TestReportAddMiscInfo("Fault injection method used", "No");
  TestReportAddMiscInfo("Resource usage evaluation", "No");
  TestReportAddMiscInfo("Priority", "No");
  TestReportAddMiscInfo("Safety relevant", "No");
  
  AddRequirementInfo("Requirement under test", "ARCH_SW_CIL_0011, ARCH_SW_CIL_0016");
  AddRequirementInfo("ARCH_SW_CIL_0011", "Signal PS_Curve_FL/FR_Stat_ST3 shall be written and send to CAN.");
  AddRequirementInfo("ARCH_SW_CIL_0016", "Signal shall be send with the exact same value read as Input for Curve Signal.");
  //***************************************************************************************
    
  testCaseComment("Preconditions");
  testStep("STEP", "Bench Initialization");
  RunPreTs();


    testStep("STEP", "Set signal PS_Curve_FL_Rq_HU_ST3 to KU8_TWO.");
    setSignal(BODY3::BeltAdj_UI_Set_Rq_ST3::PS_Curve_FL_Rq_HU_ST3, 0x2);
    testWaitForTimeout(500);
    
    testStep("STEP", "Set a breakpoint in function cil_ManageOutputSignals() at line '(void)Rte_Write_CIL_AC_CommunicationInteractionLayer_IF_PS_Curve_FL_Stat_ST3_PS_Curve_FL_Stat_ST3(CIL_u8PSCurve);'.");
    debugger_setBpAtLine("s:\\Components\\Application\\Autoliv\\CIL\\Implementation\\src\\CIL_AppliToCAN.c", 647);
  
    testStep("STEP", "Check if CPU stopped at line '(void)Rte_Write_CIL_AC_CommunicationInteractionLayer_IF_PS_Curve_FL_Stat_ST3_PS_Curve_FL_Stat_ST3(CIL_u8PSCurve);'.");
    debugger_isCPUStoppedAtFunction("cil_ManageOutputSignals");
  
  
    testCaseComment("Action: ARCH_SW_CIL_0011");
    testStep("STEP", "Check if variable CIL_u8PSCurve is I_CO2_OFF_STAGE1_STAGE2_STAGE2. --> 2");
    result = debugger_readGlobalVariable("uint8", "CIL_u8PSCurve,,app.elf", 0);
    EvalManStepEqual("Expected Test Result", result, 2);
    
    testCaseComment("Action: ARCH_SW_CIL_0011, ARCH_SW_CIL_0016");
    testStep("STEP", "Check if signal PS_Curve_FL_Stat_ST3 value is I_CO2_OFF_STAGE1_STAGE2_STAGE2. --> 2");
    EvalManStepEqual("Expected Test Result", $PS_Curve_FL_Stat_ST3.raw64, 2);
    

  testCaseComment("Postcondition");
  testStep("STEP", "Return ECU to default values");
  setSignal(BODY3::BeltAdj_UI_Set_Rq_ST3::PS_Curve_FL_Rq_HU_ST3, 0x3);
  RunPostTs();
}


testcase SW_IT_CIL_runAppliToCAN_02()
{
  //***********************************Test report header*********************************
  testReportAddMiscInfoBlock("AUTOLIV ELECTRONICS document");
  TestReportAddMiscInfo("Nightly test", "No");
  TestReportAddMiscInfo("Test type", "Requirement-Based test");
  TestReportAddMiscInfo("Regression Test", "No");
  TestReportAddMiscInfo("Fault injection method used", "No");
  TestReportAddMiscInfo("Resource usage evaluation", "No");
  TestReportAddMiscInfo("Priority", "No");
  TestReportAddMiscInfo("Safety relevant", "No");
  
  AddRequirementInfo("Requirement under test", "ARCH_SW_CIL_0069");
  AddRequirementInfo("ARCH_SW_CIL_0069", "If HAPTIC1(cycle 18 or cycle 19)  (and his next cycle ) is executed then RBTM _FL/FR Actv_Lvl_ST35 should be 0x02 = “HAPTIC1” no matter the source of the request: API interface, PRE-SAFE interface.");
  //***************************************************************************************
    
  testCaseComment("Preconditions");
  testStep("STEP", "Bench Initialization");
  RunPreTs();

    
    testStep("STEP", "Set signal Presf_Lvl_ST3 to I_C04_PRESF_LVL_V2_LVL2.");
    setSignal(BODY3::Presf_Lvl_ST3, 2);
    testWaitForTimeout(500);
    
    testStep("STEP", "Set a breakpoint in function CIL_runAppliToCAN().");
    debugger_setRelativeFunctionBpAtLine("CIL_runAppliToCAN", 0);
  
    testStep("STEP", "Check if CPU stopped in function CIL_runAppliToCAN(). --> CPU is Stopped");
    debugger_isCPUStoppedAtFunction("CIL_runAppliToCAN");
  
    testStep("STEP", "Check if variable Rte_MMG_psrEnableCycle18_b8CycleValidity is KU8_TRUE. --> KU8_TRUE (170)");
    result = debugger_readGlobalVariable("uint8", "Rte_MMG_psrEnableCycle18_b8CycleValidity,,app.elf", 0);
    EvalManStepEqual("Expected Test Result", result, 170);
    
    debugger_deleteAllBP();
    debugger_run();

    testCaseComment("Action: ARCH_SW_CIL_0069");
    testStep("STEP", "Check if signal RBTMFL_Actv_Lvl_ST35 value is I_C06_RBTM_LVL_STAT_PROFILE2. --> I_C06_RBTM_LVL_STAT_PROFILE2");
    EvalManStepEqual("Expected Test Result", $RBTMFL_Actv_Lvl_ST35.raw64, 2);
  

  testCaseComment("Postcondition");
  testStep("STEP", "Return ECU to default values");
  setSignal(BODY3::Presf_Lvl_ST3, 0);
  RunPostTs(); 
}


testcase SW_IT_CIL_runAppliToCAN_03()
{
  //***********************************Test report header*********************************
  testReportAddMiscInfoBlock("AUTOLIV ELECTRONICS document");
  TestReportAddMiscInfo("Nightly test", "No");
  TestReportAddMiscInfo("Test type", "Requirement-Based test");
  TestReportAddMiscInfo("Regression Test", "No");
  TestReportAddMiscInfo("Fault injection method used", "No");
  TestReportAddMiscInfo("Resource usage evaluation", "No");
  TestReportAddMiscInfo("Priority", "No");
  TestReportAddMiscInfo("Safety relevant", "No");
  
  AddRequirementInfo("Requirement under test", "ARCH_SW_CIL_0070");
  AddRequirementInfo("ARCH_SW_CIL_0070", "If PRE-SAFE1 is executed (cycle 0) (and his next cycle ) then RBTM _FL/FR Actv_Lvl_ST35 should be equal to 0x01=“PRE-SAFE 1” no matter the source of the request: API interface, PRE SAFE interface, Diagnostic request.");
  //***************************************************************************************
    
  testCaseComment("Preconditions");
  testStep("STEP", "Bench Initialization");
  RunPreTs();

   
    testStep("STEP", "Set signal Presf_Lvl_ST3 to I_C04_PRESF_LVL_V2_LVL1.");
    setSignal(BODY3::Presf_Lvl_ST3, 1);
    testWaitForTimeout(500);
    
    testStep("STEP", "Set a breakpoint in function CIL_runAppliToCAN().");
    debugger_setRelativeFunctionBpAtLine("CIL_runAppliToCAN", 0);
  
    testStep("STEP", "Check if CPU stopped in function CIL_runAppliToCAN(). --> CPU is Stopped");
debugger_isCPUStoppedAtFunction("CIL_runAppliToCAN");    ////EvalManStepEqual("Expected Test Result", debugger_result, "CPU is Stopped");
  
    
    debugger_deleteAllBP();
  
  
    testStep("STEP", "Set a breakpoint in function cil_ManageActiveLevelSignal() after line 'CIL_u8Actv_Lvl = I_C06_RBTM_LVL_STAT_PROFILE1;'.");
    debugger_setBpAtLine("s:\\Components\\Application\\Autoliv\\CIL\\Implementation\\src\\CIL_AppliToCAN.c", 491);
  
    debugger_run();
  
    testStep("STEP", "Check if CPU stopped in function cil_ManageActiveLevelSignal() after line 'CIL_u8Actv_Lvl = I_C06_RBTM_LVL_STAT_PROFILE1;'. --> CPU is Stopped");
debugger_isCPUStoppedAtFunction("cil_ManageActiveLevelSignal");    ////EvalManStepEqual("Expected Test Result", debugger_result, "CPU is Stopped");
  
  
    testCaseComment("Action: ARCH_SW_CIL_0070");
    testStep("STEP", "Check if variable CIL_u8Actv_Lvl is I_C06_RBTM_LVL_STAT_PROFILE1. --> 1");
    result = debugger_readGlobalVariable("uint8", "CIL_u8Actv_Lvl,,app.elf", 0);
    EvalManStepEqual("Expected Test Result", result, 1);

    testCaseComment("Action: ARCH_SW_CIL_0070");
    testStep("STEP", "Check if signal RBTMFL_Actv_Lvl_ST35 value is I_C06_RBTM_LVL_STAT_PROFILE1. --> 1");
    EvalManStepEqual("Expected Test Result", $RBTMFL_Actv_Lvl_ST35.raw64, 1);
  

  testCaseComment("Postcondition");
  testStep("STEP", "Return ECU to default values");
  setSignal(BODY3::Presf_Lvl_ST3, 0);
  RunPostTs();
}


testcase SW_IT_CIL_runAppliToCAN_04()
{
  //***********************************Test report header*********************************
  testReportAddMiscInfoBlock("AUTOLIV ELECTRONICS document");
  TestReportAddMiscInfo("Nightly test", "No");
  TestReportAddMiscInfo("Test type", "Requirement-Based test");
  TestReportAddMiscInfo("Regression Test", "No");
  TestReportAddMiscInfo("Fault injection method used", "No");
  TestReportAddMiscInfo("Resource usage evaluation", "No");
  TestReportAddMiscInfo("Priority", "No");
  TestReportAddMiscInfo("Safety relevant", "No");
  
  AddRequirementInfo("Requirement under test", "ARCH_SW_CIL_0083");
  AddRequirementInfo("ARCH_SW_CIL_0083", "If PRE-SAFE3 is executed (cycle 1) (and his next cycle ) then RBTM _FL/FR Actv_Lvl_ST35 should be equal to 0x03 = “PRE-SAFE 3” no matter the source of the request: API interface, PRE SAFE interface, Diagnostic request.");
  //***************************************************************************************
    
  testCaseComment("Preconditions");
  testStep("STEP", "Bench Initialization");
  RunPreTs();

  
    testStep("STEP", "Set signal Presf_Lvl_ST3 to I_C04_PRESF_LVL_V2_LVL3.");
    setSignal(BODY3::Presf_Lvl_ST3, 3);
    testWaitForTimeout(500);

  
    testStep("STEP", "Set a breakpoint in function CIL_runAppliToCAN().");
    debugger_setRelativeFunctionBpAtLine("CIL_runAppliToCAN", 0);
  
    testStep("STEP", "Check if CPU stopped in function CIL_runAppliToCAN(). --> CPU is Stopped");
debugger_isCPUStoppedAtFunction("CIL_runAppliToCAN");    ////EvalManStepEqual("Expected Test Result", debugger_result, "CPU is Stopped");
  
    
    debugger_deleteAllBP();
  
  
    testStep("STEP", "Set a breakpoint in function cil_ManageActiveLevelSignal() after line 'CIL_u8Actv_Lvl = I_C06_RBTM_LVL_STAT_PROFILE3;'.");
    debugger_setBpAtLine("s:\\Components\\Application\\Autoliv\\CIL\\Implementation\\src\\CIL_AppliToCAN.c", 500);
  
    debugger_run();
  
    testStep("STEP", "Check if CPU stopped in function cil_ManageActiveLevelSignal() after line 'CIL_u8Actv_Lvl = I_C06_RBTM_LVL_STAT_PROFILE3;'. --> CPU is Stopped");
debugger_isCPUStoppedAtFunction("cil_ManageActiveLevelSignal");    ////EvalManStepEqual("Expected Test Result", debugger_result, "CPU is Stopped");
  
  
    testCaseComment("Action: ARCH_SW_CIL_0083");
    testStep("STEP", "Check if variable CIL_u8Actv_Lvl is I_C06_RBTM_LVL_STAT_PROFILE3. --> I_C06_RBTM_LVL_STAT_PROFILE3");
    result = debugger_readGlobalVariable("uint8", "CIL_u8Actv_Lvl,,app.elf", 0);
    EvalManStepEqual("Expected Test Result", result, 3);

    testCaseComment("Action: ARCH_SW_CIL_0083");
    testStep("STEP", "Check if signal RBTMFL_Actv_Lvl_ST35 value is I_C06_RBTM_LVL_STAT_PROFILE3. --> I_C06_RBTM_LVL_STAT_PROFILE3");
    EvalManStepEqual("Expected Test Result", $RBTMFL_Actv_Lvl_ST35.raw64, 3);
  
  
  testCaseComment("Postcondition");
  testStep("STEP", "Return ECU to default values");
  setSignal(BODY3::Presf_Lvl_ST3, 0);
  RunPostTs();
}


testcase SW_IT_CIL_runAppliToCAN_05()
{
  //***********************************Test report header*********************************
  testReportAddMiscInfoBlock("AUTOLIV ELECTRONICS document");
  TestReportAddMiscInfo("Nightly test", "No");
  TestReportAddMiscInfo("Test type", "Requirement-Based test");
  TestReportAddMiscInfo("Regression Test", "No");
  TestReportAddMiscInfo("Fault injection method used", "No");
  TestReportAddMiscInfo("Resource usage evaluation", "No");
  TestReportAddMiscInfo("Priority", "No");
  TestReportAddMiscInfo("Safety relevant", "No");
  
  AddRequirementInfo("Requirement under test", "ARCH_SW_CIL_0084");
  AddRequirementInfo("ARCH_SW_CIL_0084", "If PRE-SAFE4 is executed (cycle 2) (and his next cycle ) then RBTM _FL/FR Actv_Lvl_ST35 should be equal to 0x04 = “PRE-SAFE 4” no matter the source of the request: API interface, PRE SAFE interface, Diagnostic request.");
  //***************************************************************************************
    
  testCaseComment("Preconditions");
  testStep("STEP", "Bench Initialization");
  RunPreTs();


    testStep("STEP", "Set signal Presf_Lvl_ST3 to I_C04_PRESF_LVL_V2_LVL4.");
    setSignal(BODY3::Presf_Lvl_ST3, 4);
    testWaitForTimeout(500);

  
    testStep("STEP", "Set a breakpoint in function CIL_runAppliToCAN().");
    debugger_setRelativeFunctionBpAtLine("CIL_runAppliToCAN", 0);
  
    testStep("STEP", "Check if CPU stopped in function CIL_runAppliToCAN(). --> CPU is Stopped");
debugger_isCPUStoppedAtFunction("CIL_runAppliToCAN");    ////EvalManStepEqual("Expected Test Result", debugger_result, "CPU is Stopped");
  
    
    debugger_deleteAllBP();
  
  
    testStep("STEP", "Set a breakpoint in function cil_ManageActiveLevelSignal() after line 'CIL_u8Actv_Lvl = I_C06_RBTM_LVL_STAT_PROFILE4;'.");
    debugger_setBpAtLine("s:\\Components\\Application\\Autoliv\\CIL\\Implementation\\src\\CIL_AppliToCAN.c", 535);
  
    debugger_run();
  
    testStep("STEP", "Check if CPU stopped in function cil_ManageActiveLevelSignal() after line 'CIL_u8Actv_Lvl = I_C06_RBTM_LVL_STAT_PROFILE4;'. --> CPU is Stopped");
debugger_isCPUStoppedAtFunction("cil_ManageActiveLevelSignal");    ////EvalManStepEqual("Expected Test Result", debugger_result, "CPU is Stopped");
  
  
    testCaseComment("Action: ARCH_SW_CIL_0084");
    testStep("STEP", "Check if variable CIL_u8Actv_Lvl is I_C06_RBTM_LVL_STAT_PROFILE4. --> CIL_u8Actv_Lvl is equal to I_C06_RBTM_LVL_STAT_PROFILE4");
    result = debugger_readGlobalVariable("uint8", "CIL_u8Actv_Lvl,,app.elf", 0);
    EvalManStepEqual("Expected Test Result", result, 4);

    testCaseComment("Action: ARCH_SW_CIL_0084");
    testStep("STEP", "Check if signal RBTMFL_Actv_Lvl_ST35 value is I_C06_RBTM_LVL_STAT_PROFILE4. --> CIL_u8Actv_Lvl is equal to I_C06_RBTM_LVL_STAT_PROFILE4");
    EvalManStepEqual("Expected Test Result", $RBTMFL_Actv_Lvl_ST35.raw64, 4);
  
  
  testCaseComment("Postcondition");
  testStep("STEP", "Return ECU to default values");
  setSignal(BODY3::Presf_Lvl_ST3, 0);
  RunPostTs();
}


testcase SW_IT_CIL_runAppliToCAN_06()
{
  //***********************************Test report header*********************************
  testReportAddMiscInfoBlock("AUTOLIV ELECTRONICS document");
  TestReportAddMiscInfo("Nightly test", "No");
  TestReportAddMiscInfo("Test type", "Requirement-Based test");
  TestReportAddMiscInfo("Regression Test", "No");
  TestReportAddMiscInfo("Fault injection method used", "No");
  TestReportAddMiscInfo("Resource usage evaluation", "No");
  TestReportAddMiscInfo("Priority", "No");
  TestReportAddMiscInfo("Safety relevant", "No");
  
  AddRequirementInfo("Requirement under test", "ARCH_SW_CIL_0085");
  AddRequirementInfo("ARCH_SW_CIL_0085", "If PRE-SAFE5 is executed (cycle 3) (and his next cycle ) then RBTM _FL/FR Actv_Lvl_ST35 should be equal to 0x05=“PRE-SAFE 5” no matter the source of the request: API interface, PRE SAFE interface, Diagnostic request.");
  //***************************************************************************************
    
  testCaseComment("Preconditions");
  testStep("STEP", "Bench Initialization");
  RunPreTs();


    testStep("STEP", "Set signal Presf_Lvl_ST3 to I_C04_PRESF_LVL_V2_LVL5.");
    setSignal(BODY3::Presf_Lvl_ST3, 5);
    testWaitForTimeout(500);
  
  
    testStep("STEP", "Set a breakpoint in function CIL_runAppliToCAN().");
    debugger_setRelativeFunctionBpAtLine("CIL_runAppliToCAN", 0);
  
    testStep("STEP", "Check if CPU stopped in function CIL_runAppliToCAN(). --> CPU is Stopped");
debugger_isCPUStoppedAtFunction("CIL_runAppliToCAN");    ////EvalManStepEqual("Expected Test Result", debugger_result, "CPU is Stopped");
  
  
    debugger_deleteAllBP();
  
  
    testStep("STEP", "Set a breakpoint in function cil_ManageActiveLevelSignal() after line 'CIL_u8Actv_Lvl = I_C06_RBTM_LVL_STAT_PROFILE5;'.");
    debugger_setBpAtLine("s:\\Components\\Application\\Autoliv\\CIL\\Implementation\\src\\CIL_AppliToCAN.c", 508);
  
    debugger_run();
    testWaitForTimeout(500);
  
    testCaseComment("Action: ARCH_SW_CIL_0085");
    testStep("STEP", "Check if CPU stopped in function cil_ManageActiveLevelSignal() after line 'CIL_u8Actv_Lvl = I_C06_RBTM_LVL_STAT_PROFILE5;'. --> CPU is Stopped");
debugger_isCPUStoppedAtFunction("cil_ManageActiveLevelSignal");    ////EvalManStepEqual("Expected Test Result", debugger_result, "CPU is Stopped");

  
  testCaseComment("Postcondition");
  testStep("STEP", "Return ECU to default values");
  setSignal(BODY3::Presf_Lvl_ST3, 0);
  RunPostTs();
}


testcase SW_IT_CIL_runAppliToCAN_07()
{
  //***********************************Test report header*********************************
  testReportAddMiscInfoBlock("AUTOLIV ELECTRONICS document");
  TestReportAddMiscInfo("Nightly test", "No");
  TestReportAddMiscInfo("Test type", "Requirement-Based test");
  TestReportAddMiscInfo("Regression Test", "No");
  TestReportAddMiscInfo("Fault injection method used", "No");
  TestReportAddMiscInfo("Resource usage evaluation", "No");
  TestReportAddMiscInfo("Priority", "No");
  TestReportAddMiscInfo("Safety relevant", "No");
  
  AddRequirementInfo("Requirement under test", "ARCH_SW_CIL_0164");
  AddRequirementInfo("ARCH_SW_CIL_0164", "If PRE-SAFE6 is executed (cycle 4) (and his next cycle ) then RBTM _FL/FR Actv_Lvl_ST35 should be equal to 0x06=“PRE-SAFE 6” no matter the source of the request: API interface, PRE SAFE interface, Diagnostic request.");
  //***************************************************************************************
    
  testCaseComment("Preconditions");
  testStep("STEP", "Bench Initialization");
  RunPreTs();


    testStep("STEP", "Set signal Presf_Lvl_ST3 to I_C04_PRESF_LVL_V2_LVL6.");
    setSignal(BODY3::Presf_Lvl_ST3, 6);
    testWaitForTimeout(500);

  
    testStep("STEP", "Set a breakpoint in function CIL_runAppliToCAN().");
    debugger_setRelativeFunctionBpAtLine("CIL_runAppliToCAN", 0);
  
    testStep("STEP", "Check if CPU stopped in function CIL_runAppliToCAN(). --> CPU is Stopped");
debugger_isCPUStoppedAtFunction("CIL_runAppliToCAN");    ////EvalManStepEqual("Expected Test Result", debugger_result, "CPU is Stopped");
  
    testStep("STEP", "Set variable cil_stPresfActAdjFrame.Presf_Lvl_ST3 to I_C04_PRESF_LVL_V2_LVL6.");
    debugger_writeGlobalVariable("uint8", "cil_stPresfActAdjFrame,,app.elf", 2, 6);  
    
    debugger_deleteAllBP();
  
  
    testStep("STEP", "Set a breakpoint in function cil_ManageActiveLevelSignal() at line 'CIL_u8Actv_Lvl = I_C06_RBTM_LVL_STAT_PROFILE6;'.");
    debugger_setBpAtLine("s:\\Components\\Application\\Autoliv\\CIL\\Implementation\\src\\CIL_AppliToCAN.c", 512);
  
    debugger_run();
    testWaitForTimeout(500);
  
    testCaseComment("Action: ARCH_SW_CIL_0164");
    testStep("STEP", "Check if CPU stopped in function cil_ManageActiveLevelSignal() at line 'CIL_u8Actv_Lvl = I_C06_RBTM_LVL_STAT_PROFILE6;'. --> CPU is Stopped");
debugger_isCPUStoppedAtFunction("cil_ManageActiveLevelSignal");    ////EvalManStepEqual("Expected Test Result", debugger_result, "CPU is Stopped");
  
  
  testCaseComment("Postcondition");
  testStep("STEP", "Return ECU to default values");
  setSignal(BODY3::Presf_Lvl_ST3, 0);
  RunPostTs();
}


testcase SW_IT_CIL_runAppliToCAN_08()
{
  //***********************************Test report header*********************************
  testReportAddMiscInfoBlock("AUTOLIV ELECTRONICS document");
  TestReportAddMiscInfo("Nightly test", "No");
  TestReportAddMiscInfo("Test type", "Requirement-Based test");
  TestReportAddMiscInfo("Regression Test", "No");
  TestReportAddMiscInfo("Fault injection method used", "No");
  TestReportAddMiscInfo("Resource usage evaluation", "No");
  TestReportAddMiscInfo("Priority", "No");
  TestReportAddMiscInfo("Safety relevant", "No");
  
  AddRequirementInfo("Requirement under test", "ARCH_SW_CIL_0165");
  AddRequirementInfo("ARCH_SW_CIL_0165", "If PRE-SAFE7 is executed (cycle 5) (and his next cycle ) then RBTM _FL/FR Actv_Lvl_ST35 should be equal to 0x07=“PRE-SAFE 7” no matter the source of the request: API interface, PRE SAFE interface, Diagnostic request.");
  //***************************************************************************************
    
  testCaseComment("Preconditions");
  testStep("STEP", "Bench Initialization");
  RunPreTs();


    testStep("STEP", "Set signal Presf_Lvl_ST3 to I_C04_PRESF_LVL_V2_LVL7.");
    setSignal(BODY3::Presf_Lvl_ST3, 7);
    testWaitForTimeout(500);

  
    testStep("STEP", "Set a breakpoint in function CIL_runAppliToCAN().");
    debugger_setRelativeFunctionBpAtLine("CIL_runAppliToCAN", 0);
  
    testStep("STEP", "Check if CPU stopped in function CIL_runAppliToCAN(). --> CPU is Stopped");
debugger_isCPUStoppedAtFunction("CIL_runAppliToCAN");    ////EvalManStepEqual("Expected Test Result", debugger_result, "CPU is Stopped");
  
    testStep("STEP", "Set variable cil_stPresfActAdjFrame.Presf_Lvl_ST3 to I_C04_PRESF_LVL_V2_LVL7.");
    debugger_writeGlobalVariable("uint8", "cil_stPresfActAdjFrame,,app.elf", 2, 7); 
    
    debugger_deleteAllBP();
  
  
    testStep("STEP", "Set a breakpoint in function cil_ManageActiveLevelSignal() after line 'CIL_u8Actv_Lvl = I_C06_RBTM_LVL_STAT_PROFILE7;'.");
    debugger_setBpAtLine("s:\\Components\\Application\\Autoliv\\CIL\\Implementation\\src\\CIL_AppliToCAN.c", 516);
  
    debugger_run();
    testWaitForTimeout(500);
    
    testCaseComment("Action: ARCH_SW_CIL_0165");
    testStep("STEP", "Check if CPU stopped in function cil_ManageActiveLevelSignal() after line 'CIL_u8Actv_Lvl = I_C06_RBTM_LVL_STAT_PROFILE7;'. --> CPU is Stopped");
debugger_isCPUStoppedAtFunction("cil_ManageActiveLevelSignal");    ////EvalManStepEqual("Expected Test Result", debugger_result, "CPU is Stopped");
  
  
  testCaseComment("Postcondition");
  testStep("STEP", "Return ECU to default values");
  setSignal(BODY3::Presf_Lvl_ST3, 0);
  RunPostTs();
}


testcase SW_IT_CIL_runAppliToCAN_09()
{
  //***********************************Test report header*********************************
  testReportAddMiscInfoBlock("AUTOLIV ELECTRONICS document");
  TestReportAddMiscInfo("Nightly test", "No");
  TestReportAddMiscInfo("Test type", "Requirement-Based test");
  TestReportAddMiscInfo("Regression Test", "No");
  TestReportAddMiscInfo("Fault injection method used", "No");
  TestReportAddMiscInfo("Resource usage evaluation", "No");
  TestReportAddMiscInfo("Priority", "No");
  TestReportAddMiscInfo("Safety relevant", "No");
  
  AddRequirementInfo("Requirement under test", "ARCH_SW_CIL_0166");
  AddRequirementInfo("ARCH_SW_CIL_0166", "If PRE-SAFE8 is executed (cycle 6) (and his next cycle ) then RBTM _FL/FR Actv_Lvl_ST35 should be equal to 0x08=“PRE-SAFE 8” no matter the source of the request: API interface, PRE SAFE interface, Diagnostic request , ORC req.");
  //***************************************************************************************
    
  testCaseComment("Preconditions");
  testStep("STEP", "Bench Initialization");
  RunPreTs();

  
    testStep("STEP", "Set a breakpoint in function CIL_runAppliToCAN().");
    debugger_setRelativeFunctionBpAtLine("CIL_runAppliToCAN", 0);
  
    testStep("STEP", "Check if CPU stopped in function CIL_runAppliToCAN(). --> CPU is Stopped");
debugger_isCPUStoppedAtFunction("CIL_runAppliToCAN");    ////EvalManStepEqual("Expected Test Result", debugger_result, "CPU is Stopped");

  
    testStep("STEP", "Set a breakpoint in function cil_ManageActiveLevelSignal() after line 'CIL_u8Actv_Lvl = I_C06_RBTM_LVL_STAT_PROFILE8;'.");
    debugger_setBpAtLine("s:\\Components\\Application\\Autoliv\\CIL\\Implementation\\src\\CIL_AppliToCAN.c", 520);
  
    testStep("STEP", "Set signal Presf_Lvl_ST3 to I_C04_PRESF_LVL_V2_LVL8.");
    setSignal(BODY3::Presf_Lvl_ST3, 8);
    testWaitForTimeout(500);
  
    debugger_run();
    testWaitForTimeout(500);
  
    testCaseComment("Action: ARCH_SW_CIL_0166");
    testStep("STEP", "Check if CPU stopped in function cil_ManageActiveLevelSignal() after line 'CIL_u8Actv_Lvl = I_C06_RBTM_LVL_STAT_PROFILE8;'. --> CPU is Stopped");
debugger_isCPUStoppedAtFunction("cil_ManageActiveLevelSignal");    ////EvalManStepEqual("Expected Test Result", debugger_result, "CPU is Stopped");
  
  
  testCaseComment("Postcondition");
  testStep("STEP", "Return ECU to default values");
  setSignal(BODY3::Presf_Lvl_ST3, 0);
  RunPostTs();
}


testcase SW_IT_CIL_runAppliToCAN_10()
{
  //***********************************Test report header*********************************
  testReportAddMiscInfoBlock("AUTOLIV ELECTRONICS document");
  TestReportAddMiscInfo("Nightly test", "No");
  TestReportAddMiscInfo("Test type", "Requirement-Based test");
  TestReportAddMiscInfo("Regression Test", "No");
  TestReportAddMiscInfo("Fault injection method used", "No");
  TestReportAddMiscInfo("Resource usage evaluation", "No");
  TestReportAddMiscInfo("Priority", "No");
  TestReportAddMiscInfo("Safety relevant", "No");
  
  AddRequirementInfo("Requirement under test", "ARCH_SW_CIL_0167");
  AddRequirementInfo("ARCH_SW_CIL_0167", "If PRE-SAFE9 is executed (cycle 7) (and his next cycle ) then RBTM _FL/FR Actv_Lvl_ST35 should be equal to 0x09=“PRE-SAFE 9” no matter the source of the request: API interface, Diagnostic request.");
  //***************************************************************************************
    
  testCaseComment("Preconditions");
  testStep("STEP", "Bench Initialization");
  RunPreTs();
  

    testStep("STEP", "Set signal RBTMFL_SP_Lvl_Rq_ST35 to I_C06_RBTM_LVL_STAT_PROFILE9.");
    setSignal(BODY3::RBTMFL_SP_Lvl_Rq_ST35, 9);
    testWaitForTimeout(500);

  
    testStep("STEP", "Set a breakpoint in function CIL_runAppliToCAN().");
    debugger_setRelativeFunctionBpAtLine("CIL_runAppliToCAN", 0);
  
    testStep("STEP", "Check if CPU stopped in function CIL_runAppliToCAN(). --> CPU is Stopped");
debugger_isCPUStoppedAtFunction("CIL_runAppliToCAN");    ////EvalManStepEqual("Expected Test Result", debugger_result, "CPU is Stopped");
  
    
    debugger_deleteAllBP();
  
  
    testStep("STEP", "Set a breakpoint in function cil_ManageActiveLevelSignal() after line 'CIL_u8Actv_Lvl = I_C06_RBTM_LVL_STAT_PROFILE9;'.");
    debugger_setBpAtLine("s:\\Components\\Application\\Autoliv\\CIL\\Implementation\\src\\CIL_AppliToCAN.c", 524);
  
    debugger_run();
    
    testCaseComment("Action: ARCH_SW_CIL_0167");
    testStep("STEP", "Check if CPU stopped in function cil_ManageActiveLevelSignal() after line 'CIL_u8Actv_Lvl = I_C06_RBTM_LVL_STAT_PROFILE9;'. --> CPU is Stopped");
debugger_isCPUStoppedAtFunction("cil_ManageActiveLevelSignal");    ////EvalManStepEqual("Expected Test Result", debugger_result, "CPU is Stopped");
  
  
  testCaseComment("Postcondition");
  testStep("STEP", "Return ECU to default values");
  setSignal(BODY3::RBTMFL_SP_Lvl_Rq_ST35, 0);
  RunPostTs();
}


testcase SW_IT_CIL_runAppliToCAN_11()
{
  //***********************************Test report header*********************************
  testReportAddMiscInfoBlock("AUTOLIV ELECTRONICS document");
  TestReportAddMiscInfo("Nightly test", "No");
  TestReportAddMiscInfo("Test type", "Requirement-Based test");
  TestReportAddMiscInfo("Regression Test", "No");
  TestReportAddMiscInfo("Fault injection method used", "No");
  TestReportAddMiscInfo("Resource usage evaluation", "No");
  TestReportAddMiscInfo("Priority", "No");
  TestReportAddMiscInfo("Safety relevant", "No");
  
  AddRequirementInfo("Requirement under test", "ARCH_SW_CIL_0168");
  AddRequirementInfo("ARCH_SW_CIL_0168", "If PRE-SAFE10 is executed (cycle 8) (and his next cycle ) then RBTM _FL/FR Actv_Lvl_ST35 should be equal to 0x0A=“PRE-SAFE 10” no matter the source of the request: API interface, Diagnostic request.");
  //***************************************************************************************
    
  testCaseComment("Preconditions");
  testStep("STEP", "Bench Initialization");
  RunPreTs();
  

    testStep("STEP", "Set signal RBTMFL_SP_Lvl_Rq_ST35 to I_C06_RBTM_LVL_STAT_PROFILE10.");
    setSignal(BODY3::RBTMFL_SP_Lvl_Rq_ST35, 10);
    testWaitForTimeout(500);

  
    testStep("STEP", "Set a breakpoint in function CIL_runAppliToCAN().");
    debugger_setRelativeFunctionBpAtLine("CIL_runAppliToCAN", 0);
  
    testStep("STEP", "Check if CPU stopped in function CIL_runAppliToCAN(). --> CPU is Stopped");
debugger_isCPUStoppedAtFunction("CIL_runAppliToCAN");    ////EvalManStepEqual("Expected Test Result", debugger_result, "CPU is Stopped");
  
    
    debugger_deleteAllBP();
  
  
    testStep("STEP", "Set a breakpoint in function cil_ManageActiveLevelSignal() after line 'CIL_u8Actv_Lvl = I_C06_RBTM_LVL_STAT_PROFILE10;'.");
    debugger_setBpAtLine("s:\\Components\\Application\\Autoliv\\CIL\\Implementation\\src\\CIL_AppliToCAN.c", 528);
  
    debugger_run();
  
    testCaseComment("Action: ARCH_SW_CIL_0168");
    testStep("STEP", "Check if CPU stopped in function cil_ManageActiveLevelSignal() after line 'CIL_u8Actv_Lvl = I_C06_RBTM_LVL_STAT_PROFILE10;'. --> CPU is Stopped");
debugger_isCPUStoppedAtFunction("cil_ManageActiveLevelSignal");    ////EvalManStepEqual("Expected Test Result", debugger_result, "CPU is Stopped");
  
  
  testCaseComment("Postcondition");
  testStep("STEP", "Return ECU to default values");
  setSignal(BODY3::RBTMFL_SP_Lvl_Rq_ST35, 0);
  RunPostTs();
}


testcase SW_IT_CIL_runAppliToCAN_12()
{
  //***********************************Test report header*********************************
  testReportAddMiscInfoBlock("AUTOLIV ELECTRONICS document");
  TestReportAddMiscInfo("Nightly test", "No");
  TestReportAddMiscInfo("Test type", "Requirement-Based test");
  TestReportAddMiscInfo("Regression Test", "No");
  TestReportAddMiscInfo("Fault injection method used", "No");
  TestReportAddMiscInfo("Resource usage evaluation", "No");
  TestReportAddMiscInfo("Priority", "No");
  TestReportAddMiscInfo("Safety relevant", "No");
  
  AddRequirementInfo("Requirement under test", "ARCH_SW_CIL_0169");
  AddRequirementInfo("ARCH_SW_CIL_0169", "If PRE-SAFE11 is executed (cycle 9) (and his next cycle ) then RBTM _FL/FR Actv_Lvl_ST35 should be equal to 0x0B=“PRE-SAFE 11” no matter the source of the request: API interface, Diagnostic request.");
  //***************************************************************************************
    
  testCaseComment("Preconditions");
  testStep("STEP", "Bench Initialization");
  RunPreTs();
  

    testStep("STEP", "Set signal RBTMFL_SP_Lvl_Rq_ST35 to I_C06_RBTM_LVL_STAT_PROFILE11.");
    setSignal(BODY3::RBTMFL_SP_Lvl_Rq_ST35, 11);
    testWaitForTimeout(500);

  
    testStep("STEP", "Set a breakpoint in function CIL_runAppliToCAN().");
    debugger_setRelativeFunctionBpAtLine("CIL_runAppliToCAN", 0);
  
    testStep("STEP", "Check if CPU stopped in function CIL_runAppliToCAN(). --> CPU is Stopped");
debugger_isCPUStoppedAtFunction("CIL_runAppliToCAN");    ////EvalManStepEqual("Expected Test Result", debugger_result, "CPU is Stopped");
  
    
    debugger_deleteAllBP();
  
  
    testStep("STEP", "Set a breakpoint in function cil_ManageActiveLevelSignal() after line 'CIL_u8Actv_Lvl = I_C06_RBTM_LVL_STAT_PROFILE11;'.");
    debugger_setBpAtLine("s:\\Components\\Application\\Autoliv\\CIL\\Implementation\\src\\CIL_AppliToCAN.c", 532);
  
    debugger_run();
    testWaitForTimeout(500);
  
    testCaseComment("Action: ARCH_SW_CIL_0169");
    testStep("STEP", "Check if CPU stopped in function cil_ManageActiveLevelSignal() after line 'CIL_u8Actv_Lvl = I_C06_RBTM_LVL_STAT_PROFILE11;'. --> CPU is Stopped");
debugger_isCPUStoppedAtFunction("cil_ManageActiveLevelSignal");    ////EvalManStepEqual("Expected Test Result", debugger_result, "CPU is Stopped");
  
  
  testCaseComment("Postcondition");
  testStep("STEP", "Return ECU to default values");
  setSignal(BODY3::RBTMFL_SP_Lvl_Rq_ST35, 0);
  RunPostTs();
}


testcase SW_IT_CIL_runAppliToCAN_13()
{
  //***********************************Test report header*********************************
  testReportAddMiscInfoBlock("AUTOLIV ELECTRONICS document");
  TestReportAddMiscInfo("Nightly test", "No");
  TestReportAddMiscInfo("Test type", "Requirement-Based test");
  TestReportAddMiscInfo("Regression Test", "No");
  TestReportAddMiscInfo("Fault injection method used", "No");
  TestReportAddMiscInfo("Resource usage evaluation", "No");
  TestReportAddMiscInfo("Priority", "No");
  TestReportAddMiscInfo("Safety relevant", "No");
  
  AddRequirementInfo("Requirement under test", "ARCH_SW_CIL_0170");
  AddRequirementInfo("ARCH_SW_CIL_0170", "If PRE-SAFE12 is executed (cycle 10) (and his next cycle ) then RBTM _FL/FR Actv_Lvl_ST35 should be equal to 0x0C=“PRE-SAFE 12” no matter the source of the request: API interface, Diagnostic request.");
  //***************************************************************************************
    
  testCaseComment("Preconditions");
  testStep("STEP", "Bench Initialization");
  RunPreTs();


    testStep("STEP", "Set signal RBTMFL_SP_Lvl_Rq_ST35 to I_C06_RBTM_LVL_STAT_PROFILE12.");
    setSignal(BODY3::RBTMFL_SP_Lvl_Rq_ST35, 12);
    testWaitForTimeout(500);

  
    testStep("STEP", "Set a breakpoint in function CIL_runAppliToCAN().");
    debugger_setRelativeFunctionBpAtLine("CIL_runAppliToCAN", 0);
  
    testStep("STEP", "Check if CPU stopped in function CIL_runAppliToCAN(). --> CPU is Stopped");
debugger_isCPUStoppedAtFunction("CIL_runAppliToCAN");    ////EvalManStepEqual("Expected Test Result", debugger_result, "CPU is Stopped");
  
    
    debugger_deleteAllBP();
  
  
    testStep("STEP", "Set a breakpoint in function cil_ManageActiveLevelSignal() after line 'CIL_u8Actv_Lvl = I_C06_RBTM_LVL_STAT_PROFILE12;'.");
    debugger_setBpAtLine("s:\\Components\\Application\\Autoliv\\CIL\\Implementation\\src\\CIL_AppliToCAN.c", 567);
  
    debugger_run();
    testWaitForTimeout(500);
  
    testCaseComment("Action: ARCH_SW_CIL_0170");
    testStep("STEP", "Check if CPU stopped in function cil_ManageActiveLevelSignal() after line 'CIL_u8Actv_Lvl = I_C06_RBTM_LVL_STAT_PROFILE12;'. --> CPU is Stopped");
debugger_isCPUStoppedAtFunction("cil_ManageActiveLevelSignal");    ////EvalManStepEqual("Expected Test Result", debugger_result, "CPU is Stopped");
  
  
    debugger_run();
  
  
    testCaseComment("Action: ARCH_SW_CIL_0170");
    testStep("STEP", "Check if signal RBTMFL_Actv_Lvl_ST35 is equal to I_C06_RBTM_LVL_STAT_PROFILE12. --> RBTMFL_Actv_Lvl_ST35 is equal to I_C06_RBTM_LVL_STAT_PROFILE12");
    EvalManStepEqual("Expected Test Result", $RBTMFL_Actv_Lvl_ST35.raw64, 0x0C);
    
  
  testCaseComment("Postcondition");
  testStep("STEP", "Return ECU to default values");
  setSignal(BODY3::RBTMFL_SP_Lvl_Rq_ST35, 0);
  RunPostTs();
}


testcase SW_IT_CIL_runAppliToCAN_14()
{
  //***********************************Test report header*********************************
  testReportAddMiscInfoBlock("AUTOLIV ELECTRONICS document");
  TestReportAddMiscInfo("Nightly test", "No");
  TestReportAddMiscInfo("Test type", "Requirement-Based test");
  TestReportAddMiscInfo("Regression Test", "No");
  TestReportAddMiscInfo("Fault injection method used", "No");
  TestReportAddMiscInfo("Resource usage evaluation", "No");
  TestReportAddMiscInfo("Priority", "No");
  TestReportAddMiscInfo("Safety relevant", "No");
  
  AddRequirementInfo("Requirement under test", "ARCH_SW_CIL_0171");
  AddRequirementInfo("ARCH_SW_CIL_0171", "If PRE-SAFE13 is executed (cycle 11) (and his next cycle ) then RBTM _FL/FR Actv_Lvl_ST35 should be equal to 0x0D=“PRE-SAFE 13” no matter the source of the request: API interface, Diagnostic request.");
  //***************************************************************************************
    
  testCaseComment("Preconditions");
  testStep("STEP", "Bench Initialization");
  RunPreTs();


    testStep("STEP", "Set signal RBTMFL_SP_Lvl_Rq_ST35 to I_C06_RBTM_LVL_STAT_PROFILE13.");
    setSignal(BODY3::RBTMFL_SP_Lvl_Rq_ST35, 13);
    testWaitForTimeout(500);

  
    testStep("STEP", "Set a breakpoint in function CIL_runAppliToCAN().");
    debugger_setRelativeFunctionBpAtLine("CIL_runAppliToCAN", 0);
  
    testStep("STEP", "Check if CPU stopped in function CIL_runAppliToCAN(). --> CPU is Stopped");
debugger_isCPUStoppedAtFunction("CIL_runAppliToCAN");    ////EvalManStepEqual("Expected Test Result", debugger_result, "CPU is Stopped");
  
    
    debugger_deleteAllBP();
  
  
    testStep("STEP", "Set a breakpoint in function cil_ManageActiveLevelSignal() after line 'CIL_u8Actv_Lvl = I_C06_RBTM_LVL_STAT_PROFILE13;'.");
    debugger_setBpAtLine("s:\\Components\\Application\\Autoliv\\CIL\\Implementation\\src\\CIL_AppliToCAN.c", 540);
  
    debugger_run();
    testWaitForTimeout(500);
  
    testCaseComment("Action: ARCH_SW_CIL_0171");
    testStep("STEP", "Check if CPU stopped in function cil_ManageActiveLevelSignal() after line 'CIL_u8Actv_Lvl = I_C06_RBTM_LVL_STAT_PROFILE13;'. --> CPU is Stopped");
debugger_isCPUStoppedAtFunction("cil_ManageActiveLevelSignal");    ////EvalManStepEqual("Expected Test Result", debugger_result, "CPU is Stopped");
  
  
  testCaseComment("Postcondition");
  testStep("STEP", "Return ECU to default values");
  setSignal(BODY3::RBTMFL_SP_Lvl_Rq_ST35, 0);
  RunPostTs();
}


testcase SW_IT_CIL_runAppliToCAN_15()
{
  //***********************************Test report header*********************************
  testReportAddMiscInfoBlock("AUTOLIV ELECTRONICS document");
  TestReportAddMiscInfo("Nightly test", "No");
  TestReportAddMiscInfo("Test type", "Requirement-Based test");
  TestReportAddMiscInfo("Regression Test", "No");
  TestReportAddMiscInfo("Fault injection method used", "No");
  TestReportAddMiscInfo("Resource usage evaluation", "No");
  TestReportAddMiscInfo("Priority", "No");
  TestReportAddMiscInfo("Safety relevant", "No");
  
  AddRequirementInfo("Requirement under test", "ARCH_SW_CIL_0172");
  AddRequirementInfo("ARCH_SW_CIL_0172", "If PRE-SAFE14 is executed (cycle 12) (and his next cycle ) then RBTM _FL/FR Actv_Lvl_ST35 should be equal to 0x0E=“PRE-SAFE 14” no matter the source of the request: API interface, Diagnostic request.");
  //***************************************************************************************
     
  testCaseComment("Preconditions");
  testStep("STEP", "Bench Initialization");
  RunPreTs();


    testStep("STEP", "Set signal RBTMFL_SP_Lvl_Rq_ST35 to I_C06_RBTM_LVL_STAT_PROFILE14.");
    setSignal(BODY3::RBTMFL_SP_Lvl_Rq_ST35, 14);
    testWaitForTimeout(500);

  
    testStep("STEP", "Set a breakpoint in function CIL_runAppliToCAN().");
    debugger_setRelativeFunctionBpAtLine("CIL_runAppliToCAN", 0);
  
    testStep("STEP", "Check if CPU stopped in function CIL_runAppliToCAN(). --> CPU is Stopped");
debugger_isCPUStoppedAtFunction("CIL_runAppliToCAN");    ////EvalManStepEqual("Expected Test Result", debugger_result, "CPU is Stopped");
  
    
    debugger_deleteAllBP();
  
  
    testStep("STEP", "Set a breakpoint in function cil_ManageActiveLevelSignal() after line 'CIL_u8Actv_Lvl = I_C06_RBTM_LVL_STAT_PROFILE14;'.");
    debugger_setBpAtLine("s:\\Components\\Application\\Autoliv\\CIL\\Implementation\\src\\CIL_AppliToCAN.c", 544);
  
    debugger_run();
    testWaitForTimeout(500);
  
    testCaseComment("Action: ARCH_SW_CIL_0172");
    testStep("STEP", "Check if CPU stopped in function cil_ManageActiveLevelSignal() after line 'CIL_u8Actv_Lvl = I_C06_RBTM_LVL_STAT_PROFILE14;'. --> CPU is Stopped");
debugger_isCPUStoppedAtFunction("cil_ManageActiveLevelSignal");    ////EvalManStepEqual("Expected Test Result", debugger_result, "CPU is Stopped");
  
  
  testCaseComment("Postcondition");
  testStep("STEP", "Return ECU to default values");
  setSignal(BODY3::RBTMFL_SP_Lvl_Rq_ST35, 0);
  RunPostTs();
}


testcase SW_IT_CIL_runAppliToCAN_16()
{
  //***********************************Test report header*********************************
  testReportAddMiscInfoBlock("AUTOLIV ELECTRONICS document");
  TestReportAddMiscInfo("Nightly test", "No");
  TestReportAddMiscInfo("Test type", "Requirement-Based test");
  TestReportAddMiscInfo("Regression Test", "No");
  TestReportAddMiscInfo("Fault injection method used", "No");
  TestReportAddMiscInfo("Resource usage evaluation", "No");
  TestReportAddMiscInfo("Priority", "No");
  TestReportAddMiscInfo("Safety relevant", "No");
  
  AddRequirementInfo("Requirement under test", "ARCH_SW_CIL_0173");
  AddRequirementInfo("ARCH_SW_CIL_0173", "If PRE-SAFE15 is executed (cycle 13) (and his next cycle ) then RBTM _FL/FR Actv_Lvl_ST35 should be equal to 0x0F=“PRE-SAFE 15” no matter the source of the request: API interface, Diagnostic request.");
  //***************************************************************************************
  
  testCaseComment("Preconditions");
  testStep("STEP", "Bench Initialization");
  RunPreTs();


    testStep("STEP", "Set signal RBTMFL_SP_Lvl_Rq_ST35 to I_C06_RBTM_LVL_STAT_PROFILE15.");
    setSignal(BODY3::RBTMFL_SP_Lvl_Rq_ST35, 15);
    testWaitForTimeout(500);

  
    testStep("STEP", "Set a breakpoint in function CIL_runAppliToCAN().");
    debugger_setRelativeFunctionBpAtLine("CIL_runAppliToCAN", 0);
  
    testStep("STEP", "Check if CPU stopped in function CIL_runAppliToCAN(). --> CPU is Stopped");
debugger_isCPUStoppedAtFunction("CIL_runAppliToCAN");    ////EvalManStepEqual("Expected Test Result", debugger_result, "CPU is Stopped");
  
    
    debugger_deleteAllBP();
  
  
    testStep("STEP", "Set a breakpoint in function cil_ManageActiveLevelSignal() after line 'CIL_u8Actv_Lvl = I_C06_RBTM_LVL_STAT_PROFILE15;'.");
    debugger_setBpAtLine("s:\\Components\\Application\\Autoliv\\CIL\\Implementation\\src\\CIL_AppliToCAN.c", 548);
  
    debugger_run();
    testWaitForTimeout(500);
  
    testCaseComment("Action: ARCH_SW_CIL_0173");
    testStep("STEP", "Check if CPU stopped in function cil_ManageActiveLevelSignal() after line 'CIL_u8Actv_Lvl = I_C06_RBTM_LVL_STAT_PROFILE15;'. --> CPU is Stopped");
debugger_isCPUStoppedAtFunction("cil_ManageActiveLevelSignal");    ////EvalManStepEqual("Expected Test Result", debugger_result, "CPU is Stopped");
  
  
  testCaseComment("Postcondition");
  testStep("STEP", "Return ECU to default values");
  setSignal(BODY3::RBTMFL_SP_Lvl_Rq_ST35, 0);
  RunPostTs();
}


testcase SW_IT_CIL_runAppliToCAN_17()
{
  //***********************************Test report header*********************************
  testReportAddMiscInfoBlock("AUTOLIV ELECTRONICS document");
  TestReportAddMiscInfo("Nightly test", "No");
  TestReportAddMiscInfo("Test type", "Requirement-Based test");
  TestReportAddMiscInfo("Regression Test", "No");
  TestReportAddMiscInfo("Fault injection method used", "No");
  TestReportAddMiscInfo("Resource usage evaluation", "No");
  TestReportAddMiscInfo("Priority", "No");
  TestReportAddMiscInfo("Safety relevant", "No");
  
  AddRequirementInfo("Requirement under test", "ARCH_SW_CIL_0097");
  AddRequirementInfo("ARCH_SW_CIL_0097", "If PRE-SAFE_CURVE1 is executed (cycle 14) (and his next cycle) then  RBTM _FL/FR Actv_Lvl_ST35 should be equal to 0x16 no matter the source of the request : API interface,Diagnostic request.");
  //***************************************************************************************
  
  testCaseComment("Preconditions");
  testStep("STEP", "Bench Initialization");
  RunPreTs();


    testStep("STEP", "Set signal RBTMFL_SP_Lvl_Rq_ST35 to I_C06_RBTM_LVL_STAT_PROFILE22.");
    setSignal(BODY3::RBTMFL_SP_Lvl_Rq_ST35, 22);
    testWaitForTimeout(500);

  
    testStep("STEP", "Set a breakpoint in function CIL_runAppliToCAN().");
    debugger_setRelativeFunctionBpAtLine("CIL_runAppliToCAN", 0);
  
    testStep("STEP", "Check if CPU stopped in function CIL_runAppliToCAN(). --> CPU is Stopped");
debugger_isCPUStoppedAtFunction("CIL_runAppliToCAN");    ////EvalManStepEqual("Expected Test Result", debugger_result, "CPU is Stopped");
  
    
    debugger_deleteAllBP();
  
  
    testStep("STEP", "Set a breakpoint in function cil_ManageActiveLevelSignal() after line 'CIL_u8Actv_Lvl = I_C06_RBTM_LVL_STAT_PROFILE22;'.");
    debugger_setBpAtLine("s:\\Components\\Application\\Autoliv\\CIL\\Implementation\\src\\CIL_AppliToCAN.c", 579);
  
    debugger_run();
    testWaitForTimeout(500);
  
    testCaseComment("Action: ARCH_SW_CIL_0097");
    testStep("STEP", "Check if CPU stopped in function cil_ManageActiveLevelSignal() after line 'CIL_u8Actv_Lvl = I_C06_RBTM_LVL_STAT_PROFILE22;'. --> CPU is Stopped");
debugger_isCPUStoppedAtFunction("cil_ManageActiveLevelSignal");    ////EvalManStepEqual("Expected Test Result", debugger_result, "CPU is Stopped");
  
  
  testCaseComment("Postcondition");
  testStep("STEP", "Return ECU to default values");
  setSignal(BODY3::RBTMFL_SP_Lvl_Rq_ST35, 0);
  RunPostTs();
}


testcase SW_IT_CIL_runAppliToCAN_18()
{
  //***********************************Test report header*********************************
  testReportAddMiscInfoBlock("AUTOLIV ELECTRONICS document");
  TestReportAddMiscInfo("Nightly test", "No");
  TestReportAddMiscInfo("Test type", "Requirement-Based test");
  TestReportAddMiscInfo("Regression Test", "No");
  TestReportAddMiscInfo("Fault injection method used", "No");
  TestReportAddMiscInfo("Resource usage evaluation", "No");
  TestReportAddMiscInfo("Priority", "No");
  TestReportAddMiscInfo("Safety relevant", "No");
  
  AddRequirementInfo("Requirement under test", "ARCH_SW_CIL_0174");
  AddRequirementInfo("ARCH_SW_CIL_0174", "If PRE-SAFE_CURVE2 is executed (cycle 15) (and his next cycle) then  RBTM _FL/FR Actv_Lvl_ST35 should be equal to 0x17 no matter the source of the request : API interface, Diagnostic request.");
  //***************************************************************************************
   
  testCaseComment("Preconditions");
  testStep("STEP", "Bench Initialization");
  RunPreTs();
  

    testStep("STEP", "Set signal RBTMFL_SP_Lvl_Rq_ST35 to I_C06_RBTM_LVL_STAT_PROFILE23.");
    setSignal(BODY3::RBTMFL_SP_Lvl_Rq_ST35, 23);
    testWaitForTimeout(500);

  
    testStep("STEP", "Set a breakpoint in function CIL_runAppliToCAN().");
    debugger_setRelativeFunctionBpAtLine("CIL_runAppliToCAN", 0);
  
    testStep("STEP", "Check if CPU stopped in function CIL_runAppliToCAN(). --> CPU is Stopped");
    debugger_WaitUntilBPisReached(1000);
    
    
    debugger_deleteAllBP();
  
  
    testStep("STEP", "Set a breakpoint in function cil_ManageActiveLevelSignal() after line 'CIL_u8Actv_Lvl = I_C06_RBTM_LVL_STAT_PROFILE23;'.");
    debugger_setBpAtLine("s:\\Components\\Application\\Autoliv\\CIL\\Implementation\\src\\CIL_AppliToCAN.c", 615);
  
    debugger_run();
    testWaitForTimeout(500);
  
    testCaseComment("Action: ARCH_SW_CIL_0174");
    testStep("STEP", "Check if CPU stopped in function cil_ManageActiveLevelSignal() after line 'CIL_u8Actv_Lvl = I_C06_RBTM_LVL_STAT_PROFILE23;'. --> CPU is Stopped");
    debugger_WaitUntilBPisReached(1000);
  
  
  testCaseComment("Postcondition");
  testStep("STEP", "Return ECU to default values");
  setSignal(BODY3::RBTMFL_SP_Lvl_Rq_ST35, 0);
  RunPostTs();
}


testcase SW_IT_CIL_runAppliToCAN_19()
{
  //***********************************Test report header*********************************
  testReportAddMiscInfoBlock("AUTOLIV ELECTRONICS document");
  TestReportAddMiscInfo("Nightly test", "No");
  TestReportAddMiscInfo("Test type", "Requirement-Based test");
  TestReportAddMiscInfo("Regression Test", "No");
  TestReportAddMiscInfo("Fault injection method used", "No");
  TestReportAddMiscInfo("Resource usage evaluation", "No");
  TestReportAddMiscInfo("Priority", "No");
  TestReportAddMiscInfo("Safety relevant", "No");
  
  AddRequirementInfo("Requirement under test", "ARCH_SW_CIL_0175");
  AddRequirementInfo("ARCH_SW_CIL_0175", "If PRE-SAFE_CURVE3 is executed (cycle 16) (and his next cycle) then  RBTM _FL/FR Actv_Lvl_ST35 should be equal to 0x18 no matter the source of the request : API interface, Diagnostic request.");
  //***************************************************************************************
   
  testCaseComment("Preconditions");
  testStep("STEP", "Bench Initialization");
  RunPreTs();


    testStep("STEP", "Set signal RBTMFL_SP_Lvl_Rq_ST35 to I_C06_RBTM_LVL_STAT_PROFILE24.");
    setSignal(BODY3::RBTMFL_SP_Lvl_Rq_ST35, 24);
    testWaitForTimeout(500);

  
    testStep("STEP", "Set a breakpoint in function CIL_runAppliToCAN().");
    debugger_setRelativeFunctionBpAtLine("CIL_runAppliToCAN", 0);
  
    testStep("STEP", "Check if CPU stopped in function CIL_runAppliToCAN(). --> CPU is Stopped");
debugger_isCPUStoppedAtFunction("CIL_runAppliToCAN");    ////EvalManStepEqual("Expected Test Result", debugger_result, "CPU is Stopped");
    
    
    debugger_deleteAllBP();
  
  
    testStep("STEP", "Set a breakpoint in function cil_ManageActiveLevelSignal() after line 'CIL_u8Actv_Lvl = I_C06_RBTM_LVL_STAT_PROFILE24;'.");
    debugger_setBpAtLine("s:\\Components\\Application\\Autoliv\\CIL\\Implementation\\src\\CIL_AppliToCAN.c", 587);
  
    debugger_run();
    testWaitForTimeout(500);

    testCaseComment("Action: ARCH_SW_CIL_0175");
    testStep("STEP", "Check if CPU stopped in function cil_ManageActiveLevelSignal() after line 'CIL_u8Actv_Lvl = I_C06_RBTM_LVL_STAT_PROFILE24;'. --> CPU is Stopped");
debugger_isCPUStoppedAtFunction("cil_ManageActiveLevelSignal");    ////EvalManStepEqual("Expected Test Result", debugger_result, "CPU is Stopped");
  
  
  testCaseComment("Postcondition");
  testStep("STEP", "Return ECU to default values");
  setSignal(BODY3::RBTMFL_SP_Lvl_Rq_ST35, 0);
  RunPostTs();
}


testcase SW_IT_CIL_runAppliToCAN_20()
{
  //***********************************Test report header*********************************
  testReportAddMiscInfoBlock("AUTOLIV ELECTRONICS document");
  TestReportAddMiscInfo("Nightly test", "No");
  TestReportAddMiscInfo("Test type", "Requirement-Based test");
  TestReportAddMiscInfo("Regression Test", "No");
  TestReportAddMiscInfo("Fault injection method used", "No");
  TestReportAddMiscInfo("Resource usage evaluation", "No");
  TestReportAddMiscInfo("Priority", "No");
  TestReportAddMiscInfo("Safety relevant", "No");
  
  AddRequirementInfo("Requirement under test", "ARCH_SW_CIL_0176");
  AddRequirementInfo("ARCH_SW_CIL_0176", "If PRE-SAFE_CURVE4 is executed (cycle 17) (and his next cycle) then  RBTM _FL/FR Actv_Lvl_ST35 should be equal to 0x19 no matter the source of the request : API interface,Diagnostic request.");
  //***************************************************************************************
    
  testCaseComment("Preconditions");
  testStep("STEP", "Bench Initialization");
  RunPreTs();


    testStep("STEP", "Set signal RBTMFL_SP_Lvl_Rq_ST35 to I_C06_RBTM_LVL_STAT_PROFILE25.");
    setSignal(BODY3::RBTMFL_SP_Lvl_Rq_ST35, 25);
    testWaitForTimeout(500);

  
    testStep("STEP", "Set a breakpoint in function CIL_runAppliToCAN().");
    debugger_setRelativeFunctionBpAtLine("CIL_runAppliToCAN", 0);
  
    testStep("STEP", "Check if CPU stopped in function CIL_runAppliToCAN(). --> CPU is Stopped");
debugger_isCPUStoppedAtFunction("CIL_runAppliToCAN");    ////EvalManStepEqual("Expected Test Result", debugger_result, "CPU is Stopped");
    
    
    debugger_deleteAllBP();
  
  
    testStep("STEP", "Set a breakpoint in function cil_ManageActiveLevelSignal() after line 'CIL_u8Actv_Lvl = I_C06_RBTM_LVL_STAT_PROFILE25;'.");
    debugger_setBpAtLine("s:\\Components\\Application\\Autoliv\\CIL\\Implementation\\src\\CIL_AppliToCAN.c", 591);
  
    debugger_run();
    testWaitForTimeout(500);
  
    testCaseComment("Action: ARCH_SW_CIL_0176");
    testStep("STEP", "Check if CPU stopped in function cil_ManageActiveLevelSignal() after line 'CIL_u8Actv_Lvl = I_C06_RBTM_LVL_STAT_PROFILE25;'. --> CPU is Stopped");
debugger_isCPUStoppedAtFunction("cil_ManageActiveLevelSignal");    ////EvalManStepEqual("Expected Test Result", debugger_result, "CPU is Stopped");
  
  
  testCaseComment("Postcondition");
  testStep("STEP", "Return ECU to default values");
  setSignal(BODY3::RBTMFL_SP_Lvl_Rq_ST35, 0);
  RunPostTs();
}


testcase SW_IT_CIL_runAppliToCAN_21()
{
  //***********************************Test report header*********************************
  testReportAddMiscInfoBlock("AUTOLIV ELECTRONICS document");
  TestReportAddMiscInfo("Nightly test", "No");
  TestReportAddMiscInfo("Test type", "Requirement-Based test");
  TestReportAddMiscInfo("Regression Test", "No");
  TestReportAddMiscInfo("Fault injection method used", "No");
  TestReportAddMiscInfo("Resource usage evaluation", "No");
  TestReportAddMiscInfo("Priority", "No");
  TestReportAddMiscInfo("Safety relevant", "No");
  
  AddRequirementInfo("Requirement under test", "ARCH_SW_CIL_0071, ARCH_SW_CIL_0072, ARCH_SW_CIL_0073, ARCH_SW_CIL_0177, ARCH_SW_CIL_0178");
  AddRequirementInfo("ARCH_SW_CIL_0071", "If a belt profile requested is not programed (cycle or step not valid) RBTM _FL/FR Actv_Lvl_ST35 should be 0x3E = “Rejected” no matter the source of the request: API interface, PRE-SAFE interface.");
  AddRequirementInfo("ARCH_SW_CIL_0072", "If a belt profile requested is undefined or not implemented RBTM _FL/FR Actv_Lvl_ST35 should be 0x3E = “Rejected” no matter the source of the request: API interface, PRE-SAFE interface.");
  AddRequirementInfo("ARCH_SW_CIL_0073", "If a belt profile requested can not be executed no matter the inhibition cause the RBTM _FL/FR Actv_Lvl_ST35 should be 0x3E = “Rejected”. “Rejected” will be transmitted as long the request is active.");
  AddRequirementInfo("ARCH_SW_CIL_0177", "If a belt profile requested is aborted the RBTM _FL/FR Actv_Lvl_ST35 should be 0x3E = “Rejected”. “Rejected” will be transmitted as long the request is active.");
  AddRequirementInfo("ARCH_SW_CIL_0178", "If a belt profile requested is not programed (cycle or step not valid) RBTM _FL/FR Actv_Lvl_ST35 should be 0x3E = “Rejected” no matter the source of the request: API interface, PRE-SAFE interface.");
  //***************************************************************************************
         
  testCaseComment("Preconditions");
  testStep("STEP", "Bench Initialization");
  RunPreTs();


    testStep("STEP", "Set signal RBTMFL_SP_Lvl_Rq_ST35 to I_C06_RBTM_LVL_STAT_REJECTED.");
    setSignal(BODY3::RBTMFL_SP_Lvl_Rq_ST35, 0x3E);
    testWaitForTimeout(500);

  
    testStep("STEP", "Set a breakpoint in function CIL_runAppliToCAN().");
    debugger_setRelativeFunctionBpAtLine("CIL_runAppliToCAN", 0);
  
    testStep("STEP", "Check if CPU stopped in function CIL_runAppliToCAN(). --> CPU is Stopped");
debugger_isCPUStoppedAtFunction("CIL_runAppliToCAN");    ////EvalManStepEqual("Expected Test Result", debugger_result, "CPU is Stopped");

    
    debugger_deleteAllBP();
  
  
    testStep("STEP", "Set a breakpoint in function cil_ManageActiveLevelSignal() after line 'CIL_u8Actv_Lvl = I_C06_RBTM_LVL_STAT_REJECTED;'.");
    debugger_setBpAtLine("s:\\Components\\Application\\Autoliv\\CIL\\Implementation\\src\\CIL_AppliToCAN.c", 487);
  
    debugger_run();
    testWaitForTimeout(500);
  
    testCaseComment("Action: ARCH_SW_CIL_0071, ARCH_SW_CIL_0072, ARCH_SW_CIL_0073, ARCH_SW_CIL_0177, ARCH_SW_CIL_0178");
    testStep("STEP", "Check if CPU stopped in function cil_ManageActiveLevelSignal() after line 'CIL_u8Actv_Lvl = I_C06_RBTM_LVL_STAT_REJECTED;'. --> CPU is Stopped");
debugger_isCPUStoppedAtFunction("cil_ManageActiveLevelSignal");    ////EvalManStepEqual("Expected Test Result", debugger_result, "CPU is Stopped");
    
  
  testCaseComment("Postcondition");
  testStep("STEP", "Return ECU to default values");
  setSignal(BODY3::RBTMFL_SP_Lvl_Rq_ST35, 0);
  RunPostTs();
}


testcase SW_IT_CIL_runAppliToCAN_23()
{
  //***********************************Test report header*********************************
  testReportAddMiscInfoBlock("AUTOLIV ELECTRONICS document");
  TestReportAddMiscInfo("Nightly test", "No");
  TestReportAddMiscInfo("Test type", "Requirement-Based test");
  TestReportAddMiscInfo("Regression Test", "No");
  TestReportAddMiscInfo("Fault injection method used", "No");
  TestReportAddMiscInfo("Resource usage evaluation", "No");
  TestReportAddMiscInfo("Priority", "No");
  TestReportAddMiscInfo("Safety relevant", "No");
  
  AddRequirementInfo("Requirement under test", "ARCH_SW_CIL_0012, ARCH_SW_CIL_0013, ARCH_SW_CIL_0019");
  AddRequirementInfo("ARCH_SW_CIL_0012", "Signal RBTM_FL/FR_Disp_Rq_ST3 shall be written and send to CAN.");
  AddRequirementInfo("ARCH_SW_CIL_0013", "Signal RBTM_FL/FR_Disp_Rq_ST3 shall be written and send to CAN.");
  AddRequirementInfo("ARCH_SW_CIL_0019", "Value for signal RBTM_FL/FR_Disp_Rq_ST3 will be 1 = SRV_DISP_RQ for 3s after Rid0302 is requested or if a DTCS with warning indicator is qualified, otherwise will be set to 0 = IDLE.");
  //***************************************************************************************
    
  testCaseComment("Preconditions");
  testStep("STEP", "Bench Initialization");
  RunPreTs();

  
    testCaseComment("Action: ARCH_SW_CIL_0019");
    testStep("STEP", "Request Rid0302.");
    result = diagSendRequest(req_Tensioning_Cycle_BSR_Read);
    
    testStep("STEP", "Set a breakpoint in function CIL_runAppliToCAN().");
    debugger_setRelativeFunctionBpAtLine("CIL_runAppliToCAN", 0);
  
    testStep("STEP", "Check if CPU stopped in function CIL_runAppliToCAN(). --> CPU is Stopped");
debugger_isCPUStoppedAtFunction("CIL_runAppliToCAN");    ////EvalManStepEqual("Expected Test Result", debugger_result, "CPU is Stopped");
    
    
    debugger_deleteAllBP();
    
  
    testStep("STEP", "Set a breakpoint in function cil_ManagePresfDisplay() at line '(void)Rte_Write_CIL_AC_CommunicationInteractionLayer_IF_RBTM_FL_Disp_Rq_ST3_RBTM_FL_Disp_Rq_ST3(cil_u8RBTMDisp);'.");
    debugger_setBpAtLine("s:\\Components\\Application\\Autoliv\\CIL\\Implementation\\src\\CIL_AppliToCAN.c", 220);
  
    debugger_run();
  
    testStep("STEP", "Check if CPU stopped at line '(void)Rte_Write_CIL_AC_CommunicationInteractionLayer_IF_RBTM_FL_Disp_Rq_ST3_RBTM_FL_Disp_Rq_ST3(cil_u8RBTMDisp);'. --> CPU is Stopped");
    debugger_isCPUStoppedAtFunction("cil_ManagePresfDisplay");
    ////EvalManStepEqual("Expected Test Result", debugger_result, "CPU is Stopped");
  
  
    testCaseComment("Action: ARCH_SW_CIL_0012, ARCH_SW_CIL_0013");
    testStep("STEP", "Check if variable cil_u8RBTMDisp is equal to KU8_ZERO. -->  KU8_ZERO)");
    result = debugger_readGlobalVariable("uint8", "CIL_u8Actv_Lvl,,app.elf", 0);
    EvalManStepEqual("Expected Test Result", result, 0);
    
    testCaseComment("Action: ARCH_SW_CIL_0019");
    testStep("STEP", "Check if signal RBTM_FL_Disp_Rq_ST3 value is KU8_ZERO. --> KU8_ZERO");
    EvalManStepEqual("Expected Test Result", result, 0);
    

  testCaseComment("Postcondition");
  testStep("STEP", "Return ECU to default values");
  RunPostTs();
}


testcase SW_IT_CIL_runAppliToCAN_24()
{
  //***********************************Test report header*********************************
  testReportAddMiscInfoBlock("AUTOLIV ELECTRONICS document");
  TestReportAddMiscInfo("Nightly test", "No");
  TestReportAddMiscInfo("Test type", "Requirement-Based test");
  TestReportAddMiscInfo("Regression Test", "No");
  TestReportAddMiscInfo("Fault injection method used", "No");
  TestReportAddMiscInfo("Resource usage evaluation", "No");
  TestReportAddMiscInfo("Priority", "No");
  TestReportAddMiscInfo("Safety relevant", "No");
  
  AddRequirementInfo("Requirement under test", "ARCH_SW_CIL_0020");
  AddRequirementInfo("ARCH_SW_CIL_0020", "Value for signal RBTM_FL/FR_Tgl_ST3 will be 0(default) or 1.");
  //***************************************************************************************
    
  testCaseComment("Preconditions");
  testStep("STEP", "Bench Initialization");
  RunPreTs();
  
  
    testStep("STEP", "Set a breakpoint in function CIL_runAppliToCAN().");
    debugger_setRelativeFunctionBpAtLine("CIL_runAppliToCAN", 0);
  
    testStep("STEP", "Check if CPU stopped in function CIL_runAppliToCAN(). --> CPU is Stopped");
    debugger_WaitUntilBPisReached(1000);
    
    
    debugger_deleteAllBP();
    
    
    testStep("STEP", "Set a breakpoint in function cil_ManageOutputSignals() at line '(void)Rte_Write_CIL_AC_CommunicationInteractionLayer_IF_RBTM_FL_Tgl_ST3_RBTM_FL_Tgl_ST3(CIL_bRBTMTgl);'.");
    debugger_setBpAtLine("s:\\Components\\Application\\Autoliv\\CIL\\Implementation\\src\\CIL_AppliToCAN.c", 673);
  
    debugger_run();
  
    testStep("STEP", "Check if CPU stopped at line '(void)Rte_Write_CIL_AC_CommunicationInteractionLayer_IF_RBTM_FL_Tgl_ST3_RBTM_FL_Tgl_ST3(CIL_bRBTMTgl);'. --> CPU is Stopped");
    debugger_WaitUntilBPisReached(1000);
    
    
    testCaseComment("Action: ARCH_SW_CIL_0020");
    testStep("STEP", "Check if signal RBTM_FL_Tgl_ST3 value is KB_CIL_RBTM_TGL_SIGNAL_TGL_ONE. --> KU8_ONE");
    EvalManStepEqual("Expected Test Result", $RBTM_FL_Tgl_ST3.raw64, 1);
  
  
  testCaseComment("Postcondition");
  testStep("STEP", "Return ECU to default values");
  RunPostTs();
}


testcase SW_IT_CIL_runAppliToCAN_25()
{
  //***********************************Test report header*********************************
  testReportAddMiscInfoBlock("AUTOLIV ELECTRONICS document");
  TestReportAddMiscInfo("Nightly test", "No");
  TestReportAddMiscInfo("Test type", "Requirement-Based test");
  TestReportAddMiscInfo("Regression Test", "No");
  TestReportAddMiscInfo("Fault injection method used", "No");
  TestReportAddMiscInfo("Resource usage evaluation", "No");
  TestReportAddMiscInfo("Priority", "No");
  TestReportAddMiscInfo("Safety relevant", "No");
  
  AddRequirementInfo("Requirement under test", "ARCH_SW_CIL_0015, ARCH_SW_CIL_0021");
  AddRequirementInfo("ARCH_SW_CIL_0015", "Signal BltSlckDec_Md_FL/FR_Stat_ST3 shall be written and send to CAN.");
  //***************************************************************************************
    
  testCaseComment("Preconditions");
  testStep("STEP", "Bench Initialization");
  RunPreTs();

  
    testStep("STEP", "Set a breakpoint in function CIL_runAppliToCAN().");
    debugger_setRelativeFunctionBpAtLine("CIL_runAppliToCAN", 0);
  
    testStep("STEP", "Check if CPU stopped in function CIL_runAppliToCAN(). --> CPU is Stopped");
debugger_isCPUStoppedAtFunction("CIL_runAppliToCAN");    ////EvalManStepEqual("Expected Test Result", debugger_result, "CPU is Stopped");
  
  
    debugger_deleteAllBP();
  

    testStep("STEP", "Set a breakpoint in function cil_ManageOutputSignals() at line '(void)Rte_Write_CIL_AC_CommunicationInteractionLayer_IF_BltSlckDec_Md_XX_Stat_ST3_BltSlckDec_Md_XX_Stat_ST3(CIL_u8BltSlckDec_Md);'.");
    debugger_setBpAtLine("s:\\Components\\Application\\Autoliv\\CIL\\Implementation\\src\\CIL_AppliToCAN.c", 645);
  
    debugger_run();
  
    testCaseComment("Action: ARCH_SW_CIL_0021");
    testStep("STEP", "Check if CPU stopped at line '(void)Rte_Write_CIL_AC_CommunicationInteractionLayer_IF_BltSlckDec_Md_XX_Stat_ST3_BltSlckDec_Md_XX_Stat_ST3(CIL_u8BltSlckDec_Md);'. --> CPU is Stopped");
    debugger_isCPUStoppedAtFunction("cil_ManageOutputSignals");
    ////EvalManStepEqual("Expected Test Result", debugger_result, "CPU is Stopped");
  
  
    testCaseComment("Action: ARCH_SW_CIL_0015");
    testStep("STEP", "Check if variable NVP_BLOCK_ID_CAN_INPUT_SIGNALS_RamBlockData.NVP_u8BeltSlkDecMode is equal to BltSlckDec_Md_Rq_HU_ST3. -->  NVP_u8BeltSlkDecMode == BltSlckDec_Md_Rq_HU_ST3");
    result = debugger_readGlobalVariable("uint8", "NVP_BLOCK_ID_CAN_INPUT_SIGNALS_RamBlockData,,app.elf", 0);
    EvalManStepEqual("Expected Test Result", result, $BltSlckDec_Md_Rq_HU_ST3.raw64);
    

  testCaseComment("Postcondition");
  testStep("STEP", "Return ECU to default values");
  RunPostTs(); 
}


testcase SW_IT_CIL_ActiveClient_01()
{
  //***********************************Test report header*********************************
  testReportAddMiscInfoBlock("AUTOLIV ELECTRONICS document");
  TestReportAddMiscInfo("Nightly test", "No");
  TestReportAddMiscInfo("Test type", "Requirement-Based test");
  TestReportAddMiscInfo("Regression Test", "No");
  TestReportAddMiscInfo("Fault injection method used", "No");
  TestReportAddMiscInfo("Resource usage evaluation", "No");
  TestReportAddMiscInfo("Priority", "No");
  TestReportAddMiscInfo("Safety relevant", "No");
  
  AddRequirementInfo("Requirement under test", "ARCH_SW_CIL_0098, ARCH_SW_CIL_0099, ARCH_SW_CIL_0104");
  AddRequirementInfo("ARCH_SW_CIL_0099", "When no profile is executed the signal RBTMxy_SP_ActvClient_ST35 shall be set to 0.");
  AddRequirementInfo("ARCH_SW_CIL_0098", "Signal RBTMxy_SP_ActvClient_ST35 shall be written and send to CAN.");
  AddRequirementInfo("ARCH_SW_CIL_0104", "Signal RBTMxy_SP_ActvClient_ST35 shall be 0x0F dring initialization phase.");
  //***************************************************************************************
    
  testCaseComment("Preconditions");
  testStep("STEP", "Bench Initialization");

  RunPreTs();
  
    
    testCaseComment("Action: ARCH_SW_CIL_0104");
    testStep("STEP", "Check if variable CIL_u8Actv_Client is equal to I_C04_RBTM_ACTVCLIENT_SNA. -->  I_C04_RBTM_ACTVCLIENT_SNA (0x0F)");
    result = debugger_readGlobalVariable("uint8", "CIL_u8Actv_Client,,app.elf", 0);
    EvalManStepEqual("Expected Test Result", result, 0);
  
  
    testStep("STEP", "Set signal RBTMFL_SP_Lvl_Rq_ST35 to I_C04_PRESF_LVL_V2_NOLVL.");
    setSignal(BODY3::RBTMFL_SP_Lvl_Rq_ST35, 0);
    testWaitForTimeout(500);
    
    
    testStep("STEP", "Set a breakpoint in function CIL_runAppliToCAN().");
    debugger_setRelativeFunctionBpAtLine("CIL_runAppliToCAN", 0);
  
    testStep("STEP", "Check if CPU stopped in function CIL_runAppliToCAN(). --> CPU is Stopped");
debugger_isCPUStoppedAtFunction("CIL_runAppliToCAN");    ////EvalManStepEqual("Expected Test Result", debugger_result, "CPU is Stopped");
  
  
    debugger_deleteAllBP();

    
    testStep("STEP", "Set a breakpoint in function cil_ManageActiveClientRequestSource() at line '(void)Rte_Write_CIL_AC_CommunicationInteractionLayer_P_RBTMFL_SP_ActvClient_ST35_RBTMFL_SP_ActvClient_ST35(CIL_u8Actv_Client);'.");
    debugger_setBpAtLine("s:\\Components\\Application\\Autoliv\\CIL\\Implementation\\src\\CIL_AppliToCAN.c", 431);
    
    debugger_run();
  
    testStep("STEP", "Check if CPU stopped at line '(void)Rte_Write_CIL_AC_CommunicationInteractionLayer_P_RBTMFL_SP_ActvClient_ST35_RBTMFL_SP_ActvClient_ST35(CIL_u8Actv_Client);'. --> CPU is Stopped");
    debugger_isCPUStoppedAtFunction("cil_ManageActiveClientRequestSource");
    ////EvalManStepEqual("Expected Test Result", debugger_result, "CPU is Stopped");
    
    
    testCaseComment("Action: ARCH_SW_CIL_0098, ARCH_SW_CIL_0099");
    testStep("STEP", "Check if signal RBTMFL_SP_ActvClient_ST35 value is I_C04_RBTM_ACTVCLIENT_NONE. --> I_C04_RBTM_ACTVCLIENT_NONE");
    EvalManStepEqual("Expected Test Result", $RBTMFL_SP_ActvClient_ST35.raw64, 0);
  
  
  testCaseComment("Postcondition");
  testStep("STEP", "Return ECU to default values");
  RunPostTs();
}


testcase SW_IT_CIL_ActiveClient_02()
{
  //***********************************Test report header*********************************
  testReportAddMiscInfoBlock("AUTOLIV ELECTRONICS document");
  TestReportAddMiscInfo("Nightly test", "No");
  TestReportAddMiscInfo("Test type", "Requirement-Based test");
  TestReportAddMiscInfo("Regression Test", "No");
  TestReportAddMiscInfo("Fault injection method used", "No");
  TestReportAddMiscInfo("Resource usage evaluation", "No");
  TestReportAddMiscInfo("Priority", "No");
  TestReportAddMiscInfo("Safety relevant", "No");
  
  AddRequirementInfo("Requirement under test", "ARCH_SW_CIL_0100");
  AddRequirementInfo("ARCH_SW_CIL_0100", "When executed cycle is requested on PRESAFE, signal RBTMxy_SP_ActvClient_ST35 shall be 1, as long as profile and next cycle is executed.");
  //***************************************************************************************
    
  testCaseComment("Preconditions");
  testStep("STEP", "Bench Initialization");
  RunPreTs();
  
  
    testStep("STEP", "Set signal Presf_Lvl_ST3 to I_C04_PRESF_LVL_V2_LVL1.");
    setSignal(BODY3::Presf_Lvl_ST3, 1);
    testWaitForTimeout(500);
    
    testStep("STEP", "Set a breakpoint in function CIL_runAppliToCAN().");
    debugger_setRelativeFunctionBpAtLine("CIL_runAppliToCAN", 0);
  
    testStep("STEP", "Check if CPU stopped in function CIL_runAppliToCAN(). --> CPU is Stopped");
debugger_isCPUStoppedAtFunction("CIL_runAppliToCAN");    ////EvalManStepEqual("Expected Test Result", debugger_result, "CPU is Stopped");
  
  
    debugger_deleteAllBP();

    
    testStep("STEP", "Set a breakpoint in function cil_ManageActiveClientRequestSource() at line '(void)Rte_Write_CIL_AC_CommunicationInteractionLayer_P_RBTMFL_SP_ActvClient_ST35_RBTMFL_SP_ActvClient_ST35(CIL_u8Actv_Client);'.");
    debugger_setBpAtLine("s:\\Components\\Application\\Autoliv\\CIL\\Implementation\\src\\CIL_AppliToCAN.c", 431);
    
    debugger_run();
  
    testStep("STEP", "Check if CPU stopped at line '(void)Rte_Write_CIL_AC_CommunicationInteractionLayer_P_RBTMFL_SP_ActvClient_ST35_RBTMFL_SP_ActvClient_ST35(CIL_u8Actv_Client);'. --> CPU is Stopped");
    debugger_isCPUStoppedAtFunction("cil_ManageActiveClientRequestSource");
    ////EvalManStepEqual("Expected Test Result", debugger_result, "CPU is Stopped");
    
    
    testCaseComment("Action: ARCH_SW_CIL_0100");
    testStep("STEP", "Check if signal RBTMFL_SP_ActvClient_ST35 value is I_C04_RBTM_ACTVCLIENT_PRESAFE. --> I_C04_RBTM_ACTVCLIENT_PRESAFE (0x1)");
    EvalManStepEqual("Expected Test Result", $RBTMFL_SP_ActvClient_ST35.raw64, 1);
  
  
  testCaseComment("Postcondition");
  testStep("STEP", "Return ECU to default values");
  setSignal(BODY3::Presf_Lvl_ST3, 0);
  RunPostTs();
}


testcase SW_IT_CIL_ActiveClient_03()
{
  //***********************************Test report header*********************************
  testReportAddMiscInfoBlock("AUTOLIV ELECTRONICS document");
  TestReportAddMiscInfo("Nightly test", "No");
  TestReportAddMiscInfo("Test type", "Requirement-Based test");
  TestReportAddMiscInfo("Regression Test", "No");
  TestReportAddMiscInfo("Fault injection method used", "No");
  TestReportAddMiscInfo("Resource usage evaluation", "No");
  TestReportAddMiscInfo("Priority", "No");
  TestReportAddMiscInfo("Safety relevant", "No");
  
  AddRequirementInfo("Requirement under test", "ARCH_SW_CIL_0179");
  AddRequirementInfo("ARCH_SW_CIL_0179", "When executed cycle is requested on ORC ( via Impact ro type), signal RBTMxy_SP_ActvClient_ST35 shall be 2, as long as profile and next cycle is executed.");
  //***************************************************************************************
  
  testCaseComment("Preconditions");
  testStep("STEP", "Bench Initialization");
  RunPreTs();
  
     
    testStep("STEP", "Set a breakpoint in function CIL_runAppliToCAN().");
    debugger_setRelativeFunctionBpAtLine("CIL_runAppliToCAN", 0);
  
    testStep("STEP", "Set signal Impact_RO_type2_ST3 to KU8_ONE.");
    setSignal(BODY3::Impact_RO_type2_ST3, 1);
    testWaitForTimeout(250);
  
    testStep("STEP", "Check if CPU stopped in function CIL_runAppliToCAN(). --> CPU is Stopped");
    debugger_isCPUStoppedAtFunction("CIL_runAppliToCAN");
    
    
    debugger_deleteAllBP();
    
      
    testStep("STEP", "Set a breakpoint in function cil_ManageActiveClientRequestSource() at line '(void)Rte_Write_CIL_AC_CommunicationInteractionLayer_P_RBTMFL_SP_ActvClient_ST35_RBTMFL_SP_ActvClient_ST35(CIL_u8Actv_Client);'.");
    debugger_setBpAtLine("s:\\Components\\Application\\Autoliv\\CIL\\Implementation\\src\\CIL_AppliToCAN.c", 463);
    
    debugger_run();
  
    testStep("STEP", "Check if CPU stopped at line '(void)Rte_Write_CIL_AC_CommunicationInteractionLayer_P_RBTMFL_SP_ActvClient_ST35_RBTMFL_SP_ActvClient_ST35(CIL_u8Actv_Client);'. --> CPU is Stopped");
    debugger_WaitUntilBPisReached(1000);
    
    
    debugger_deleteAllBP();
    debugger_run();
    
    
    testCaseComment("Action: ARCH_SW_CIL_0179");
    testStep("STEP", "Check if signal RBTMFL_SP_ActvClient_ST35 value is I_C04_RBTM_ACTVCLIENT_POSTCRASH. --> I_C04_RBTM_ACTVCLIENT_POSTCRASH (0x2)");
    EvalManStepEqual("Expected Test Result", $RBTMFL_SP_ActvClient_ST35.raw64, 2);
  
  
  testCaseComment("Postcondition");
  testStep("STEP", "Return ECU to default values");
  setSignal(BODY3::Impact_RO_type2_ST3, 0);
  RunPostTs();
}


testcase SW_IT_CIL_ActiveClient_04()
{
  //***********************************Test report header*********************************
  testReportAddMiscInfoBlock("AUTOLIV ELECTRONICS document");
  TestReportAddMiscInfo("Nightly test", "No");
  TestReportAddMiscInfo("Test type", "Requirement-Based test");
  TestReportAddMiscInfo("Regression Test", "No");
  TestReportAddMiscInfo("Fault injection method used", "No");
  TestReportAddMiscInfo("Resource usage evaluation", "No");
  TestReportAddMiscInfo("Priority", "No");
  TestReportAddMiscInfo("Safety relevant", "No");
  
  AddRequirementInfo("Requirement under test", "ARCH_SW_CIL_0101");
  AddRequirementInfo("ARCH_SW_CIL_0101", "When executed cycle is requested on API, signal RBTMxy_SP_ActvClient_ST35 shall be 3, as long as profile and next cycle is executed.");
  //***************************************************************************************
    
  testCaseComment("Preconditions");
  testStep("STEP", "Bench Initialization");
  RunPreTs();
  
    testStep("STEP", "Set signal RBTMFL_SP_Lvl_Rq_ST35 to I_C06_RBTM_LVL_RQ_PROFILE1.");
    setSignal(BODY3::RBTMFL_SP_Lvl_Rq_ST35, 1);
    testWaitForTimeout(500);
  

    testStep("STEP", "Set a breakpoint in function CIL_runAppliToCAN().");
    debugger_setRelativeFunctionBpAtLine("CIL_runAppliToCAN", 0);
  
    testStep("STEP", "Check if CPU stopped in function CIL_runAppliToCAN(). --> CPU is Stopped");
debugger_isCPUStoppedAtFunction("CIL_runAppliToCAN");    ////EvalManStepEqual("Expected Test Result", debugger_result, "CPU is Stopped");
  
  
    debugger_deleteAllBP();

    
    testStep("STEP", "Set a breakpoint in function cil_ManageActiveClientRequestSource() at line '(void)Rte_Write_CIL_AC_CommunicationInteractionLayer_P_RBTMFL_SP_ActvClient_ST35_RBTMFL_SP_ActvClient_ST35(CIL_u8Actv_Client);'.");
    debugger_setBpAtLine("s:\\Components\\Application\\Autoliv\\CIL\\Implementation\\src\\CIL_AppliToCAN.c", 431);
    
    debugger_run();
  
    testStep("STEP", "Check if CPU stopped at line '(void)Rte_Write_CIL_AC_CommunicationInteractionLayer_P_RBTMFL_SP_ActvClient_ST35_RBTMFL_SP_ActvClient_ST35(CIL_u8Actv_Client);'. --> CPU is Stopped");
    debugger_isCPUStoppedAtFunction("cil_ManageActiveClientRequestSource");
    ////EvalManStepEqual("Expected Test Result", debugger_result, "CPU is Stopped");
    
    
    testCaseComment("Action: ARCH_SW_CIL_0101");
    testStep("STEP", "Check if signal RBTMFL_SP_ActvClient_ST35 value is I_C04_RBTM_ACTVCLIENT_SERVICE_PROVIDER. --> I_C04_RBTM_ACTVCLIENT_SERVICE_PROVIDER (0x3)");
    EvalManStepEqual("Expected Test Result", $RBTMFL_SP_ActvClient_ST35.raw64, 3);
  
  
  testCaseComment("Postcondition");
  testStep("STEP", "Return ECU to default values");
  setSignal(BODY3::RBTMFL_SP_Lvl_Rq_ST35, 0);
  RunPostTs();
}


testcase SW_IT_CIL_ActiveClient_05()
{
  //***********************************Test report header*********************************
  testReportAddMiscInfoBlock("AUTOLIV ELECTRONICS document");
  TestReportAddMiscInfo("Nightly test", "No");
  TestReportAddMiscInfo("Test type", "Requirement-Based test");
  TestReportAddMiscInfo("Regression Test", "No");
  TestReportAddMiscInfo("Fault injection method used", "No");
  TestReportAddMiscInfo("Resource usage evaluation", "No");
  TestReportAddMiscInfo("Priority", "No");
  TestReportAddMiscInfo("Safety relevant", "No");
  
  AddRequirementInfo("Requirement under test", "ARCH_SW_CIL_0102, ARCH_SW_CIL_0068");
  AddRequirementInfo("ARCH_SW_CIL_0102", "When executed cycle is BSR 1, signal RBTMxy_SP_ActvClient_ST35 shall be 4, as long as profile and next cycle is executed.");
  AddRequirementInfo("ARCH_SW_CIL_0068", "If BSR1(cycle 26) is executed (and his next cycle ) then RBTM _FL/FR Actv_Lvl_ST35 should be 0x13 = “BSR1” no matter the source of the request: API interface, PRE-SAFE interface.");
  //***************************************************************************************
    
  testCaseComment("Preconditions");
  testStep("STEP", "Bench Initialization");
  RunPreTs();
  
  
    testStep("STEP", "Set signal PT4_PTCoor_PT_Rdy_ST3 to RDY.");
    setSignal(BODY3::PT4_PTCoor4_ST3::PT4_PTCoor_PT_Rdy_ST3, 1); 
    testWaitForTimeoutSilent(100);
  
    testStep("STEP", "Set signal Bckl_Sw_D_Stat_ST3 to I_C02_BCKL_SW_STAT_NOT.");
    setSignal(BODY3::Bckl_Sw_D_Stat_ST3, 1);
  
    testWaitForTimeout(100);
  
    testStep("STEP", "Set signal Bckl_Sw_D_Stat_ST3 to I_C02_BCKL_SW_STAT_OK.");
    setSignal(BODY3::Bckl_Sw_D_Stat_ST3, 0);
    
  
    while ($RBTMFL_SP_ActvClient_ST35.raw64 == 0)
    {
      testWaitForTimeoutSilent(10);
    }
    
    result = $RBTMFL_SP_ActvClient_ST35.raw64;
  
    
    testStep("STEP", "Set a breakpoint in function CIL_runAppliToCAN().");
    debugger_setRelativeFunctionBpAtLine("CIL_runAppliToCAN", 0);
  
    testStep("STEP", "Check if CPU stopped in function CIL_runAppliToCAN(). --> CPU is Stopped");
debugger_isCPUStoppedAtFunction("CIL_runAppliToCAN");    ////EvalManStepEqual("Expected Test Result", debugger_result, "CPU is Stopped");
  
  
    debugger_deleteAllBP();

    
    testStep("STEP", "Set a breakpoint in function cil_ManageActiveClientRequestSource() at line '(void)Rte_Write_CIL_AC_CommunicationInteractionLayer_P_RBTMFL_SP_ActvClient_ST35_RBTMFL_SP_ActvClient_ST35(CIL_u8Actv_Client);'.");
    debugger_setBpAtLine("s:\\Components\\Application\\Autoliv\\CIL\\Implementation\\src\\CIL_AppliToCAN.c", 431);
    
    debugger_run();
  
    testCaseComment("Action: ARCH_SW_CIL_0068");
    testStep("STEP", "Check if CPU stopped at line '(void)Rte_Write_CIL_AC_CommunicationInteractionLayer_P_RBTMFL_SP_ActvClient_ST35_RBTMFL_SP_ActvClient_ST35(CIL_u8Actv_Client);'. --> CPU is Stopped");
    debugger_isCPUStoppedAtFunction("cil_ManageActiveClientRequestSource");
    ////EvalManStepEqual("Expected Test Result", debugger_result, "CPU is Stopped");
    
  
    debugger_deleteAllBP();
    debugger_run();
  
    
    testCaseComment("Action: ARCH_SW_CIL_0102");
    testStep("STEP", "Check if signal RBTMFL_SP_ActvClient_ST35 value is I_C04_RBTM_ACTVCLIENT_BELTSLACK_REDUCTION. --> I_C04_RBTM_ACTVCLIENT_BELTSLACK_REDUCTION (0x4)");
    EvalManStepEqual("Expected Test Result", result, 4);
  
 
  testCaseComment("Postcondition");
  testStep("STEP", "Return ECU to default values");
  setSignal(BODY3::RBTMFL_SP_Lvl_Rq_ST35, 0);
  RunPostTs(); 
}


testcase SW_IT_CIL_ActiveClient_06()
{
  //***********************************Test report header*********************************
  testReportAddMiscInfoBlock("AUTOLIV ELECTRONICS document");
  TestReportAddMiscInfo("Nightly test", "No");
  TestReportAddMiscInfo("Test type", "Requirement-Based test");
  TestReportAddMiscInfo("Regression Test", "No");
  TestReportAddMiscInfo("Fault injection method used", "No");
  TestReportAddMiscInfo("Resource usage evaluation", "No");
  TestReportAddMiscInfo("Priority", "No");
  TestReportAddMiscInfo("Safety relevant", "No");
  
  AddRequirementInfo("Requirement under test", "ARCH_SW_CIL_0103");
  AddRequirementInfo("ARCH_SW_CIL_0103", "When executed cycle is requested on another source, signal RBTMxy_SP_ActvClient_ST35 shall be 6, as long as profile and next cycle is executed.");
  //***************************************************************************************
  
  testCaseComment("Preconditions");
  testStep("STEP", "Bench Initialization");
  RunPreTs();


  
    testStep("STEP", "Set a breakpoint in function CIL_runAppliToCAN() under line 'cil_ManageActiveClientRequestSource(u8ExecutedCycle,u8SelectedCycle);'.");
    debugger_setRelativeFunctionBpAtLine("CIL_runAppliToCAN", 33);
  
    testStep("STEP", "Check if CPU stopped in function CIL_runAppliToCAN() under line 'cil_ManageActiveClientRequestSource(u8ExecutedCycle,u8SelectedCycle);'. --> CPU is Stopped");
    debugger_WaitUntilBPisReached(1000);
  
  
    debugger_deleteAllBP();

    
    testStep("STEP", "Set a breakpoint in function cil_ManageActiveClientRequestSource() at line 'if (I_C04_RBTM_ACTVCLIENT_NONE == Rte_IrvRead_CIL_runAppliToCAN_u8RequestSource())'.");
    debugger_setBpAtLine("s:\\Components\\Application\\Autoliv\\CIL\\Implementation\\src\\CIL_AppliToCAN.c", 407);
    
    debugger_run();
  
    testStep("STEP", "Check if CPU stopped in function cil_ManageActiveClientRequestSource() at line 'if (I_C04_RBTM_ACTVCLIENT_NONE == Rte_IrvRead_CIL_runAppliToCAN_u8RequestSource())'. --> CPU is Stopped");
    debugger_WaitUntilBPisReached(1000);
    
  
    testStep("STEP", "Set variable Rte_Irv_CIL_u8RequestSource to I_C04_RBTM_ACTVCLIENT_OTHER.");
    debugger_writeGlobalVariable("uint8", "Rte_Irv_CIL_u8RequestSource,,app.elf", 0, 6);
  
  
    debugger_deleteAllBP();
    debugger_run();
  
    
    testCaseComment("Action: ARCH_SW_CIL_0103");
    testStep("STEP", "Check if signal RBTMFL_SP_ActvClient_ST35 value is I_C04_RBTM_ACTVCLIENT_OTHER. --> RBTMFL_SP_ActvClient_ST35 is equal to I_C04_RBTM_ACTVCLIENT_OTHER");
    EvalManStepEqual("Expected Test Result", $RBTMFL_SP_ActvClient_ST35.raw64, 6);
  
  
  testCaseComment("Postcondition");
  testStep("STEP", "Return ECU to default values");
  RunPostTs();
}


testcase SW_IT_CIL_FctPrecond_04()
{
  //***********************************Test report header*********************************
  testReportAddMiscInfoBlock("AUTOLIV ELECTRONICS document");
  TestReportAddMiscInfo("Nightly test", "No");
  TestReportAddMiscInfo("Test type", "Requirement-Based test");
  TestReportAddMiscInfo("Regression Test", "No");
  TestReportAddMiscInfo("Fault injection method used", "No");
  TestReportAddMiscInfo("Resource usage evaluation", "No");
  TestReportAddMiscInfo("Priority", "No");
  TestReportAddMiscInfo("Safety relevant", "No");
  
  AddRequirementInfo("Requirement under test", "ARCH_SW_CIL_0105, ARCH_SW_CIL_0106");
  AddRequirementInfo("ARCH_SW_CIL_0105", "Signal RBTMxy_SP_FctPrecond_Stat_ST35 shall be written and send to CAN.");
  AddRequirementInfo("ARCH_SW_CIL_0106", "Signal should be set to 0 if no setting condition is present.");
  //***************************************************************************************
    
  testCaseComment("Preconditions");
  testStep("STEP", "Bench Initialization");
  RunPreTs();
  
  
    testStep("STEP", "Set a breakpoint in function CIL_runAppliToCAN().");
    debugger_setRelativeFunctionBpAtLine("CIL_runAppliToCAN", 0);
  
    testStep("STEP", "Check if CPU stopped in function CIL_runAppliToCAN(). --> CPU is Stopped");
debugger_isCPUStoppedAtFunction("CIL_runAppliToCAN");    ////EvalManStepEqual("Expected Test Result", debugger_result, "CPU is Stopped");
  
  
    debugger_deleteAllBP();

  
    testStep("STEP", "Set a breakpoint in function cil_ManageFctPrecondSignal() at line '(void)Rte_Write_CIL_AC_CommunicationInteractionLayer_P_RBTMFL_SP_FctPrecond_Stat_ST35_RBTMFL_SP_FctPrecond_Stat_ST35(cil_u16Fct_Precond);'.");
    debugger_setBpAtLine("s:\\Components\\Application\\Autoliv\\CIL\\Implementation\\src\\CIL_AppliToCAN.c", 346);
    
    debugger_run();
  
    testCaseComment("Action: ARCH_SW_CIL_0105");
    testStep("STEP", "Check if CPU stopped in function cil_ManageFctPrecondSignal() at line '(void)Rte_Write_CIL_AC_CommunicationInteractionLayer_P_RBTMFL_SP_FctPrecond_Stat_ST35_RBTMFL_SP_FctPrecond_Stat_ST35(cil_u16Fct_Precond);'. --> CPU is Stopped");
debugger_isCPUStoppedAtFunction("cil_ManageFctPrecondSignal");    ////EvalManStepEqual("Expected Test Result", debugger_result, "CPU is Stopped");
  
  
    debugger_deleteAllBP();
    debugger_run();
    
  
    testCaseComment("Action: ARCH_SW_CIL_0105, ARCH_SW_CIL_0106");
    testStep("STEP", "Check if signal RBTMFL_SP_FctPrecond_Stat_ST35 value is I_C02_BCKL_SW_STAT_OK. --> I_C02_BCKL_SW_STAT_OK");
    EvalManStepEqual("Expected Test Result", $RBTMFL_SP_FctPrecond_Stat_ST35.raw64, 0);
  
  
  testCaseComment("Postcondition");
  testStep("STEP", "Return ECU to default values");
  RunPostTs();
}


testcase SW_IT_CIL_FctPrecond_05()
{
  //***********************************Test report header*********************************
  testReportAddMiscInfoBlock("AUTOLIV ELECTRONICS document");
  TestReportAddMiscInfo("Nightly test", "No");
  TestReportAddMiscInfo("Test type", "Requirement-Based test");
  TestReportAddMiscInfo("Regression Test", "No");
  TestReportAddMiscInfo("Fault injection method used", "No");
  TestReportAddMiscInfo("Resource usage evaluation", "No");
  TestReportAddMiscInfo("Priority", "No");
  TestReportAddMiscInfo("Safety relevant", "No");
  
  AddRequirementInfo("Requirement under test", "ARCH_SW_CIL_0107");
  AddRequirementInfo("ARCH_SW_CIL_0107", "Bit 0 from signal RBTMxy_SP_FctPrecond_Stat_ST35 shall be set to 1 if belt is not buckled. (Bckl_SW_D/FP_STAT_St3).");
  //***************************************************************************************
    
  testCaseComment("Preconditions");
  testStep("STEP", "Bench Initialization");
  RunPreTs();
  
  
    testStep("STEP", "Set signal Bckl_Sw_D_Stat_ST3 to I_C02_BCKL_SW_STAT_NOT.");
    setSignal(BODY3::Bckl_Sw_D_Stat_ST3, 1);
  
  
    testStep("STEP", "Set a breakpoint in function CIL_runAppliToCAN().");
    debugger_setRelativeFunctionBpAtLine("CIL_runAppliToCAN", 0);
  
    testStep("STEP", "Check if CPU stopped in function CIL_runAppliToCAN(). --> CPU is Stopped");
    debugger_WaitUntilBPisReached(1000);
  
  
    debugger_deleteAllBP();
  
  
    testStep("STEP", "Set a breakpoint in function cil_ManageFctPrecondSignal() at line '(void)Rte_Write_CIL_AC_CommunicationInteractionLayer_P_RBTMFL_SP_FctPrecond_Stat_ST35_RBTMFL_SP_FctPrecond_Stat_ST35(cil_u16Fct_Precond);'.");
    debugger_setRelativeFunctionBpAtLine("cil_ManageFctPrecondSignal", 129);
    
    debugger_run();
  
    testCaseComment("Action: ARCH_SW_CIL_0107");
    testStep("STEP", "Check if CPU stopped in function cil_ManageFctPrecondSignal() at line '(void)Rte_Write_CIL_AC_CommunicationInteractionLayer_P_RBTMFL_SP_FctPrecond_Stat_ST35_RBTMFL_SP_FctPrecond_Stat_ST35(cil_u16Fct_Precond);'. --> CPU is Stopped");
    debugger_WaitUntilBPisReached(1000);
  
  
    debugger_deleteAllBP();
    debugger_run();
  
    
    testCaseComment("Action: ARCH_SW_CIL_0107");
    testStep("STEP", "Check if signal RBTMFL_SP_FctPrecond_Stat_ST35 value is I_C02_BCKL_SW_STAT_NOT. --> I_C02_BCKL_SW_STAT_NOT");
    EvalManStepEqual("Expected Test Result", $RBTMFL_SP_FctPrecond_Stat_ST35.raw64, 1);
  
  
  testCaseComment("Postcondition");
  testStep("STEP", "Return ECU to default values");
  setSignal(BODY3::Bckl_Sw_D_Stat_ST3, 0);
  RunPostTs();
}


testcase SW_IT_CIL_FctPrecond_06()
{
  //***********************************Test report header*********************************
  testReportAddMiscInfoBlock("AUTOLIV ELECTRONICS document");
  TestReportAddMiscInfo("Nightly test", "No");
  TestReportAddMiscInfo("Test type", "Requirement-Based test");
  TestReportAddMiscInfo("Regression Test", "No");
  TestReportAddMiscInfo("Fault injection method used", "No");
  TestReportAddMiscInfo("Resource usage evaluation", "No");
  TestReportAddMiscInfo("Priority", "No");
  TestReportAddMiscInfo("Safety relevant", "No");
  
  AddRequirementInfo("Requirement under test", "ARCH_SW_CIL_0180");
  AddRequirementInfo("ARCH_SW_CIL_0180", "Bit 3 from signal RBTMxy_SP_FctPrecond_Stat_ST35 shall be set to 1 when DTC B228B49: ECU is defective is qualified. Or ?	B228B71: System is defective.");
  //***************************************************************************************
    
  testCaseComment("Preconditions");
  testStep("STEP", "Bench Initialization");
  RunPreTs();

  
    testStep("STEP", "Set a breakpoint in function cil_ManageFctPrecondSignal() at line 'if (KU32_ZERO != (u32AECGroupStatus & CIL_KU32_AEC_MASK_HW_FAILURE))'.");
    debugger_setRelativeFunctionBpAtLine("cil_ManageFctPrecondSignal", 41);
  
    testStep("STEP", "Check if CPU stopped in function cil_ManageFctPrecondSignal() at line 'if (KU32_ZERO != (u32AECGroupStatus & CIL_KU32_AEC_MASK_HW_FAILURE))'. --> CPU is Stopped");
debugger_isCPUStoppedAtFunction("cil_ManageFctPrecondSignal");    ////EvalManStepEqual("Expected Test Result", debugger_result, "CPU is Stopped");
  
  
    testStep("STEP", "Set variable u32AECGroupStatus to CIL_KU32_AEC_MASK_HW_FAILURE.");
    debugger_writeLocalVariable("u32AECGroupStatus", 1);
    
  
    debugger_deleteAllBP();
  
  
    testStep("STEP", "Set a breakpoint in function cil_ManageFctPrecondSignal() at line 'CIL_SET_FCT_COND_MASK_ON (c10_RBTM_Fct_Precond_Internal_failure_BflMask);'.");
    debugger_setRelativeFunctionBpAtLine("cil_ManageFctPrecondSignal", 43);
  
    debugger_run();
  
    testCaseComment("Action: ARCH_SW_CIL_0180");
    testStep("STEP", "Check if CPU stopped in function cil_ManageFctPrecondSignal() at line 'CIL_SET_FCT_COND_MASK_ON (c10_RBTM_Fct_Precond_Internal_failure_BflMask);'. --> CPU is Stopped");
debugger_isCPUStoppedAtFunction("cil_ManageFctPrecondSignal");    ////EvalManStepEqual("Expected Test Result", debugger_result, "CPU is Stopped");
  
  
  testCaseComment("Postcondition");
  testStep("STEP", "Return ECU to default values");
  RunPostTs();
}


testcase SW_IT_CIL_FctPrecond_07()
{
  //***********************************Test report header*********************************
  testReportAddMiscInfoBlock("AUTOLIV ELECTRONICS document");
  TestReportAddMiscInfo("Nightly test", "No");
  TestReportAddMiscInfo("Test type", "Requirement-Based test");
  TestReportAddMiscInfo("Regression Test", "No");
  TestReportAddMiscInfo("Fault injection method used", "No");
  TestReportAddMiscInfo("Resource usage evaluation", "No");
  TestReportAddMiscInfo("Priority", "No");
  TestReportAddMiscInfo("Safety relevant", "No");
  
  AddRequirementInfo("Requirement under test", "ARCH_SW_CIL_0108");
  AddRequirementInfo("ARCH_SW_CIL_0108", "Bit 2 from signal RBTMxy_SP_FctPrecond_Stat_ST35 shall be set to 1 if DTC B228B4B is set (Overtemperature group error).");
  //***************************************************************************************
    
  testCaseComment("Preconditions");
  testStep("STEP", "Bench Initialization");
  RunPreTs();
  
  
    testStep("STEP", "Set a breakpoint in function cil_ManageFctPrecondSignal() at line 'CIL_SET_FCT_COND_MASK_ON(c10_RBTM_Fct_Precond_Overtemperature_BflMask);'.");
    debugger_setBpAtLine("s:\\Components\\Application\\Autoliv\\CIL\\Implementation\\src\\CIL_AppliToCAN.c", 277);
    
    testStep("STEP", "Check if CPU stopped in function cil_ManageFctPrecondSignal() at line 'if (KU32_ZERO != (u32AECGroupStatus&KU32_AEC_GROUP_MASK_SELF_PROTECTION))'. --> CPU is Stopped");
debugger_isCPUStoppedAtFunction("cil_ManageFctPrecondSignal");    ////EvalManStepEqual("Expected Test Result", debugger_result, "CPU is Stopped");
  
    testStep("STEP", "Set variable u32AECGroupStatus to KU32_AEC_GROUP_MASK_SELF_PROTECTION.");
    debugger_writeLocalVariable("u32AECGroupStatus", 2048);

  
    debugger_deleteAllBP();
  
  
    testStep("STEP", "Set a breakpoint in function cil_ManageFctPrecondSignal() at line 'CIL_SET_FCT_COND_MASK_ON(c10_RBTM_Fct_Precond_Overtemperature_BflMask);'.");
    debugger_setBpAtLine("s:\\Components\\Application\\Autoliv\\CIL\\Implementation\\src\\CIL_AppliToCAN.c", 280);
    
    debugger_run();
  
    testCaseComment("Action: ARCH_SW_CIL_0108");
    testStep("STEP", "Check if CPU stopped in function cil_ManageFctPrecondSignal() at line 'CIL_SET_FCT_COND_MASK_ON(c10_RBTM_Fct_Precond_Overtemperature_BflMask);'. --> CPU is Stopped");
debugger_isCPUStoppedAtFunction("cil_ManageFctPrecondSignal");    ////EvalManStepEqual("Expected Test Result", debugger_result, "CPU is Stopped");
  
  
  testCaseComment("Postcondition");
  testStep("STEP", "Return ECU to default values");
  RunPostTs();
}


testcase SW_IT_CIL_CheckTimeoutError_01()
{
  //***********************************Test report header*********************************
  testReportAddMiscInfoBlock("AUTOLIV ELECTRONICS document");
  TestReportAddMiscInfo("Nightly test", "No");
  TestReportAddMiscInfo("Test type", "Requirement-Based test");
  TestReportAddMiscInfo("Regression Test", "No");
  TestReportAddMiscInfo("Fault injection method used", "No");
  TestReportAddMiscInfo("Resource usage evaluation", "No");
  TestReportAddMiscInfo("Priority", "No");
  TestReportAddMiscInfo("Safety relevant", "No");
  
  AddRequirementInfo("Requirement under test", "ARCH_SW_CIL_0800");
  AddRequirementInfo("ARCH_SW_CIL_0800", "CIL shall check if timeout is present for Presafe frame.");
  //***************************************************************************************
    
  testCaseComment("Preconditions");
  testStep("STEP", "Bench Initialization");
  RunPreTs();
  
  
    testStep("STEP", "Set signal PresfAct_Adj_ST3 to I_C04_PRESF_LVL_V2_SNA.");
    setSignal(BODY3::PresfAct_Adj_ST3::Presf_Lvl_ST3, I_C04_PRESF_LVL_V2_SNA);
    testWaitForTimeout(500);
    
  
    testStep("STEP", "Set a breakpoint in function CIL_Autotest_Presafe_CheckTimeoutError( ) at line *pu8TestResult = cil_u8ResultOfAutoTest;.");
    debugger_setRelativeFunctionBpAtLine("CIL_Autotest_Presafe_CheckTimeoutError", 61);
    
    testCaseComment("Action: ARCH_SW_CIL_0800");
    testStep("STEP", "Check if CPU stopped at line *pu8TestResult = cil_u8ResultOfAutoTest;. --> CPU is Stopped");
    debugger_WaitUntilBPisReached(1000);
    
  
    testCaseComment("Action: ARCH_SW_CIL_0800");
    testStep("STEP", "Evaluate variable *pu8TestResult. --> KU8_ATM_TEST_OK");
    result = debugger_readLocalVariable("*(pu8TestResult)");
    EvalManStepEqual("Expected Test Result", result, 1);
  
  
  testCaseComment("Postcondition");
  testStep("STEP", "Return ECU to default values");
  setSignal(BODY3::PresfAct_Adj_ST3::Presf_Lvl_ST3, I_C04_PRESF_LVL_V2_NOLVL);
  RunPostTs();
}


testcase SW_IT_CIL_CheckTimeoutError_02()
{
  //***********************************Test report header*********************************
  testReportAddMiscInfoBlock("AUTOLIV ELECTRONICS document");
  TestReportAddMiscInfo("Nightly test", "No");
  TestReportAddMiscInfo("Test type", "Requirement-Based test");
  TestReportAddMiscInfo("Regression Test", "No");
  TestReportAddMiscInfo("Fault injection method used", "No");
  TestReportAddMiscInfo("Resource usage evaluation", "No");
  TestReportAddMiscInfo("Priority", "No");
  TestReportAddMiscInfo("Safety relevant", "No");
  
  AddRequirementInfo("Requirement under test", "ARCH_SW_CIL_0801");
  AddRequirementInfo("ARCH_SW_CIL_0801", "CIL shall check if timeout is present for Buckle frame.");
  //***************************************************************************************
    
  testCaseComment("Preconditions");
  testStep("STEP", "Bench Initialization");
  RunPreTs(); 
  
  
    testStep("STEP", "Set signal Bckl_Sw_D_Stat_ST3 to I_C02_BCKL_SW_STAT_SNA (0x3).");
    setSignal(BODY3::Bckl_Sw_D_Stat_ST3, 3);
    testWaitForTimeout(500);
    
  
    testStep("STEP", "Set a breakpoint in function CIL_Autotest_Buckle_CheckTimeoutError() at line *pu8TestResult = cil_u8ResultOfAutoTest;.");
    debugger_setRelativeFunctionBpAtLine("CIL_Autotest_Buckle_CheckTimeoutError", 61);
    
    testCaseComment("Action: ARCH_SW_CIL_0801");
    testStep("STEP", "Check if CPU stopped at line *pu8TestResult = cil_u8ResultOfAutoTest;. --> CPU is Stopped");
    debugger_WaitUntilBPisReached(1000);
    
    
    testCaseComment("Action: ARCH_SW_CIL_0801");
    testStep("STEP", "Evaluate variable *pu8TestResult. --> KU8_ATM_TEST_OK");
    result = debugger_readLocalVariable("*(pu8TestResult)");
    EvalManStepEqual("Expected Test Result", result, 1);

  
  testCaseComment("Postcondition");
  testStep("STEP", "Return ECU to default values");
  setSignal(BODY3::Bckl_Sw_D_Stat_ST3, 0);
  RunPostTs();
}


testcase SW_IT_CIL_CheckTimeoutError_03()
{
  //***********************************Test report header*********************************
  testReportAddMiscInfoBlock("AUTOLIV ELECTRONICS document");
  TestReportAddMiscInfo("Nightly test", "No");
  TestReportAddMiscInfo("Test type", "Requirement-Based test");
  TestReportAddMiscInfo("Regression Test", "No");
  TestReportAddMiscInfo("Fault injection method used", "No");
  TestReportAddMiscInfo("Resource usage evaluation", "No");
  TestReportAddMiscInfo("Priority", "No");
  TestReportAddMiscInfo("Safety relevant", "No");
  
  AddRequirementInfo("Requirement under test", "ARCH_SW_CIL_0199");
  AddRequirementInfo("ARCH_SW_CIL_0199", "CIL shall check if timeout is present for Ignition frame.");
  //***************************************************************************************
    
  testCaseComment("Preconditions");
  testStep("STEP", "Bench Initialization");
  RunPreTs();
  
  
    testStep("STEP", "Set signal ISw_Stat_ST3 to I_C03_ISW_STAT_SNA (0x7).");
    setSignal(BODY3::Ign_Stat_ST3::ISw_Stat_ST3, 7);
    testWaitForTimeout(500);
  
  
    testStep("STEP", "Set a breakpoint in function CIL_Autotest_CheckTimeoutError_Ignition at line *pu8TestResult = cil_u8ResultOfAutoTest;.");
    debugger_setRelativeFunctionBpAtLine("CIL_Autotest_CheckTimeoutError_Ignition", 11);
    
    testCaseComment("Action: ARCH_SW_CIL_0199");
    testStep("STEP", "Check if CPU stopped at line *pu8TestResult = cil_u8ResultOfAutoTest;. --> CPU is Stopped");
    debugger_WaitUntilBPisReached(1000);
    
  
    testCaseComment("Action: ARCH_SW_CIL_0199");
    testStep("STEP", "Evaluate variable *pu8TestResult. --> KU8_ATM_TEST_OK");
    result = debugger_readLocalVariable("*(pu8TestResult)");
    EvalManStepEqual("Expected Test Result", result, 1);
  

  testCaseComment("Postcondition");
  testStep("STEP", "Return ECU to default values");
  setSignal(BODY3::ISw_Stat_ST3, 4);
  RunPostTs(); 
}


testcase SW_IT_CIL_CheckTimeoutError_04()
{
  //***********************************Test report header*********************************
  testReportAddMiscInfoBlock("AUTOLIV ELECTRONICS document");
  TestReportAddMiscInfo("Nightly test", "No");
  TestReportAddMiscInfo("Test type", "Requirement-Based test");
  TestReportAddMiscInfo("Regression Test", "No");
  TestReportAddMiscInfo("Fault injection method used", "No");
  TestReportAddMiscInfo("Resource usage evaluation", "No");
  TestReportAddMiscInfo("Priority", "No");
  TestReportAddMiscInfo("Safety relevant", "No");
  
  AddRequirementInfo("Requirement under test", "ARCH_SW_CIL_0200");
  AddRequirementInfo("ARCH_SW_CIL_0200", "CIL shall check if timeout is present for Powertrain frame.");
  //***************************************************************************************
    
  testCaseComment("Preconditions");
  testStep("STEP", "Bench Initialization");
  RunPreTs();
  
  
    testStep("STEP", "Set signal PT4_PTCoor_PT_Rdy_ST3 to I_C02_PT_RDY_V2_SNA (0x3).");
    setSignal(BODY3::PT4_PTCoor_PT_Rdy_ST3, I_C02_PT_RDY_V2_SNA);
    testWaitForTimeout(500);
    
  
    testStep("STEP", "Set a breakpoint in function CIL_Autotest_CheckTimeoutError_Powertrain at line '*pu8TestResult = cil_u8ResultOfAutoTest;'.");
    debugger_setRelativeFunctionBpAtLine("CIL_Autotest_CheckTimeoutError_Powertrain", 60);
    
    testCaseComment("Action: ARCH_SW_CIL_0200");
    testStep("STEP", "Check if CPU stopped at line *pu8TestResult = cil_u8ResultOfAutoTest;. --> CPU is Stopped");
    debugger_WaitUntilBPisReached(1000);
    
  
    testCaseComment("Action: ARCH_SW_CIL_0200");
    testStep("STEP", "Evaluate variable *pu8TestResult. --> KU8_ATM_TEST_OK");
    result = debugger_readLocalVariable("*(pu8TestResult)");
    EvalManStepEqual("Expected Test Result", result, 1);
    
    
  testCaseComment("Postcondition");
  testStep("STEP", "Return ECU to default values");
  setSignal(BODY3::PT4_PTCoor_PT_Rdy_ST3, 0);
  RunPostTs(); 
}


testcase SW_IT_CIL_CheckTimeoutError_05()
{
  //***********************************Test report header*********************************
  testReportAddMiscInfoBlock("AUTOLIV ELECTRONICS document");
  TestReportAddMiscInfo("Nightly test", "No");
  TestReportAddMiscInfo("Test type", "Requirement-Based test");
  TestReportAddMiscInfo("Regression Test", "No");
  TestReportAddMiscInfo("Fault injection method used", "No");
  TestReportAddMiscInfo("Resource usage evaluation", "No");
  TestReportAddMiscInfo("Priority", "No");
  TestReportAddMiscInfo("Safety relevant", "No");
  
  AddRequirementInfo("Requirement under test", "ARCH_SW_CIL_0201, ARCH_SW_CIL_0202, ARCH_SW_CIL_0203, ARCH_SW_CIL_0204, ARCH_SW_CIL_0160");
  AddRequirementInfo("ARCH_SW_CIL_0201", "CIL shall check if timeout is present for Belthandover_L frame.");
  AddRequirementInfo("ARCH_SW_CIL_0202", "CIL shall check if BeldHandOver_Availability is enabled or not.");
  AddRequirementInfo("ARCH_SW_CIL_0203", "CIL shall check if timeout is present for Belthandover Right frame.");
  AddRequirementInfo("ARCH_SW_CIL_0204", "CIL shall check if BeldHandOver_Availability is enabled or not.");
  //***************************************************************************************
    
  testCaseComment("Preconditions");
  testStep("STEP", "Bench Initialization");
  RunPreTs();

  
    testStep("STEP", "Set signal BeltHdOvr_FL_Stat_ST3 to I_C02_BELTHDOVL_STAT_SNA (0x3).");
    setSignal(BODY3::BeltHdOvr_FL_Stat_ST3, 3);
    testWaitForTimeout(500);
  
  
    testStep("STEP", "Set a breakpoint in function CIL_Autotest_CheckTimeoutError_BelthandoverL at line 'if(NVP_stVehicleEquipmentData.BltHandOverAvailabiliy != BLTHANDOVER_AVAILABILITY_DISABLED)'.");
    debugger_setRelativeFunctionBpAtLine("CIL_Autotest_CheckTimeoutError_BelthandoverL", 0);
    
    testCaseComment("Action: ARCH_SW_CIL_0202, ARCH_SW_CIL_0203");
    testStep("STEP", "Check if CPU stopped at line 'if(NVP_stVehicleEquipmentData.BltHandOverAvailabiliy != BLTHANDOVER_AVAILABILITY_DISABLED)'. --> CPU is Stopped");
    debugger_WaitUntilBPisReached(1000);
    
    
    testStep("STEP", "Set a breakpoint in function CIL_Autotest_CheckTimeoutError_BelthandoverL at line *pu8TestResult = cil_u8ResultOfAutoTest;.");
    debugger_setRelativeFunctionBpAtLine("CIL_Autotest_CheckTimeoutError_BelthandoverL", 17);
    
    debugger_run();
    testWaitForTimeout(500);
  
    testCaseComment("Action: ARCH_SW_CIL_0201, ARCH_SW_CIL_0160");
    testStep("STEP", "Check if CPU stopped at line *pu8TestResult = cil_u8ResultOfAutoTest;. --> CPU is Stopped");
    debugger_WaitUntilBPisReached(1000);
    
    
    testCaseComment("Action: ARCH_SW_CIL_0201, ARCH_SW_CIL_0204");
    testStep("STEP", "Evaluate variable *pu8TestResult. --> KU8_ATM_TEST_NOK");
    result = debugger_readLocalVariable("*(pu8TestResult)");
    EvalManStepEqual("Expected Test Result", result, 2);
  
  
  testCaseComment("Postcondition");
  testStep("STEP", "Return ECU to default values");
  setSignal(BODY3::BeltHdOvr_FL_Stat_ST3, 0);
  RunPostTs(); 
}


testcase SW_IT_CIL_CheckTimeoutError_06()
{
  //***********************************Test report header*********************************
  testReportAddMiscInfoBlock("AUTOLIV ELECTRONICS document");
  TestReportAddMiscInfo("Nightly test", "No");
  TestReportAddMiscInfo("Test type", "Requirement-Based test");
  TestReportAddMiscInfo("Regression Test", "No");
  TestReportAddMiscInfo("Fault injection method used", "No");
  TestReportAddMiscInfo("Resource usage evaluation", "No");
  TestReportAddMiscInfo("Priority", "No");
  TestReportAddMiscInfo("Safety relevant", "No");
  
  AddRequirementInfo("Requirement under test", "ARCH_SW_CIL_0205");
  AddRequirementInfo("ARCH_SW_CIL_0205", "CIL shall check if timeout is present for API frame.");
  //***************************************************************************************
    
  testCaseComment("Preconditions");
  testStep("STEP", "Bench Initialization");
  RunPreTs();

  
    testStep("STEP", "Set signal RBTMFL_SP_Lvl_Rq_ST35 to I_C06_RBTM_LVL_RQ_SNA (26).");
    setSignal(BODY3::RBTMFL_SP_Lvl_Rq_ST35, 26);
    testWaitForTimeout(500);
  
  
    testStep("STEP", "Set a breakpoint in function CIL_Autotest_CheckTimeoutError_API at line *pu8TestResult = cil_u8ResultOfAutoTest;.");
    debugger_setRelativeFunctionBpAtLine("CIL_Autotest_CheckTimeoutError_API", 11);
  
    testCaseComment("Action: ARCH_SW_CIL_0205");
    testStep("STEP", "Check if CPU stopped at line *pu8TestResult = cil_u8ResultOfAutoTest;. --> CPU is Stopped");
    debugger_WaitUntilBPisReached(1000);
    
    
    testCaseComment("Action: ARCH_SW_CIL_0205");
    testStep("STEP", "Evaluate variable *pu8TestResult. --> KU8_ATM_TEST_OK");
    result = debugger_readLocalVariable("*(pu8TestResult)");
    EvalManStepEqual("Expected Test Result", result, 1);
  
  
  testCaseComment("Postcondition");
  testStep("STEP", "Return ECU to default values");
  setSignal(BODY3::RBTMFL_SP_Lvl_Rq_ST35, 0);
  RunPostTs(); 
}


testcase SW_IT_CIL_CheckImplausibleData_17()
{
  //***********************************Test report header*********************************
  testReportAddMiscInfoBlock("AUTOLIV ELECTRONICS document");
  TestReportAddMiscInfo("Nightly test", "No");
  TestReportAddMiscInfo("Test type", "Requirement-Based test");
  TestReportAddMiscInfo("Regression Test", "No");
  TestReportAddMiscInfo("Fault injection method used", "No");
  TestReportAddMiscInfo("Resource usage evaluation", "No");
  TestReportAddMiscInfo("Priority", "No");
  TestReportAddMiscInfo("Safety relevant", "No");
  
  AddRequirementInfo("Requirement under test", "ARCH_SW_CIL_0086, ARCH_SW_CIL_0089");
  AddRequirementInfo("ARCH_SW_CIL_0086", "Signal CRC_PresfAct_Adj_Pr5_ST3 shall be evaluated (with help form E2E) to set the specified autotest to OK/NOK.");
  //***************************************************************************************
    
  testCaseComment("Preconditions");
  testStep("STEP", "Bench Initialization");
  RunPreTs();
  
  
    testStep("STEP", "Set signal CRC_PresfAct_Adj_Pr5_ST3 to KU8_ZERO.");
    setSignal(BODY3::CRC_PresfAct_Adj_Pr5_ST3, 0);
    testWaitForTimeout(500);
    
  
    testStep("STEP", "Set a breakpoint in function CIL_Autotest_CheckImplausibleData_Presafe() at line *pu8TestResult = cil_u8ResultOfAutoTest;.");
    debugger_setRelativeFunctionBpAtLine("CIL_Autotest_CheckImplausibleData_Presafe", 13);
  
    testCaseComment("Action: ARCH_SW_CIL_0086, ARCH_SW_CIL_0089");
    testStep("STEP", "Check if CPU stopped at line *pu8TestResult = cil_u8ResultOfAutoTest;. --> CPU is Stopped");
    debugger_WaitUntilBPisReached(1000);
  
  
    testCaseComment("Action: ARCH_SW_CIL_0086");
    testStep("STEP", "Evaluate variable *pu8TestResult. --> KU8_ATM_TEST_OK");
    result = debugger_readLocalVariable("*(pu8TestResult)");
    EvalManStepEqual("Expected Test Result", result, 1);
  
  
  testCaseComment("Postcondition");
  testStep("STEP", "Return ECU to default values");
  RunPostTs(); 
}


testcase SW_IT_CIL_CheckImplausibleData_18()
{
  //***********************************Test report header*********************************
  testReportAddMiscInfoBlock("AUTOLIV ELECTRONICS document");
  TestReportAddMiscInfo("Nightly test", "No");
  TestReportAddMiscInfo("Test type", "Requirement-Based test");
  TestReportAddMiscInfo("Regression Test", "No");
  TestReportAddMiscInfo("Fault injection method used", "No");
  TestReportAddMiscInfo("Resource usage evaluation", "No");
  TestReportAddMiscInfo("Priority", "No");
  TestReportAddMiscInfo("Safety relevant", "No");
  
  AddRequirementInfo("Requirement under test", "ARCH_SW_CIL_0087");
  AddRequirementInfo("ARCH_SW_CIL_0087", "Signal SQC_PresfAct_Adj_Pr5_ST3 shall be evaluated (with help form E2E) to set the specified autotest to OK/NOK.");
  //***************************************************************************************
    
  testCaseComment("Preconditions");
  testStep("STEP", "Bench Initialization");
  RunPreTs();

  
    testStep("STEP", "Set signal SQC_PresfAct_Adj_Pr5_ST3 to KU8_ZERO.");
    setSignal(BODY3::SQC_PresfAct_Adj_Pr5_ST3, 0);
    testWaitForTimeout(500);
    
    testStep("STEP", "Set a breakpoint in function CIL_Autotest_CheckImplausibleData_Presafe() at line *pu8TestResult = cil_u8ResultOfAutoTest;.");
    debugger_setRelativeFunctionBpAtLine("CIL_Autotest_CheckImplausibleData_Presafe", 13);
    
    testCaseComment("Action: ARCH_SW_CIL_0087");
    testStep("STEP", "Check if CPU stopped at line *pu8TestResult = cil_u8ResultOfAutoTest;. --> CPU is Stopped");
    debugger_WaitUntilBPisReached(1000);
  
    
    testCaseComment("Action: ARCH_SW_CIL_0087");
    testStep("STEP", "Evaluate variable *pu8TestResult. --> KU8_ATM_TEST_OK");
    result = debugger_readLocalVariable("*(pu8TestResult)");
    EvalManStepEqual("Expected Test Result", result, 1);
  
  
  testCaseComment("Postcondition");
  testStep("STEP", "Return ECU to default values");
  RunPostTs(); 
}


testcase SW_IT_CIL_CheckImplausibleData_16()
{
  //***********************************Test report header*********************************
  testReportAddMiscInfoBlock("AUTOLIV ELECTRONICS document");
  TestReportAddMiscInfo("Nightly test", "No");
  TestReportAddMiscInfo("Test type", "Requirement-Based test");
  TestReportAddMiscInfo("Regression Test", "No");
  TestReportAddMiscInfo("Fault injection method used", "No");
  TestReportAddMiscInfo("Resource usage evaluation", "No");
  TestReportAddMiscInfo("Priority", "No");
  TestReportAddMiscInfo("Safety relevant", "No");
  
  AddRequirementInfo("Requirement under test", "ARCH_SW_CIL_0088");
  AddRequirementInfo("ARCH_SW_CIL_0088", "Signal Presf_Enbl_ST3 shall be evaluated (SNA) to set the specified autotest to OK/NOK.");
  //***************************************************************************************
  
  testCaseComment("Preconditions");
  testStep("STEP", "Bench Initialization");
  RunPreTs();
  
  
    testStep("STEP", "Set signal Presf_Enbl_ST3 to KU8_ZERO.");
    setSignal(BODY3::Presf_Enbl_ST3, 0);
    testWaitForTimeout(500);
    
    testStep("STEP", "Set a breakpoint in function CIL_Autotest_CheckImplausibleData_Presafe() at line *pu8TestResult = cil_u8ResultOfAutoTest;.");
    debugger_setRelativeFunctionBpAtLine("CIL_Autotest_CheckImplausibleData_Presafe", 13);
    
    testCaseComment("Action: ARCH_SW_CIL_0088");
    testStep("STEP", "Check if CPU stopped at line *pu8TestResult = cil_u8ResultOfAutoTest;. --> CPU is Stopped");
    debugger_WaitUntilBPisReached(1000);
  
    
    testCaseComment("Action: ARCH_SW_CIL_0088");
    testStep("STEP", "Evaluate variable *pu8TestResult. --> KU8_ATM_TEST_OK");
    result = debugger_readLocalVariable("*(pu8TestResult)");
    EvalManStepEqual("Expected Test Result", result, 1);
  
  
  testCaseComment("Postcondition");
  testStep("STEP", "Return ECU to default values");
  RunPostTs(); 
}


testcase SW_IT_CIL_CheckImplausibleData_04()
{
  //***********************************Test report header*********************************
  testReportAddMiscInfoBlock("AUTOLIV ELECTRONICS document");
  TestReportAddMiscInfo("Nightly test", "No");
  TestReportAddMiscInfo("Test type", "Requirement-Based test");
  TestReportAddMiscInfo("Regression Test", "No");
  TestReportAddMiscInfo("Fault injection method used", "No");
  TestReportAddMiscInfo("Resource usage evaluation", "No");
  TestReportAddMiscInfo("Priority", "No");
  TestReportAddMiscInfo("Safety relevant", "No");
  
  AddRequirementInfo("Requirement under test", "ARCH_SW_CIL_0191, ARCH_SW_CIL_0194");
  AddRequirementInfo("ARCH_SW_CIL_0191", "Signal CRC_Ign_Stat_Pr5_ST3 shall be evaluated (with help form E2E) to set the specified autotest to OK/NOK.");
  AddRequirementInfo("ARCH_SW_CIL_0194", "CIL shall check if CRC or SQC error is present for Ignition frame.");
  //***************************************************************************************
    
  testCaseComment("Preconditions");
  testStep("STEP", "Bench Initialization");
  RunPreTs();
  
    
    testStep("STEP", "Set signal CRC_Ign_Stat_Pr5_ST3 to KU8_ZERO.");
    setSignal(BODY3::CRC_Ign_Stat_Pr5_ST3, 0);
    testWaitForTimeout(500);
    
    testStep("STEP", "Set a breakpoint in function CIL_Autotest_CheckImplausibleData_Ignition() at line *pu8TestResult = cil_u8ResultOfAutoTest;.");
    debugger_setRelativeFunctionBpAtLine("CIL_Autotest_CheckImplausibleData_Ignition", 13);
    
    testCaseComment("Action: ARCH_SW_CIL_0191, ARCH_SW_CIL_0194");
    testStep("STEP", "Check if CPU stopped at line *pu8TestResult = cil_u8ResultOfAutoTest;. --> CPU is Stopped");
    debugger_WaitUntilBPisReached(1000);
  
    
    testCaseComment("Action: ARCH_SW_CIL_0191");
    testStep("STEP", "Evaluate variable *pu8TestResult. --> KU8_ATM_TEST_OK");
    result = debugger_readLocalVariable("*(pu8TestResult)");
    EvalManStepEqual("Expected Test Result", result, 1);
  
  
  testCaseComment("Postcondition");
  testStep("STEP", "Return ECU to default values");
  RunPostTs(); 
}


testcase SW_IT_CIL_CheckImplausibleData_05()
{
  //***********************************Test report header*********************************
  testReportAddMiscInfoBlock("AUTOLIV ELECTRONICS document");
  TestReportAddMiscInfo("Nightly test", "No");
  TestReportAddMiscInfo("Test type", "Requirement-Based test");
  TestReportAddMiscInfo("Regression Test", "No");
  TestReportAddMiscInfo("Fault injection method used", "No");
  TestReportAddMiscInfo("Resource usage evaluation", "No");
  TestReportAddMiscInfo("Priority", "No");
  TestReportAddMiscInfo("Safety relevant", "No");
  
  AddRequirementInfo("Requirement under test", "ARCH_SW_CIL_0192");
  AddRequirementInfo("ARCH_SW_CIL_0192", "Signal SQC_ Ign_Stat _Pr5_ST3 shall be evaluated (with help form E2E) to set the specified autotest to OK/NOK.");
  //***************************************************************************************
    
  testCaseComment("Preconditions");
  testStep("STEP", "Bench Initialization");
  RunPreTs();

  
    testStep("STEP", "Set signal SQC_Ign_Stat_Pr5_ST3 to KU8_ZERO.");
    setSignal(BODY3::SQC_Ign_Stat_Pr5_ST3, 0);
    testWaitForTimeout(500);
    
    testStep("STEP", "Set a breakpoint in function CIL_Autotest_CheckImplausibleData_Ignition() at line *pu8TestResult = cil_u8ResultOfAutoTest;.");
    debugger_setRelativeFunctionBpAtLine("CIL_Autotest_CheckImplausibleData_Ignition", 13);
  
    testCaseComment("Action: ARCH_SW_CIL_0192");
    testStep("STEP", "Check if CPU stopped at line *pu8TestResult = cil_u8ResultOfAutoTest;. --> CPU is Stopped");
    debugger_WaitUntilBPisReached(1000);
  
    
    testCaseComment("Action: ARCH_SW_CIL_0192");
    testStep("STEP", "Evaluate variable *pu8TestResult. --> KU8_ATM_TEST_OK");
    result = debugger_readLocalVariable("*(pu8TestResult)");
    EvalManStepEqual("Expected Test Result", result, 1);
  

  testCaseComment("Postcondition");
  testStep("STEP", "Return ECU to default values");
  RunPostTs(); 
}


testcase SW_IT_CIL_CheckImplausibleData_06()
{
  //***********************************Test report header*********************************
  testReportAddMiscInfoBlock("AUTOLIV ELECTRONICS document");
  TestReportAddMiscInfo("Nightly test", "No");
  TestReportAddMiscInfo("Test type", "Requirement-Based test");
  TestReportAddMiscInfo("Regression Test", "No");
  TestReportAddMiscInfo("Fault injection method used", "No");
  TestReportAddMiscInfo("Resource usage evaluation", "No");
  TestReportAddMiscInfo("Priority", "No");
  TestReportAddMiscInfo("Safety relevant", "No");
  
  AddRequirementInfo("Requirement under test", "ARCH_SW_CIL_0193");
  AddRequirementInfo("ARCH_SW_CIL_0193", "Signal ISw_Stat_ST3 shall be evaluated (SNA) to set the specified autotest to OK/NOK.");
  //***************************************************************************************
    
  testCaseComment("Preconditions");
  testStep("STEP", "Bench Initialization");
  RunPreTs();

  
    testStep("STEP", "Set signal ISw_Stat_ST3 to I_C03_ISW_STAT_ON.");
    setSignal(BODY3::ISw_Stat_ST3, 4);
    testWaitForTimeoutSilent(500);
    
    testStep("STEP", "Set a breakpoint in function CIL_Autotest_CheckImplausibleData_Ignition() at line *pu8TestResult = cil_u8ResultOfAutoTest;.");
    debugger_setRelativeFunctionBpAtLine("CIL_Autotest_CheckImplausibleData_Ignition", 13);
  
    testCaseComment("Action: ARCH_SW_CIL_0193");
    testStep("STEP", "Check if CPU stopped at line *pu8TestResult = cil_u8ResultOfAutoTest;. --> CPU is Stopped");
    debugger_WaitUntilBPisReached(1000);
  
    
    testCaseComment("Action: ARCH_SW_CIL_0193");
    testStep("STEP", "Evaluate variable *pu8TestResult. --> KU8_ATM_TEST_OK");
    result = debugger_readLocalVariable("*(pu8TestResult)");
    testWaitForTimeoutSilent(1000);
    EvalManStepEqual("Expected Test Result", result, 1);
  
  
  testCaseComment("Postcondition");
  testStep("STEP", "Return ECU to default values");
  RunPostTs(); 
}



testcase SW_IT_CIL_CheckImplausibleData_07()
{
  //***********************************Test report header*********************************
  testReportAddMiscInfoBlock("AUTOLIV ELECTRONICS document");
  TestReportAddMiscInfo("Nightly test", "No");
  TestReportAddMiscInfo("Test type", "Requirement-Based test");
  TestReportAddMiscInfo("Regression Test", "No");
  TestReportAddMiscInfo("Fault injection method used", "No");
  TestReportAddMiscInfo("Resource usage evaluation", "No");
  TestReportAddMiscInfo("Priority", "No");
  TestReportAddMiscInfo("Safety relevant", "No");
  
  AddRequirementInfo("Requirement under test", "ARCH_SW_CIL_0195, ARCH_SW_CIL_0198, ARCH_SW_CIL_500");
  AddRequirementInfo("ARCH_SW_CIL_0195", "Signal CRC_Bckl_Sw_Fx_Stat_Pr5_ST3 shall be evaluated (with help form E2E) to set the specified autotest to OK/NOK.");
  AddRequirementInfo("ARCH_SW_CIL_0198", "CIL shall check if CRC or SQC error is present for Presafe frame.");
  AddRequirementInfo("ARCH_SW_CIL_500", "CIL module shall check if CRC or SQC error is present for Impact3_Pr5_ST3.");
  //***************************************************************************************
    
  testCaseComment("Preconditions");
  testStep("STEP", "Bench Initialization");
  RunPreTs();
  
  
    testStep("STEP", "Set signal CRC_Bckl_Sw_Fx_Stat_Pr5_ST3 to KU8_ZERO.");
    setSignal(BODY3::CRC_Bckl_Sw_Fx_Stat_Pr5_ST3, 0);
    testWaitForTimeout(500);
    
    testStep("STEP", "Set a breakpoint in function CIL_Autotest_CheckImplausibleData_Buckle() at line *pu8TestResult = cil_u8ResultOfAutoTest;.");
    debugger_setRelativeFunctionBpAtLine("CIL_Autotest_CheckImplausibleData_Buckle", 14);
  
    testCaseComment("Action: ARCH_SW_CIL_0198, ARCH_SW_CIL_500");
    testStep("STEP", "Check if CPU stopped at line *pu8TestResult = cil_u8ResultOfAutoTest;. --> CPU is Stopped");
    debugger_WaitUntilBPisReached(1000);
  
    
    testCaseComment("Action: ARCH_SW_CIL_0195");
    testStep("STEP", "Evaluate variable *pu8TestResult. --> KU8_ATM_TEST_OK");
    result = debugger_readLocalVariable("*(pu8TestResult)");
    EvalManStepEqual("Expected Test Result", result, 1);
  
  
  testCaseComment("Postcondition");
  testStep("STEP", "Return ECU to default values"); 
  RunPostTs(); 
}


testcase SW_IT_CIL_CheckImplausibleData_08()
{
  //***********************************Test report header*********************************
  testReportAddMiscInfoBlock("AUTOLIV ELECTRONICS document");
  TestReportAddMiscInfo("Nightly test", "No");
  TestReportAddMiscInfo("Test type", "Requirement-Based test");
  TestReportAddMiscInfo("Regression Test", "No");
  TestReportAddMiscInfo("Fault injection method used", "No");
  TestReportAddMiscInfo("Resource usage evaluation", "No");
  TestReportAddMiscInfo("Priority", "No");
  TestReportAddMiscInfo("Safety relevant", "No");
  
  AddRequirementInfo("Requirement under test", "ARCH_SW_CIL_0196");
  AddRequirementInfo("ARCH_SW_CIL_0196", "Signal SQC_Bckl_Sw_Fx_Stat_Pr5_ST3 shall be evaluated (with help form E2E) to set the specified autotest to OK/NOK.");
  //***************************************************************************************
    
  testCaseComment("Preconditions");
  testStep("STEP", "Bench Initialization");
  RunPreTs();

  
    testStep("STEP", "Set signal SQC_Bckl_Sw_Fx_Stat_Pr5_ST3 to KU8_ZERO.");
    setSignal(BODY3::SQC_Bckl_Sw_Fx_Stat_Pr5_ST3, 0);
    testWaitForTimeout(500);
    
    testStep("STEP", "Set a breakpoint in function CIL_Autotest_CheckImplausibleData_Buckle() at line *pu8TestResult = cil_u8ResultOfAutoTest;.");
    debugger_setRelativeFunctionBpAtLine("CIL_Autotest_CheckImplausibleData_Buckle", 14);
    
    testCaseComment("Action: ARCH_SW_CIL_0196");
    testStep("STEP", "Check if CPU stopped at line *pu8TestResult = cil_u8ResultOfAutoTest;. --> CPU is Stopped");
    debugger_WaitUntilBPisReached(1000);
  
    
    testCaseComment("Action: ARCH_SW_CIL_0196");
    testStep("STEP", "Evaluate variable *pu8TestResult. --> KU8_ATM_TEST_OK");
    result = debugger_readLocalVariable("*(pu8TestResult)");
    EvalManStepEqual("Expected Test Result", result, 1);
  
  
  testCaseComment("Postcondition");
  testStep("STEP", "Return ECU to default values");
  RunPostTs(); 
}


testcase SW_IT_CIL_CheckImplausibleData_09()
{
  //***********************************Test report header*********************************
  testReportAddMiscInfoBlock("AUTOLIV ELECTRONICS document");
  TestReportAddMiscInfo("Nightly test", "No");
  TestReportAddMiscInfo("Test type", "Requirement-Based test");
  TestReportAddMiscInfo("Regression Test", "No");
  TestReportAddMiscInfo("Fault injection method used", "No");
  TestReportAddMiscInfo("Resource usage evaluation", "No");
  TestReportAddMiscInfo("Priority", "No");
  TestReportAddMiscInfo("Safety relevant", "No");
  
  AddRequirementInfo("Requirement under test", "ARCH_SW_CIL_0197");
  AddRequirementInfo("ARCH_SW_CIL_0197", "Signal Bckl_Sw_FP_Stat_ST3 shall be evaluated (SNA/FLT) to set the specified autotest to OK/NOK.");
  //***************************************************************************************
    
  testCaseComment("Preconditions");
  testStep("STEP", "Bench Initialization");
  RunPreTs();

  
    testStep("STEP", "Set signal Bckl_Sw_FP_Stat_ST3 to KU8_ZERO.");
    setSignal(BODY3::Bckl_Sw_FP_Stat_ST3, 0);
    testWaitForTimeout(500);
    
    testStep("STEP", "Set a breakpoint in function CIL_Autotest_CheckImplausibleData_Buckle() at line *pu8TestResult = cil_u8ResultOfAutoTest;.");
    debugger_setRelativeFunctionBpAtLine("CIL_Autotest_CheckImplausibleData_Buckle", 14);
  
    testCaseComment("Action: ARCH_SW_CIL_0197");
    testStep("STEP", "Check if CPU stopped at line *pu8TestResult = cil_u8ResultOfAutoTest;. --> CPU is Stopped");
    debugger_WaitUntilBPisReached(1000);  
  
    
    testCaseComment("Action: ARCH_SW_CIL_0197");
    testStep("STEP", "Evaluate variable *pu8TestResult. --> KU8_ATM_TEST_OK");
    result = debugger_readLocalVariable("*(pu8TestResult)");
    EvalManStepEqual("Expected Test Result", result, 1);
  

  testCaseComment("Postcondition");
  testStep("STEP", "Return ECU to default values");
  RunPostTs(); 
}


testcase SW_IT_CIL_CheckImplausibleData_10()
{
  //***********************************Test report header*********************************
  testReportAddMiscInfoBlock("AUTOLIV ELECTRONICS document");
  TestReportAddMiscInfo("Nightly test", "No");
  TestReportAddMiscInfo("Test type", "Requirement-Based test");
  TestReportAddMiscInfo("Regression Test", "No");
  TestReportAddMiscInfo("Fault injection method used", "No");
  TestReportAddMiscInfo("Resource usage evaluation", "No");
  TestReportAddMiscInfo("Priority", "No");
  TestReportAddMiscInfo("Safety relevant", "No");
  
  AddRequirementInfo("Requirement under test", "ARCH_SW_CIL_0410");
  AddRequirementInfo("ARCH_SW_CIL_0410", "Signal CRC_ORC_Impact3_Pr5_ST3 shall be evaluated (with help form E2E) to set the specified autotest to OK/NOK.");
  //***************************************************************************************
    
  testCaseComment("Preconditions");
  testStep("STEP", "Bench Initialization");
  RunPreTs();
  
  
    testStep("STEP", "Set signal CRC_ORC_Impact3_Pr5_ST3 to KU8_ZERO.");
    setSignal(BODY3::CRC_ORC_Impact3_Pr5_ST3, 0);
    testWaitForTimeout(500);
    
    testStep("STEP", "Set a breakpoint in function CIL_Autotest_CheckImplausibleData_ORC at line *pu8TestResult = cil_u8ResultOfAutoTest;.");
    debugger_setRelativeFunctionBpAtLine("CIL_Autotest_CheckImplausibleData_ORC", 12);
  
    testCaseComment("Action: ARCH_SW_CIL_0410");
    testStep("STEP", "Check if CPU stopped at line *pu8TestResult = cil_u8ResultOfAutoTest;. --> CPU is Stopped");
    debugger_WaitUntilBPisReached(1000);
  
    
    testCaseComment("Action: ARCH_SW_CIL_0410");
    testStep("STEP", "Evaluate variable *pu8TestResult. --> KU8_ATM_TEST_OK");
    result = debugger_readLocalVariable("*(pu8TestResult)");
    EvalManStepEqual("Expected Test Result", result, 1);
  

  testCaseComment("Postcondition");
  testStep("STEP", "Return ECU to default values");
  RunPostTs(); 
}


testcase SW_IT_CIL_CheckImplausibleData_11()
{
  //***********************************Test report header*********************************
  testReportAddMiscInfoBlock("AUTOLIV ELECTRONICS document");
  TestReportAddMiscInfo("Nightly test", "No");
  TestReportAddMiscInfo("Test type", "Requirement-Based test");
  TestReportAddMiscInfo("Regression Test", "No");
  TestReportAddMiscInfo("Fault injection method used", "No");
  TestReportAddMiscInfo("Resource usage evaluation", "No");
  TestReportAddMiscInfo("Priority", "No");
  TestReportAddMiscInfo("Safety relevant", "No");
  
  AddRequirementInfo("Requirement under test", "ARCH_SW_CIL_0411");
  AddRequirementInfo("ARCH_SW_CIL_0411", "Signal SQC_ORC_Impact3_Pr5_ST3 shall be evaluated (with help form E2E) to set the specified autotest to OK/NOK.");
  //***************************************************************************************
    
  testCaseComment("Preconditions");
  testStep("STEP", "Bench Initialization");
  RunPreTs();

    
    testStep("STEP", "Set signal SQC_ORC_Impact3_Pr5_ST3 to KU8_ZERO.");
    setSignal(BODY3::SQC_ORC_Impact3_Pr5_ST3, 0);
    testWaitForTimeout(500);
    
    testStep("STEP", "Set a breakpoint in function CIL_Autotest_CheckImplausibleData_ORC at line *pu8TestResult = cil_u8ResultOfAutoTest;.");
    debugger_setRelativeFunctionBpAtLine("CIL_Autotest_CheckImplausibleData_ORC", 12);
  
    testCaseComment("Action: ARCH_SW_CIL_0411");
    testStep("STEP", "Check if CPU stopped at line *pu8TestResult = cil_u8ResultOfAutoTest;. --> CPU is Stopped");
    debugger_WaitUntilBPisReached(1000);
  
    
    testCaseComment("Action: ARCH_SW_CIL_0411");
    testStep("STEP", "Evaluate variable *pu8TestResult. --> KU8_ATM_TEST_OK");
    result = debugger_readLocalVariable("*(pu8TestResult)");
    EvalManStepEqual("Expected Test Result", result, 1);

  
  testCaseComment("Postcondition");
  testStep("STEP", "Return ECU to default values");
  RunPostTs(); 
}


testcase SW_IT_CIL_CheckImplausibleData_12()
{
  //***********************************Test report header*********************************
  testReportAddMiscInfoBlock("AUTOLIV ELECTRONICS document");
  TestReportAddMiscInfo("Nightly test", "No");
  TestReportAddMiscInfo("Test type", "Requirement-Based test");
  TestReportAddMiscInfo("Regression Test", "No");
  TestReportAddMiscInfo("Fault injection method used", "No");
  TestReportAddMiscInfo("Resource usage evaluation", "No");
  TestReportAddMiscInfo("Priority", "No");
  TestReportAddMiscInfo("Safety relevant", "No");
  
  AddRequirementInfo("Requirement under test", "ARCH_SW_CIL_0206");
  AddRequirementInfo("ARCH_SW_CIL_0206", "Signal PT4_PTCoor_PT_Rdy_ST3 shall be evaluated to set the specified autotest to OK/NOK.");
  //***************************************************************************************
    
  testCaseComment("Preconditions");
  testStep("STEP", "Bench Initialization");
  RunPreTs();
  
  
    testStep("STEP", "Set signal PT4_PTCoor_PT_Rdy_ST3 to KU8_ZERO.");
    setSignal(BODY3::PT4_PTCoor_PT_Rdy_ST3, 0);
    testWaitForTimeout(500);
    
    testStep("STEP", "Set a breakpoint in function CIL_Autotest_CheckImplausibleData_PowertrainRdy at line *pu8TestResult = cil_u8ResultOfAutoTest;.");
    debugger_setRelativeFunctionBpAtLine("CIL_Autotest_CheckImplausibleData_PowertrainRdy", 11);
  
    testCaseComment("Action: ARCH_SW_CIL_0206");
    testStep("STEP", "Check if CPU stopped at line *pu8TestResult = cil_u8ResultOfAutoTest;. --> CPU is Stopped");
    debugger_WaitUntilBPisReached(1000);
  
    
    testCaseComment("Action: ARCH_SW_CIL_0206");
    testStep("STEP", "Evaluate variable *pu8TestResult. --> KU8_ATM_TEST_OK");
    result = debugger_readLocalVariable("*(pu8TestResult)");
    EvalManStepEqual("Expected Test Result", result, 1);
  
  
  testCaseComment("Postcondition");
  testStep("STEP", "Return ECU to default values");
  RunPostTs();
}


testcase SW_IT_CIL_CheckImplausibleData_13()
{
  //***********************************Test report header*********************************
  testReportAddMiscInfoBlock("AUTOLIV ELECTRONICS document");
  TestReportAddMiscInfo("Nightly test", "No");
  TestReportAddMiscInfo("Test type", "Requirement-Based test");
  TestReportAddMiscInfo("Regression Test", "No");
  TestReportAddMiscInfo("Fault injection method used", "No");
  TestReportAddMiscInfo("Resource usage evaluation", "No");
  TestReportAddMiscInfo("Priority", "No");
  TestReportAddMiscInfo("Safety relevant", "No");
  
  AddRequirementInfo("Requirement under test", "ARCH_SW_CIL_0207, ARCH_SW_CIL_0208");
  AddRequirementInfo("ARCH_SW_CIL_0207", "Signal PT4_PTCoor_PT_Rdy_ST3 shall be evaluated to set the specified autotest to OK/NOK.");
  AddRequirementInfo("ARCH_SW_CIL_0208", "CIL shall check if implausible data error is present for Powertrain frame.");
  //***************************************************************************************
    
  testCaseComment("Preconditions");
  testStep("STEP", "Bench Initialization");
  RunPreTs();
  
  
    testStep("STEP", "Set signal PT4_PTCoor_PT_Rdy_ST3 to KU8_ZERO.");
    setSignal(BODY3::PT4_PTCoor_PT_Rdy_ST3, 0);
    testWaitForTimeout(500);
    
    testStep("STEP", "Set a breakpoint in function CIL_Autotest_CheckImplausibleData_PowertrainRdy at line *pu8TestResult = cil_u8ResultOfAutoTest;.");
    debugger_setRelativeFunctionBpAtLine("CIL_Autotest_CheckImplausibleData_PowertrainRdy", 11);
    
    testCaseComment("Action: ARCH_SW_CIL_0207, ARCH_SW_CIL_0208");
    testStep("STEP", "Check if CPU stopped at line *pu8TestResult = cil_u8ResultOfAutoTest;. --> CPU is Stopped");
    debugger_WaitUntilBPisReached(1000);
  
    
    testCaseComment("Action: ARCH_SW_CIL_0207");
    testStep("STEP", "Evaluate variable *pu8TestResult. --> KU8_ATM_TEST_OK");
    result = debugger_readLocalVariable("*(pu8TestResult)");
    EvalManStepEqual("Expected Test Result", result, 1);
  
  
  testCaseComment("Postcondition");
  testStep("STEP", "Return ECU to default values");
  RunPostTs();
}


testcase SW_IT_CIL_CheckImplausibleData_14()
{
  //***********************************Test report header*********************************
  testReportAddMiscInfoBlock("AUTOLIV ELECTRONICS document");
  TestReportAddMiscInfo("Nightly test", "No");
  TestReportAddMiscInfo("Test type", "Requirement-Based test");
  TestReportAddMiscInfo("Regression Test", "No");
  TestReportAddMiscInfo("Fault injection method used", "No");
  TestReportAddMiscInfo("Resource usage evaluation", "No");
  TestReportAddMiscInfo("Priority", "No");
  TestReportAddMiscInfo("Safety relevant", "No");
  
  AddRequirementInfo("Requirement under test", "ARCH_SW_CIL_0214");
  AddRequirementInfo("ARCH_SW_CIL_0214", "Signal CRC _ORC_Impact3_Pr5_ST3 shall be evaluated (with help form E2E) to set the specified autotest to OK/NOK.");
  //***************************************************************************************
    
  testCaseComment("Preconditions");
  testStep("STEP", "Bench Initialization");
  RunPreTs();
  
  
    testStep("STEP", "Set signal CRC_ORC_Impact3_Pr5_ST3 to KU8_ZERO.");
    setSignal(BODY3::CRC_ORC_Impact3_Pr5_ST3, 0);
    testWaitForTimeout(500);
    
    testStep("STEP", "Set a breakpoint in function CIL_Autotest_CheckImplausibleData_ORC() at line *pu8TestResult = cil_u8ResultOfAutoTest;.");
    debugger_setRelativeFunctionBpAtLine("CIL_Autotest_CheckImplausibleData_ORC", 12);
  
    testCaseComment("Action: ARCH_SW_CIL_0214");
    testStep("STEP", "Check if CPU stopped at line *pu8TestResult = cil_u8ResultOfAutoTest;. --> CPU is Stopped");
    debugger_WaitUntilBPisReached(1000);
  
    
    testCaseComment("Action: ARCH_SW_CIL_0214");
    testStep("STEP", "Evaluate variable *pu8TestResult. --> KU8_ATM_TEST_OK");
    result = debugger_readLocalVariable("*(pu8TestResult)");
    EvalManStepEqual("Expected Test Result", result, 1);
  
  
  testCaseComment("Postcondition");
  testStep("STEP", "Return ECU to default values");
  RunPostTs(); 
}


testcase SW_IT_CIL_CheckImplausibleData_15()
{
  //***********************************Test report header*********************************
  testReportAddMiscInfoBlock("AUTOLIV ELECTRONICS document");
  TestReportAddMiscInfo("Nightly test", "No");
  TestReportAddMiscInfo("Test type", "Requirement-Based test");
  TestReportAddMiscInfo("Regression Test", "No");
  TestReportAddMiscInfo("Fault injection method used", "No");
  TestReportAddMiscInfo("Resource usage evaluation", "No");
  TestReportAddMiscInfo("Priority", "No");
  TestReportAddMiscInfo("Safety relevant", "No");
  
  AddRequirementInfo("Requirement under test", "ARCH_SW_CIL_0215");
  AddRequirementInfo("ARCH_SW_CIL_0215", "Signal SQC_ ORC_Impact3_Pr5_ST3 shall be evaluated (with help form E2E) to set the specified autotest to OK/NOK.");
  //***************************************************************************************
    
  testCaseComment("Preconditions");
  testStep("STEP", "Bench Initialization");
  RunPreTs();
  
  
    testStep("STEP", "Set signal SQC_ORC_Impact3_Pr5_ST3 to KU8_ZERO.");
    setSignal(BODY3::SQC_ORC_Impact3_Pr5_ST3 , 0);
    testWaitForTimeout(500);
    
    testStep("STEP", "Set a breakpoint in function CIL_Autotest_CheckImplausibleData_ORC at line *pu8TestResult = cil_u8ResultOfAutoTest;.");
    debugger_setRelativeFunctionBpAtLine("CIL_Autotest_CheckImplausibleData_ORC", 12);
    
    testCaseComment("Action: ARCH_SW_CIL_0215");
    testStep("STEP", "Check if CPU stopped at line *pu8TestResult = cil_u8ResultOfAutoTest;. --> CPU is Stopped");
    debugger_WaitUntilBPisReached(1000);
  
    
    testCaseComment("Action: ARCH_SW_CIL_0215");
    testStep("STEP", "Evaluate variable *pu8TestResult. --> KU8_ATM_TEST_OK");
    result = debugger_readLocalVariable("*(pu8TestResult)");
    EvalManStepEqual("Expected Test Result", result, 1);
  
  
  testCaseComment("Postcondition");
  testStep("STEP", "Return ECU to default values");
  RunPostTs(); 
}


testcase SW_IT_CIL_CheckSteeringConfiguration_01()
{
  //***********************************Test report header*********************************
  testReportAddMiscInfoBlock("AUTOLIV ELECTRONICS document");
  TestReportAddMiscInfo("Nightly test", "No");
  TestReportAddMiscInfo("Test type", "Requirement-Based test");
  TestReportAddMiscInfo("Regression Test", "No");
  TestReportAddMiscInfo("Fault injection method used", "No");
  TestReportAddMiscInfo("Resource usage evaluation", "No");
  TestReportAddMiscInfo("Priority", "No");
  TestReportAddMiscInfo("Safety relevant", "No");
  
  AddRequirementInfo("Requirement under test", "ARCH_SW_CIL_0216");
  AddRequirementInfo("ARCH_SW_CIL_0216", "Signal EVC_List03_StStyle_ST3 shall be evaluated to set the specified autotest to OK/NOK.");
  //***************************************************************************************
    
  testCaseComment("Preconditions");
  testStep("STEP", "Bench Initialization");
  RunPreTs();
  
  
    testStep("STEP", "Set signal EVC_List03_StStyle_ST3 to KU8_ZERO.");
    setSignal(BODY3::EVC_List03_StStyle_ST3, 0);
    testWaitForTimeout(500);
    
    testStep("STEP", "Set a breakpoint in function CIL_Autotest_CheckSteeringConfiguration at line *pu8TestResult = cil_u8ResultOfAutoTest;.");
    debugger_setRelativeFunctionBpAtLine("CIL_Autotest_CheckImplausibleData_ORC", 12);
    
    testCaseComment("Action: ARCH_SW_CIL_0216");
    testStep("STEP", "Check if CPU stopped at line *pu8TestResult = cil_u8ResultOfAutoTest;.");
    debugger_WaitUntilBPisReached(1000);
  
  
    testCaseComment("Action: ARCH_SW_CIL_0216");
    testStep("STEP", "Evaluate variable *pu8TestResult. --> KU8_ATM_TEST_OK");
    result = debugger_readLocalVariable("*(pu8TestResult)");
    testWaitForTimeoutSilent(1000);
    EvalManStepEqual("Expected Test Result", result, 1);
  
  
  testCaseComment("Postcondition");
  testStep("STEP", "Return ECU to default values");
  RunPostTs(); 
}


testcase SW_IT_CIL_Update_07Cx_Block20_01()
{
  //***********************************Test report header*********************************
  testReportAddMiscInfoBlock("AUTOLIV ELECTRONICS document");
  TestReportAddMiscInfo("Nightly test", "No");
  TestReportAddMiscInfo("Test type", "Requirement-Based test");
  TestReportAddMiscInfo("Regression Test", "No");
  TestReportAddMiscInfo("Fault injection method used", "No");
  TestReportAddMiscInfo("Resource usage evaluation", "No");
  TestReportAddMiscInfo("Priority", "No");
  TestReportAddMiscInfo("Safety relevant", "No");
  
  AddRequirementInfo("Requirement under test", "ARCH_SW_CIL_0729, ARCH_SW_CIL_0770");
  AddRequirementInfo("ARCH_SW_CIL_0729", "If selected, the content of the measurement frame - block #20 shall be encoded and provided to CAN.");
  AddRequirementInfo("ARCH_SW_CIL_0770", "PMP_runGetDeficiencyLevel shall be called to get the calculated deficiency level.");
  //***************************************************************************************
    
  testCaseComment("Preconditions");
  testStep("STEP", "Bench Initialization");
  RunPreTs();
  

//    AuthenticateECU(2);
    EnterDiagnosticSession("development");
    
    testStep("STEP", "Activate Measurement Frame block 20.");
    ActivateMeasurementFrame(20);
    
  
    testStep("STEP", "Set a breakpoint in function cil_Update_07Cx_Block20_InfosToSend at line (void)Rte_Call_pclMotor_T_GetDeficiencyLevel(&u32DeficiencyLevel);.");
    debugger_setRelativeFunctionBpAtLine("cil_Update_07Cx_Block20_InfosToSend", 8);
    
    testCaseComment("Action: ARCH_SW_CIL_0770");
    testStep("STEP", "Set a breakpoint in function Rte_Call_pclMotor_T_GetDeficiencyLevel(&u32DeficiencyLevel);. --> Stepped in function PMP_runGetDeficiencyLevel");
    debugger_stepIn();
    //EvalManStepEqual("Expected Test Result", debugger_result, "Stepped in function PMP_runGetDeficiencyLevel,,app.elf");
    
    testStep("STEP", "Set a breakpoint at the last line of function cil_Update_07Cx_Block20_InfosToSend().");
    debugger_setRelativeFunctionBpAtLine("cil_Update_07Cx_Block20_InfosToSend", 29);
    
    debugger_run();
    
    testStep("STEP", "Evaluate if variable u32DeficiencyLevel is equal to KU8_ZERO. --> KU8_ZERO");
    result = debugger_readLocalVariable("u32DeficiencyLevel");
    EvalManStepEqual("Expected Test Result", result, 0);
    
    testCaseComment("Action: ARCH_SW_CIL_0729");
    testStep("STEP", "Evaluate if variable cil_stMeasurementFrameContent.Meas_RBTM_FL_01 and signal Meas_RBTM_FL_01_ST3 are equal to CU8_BLOCK_ID_20. --> CU8_BLOCK_ID_20");
    result = debugger_readGlobalVariable("uint8", "cil_stMeasurementFrameContent,,app.elf", 0);
    EvalManStepEqual("Expected Test Result", result, $Meas_RBTM_FL_01_ST3.raw64);
        
    testCaseComment("Action: ARCH_SW_CIL_0729");
    testStep("STEP", "Evaluate if variable cil_stMeasurementFrameContent.Meas_RBTM_FL_02 and signal Meas_RBTM_FL_02_ST3 are equal to KU8_ZERO. --> KU8_ZERO");
    result = debugger_readGlobalVariable("uint8", "cil_stMeasurementFrameContent,,app.elf", 1);
    EvalManStepEqual("Expected Test Result", result, $Meas_RBTM_FL_02_ST3.raw64);
    
    testCaseComment("Action: ARCH_SW_CIL_0729");
    testStep("STEP", "Evaluate if variable cil_stMeasurementFrameContent.Meas_RBTM_FL_03 and signal Meas_RBTM_FL_03_ST3 are equal to KU8_ZERO. --> KU8_ZERO");
    result = debugger_readGlobalVariable("uint8", "cil_stMeasurementFrameContent,,app.elf", 2);
    EvalManStepEqual("Expected Test Result", result, $Meas_RBTM_FL_03_ST3.raw64);
    
    testCaseComment("Action: ARCH_SW_CIL_0729");
    testStep("STEP", "Evaluate if variable cil_stMeasurementFrameContent.Meas_RBTM_FL_04 and signal Meas_RBTM_FL_04_ST3 are equal to KU8_ZERO. --> KU8_ZERO");
    result = debugger_readGlobalVariable("uint8", "cil_stMeasurementFrameContent,,app.elf", 3);
    EvalManStepEqual("Expected Test Result", result, $Meas_RBTM_FL_04_ST3.raw64);
    
    testCaseComment("Action: ARCH_SW_CIL_0729");
    testStep("STEP", "Evaluate if variable cil_stMeasurementFrameContent.Meas_RBTM_FL_05 and signal Meas_RBTM_FL_05_ST3 are equal to KU8_ZERO. --> KU8_ZERO");
    result = debugger_readGlobalVariable("uint8", "cil_stMeasurementFrameContent,,app.elf", 4);
    EvalManStepEqual("Expected Test Result", result, $Meas_RBTM_FL_05_ST3.raw64);
      
    testCaseComment("Action: ARCH_SW_CIL_0729");
    testStep("STEP", "Evaluate if variable cil_stMeasurementFrameContent.Meas_RBTM_FL_06 and signal Meas_RBTM_FL_06_ST3 are equal to KU8_MAX. --> KU8_MAX");
    result = debugger_readGlobalVariable("uint8", "cil_stMeasurementFrameContent,,app.elf", 5);
    EvalManStepEqual("Expected Test Result", result, $Meas_RBTM_FL_06_ST3.raw64);
  
    testCaseComment("Action: ARCH_SW_CIL_0729");
    testStep("STEP", "Evaluate if variable cil_stMeasurementFrameContent.Meas_RBTM_FL_07 and signal Meas_RBTM_FL_07_ST3 are equal to KU8_MAX. --> KU8_MAX");
    result = debugger_readGlobalVariable("uint8", "cil_stMeasurementFrameContent,,app.elf", 6);
    EvalManStepEqual("Expected Test Result", result, $Meas_RBTM_FL_07_ST3.raw64);
  
    testCaseComment("Action: ARCH_SW_CIL_0729");
    testStep("STEP", "Evaluate if variable cil_stMeasurementFrameContent.Meas_RBTM_FL_08 and signal Meas_RBTM_FL_08_ST3 are equal to KU8_MAX. --> KU8_MAX");
    result = debugger_readGlobalVariable("uint8", "cil_stMeasurementFrameContent,,app.elf", 7);
    EvalManStepEqual("Expected Test Result", result, $Meas_RBTM_FL_08_ST3.raw64);
  
  
  testCaseComment("Postcondition");
  testStep("STEP", "Return ECU to default values");
  RunPostTs(); 
}


testcase SW_IT_CIL_Update_07Cx_Block18_01()
{
  //***********************************Test report header*********************************
  testReportAddMiscInfoBlock("AUTOLIV ELECTRONICS document");
  TestReportAddMiscInfo("Nightly test", "No");
  TestReportAddMiscInfo("Test type", "Requirement-Based test");
  TestReportAddMiscInfo("Regression Test", "No");
  TestReportAddMiscInfo("Fault injection method used", "No");
  TestReportAddMiscInfo("Resource usage evaluation", "No");
  TestReportAddMiscInfo("Priority", "No");
  TestReportAddMiscInfo("Safety relevant", "No");
  
  AddRequirementInfo("Requirement under test", "ARCH_SW_CIL_0728");
  AddRequirementInfo("ARCH_SW_CIL_0728", "If selected, the content of the measurement frame - block #18 shall be encoded and provided to CAN.");
  //***************************************************************************************
    
  testCaseComment("Preconditions");
  testStep("STEP", "Bench Initialization");
  RunPreTs();
  

//    AuthenticateECU(2);
    EnterDiagnosticSession("development");
    
    testStep("STEP", "Activate Measurement Frame block 18.");
    ActivateMeasurementFrame(18);
    
    testStep("STEP", "Set a breakpoint at the last line of function cil_Update_07Cx_Block18_InfosToSend().");
    debugger_setRelativeFunctionBpAtLine("cil_Update_07Cx_Block18_InfosToSend", 8);
  
    testStep("STEP", "Check if CPU stopped at line *pu8TestResult = cil_u8ResultOfAutoTest;.");
debugger_isCPUStoppedAtFunction("cil_Update_07Cx_Block18_InfosToSend");    ////EvalManStepEqual("Expected Test Result", debugger_result,  "CPU is Stopped");
    
  
    testCaseComment("Action: ARCH_SW_CIL_0728");
    testStep("STEP", "Evaluate if variable cil_stMeasurementFrameContent.Meas_RBTM_FL_01 and signal Meas_RBTM_FL_01_ST3 are equal to CU8_BLOCK_ID_18. --> CU8_BLOCK_ID_18");
    result = debugger_readGlobalVariable("uint8", "cil_stMeasurementFrameContent,,app.elf", 0);
    EvalManStepEqual("Expected Test Result", result, $Meas_RBTM_FL_01_ST3.raw64);
        
    testCaseComment("Action: ARCH_SW_CIL_0728");
    testStep("STEP", "Evaluate if variable cil_stMeasurementFrameContent.Meas_RBTM_FL_02 and signal Meas_RBTM_FL_02_ST3 are equal to KU8_MAX. --> KU8_ZERO");
    result = debugger_readGlobalVariable("uint8", "cil_stMeasurementFrameContent,,app.elf", 1);
    EvalManStepEqual("Expected Test Result", result, $Meas_RBTM_FL_02_ST3.raw64);
    
    testCaseComment("Action: ARCH_SW_CIL_0728");
    testStep("STEP", "Evaluate if variable cil_stMeasurementFrameContent.Meas_RBTM_FL_03 and signal Meas_RBTM_FL_03_ST3 are equal to KU8_MAX. --> KU8_MAX");
    result = debugger_readGlobalVariable("uint8", "cil_stMeasurementFrameContent,,app.elf", 2);
    EvalManStepEqual("Expected Test Result", result, $Meas_RBTM_FL_03_ST3.raw64);
    
    testCaseComment("Action: ARCH_SW_CIL_0728");
    testStep("STEP", "Evaluate if variable cil_stMeasurementFrameContent.Meas_RBTM_FL_04 and signal Meas_RBTM_FL_04_ST3 are equal to KU8_MAX. --> KU8_MAX");
    result = debugger_readGlobalVariable("uint8", "cil_stMeasurementFrameContent,,app.elf", 3);
    EvalManStepEqual("Expected Test Result", result, $Meas_RBTM_FL_04_ST3.raw64);
    
    testCaseComment("Action: ARCH_SW_CIL_0728");
    testStep("STEP", "Evaluate if variable cil_stMeasurementFrameContent.Meas_RBTM_FL_05 and signal Meas_RBTM_FL_05_ST3 are equal to KU8_MAX. --> KU8_MAX");
    result = debugger_readGlobalVariable("uint8", "cil_stMeasurementFrameContent,,app.elf", 4);
    EvalManStepEqual("Expected Test Result", result, $Meas_RBTM_FL_05_ST3.raw64);
      
    testCaseComment("Action: ARCH_SW_CIL_0728");
    testStep("STEP", "Evaluate if variable cil_stMeasurementFrameContent.Meas_RBTM_FL_06 and signal Meas_RBTM_FL_06_ST3 are equal to KU8_MAX. --> KU8_MAX");
    result = debugger_readGlobalVariable("uint8", "cil_stMeasurementFrameContent,,app.elf", 5);
    EvalManStepEqual("Expected Test Result", result, $Meas_RBTM_FL_06_ST3.raw64);
  
    testCaseComment("Action: ARCH_SW_CIL_0728");
    testStep("STEP", "Evaluate if variable cil_stMeasurementFrameContent.Meas_RBTM_FL_07 and signal Meas_RBTM_FL_07_ST3 are equal to KU8_MAX. --> KU8_MAX");
    result = debugger_readGlobalVariable("uint8", "cil_stMeasurementFrameContent,,app.elf", 6);
    EvalManStepEqual("Expected Test Result", result, $Meas_RBTM_FL_07_ST3.raw64);
  
    testCaseComment("Action: ARCH_SW_CIL_0728");
    testStep("STEP", "Evaluate if variable cil_stMeasurementFrameContent.Meas_RBTM_FL_08 and signal Meas_RBTM_FL_08_ST3 are equal to KU8_MAX. --> KU8_MAX");
    result = debugger_readGlobalVariable("uint8", "cil_stMeasurementFrameContent,,app.elf", 7);
    EvalManStepEqual("Expected Test Result", result, $Meas_RBTM_FL_08_ST3.raw64);
  
  
  testCaseComment("Postcondition");
  testStep("STEP", "Return ECU to default values");
  RunPostTs(); 
}


testcase SW_IT_CIL_Update_07Cx_Block17_02()
{
  //***********************************Test report header*********************************
  testReportAddMiscInfoBlock("AUTOLIV ELECTRONICS document");
  TestReportAddMiscInfo("Nightly test", "No");
  TestReportAddMiscInfo("Test type", "Requirement-Based test");
  TestReportAddMiscInfo("Regression Test", "No");
  TestReportAddMiscInfo("Fault injection method used", "No");
  TestReportAddMiscInfo("Resource usage evaluation", "No");
  TestReportAddMiscInfo("Priority", "No");
  TestReportAddMiscInfo("Safety relevant", "No");
  
  AddRequirementInfo("Requirement under test", "ARCH_SW_CIL_0727");
  AddRequirementInfo("ARCH_SW_CIL_0727", "If selected, the content of the measurement frame - block #17 shall be encoded and provided to CAN.");
  //***************************************************************************************
    
  testCaseComment("Preconditions");
  testStep("STEP", "Bench Initialization");
  RunPreTs();
  

//    AuthenticateECU(2);
    EnterDiagnosticSession("development");
    
    testStep("STEP", "Activate Measurement Frame block 17.");
    ActivateMeasurementFrame(17);
    
    testStep("STEP", "Set a breakpoint in function cil_Update_07Cx_Block17_InfosToSend at line Rte_Call_pclHS1_V_Get(&u16VHs1);.");
    debugger_setRelativeFunctionBpAtLine("cil_Update_07Cx_Block17_InfosToSend", 15);
    
    testStep("STEP", "Step in function Rte_Call_pclHS1_V_Get(&u16VHs1). --> Stepped in function PMP_runGetHS1Level");
    debugger_stepIn();
    //EvalManStepEqual("Expected Test Result", debugger_result, "Stepped in function PMP_runGetHS1Level,,app.elf");
    
    testStep("STEP", "Set a breakpoint at the last line of function cil_Update_07Cx_Block17_InfosToSend().");
    debugger_setRelativeFunctionBpAtLine("cil_Update_07Cx_Block17_InfosToSend", 38);
    
    debugger_run();
  
    testCaseComment("Action: ARCH_SW_CIL_0727");
    testStep("STEP", "Evaluate if variable cil_stMeasurementFrameContent.Meas_RBTM_FL_01 and signal Meas_RBTM_FL_01_ST3 are equal to CU8_BLOCK_ID_17. --> CU8_BLOCK_ID_17");
    result = debugger_readGlobalVariable("uint8", "cil_stMeasurementFrameContent,,app.elf", 0);
    EvalManStepEqual("Expected Test Result", result, $Meas_RBTM_FL_01_ST3.raw64);
        
    testCaseComment("Action: ARCH_SW_CIL_0727");
    testStep("STEP", "Evaluate if variable cil_stMeasurementFrameContent.Meas_RBTM_FL_02 and signal Meas_RBTM_FL_02_ST3 are equal to 0x36 (54). --> 0x36 (54)");
    result = debugger_readGlobalVariable("uint8", "cil_stMeasurementFrameContent,,app.elf", 1);
    EvalManStepEqual("Expected Test Result", result, $Meas_RBTM_FL_02_ST3.raw64);
    
    testCaseComment("Action: ARCH_SW_CIL_0727");
    testStep("STEP", "Evaluate if variable cil_stMeasurementFrameContent.Meas_RBTM_FL_03 and signal Meas_RBTM_FL_03_ST3 are equal to 0x79 (121). --> 0x79 (121)");
    result = debugger_readGlobalVariable("uint8", "cil_stMeasurementFrameContent,,app.elf", 2);
    EvalManStepEqual("Expected Test Result", result, $Meas_RBTM_FL_03_ST3.raw64);
    
    testCaseComment("Action: ARCH_SW_CIL_0727");
    testStep("STEP", "Evaluate if variable cil_stMeasurementFrameContent.Meas_RBTM_FL_04 and signal Meas_RBTM_FL_04_ST3 are equal to KU8_MAX. --> KU8_MAX");
    result = debugger_readGlobalVariable("uint8", "cil_stMeasurementFrameContent,,app.elf", 3);
    EvalManStepEqual("Expected Test Result", result, $Meas_RBTM_FL_04_ST3.raw64);
    
    testCaseComment("Action: ARCH_SW_CIL_0727");
    testStep("STEP", "Evaluate if variable cil_stMeasurementFrameContent.Meas_RBTM_FL_05 and signal Meas_RBTM_FL_05_ST3 are equal to KU8_MAX. --> KU8_MAX");
    result = debugger_readGlobalVariable("uint8", "cil_stMeasurementFrameContent,,app.elf", 4);
    EvalManStepEqual("Expected Test Result", result, $Meas_RBTM_FL_05_ST3.raw64);
      
    testCaseComment("Action: ARCH_SW_CIL_0727");
    testStep("STEP", "Evaluate if variable cil_stMeasurementFrameContent.Meas_RBTM_FL_06 and signal Meas_RBTM_FL_06_ST3 are equal to KU8_MAX. --> KU8_MAX");
    result = debugger_readGlobalVariable("uint8", "cil_stMeasurementFrameContent,,app.elf", 5);
    EvalManStepEqual("Expected Test Result", result, $Meas_RBTM_FL_06_ST3.raw64);
  
    testCaseComment("Action: ARCH_SW_CIL_0727");
    testStep("STEP", "Evaluate if variable cil_stMeasurementFrameContent.Meas_RBTM_FL_07 and signal Meas_RBTM_FL_07_ST3 are equal to KU8_MAX. --> KU8_MAX");
    result = debugger_readGlobalVariable("uint8", "cil_stMeasurementFrameContent,,app.elf", 6);
    EvalManStepEqual("Expected Test Result", result, $Meas_RBTM_FL_07_ST3.raw64);
  
    testCaseComment("Action: ARCH_SW_CIL_0727");
    testStep("STEP", "Evaluate if variable cil_stMeasurementFrameContent.Meas_RBTM_FL_08 and signal Meas_RBTM_FL_08_ST3 are equal to KU8_MAX. --> KU8_MAX");
    result = debugger_readGlobalVariable("uint8", "cil_stMeasurementFrameContent,,app.elf", 7);
    EvalManStepEqual("Expected Test Result", result, $Meas_RBTM_FL_08_ST3.raw64);
  
  
  testCaseComment("Postcondition");
  testStep("STEP", "Return ECU to default values");
  RunPostTs(); 
}



testcase SW_IT_CIL_Update_07Cx_Block16_01()
{
  //***********************************Test report header*********************************
  testReportAddMiscInfoBlock("AUTOLIV ELECTRONICS document");
  TestReportAddMiscInfo("Nightly test", "No");
  TestReportAddMiscInfo("Test type", "Requirement-Based test");
  TestReportAddMiscInfo("Regression Test", "No");
  TestReportAddMiscInfo("Fault injection method used", "No");
  TestReportAddMiscInfo("Resource usage evaluation", "No");
  TestReportAddMiscInfo("Priority", "No");
  TestReportAddMiscInfo("Safety relevant", "No");
  
  AddRequirementInfo("Requirement under test", "ARCH_SW_CIL_0726");
  AddRequirementInfo("ARCH_SW_CIL_0726", "If selected, the content of the measurement frame - block #16 shall be encoded and provided to CAN.");
  //***************************************************************************************
    
  testCaseComment("Preconditions");
  testStep("STEP", "Bench Initialization");
  RunPreTs();

  
//    AuthenticateECU(2);
    EnterDiagnosticSession("development");
    
    testStep("STEP", "Activate Measurement Frame block 16.");
    ActivateMeasurementFrame(16);
    
    testStep("STEP", "Set a breakpoint at the last line of function cil_Update_07Cx_Block16_InfosToSend.");
    debugger_setRelativeFunctionBpAtLine("cil_Update_07Cx_Block16_InfosToSend", 8);
  
    testStep("STEP", "Check if CPU stopped at line *pu8TestResult = cil_u8ResultOfAutoTest;.");
debugger_isCPUStoppedAtFunction("cil_Update_07Cx_Block16_InfosToSend");    ////EvalManStepEqual("Expected Test Result", debugger_result,  "CPU is Stopped");
    
    testCaseComment("Action: ARCH_SW_CIL_0726");
    testStep("STEP", "Evaluate if variable cil_stMeasurementFrameContent.Meas_RBTM_FL_01 and signal Meas_RBTM_FL_01_ST3 are equal to CU8_BLOCK_ID_16. --> CU8_BLOCK_ID_16");
    result = debugger_readGlobalVariable("uint8", "cil_stMeasurementFrameContent,,app.elf", 0);
    EvalManStepEqual("Expected Test Result", result, $Meas_RBTM_FL_01_ST3.raw64);
        
    testCaseComment("Action: ARCH_SW_CIL_0726");
    testStep("STEP", "Evaluate if variable cil_stMeasurementFrameContent.Meas_RBTM_FL_02 and signal Meas_RBTM_FL_02_ST3 are equal to KU8_MAX. --> KU8_MAX");
    result = debugger_readGlobalVariable("uint8", "cil_stMeasurementFrameContent,,app.elf", 1);
    EvalManStepEqual("Expected Test Result", result, $Meas_RBTM_FL_02_ST3.raw64);
    
    testCaseComment("Action: ARCH_SW_CIL_0726");
    testStep("STEP", "Evaluate if variable cil_stMeasurementFrameContent.Meas_RBTM_FL_03 and signal Meas_RBTM_FL_03_ST3 are equal to KU8_MAX. --> KU8_MAX)");
    result = debugger_readGlobalVariable("uint8", "cil_stMeasurementFrameContent,,app.elf", 2);
    EvalManStepEqual("Expected Test Result", result, $Meas_RBTM_FL_03_ST3.raw64);
    
    testCaseComment("Action: ARCH_SW_CIL_0726");
    testStep("STEP", "Evaluate if variable cil_stMeasurementFrameContent.Meas_RBTM_FL_04 and signal Meas_RBTM_FL_04_ST3 are equal to KU8_MAX. --> KU8_MAX");
    result = debugger_readGlobalVariable("uint8", "cil_stMeasurementFrameContent,,app.elf", 3);
    EvalManStepEqual("Expected Test Result", result, $Meas_RBTM_FL_04_ST3.raw64);
    
    testCaseComment("Action: ARCH_SW_CIL_0726");
    testStep("STEP", "Evaluate if variable cil_stMeasurementFrameContent.Meas_RBTM_FL_05 and signal Meas_RBTM_FL_05_ST3 are equal to KU8_MAX. --> KU8_MAX");
    result = debugger_readGlobalVariable("uint8", "cil_stMeasurementFrameContent,,app.elf", 4);
    EvalManStepEqual("Expected Test Result", result, $Meas_RBTM_FL_05_ST3.raw64);
      
    testCaseComment("Action: ARCH_SW_CIL_0726");
    testStep("STEP", "Evaluate if variable cil_stMeasurementFrameContent.Meas_RBTM_FL_06 and signal Meas_RBTM_FL_06_ST3 are equal to KU8_MAX. --> KU8_MAX");
    result = debugger_readGlobalVariable("uint8", "cil_stMeasurementFrameContent,,app.elf", 5);
    EvalManStepEqual("Expected Test Result", result, $Meas_RBTM_FL_06_ST3.raw64);
  
    testCaseComment("Action: ARCH_SW_CIL_0726");
    testStep("STEP", "Evaluate if variable cil_stMeasurementFrameContent.Meas_RBTM_FL_07 and signal Meas_RBTM_FL_07_ST3 are equal to KU8_MAX. --> KU8_MAX");
    result = debugger_readGlobalVariable("uint8", "cil_stMeasurementFrameContent,,app.elf", 6);
    EvalManStepEqual("Expected Test Result", result, $Meas_RBTM_FL_07_ST3.raw64);
  
    testCaseComment("Action: ARCH_SW_CIL_0726");
    testStep("STEP", "Evaluate if variable cil_stMeasurementFrameContent.Meas_RBTM_FL_08 and signal Meas_RBTM_FL_08_ST3 are equal to KU8_MAX. --> KU8_MAX");
    result = debugger_readGlobalVariable("uint8", "cil_stMeasurementFrameContent,,app.elf", 7);
    EvalManStepEqual("Expected Test Result", result, $Meas_RBTM_FL_08_ST3.raw64);

  
  testCaseComment("Postcondition");
  testStep("STEP", "Return ECU to default values");
  RunPostTs(); 
}



testcase SW_IT_CIL_Update_07Cx_Block15_01()
{
  //***********************************Test report header*********************************
  testReportAddMiscInfoBlock("AUTOLIV ELECTRONICS document");
  TestReportAddMiscInfo("Nightly test", "No");
  TestReportAddMiscInfo("Test type", "Requirement-Based test");
  TestReportAddMiscInfo("Regression Test", "No");
  TestReportAddMiscInfo("Fault injection method used", "No");
  TestReportAddMiscInfo("Resource usage evaluation", "No");
  TestReportAddMiscInfo("Priority", "No");
  TestReportAddMiscInfo("Safety relevant", "No");
  
  AddRequirementInfo("Requirement under test", "ARCH_SW_CIL_0725, ARCH_SW_CIL_0771, ARCH_SW_CIL_0772");
  AddRequirementInfo("ARCH_SW_CIL_0725", "If selected, the content of the measurement frame - block #15 shall be encoded and provided to CAN..");
  AddRequirementInfo("ARCH_SW_CIL_0771", "Rte_BFE_psrExecutedCycle_u8CycleNumber shall be read in order to determine the current cycle.");
  AddRequirementInfo("ARCH_SW_CIL_0772", "Rte_BFE_psrExecutedStep_u8StepNumber ");
  //***************************************************************************************
    
  testCaseComment("Preconditions");
  testStep("STEP", "Bench Initialization");
  
  RunPreTs();
  

//    AuthenticateECU(2);
    EnterDiagnosticSession("development");
    
    testStep("STEP", "Activate Measurement Frame block 15.");
    ActivateMeasurementFrame(15);
    
    testStep("STEP", "Set a breakpoint in function cil_Update_07Cx_Block15_InfosToSend at line Rte_Read_prrCycleNumber_u8CycleNumber(&u8CurrentCycle);.");
    debugger_setBpAtLine("s:\\Components\\Application\\Autoliv\\CIL\\Implementation\\src\\CIL_ManageMFTransmission.c", 1658);
    testStep("STEP", "Set a breakpoint in function cil_Update_07Cx_Block15_InfosToSend at line Rte_Read_prrStepNumber_u8StepNumber(&u8CurrentStep);.");
    debugger_setBpAtLine("s:\\Components\\Application\\Autoliv\\CIL\\Implementation\\src\\CIL_ManageMFTransmission.c", 1657);
    
    testCaseComment("Action: ARCH_SW_CIL_0772");
    testStep("STEP", "Check if CPU stopped at line Rte_Read_prrStepNumber_u8StepNumber(&u8CurrentStep);. --> CPU is Stopped");
    debugger_isCPUStoppedAtFunction("cil_Update_07Cx_Block15_InfosToSend");
    ////EvalManStepEqual("Expected Test Result", debugger_result,  "CPU is Stopped");
    
    debugger_run();
    
    testCaseComment("Action: ARCH_SW_CIL_0771");
    testStep("STEP", "Check if CPU stopped at line Rte_Read_prrCycleNumber_u8CycleNumber(&u8CurrentCycle);. --> CPU is Stopped");
    debugger_isCPUStoppedAtFunction("cil_Update_07Cx_Block15_InfosToSend");
    ////EvalManStepEqual("Expected Test Result", debugger_result,  "CPU is Stopped");
    
    testStep("STEP", "Set a breakpoint at the last line of function cil_Update_07Cx_Block15_InfosToSend.");
    debugger_setRelativeFunctionBpAtLine("cil_Update_07Cx_Block15_InfosToSend", 8);
    
    debugger_run();
    
    testCaseComment("Action: ARCH_SW_CIL_0725");
    testStep("STEP", "Evaluate if variable cil_stMeasurementFrameContent.Meas_RBTM_FL_01 and signal Meas_RBTM_FL_01_ST3 are equal to CU8_BLOCK_ID_15. --> CU8_BLOCK_ID_15");
    result = debugger_readGlobalVariable("uint8", "cil_stMeasurementFrameContent,,app.elf", 0);
    EvalManStepEqual("Expected Test Result", result, $Meas_RBTM_FL_01_ST3.raw64);
        
    testCaseComment("Action: ARCH_SW_CIL_0725");
    testStep("STEP", "Evaluate if variable cil_stMeasurementFrameContent.Meas_RBTM_FL_02 and signal Meas_RBTM_FL_02_ST3 are equal to KU8_MAX. --> KU8_MAX");
    result = debugger_readGlobalVariable("uint8", "cil_stMeasurementFrameContent,,app.elf", 1);
    EvalManStepEqual("Expected Test Result", result, $Meas_RBTM_FL_02_ST3.raw64);
    
    testCaseComment("Action: ARCH_SW_CIL_0725");
    testStep("STEP", "Evaluate if variable cil_stMeasurementFrameContent.Meas_RBTM_FL_03 and signal Meas_RBTM_FL_03_ST3 are equal to KU8_MAX. --> KU8_MAX)");
    result = debugger_readGlobalVariable("uint8", "cil_stMeasurementFrameContent,,app.elf", 2);
    EvalManStepEqual("Expected Test Result", result, $Meas_RBTM_FL_03_ST3.raw64);
    
    testCaseComment("Action: ARCH_SW_CIL_0725");
    testStep("STEP", "Evaluate if variable cil_stMeasurementFrameContent.Meas_RBTM_FL_04 and signal Meas_RBTM_FL_04_ST3 are equal to KU8_MAX. --> KU8_MAX");
    result = debugger_readGlobalVariable("uint8", "cil_stMeasurementFrameContent,,app.elf", 3);
    EvalManStepEqual("Expected Test Result", result, $Meas_RBTM_FL_04_ST3.raw64);
    
    testCaseComment("Action: ARCH_SW_CIL_0725");
    testStep("STEP", "Evaluate if variable cil_stMeasurementFrameContent.Meas_RBTM_FL_05 and signal Meas_RBTM_FL_05_ST3 are equal to KU8_MAX. --> KU8_MAX");
    result = debugger_readGlobalVariable("uint8", "cil_stMeasurementFrameContent,,app.elf", 4);
    EvalManStepEqual("Expected Test Result", result, $Meas_RBTM_FL_05_ST3.raw64);
      
    testCaseComment("Action: ARCH_SW_CIL_0725");
    testStep("STEP", "Evaluate if variable cil_stMeasurementFrameContent.Meas_RBTM_FL_06 and signal Meas_RBTM_FL_06_ST3 are equal to KU8_MAX. --> KU8_MAX");
    result = debugger_readGlobalVariable("uint8", "cil_stMeasurementFrameContent,,app.elf", 5);
    EvalManStepEqual("Expected Test Result", result, $Meas_RBTM_FL_06_ST3.raw64);
  
    testCaseComment("Action: ARCH_SW_CIL_0725");
    testStep("STEP", "Evaluate if variable cil_stMeasurementFrameContent.Meas_RBTM_FL_07 and signal Meas_RBTM_FL_07_ST3 are equal to KU8_MAX. --> KU8_MAX");
    result = debugger_readGlobalVariable("uint8", "cil_stMeasurementFrameContent,,app.elf", 6);
    EvalManStepEqual("Expected Test Result", result, $Meas_RBTM_FL_07_ST3.raw64);
  
    testCaseComment("Action: ARCH_SW_CIL_0725");
    testStep("STEP", "Evaluate if variable cil_stMeasurementFrameContent.Meas_RBTM_FL_08 and signal Meas_RBTM_FL_08_ST3 are equal to KU8_MAX. --> KU8_MAX");
    result = debugger_readGlobalVariable("uint8", "cil_stMeasurementFrameContent,,app.elf", 7);
    EvalManStepEqual("Expected Test Result", result, $Meas_RBTM_FL_08_ST3.raw64);

  
  testCaseComment("Postcondition");
  testStep("STEP", "Return ECU to default values");
  
  RunPostTs(); 
}



testcase SW_IT_CIL_Update_07Cx_Block14_01()
{
  //***********************************Test report header*********************************
  testReportAddMiscInfoBlock("AUTOLIV ELECTRONICS document");
  TestReportAddMiscInfo("Nightly test", "No");
  TestReportAddMiscInfo("Test type", "Requirement-Based test");
  TestReportAddMiscInfo("Regression Test", "No");
  TestReportAddMiscInfo("Fault injection method used", "No");
  TestReportAddMiscInfo("Resource usage evaluation", "No");
  TestReportAddMiscInfo("Priority", "No");
  TestReportAddMiscInfo("Safety relevant", "No");
  
  AddRequirementInfo("Requirement under test", "ARCH_SW_CIL_0724, ARCH_SW_CIL_0760");
  AddRequirementInfo("ARCH_SW_CIL_0724", "If selected, the content of the measurement frame - block #14 shall be encoded and provided to CAN.");
  AddRequirementInfo("ARCH_SW_CIL_0760", "BMM_runGetPositionRange_mm shall be called to get the range of the belt position measured since the last ECU start-up.");
  //***************************************************************************************
    
  testCaseComment("Preconditions");
  testStep("STEP", "Bench Initialization");
  RunPreTs();

  
    EnterDiagnosticSession("development");
    
    testStep("STEP", "Activate Measurement Frame block 14.");
    ActivateMeasurementFrame(14);
    
    testStep("STEP", "Set a breakpoint in function cil_Update_07Cx_Block14_InfosToSend at line 'Rte_Call_pclBelt_D_GetRange_mm(&s16OriginPosition, &s16MaxPosition);'.");
    debugger_setRelativeFunctionBpAtLine("cil_Update_07Cx_Block14_InfosToSend", 33);
    testStep("STEP", "Set a breakpoint in function cil_Update_07Cx_Block14_InfosToSend at line 'Rte_Call_pclBelt_D_GetFromT0_mm(&s16BeltPayoutInmm);'.");
    debugger_setRelativeFunctionBpAtLine("cil_Update_07Cx_Block14_InfosToSend", 38);
    
    
    testCaseComment("Action: ARCH_SW_CIL_0760");
    testStep("STEP", "Check if CPU stopped at line Rte_Call_pclBelt_D_GetRange_mm(&s16OriginPosition, &s16MaxPosition);. --> CPU is Stopped");
    testWaitForTimeoutSilent(1000);
    
    debugger_run();
    
    testCaseComment("Action: ARCH_SW_CIL_0760");
    testStep("STEP", "Check if CPU stopped at line 'Rte_Call_pclBelt_D_GetFromT0_mm(&s16BeltPayoutInmm);'. --> CPU is Stopped");
    testWaitForTimeoutSilent(1000);
  
  
    testWaitForTimeoutSilent(1000);
  
    
    testStep("STEP", "Set a breakpoint at the last line of function cil_Update_07Cx_Block14_InfosToSend.");
    debugger_setRelativeFunctionBpAtLine("cil_Update_07Cx_Block14_InfosToSend", 61);
    
    debugger_run();
    
    testStep("STEP", "Read variable s16OriginPosition.");
    result = debugger_readLocalVariable("s16OriginPosition");
    EvalManStepEqual("Expected Test Result", result, 0);
    
    testStep("STEP", "Read variable s16BeltPayoutInmm.");
    result = debugger_readLocalVariable("s16BeltPayoutInmm");
    EvalManStepEqual("Expected Test Result", result, 0);
    
    testCaseComment("Action: ARCH_SW_CIL_0724");
    testStep("STEP", "Evaluate if variable cil_stMeasurementFrameContent.Meas_RBTM_FL_01 and signal Meas_RBTM_FL_01_ST3 are equal to CU8_BLOCK_ID_14. --> CU8_BLOCK_ID_14");
    result = debugger_readGlobalVariable("uint8", "cil_stMeasurementFrameContent,,app.elf", 0);
    EvalManStepEqual("Expected Test Result", result, $Meas_RBTM_FL_01_ST3.raw64);
        
    testCaseComment("Action: ARCH_SW_CIL_0724");
    testStep("STEP", "Evaluate if variable cil_stMeasurementFrameContent.Meas_RBTM_FL_02 and signal Meas_RBTM_FL_02_ST3 are equal to 	248 (0xF8). --> 	248 (0xF8)");
    result = debugger_readGlobalVariable("uint8", "cil_stMeasurementFrameContent,,app.elf", 1);
    EvalManStepEqual("Expected Test Result", result, $Meas_RBTM_FL_02_ST3.raw64);
    
    testCaseComment("Action: ARCH_SW_CIL_0724");
    testStep("STEP", "Evaluate if variable cil_stMeasurementFrameContent.Meas_RBTM_FL_03 and signal Meas_RBTM_FL_03_ST3 are equal to KU8_ZERO. --> KU8_ZERO");
    result = debugger_readGlobalVariable("uint8", "cil_stMeasurementFrameContent,,app.elf", 2);
    EvalManStepEqual("Expected Test Result", result, $Meas_RBTM_FL_03_ST3.raw64);
    
    testCaseComment("Action: ARCH_SW_CIL_0724");
    testStep("STEP", "Evaluate if variable cil_stMeasurementFrameContent.Meas_RBTM_FL_04 and signal Meas_RBTM_FL_04_ST3 are equal to KU8_ZERO. --> KU8_ZERO");
    result = debugger_readGlobalVariable("uint8", "cil_stMeasurementFrameContent,,app.elf", 3);
    EvalManStepEqual("Expected Test Result", result, $Meas_RBTM_FL_04_ST3.raw64);
    
    testCaseComment("Action: ARCH_SW_CIL_0724");
    testStep("STEP", "Evaluate if variable cil_stMeasurementFrameContent.Meas_RBTM_FL_05 and signal Meas_RBTM_FL_05_ST3 are equal to KU8_ZERO. --> KU8_ZERO");
    result = debugger_readGlobalVariable("uint8", "cil_stMeasurementFrameContent,,app.elf", 4);
    EvalManStepEqual("Expected Test Result", result, $Meas_RBTM_FL_05_ST3.raw64);
      
    testCaseComment("Action: ARCH_SW_CIL_0724");
    testStep("STEP", "Evaluate if variable cil_stMeasurementFrameContent.Meas_RBTM_FL_06 and signal Meas_RBTM_FL_06_ST3 are equal to KU8_ZERO. --> KU8_ZERO");
    result = debugger_readGlobalVariable("uint8", "cil_stMeasurementFrameContent,,app.elf", 5);
    EvalManStepEqual("Expected Test Result", result, $Meas_RBTM_FL_06_ST3.raw64);
  
    testCaseComment("Action: ARCH_SW_CIL_0724");
    testStep("STEP", "Evaluate if variable cil_stMeasurementFrameContent.Meas_RBTM_FL_07 and signal Meas_RBTM_FL_07_ST3 are equal to KU8_ZERO. --> KU8_ZERO");
    result = debugger_readGlobalVariable("uint8", "cil_stMeasurementFrameContent,,app.elf", 6);
    EvalManStepEqual("Expected Test Result", result, $Meas_RBTM_FL_07_ST3.raw64);
  
    testCaseComment("Action: ARCH_SW_CIL_0724");
    testStep("STEP", "Evaluate if variable cil_stMeasurementFrameContent.Meas_RBTM_FL_08 and signal Meas_RBTM_FL_08_ST3 are equal to KU8_ZERO. --> KU8_ZERO");
    result = debugger_readGlobalVariable("uint8", "cil_stMeasurementFrameContent,,app.elf", 7);
    EvalManStepEqual("Expected Test Result", result, $Meas_RBTM_FL_08_ST3.raw64);
  
  
  testCaseComment("Postcondition");
  testStep("STEP", "Return ECU to default values");
  RunPostTs(); 
}


testcase SW_IT_CIL_Update_07Cx_Block13_01()
{
  //***********************************Test report header*********************************
  testReportAddMiscInfoBlock("AUTOLIV ELECTRONICS document");
  TestReportAddMiscInfo("Nightly test", "No");
  TestReportAddMiscInfo("Test type", "Requirement-Based test");
  TestReportAddMiscInfo("Regression Test", "No");
  TestReportAddMiscInfo("Fault injection method used", "No");
  TestReportAddMiscInfo("Resource usage evaluation", "No");
  TestReportAddMiscInfo("Priority", "No");
  TestReportAddMiscInfo("Safety relevant", "No");
  
  AddRequirementInfo("Requirement under test", "ARCH_SW_CIL_0723, ARCH_SW_CIL_0757, ARCH_SW_CIL_0758, ARCH_SW_CIL_0761");
  AddRequirementInfo("ARCH_SW_CIL_0723", "If selected, the content of the measurement frame - block #13 shall be encoded and provided to CAN.");
  AddRequirementInfo("ARCH_SW_CIL_0761", "PAL_runReadMotorCurrentInA shall be called to get the motor current in Amps.");
  AddRequirementInfo("ARCH_SW_CIL_0758", "BMM_runGetPositionFromMinPos_mm shall be called to get the minimal seat belt position since the last ECU start-up.");
  AddRequirementInfo("ARCH_SW_CIL_0757", "BMM_runGetPositionFromT0_deg shall be called to get the seat belt position since the last ECU start-up.");
  //***************************************************************************************
    
  testCaseComment("Preconditions");
  testStep("STEP", "Bench Initialization");
  RunPreTs();
  

    EnterDiagnosticSession("development");
    testStep("STEP", "Activate Measurement Frame block 13.");
    ActivateMeasurementFrame(13);
    
  
    testStep("STEP", "Set a breakpoint in function cil_Update_07Cx_Block13_InfosToSend at line Rte_Call_pclMotor_I_Get_A(&s8MotorCurrentInA);.");
    debugger_setRelativeFunctionBpAtLine("cil_Update_07Cx_Block13_InfosToSend", 34);
  
    debugger_run();
  
    testCaseComment("Action: ARCH_SW_CIL_0761");
    testStep("STEP", "Check if CPU stopped at line Rte_Call_pclMotor_I_Get_A(&s8MotorCurrentInA);. --> CPU is Stopped");
    debugger_WaitUntilBPisReached(1000);
  
  
    debugger_deleteAllBP();
  
  
    testStep("STEP", "Set a breakpoint in function cil_Update_07Cx_Block13_InfosToSend at line Rte_Call_pclBelt_D_GetFromMinPos_mm(&s16BeltPayoutInmm);.");
    debugger_setRelativeFunctionBpAtLine("cil_Update_07Cx_Block13_InfosToSend", 43);
    
    debugger_run();
  
    testCaseComment("Action: ARCH_SW_CIL_0758, ARCH_SW_CIL_0757");
    testStep("STEP", "Check if CPU stopped at line Rte_Call_pclBelt_D_GetFromMinPos_mm(&s16BeltPayoutInmm);. --> CPU is Stopped");
    debugger_WaitUntilBPisReached(1000);
  
  
    debugger_deleteAllBP();
  
    
    testStep("STEP", "Set a breakpoint at the last line of function cil_Update_07Cx_Block13_InfosToSend.");
    debugger_setRelativeFunctionBpAtLine("cil_Update_07Cx_Block13_InfosToSend", 66);
    
    debugger_run();
    
    testStep("STEP", "Read variable s16BeltPayoutInmm.");
    result = debugger_readLocalVariable("s16BeltPayoutInmm");
    EvalManStepEqual("Expected Test Result", result, 0);
    
    testStep("STEP", "Read variable s8MotorCurrentInA.");
    result = debugger_readLocalVariable("s8MotorCurrentInA");
    EvalManStepEqual("Expected Test Result", result, 0);
    
    testCaseComment("Action: ARCH_SW_CIL_0723");
    testStep("STEP", "Evaluate if variable cil_stMeasurementFrameContent.Meas_RBTM_FL_01 and signal Meas_RBTM_FL_01_ST3 are equal to CU8_BLOCK_ID_13. --> CU8_BLOCK_ID_13");
    result = debugger_readGlobalVariable("uint8", "cil_stMeasurementFrameContent,,app.elf", 0);
    EvalManStepEqual("Expected Test Result", result, $Meas_RBTM_FL_01_ST3.raw64);
        
    testCaseComment("Action: ARCH_SW_CIL_0723");
    testStep("STEP", "Evaluate if variable cil_stMeasurementFrameContent.Meas_RBTM_FL_02 and signal Meas_RBTM_FL_02_ST3 are equal to 248 (0xF8). --> 248 (0xF8)");
    result = debugger_readGlobalVariable("uint8", "cil_stMeasurementFrameContent,,app.elf", 1);
    EvalManStepEqual("Expected Test Result", result, $Meas_RBTM_FL_02_ST3.raw64);
    
    testCaseComment("Action: ARCH_SW_CIL_0723");
    testStep("STEP", "Evaluate if variable cil_stMeasurementFrameContent.Meas_RBTM_FL_03 and signal Meas_RBTM_FL_03_ST3 are equal to KU8_ZERO. --> KU8_ZERO");
    result = debugger_readGlobalVariable("uint8", "cil_stMeasurementFrameContent,,app.elf", 2);
    EvalManStepEqual("Expected Test Result", result, $Meas_RBTM_FL_03_ST3.raw64);
    
    testCaseComment("Action: ARCH_SW_CIL_0723");
    testStep("STEP", "Evaluate if variable cil_stMeasurementFrameContent.Meas_RBTM_FL_04 and signal Meas_RBTM_FL_04_ST3 are equal to KU8_ZERO. --> KU8_ZERO");
    result = debugger_readGlobalVariable("uint8", "cil_stMeasurementFrameContent,,app.elf", 3);
    EvalManStepEqual("Expected Test Result", result, $Meas_RBTM_FL_04_ST3.raw64);
    
    testCaseComment("Action: ARCH_SW_CIL_0723");
    testStep("STEP", "Evaluate if variable cil_stMeasurementFrameContent.Meas_RBTM_FL_05 and signal Meas_RBTM_FL_05_ST3 are equal to KU8_ZERO. --> KU8_ZERO");
    result = debugger_readGlobalVariable("uint8", "cil_stMeasurementFrameContent,,app.elf", 4);
    EvalManStepEqual("Expected Test Result", result, $Meas_RBTM_FL_05_ST3.raw64);
      
    testCaseComment("Action: ARCH_SW_CIL_0723");
    testStep("STEP", "Evaluate if variable cil_stMeasurementFrameContent.Meas_RBTM_FL_06 and signal Meas_RBTM_FL_06_ST3 are equal to KU8_ZERO. --> KU8_ZERO");
    result = debugger_readGlobalVariable("uint8", "cil_stMeasurementFrameContent,,app.elf", 5);
    EvalManStepEqual("Expected Test Result", result, $Meas_RBTM_FL_06_ST3.raw64);
  
    testCaseComment("Action: ARCH_SW_CIL_0723");
    testStep("STEP", "Evaluate if variable cil_stMeasurementFrameContent.Meas_RBTM_FL_07 and signal Meas_RBTM_FL_07_ST3 are equal to KU8_ZERO. --> KU8_ZERO");
    result = debugger_readGlobalVariable("uint8", "cil_stMeasurementFrameContent,,app.elf", 6);
    EvalManStepEqual("Expected Test Result", result, $Meas_RBTM_FL_07_ST3.raw64);
  
    testCaseComment("Action: ARCH_SW_CIL_0723");
    testStep("STEP", "Evaluate if variable cil_stMeasurementFrameContent.Meas_RBTM_FL_08 and signal Meas_RBTM_FL_08_ST3 are equal to KU8_MAX. --> KU8_MAX");
    result = debugger_readGlobalVariable("uint8", "cil_stMeasurementFrameContent,,app.elf", 7);
    EvalManStepEqual("Expected Test Result", result, $Meas_RBTM_FL_08_ST3.raw64);
  
  
  testCaseComment("Postcondition");
  testStep("STEP", "Return ECU to default values");
  RunPostTs(); 
}


testcase SW_IT_CIL_Update_07Cx_Block12_01()
{
  //***********************************Test report header*********************************
  testReportAddMiscInfoBlock("AUTOLIV ELECTRONICS document");
  TestReportAddMiscInfo("Nightly test", "No");
  TestReportAddMiscInfo("Test type", "Requirement-Based test");
  TestReportAddMiscInfo("Regression Test", "No");
  TestReportAddMiscInfo("Fault injection method used", "No");
  TestReportAddMiscInfo("Resource usage evaluation", "No");
  TestReportAddMiscInfo("Priority", "No");
  TestReportAddMiscInfo("Safety relevant", "No");
  
  AddRequirementInfo("Requirement under test", "ARCH_SW_CIL_0722");
  AddRequirementInfo("ARCH_SW_CIL_0722", "If selected, the content of the measurement frame - block #12 shall be encoded and provided to CAN.");
  //***************************************************************************************
    
  testCaseComment("Preconditions");
  testStep("STEP", "Bench Initialization");
  RunPreTs();
  

//    AuthenticateECU(2);
    EnterDiagnosticSession("development");
    
    testStep("STEP", "Activate Measurement Frame block 12.");
    ActivateMeasurementFrame(12);
    
    testStep("STEP", "Set a breakpoint at the last line of function cil_Update_07Cx_Block12_InfosToSend.");
    debugger_setRelativeFunctionBpAtLine("cil_Update_07Cx_Block12_InfosToSend", 48);
    
    testCaseComment("Action: ARCH_SW_CIL_0722");
    testStep("STEP", "Evaluate if variable cil_stMeasurementFrameContent.Meas_RBTM_FL_01 and signal Meas_RBTM_FL_01_ST3 are equal. --> Variable cil_stMeasurementFrameContent.Meas_RBTM_FL_01 is equal to signal Meas_RBTM_FL_01_ST3");
    result = debugger_readGlobalVariable("uint8", "cil_stMeasurementFrameContent,,app.elf", 0);
    EvalManStepEqual("Expected Test Result", result, $Meas_RBTM_FL_01_ST3.raw64);
        
    testCaseComment("Action: ARCH_SW_CIL_0722");
    testStep("STEP", "Evaluate if variable cil_stMeasurementFrameContent.Meas_RBTM_FL_02 and signal Meas_RBTM_FL_02_ST3 are equal. --> Variable cil_stMeasurementFrameContent.Meas_RBTM_FL_02 is equal to signal Meas_RBTM_FL_02_ST3");
    result = debugger_readGlobalVariable("uint8", "cil_stMeasurementFrameContent,,app.elf", 1);
    EvalManStepEqual("Expected Test Result", result, $Meas_RBTM_FL_02_ST3.raw64);
    
    testCaseComment("Action: ARCH_SW_CIL_0722");
    testStep("STEP", "Evaluate if variable cil_stMeasurementFrameContent.Meas_RBTM_FL_03 and signal Meas_RBTM_FL_03_ST3 are equal. --> Variable cil_stMeasurementFrameContent.Meas_RBTM_FL_03 is equal to signal Meas_RBTM_FL_03_ST3");
    result = debugger_readGlobalVariable("uint8", "cil_stMeasurementFrameContent,,app.elf", 2);
    EvalManStepEqual("Expected Test Result", result, $Meas_RBTM_FL_03_ST3.raw64);
    
    testCaseComment("Action: ARCH_SW_CIL_0722");
    testStep("STEP", "Evaluate if variable cil_stMeasurementFrameContent.Meas_RBTM_FL_04 and signal Meas_RBTM_FL_04_ST3 are equal. --> Variable cil_stMeasurementFrameContent.Meas_RBTM_FL_04 is equal to signal Meas_RBTM_FL_04_ST3");
    result = debugger_readGlobalVariable("uint8", "cil_stMeasurementFrameContent,,app.elf", 3);
    EvalManStepEqual("Expected Test Result", result, $Meas_RBTM_FL_04_ST3.raw64);
    
    testCaseComment("Action: ARCH_SW_CIL_0722");
    testStep("STEP", "Evaluate if variable cil_stMeasurementFrameContent.Meas_RBTM_FL_05 and signal Meas_RBTM_FL_05_ST3 are equal. --> Variable cil_stMeasurementFrameContent.Meas_RBTM_FL_05 is equal to signal Meas_RBTM_FL_05_ST3");
    result = debugger_readGlobalVariable("uint8", "cil_stMeasurementFrameContent,,app.elf", 4);
    EvalManStepEqual("Expected Test Result", result, $Meas_RBTM_FL_05_ST3.raw64);
      
    testCaseComment("Action: ARCH_SW_CIL_0722");
    testStep("STEP", "Evaluate if variable cil_stMeasurementFrameContent.Meas_RBTM_FL_06 and signal Meas_RBTM_FL_06_ST3 are equal. --> Variable cil_stMeasurementFrameContent.Meas_RBTM_FL_06 is equal to signal Meas_RBTM_FL_06_ST3");
    result = debugger_readGlobalVariable("uint8", "cil_stMeasurementFrameContent,,app.elf", 5);
    EvalManStepEqual("Expected Test Result", result, $Meas_RBTM_FL_06_ST3.raw64);
  
    testCaseComment("Action: ARCH_SW_CIL_0722");
    testStep("STEP", "Evaluate if variable cil_stMeasurementFrameContent.Meas_RBTM_FL_07 and signal Meas_RBTM_FL_07_ST3 are equal. --> Variable cil_stMeasurementFrameContent.Meas_RBTM_FL_07 is equal to signal Meas_RBTM_FL_07_ST3");
    result = debugger_readGlobalVariable("uint8", "cil_stMeasurementFrameContent,,app.elf", 6);
    EvalManStepEqual("Expected Test Result", result, $Meas_RBTM_FL_07_ST3.raw64);
  
    testCaseComment("Action: ARCH_SW_CIL_0722");
    testStep("STEP", "Evaluate if variable cil_stMeasurementFrameContent.Meas_RBTM_FL_08 and signal Meas_RBTM_FL_08_ST3 are equal. --> Variable cil_stMeasurementFrameContent.Meas_RBTM_FL_08 is equal to signal Meas_RBTM_FL_08_ST3");
    result = debugger_readGlobalVariable("uint8", "cil_stMeasurementFrameContent,,app.elf", 7);
    EvalManStepEqual("Expected Test Result", result, $Meas_RBTM_FL_08_ST3.raw64);
  
  
  testCaseComment("Postcondition");
  testStep("STEP", "Return ECU to default values");
  RunPostTs(); 
}


testcase SW_IT_CIL_Update_07Cx_Block11_01()
{
  //***********************************Test report header*********************************
  testReportAddMiscInfoBlock("AUTOLIV ELECTRONICS document");
  TestReportAddMiscInfo("Nightly test", "No");
  TestReportAddMiscInfo("Test type", "Requirement-Based test");
  TestReportAddMiscInfo("Regression Test", "No");
  TestReportAddMiscInfo("Fault injection method used", "No");
  TestReportAddMiscInfo("Resource usage evaluation", "No");
  TestReportAddMiscInfo("Priority", "No");
  TestReportAddMiscInfo("Safety relevant", "No");
  
  AddRequirementInfo("Requirement under test", "ARCH_SW_CIL_0721, ARCH_SW_CIL_0750, ARCH_SW_CIL_0751, ARCH_SW_CIL_0762");
  AddRequirementInfo("ARCH_SW_CIL_0721", "If selected, the content of the measurement frame - block #11 shall be encoded and provided to CAN.");
  AddRequirementInfo("ARCH_SW_CIL_0750", "AdcIf_runGetMotor_Ip_(Ext)* shall be called to get the sampled value of the current provided by the ‘P’ half bridge.");
  AddRequirementInfo("ARCH_SW_CIL_0751", "AdcIf_runGetMotor_In_(Ext)* shall be called to get the sampled value of the current provided by the ‘N’ half bridge.");
  AddRequirementInfo("ARCH_SW_CIL_0762", "PAL_runReadMotorCurrentInmA shall be called to get the motor current in mAmps.");
  //***************************************************************************************
    
  testCaseComment("Preconditions");
  testStep("STEP", "Bench Initialization");
  RunPreTs();

//    AuthenticateECU(2);
    EnterDiagnosticSession("development");
    
    testStep("STEP", "Activate Measurement Frame block 11.");
    ActivateMeasurementFrame(11);
    
    testStep("STEP", "Set a breakpoint in function cil_Update_07Cx_Block11_InfosToSend at line Rte_Call_pclMotor_In_raw_raw_Get(&u16MotorCurrentRelRaw);.");
    debugger_setRelativeFunctionBpAtLine("cil_Update_07Cx_Block11_InfosToSend", 19);
    testStep("STEP", "Set a breakpoint in function cil_Update_07Cx_Block11_InfosToSend at line Rte_Call_pclMotor_Ip_raw_raw_Get(&u16MotorCurrentTensRaw);.");
    debugger_setRelativeFunctionBpAtLine("cil_Update_07Cx_Block11_InfosToSend", 24);
    testStep("STEP", "Set a breakpoint in function cil_Update_07Cx_Block11_InfosToSend at line Rte_Call_pclMotor_I_Get_mA(&s32ScaledMotorCurrent);.");
    debugger_setRelativeFunctionBpAtLine("cil_Update_07Cx_Block11_InfosToSend", 33);
    
    testCaseComment("Action: ARCH_SW_CIL_0751");
    testStep("STEP", "Check if CPU stopped at line Rte_Call_pclMotor_In_raw_raw_Get(&u16MotorCurrentRelRaw);. --> CPU is Stopped");
    debugger_isCPUStoppedAtFunction("cil_Update_07Cx_Block11_InfosToSend");    ////EvalManStepEqual("Expected Test Result", debugger_result,  "CPU is Stopped");
    
    debugger_run();
    
    testCaseComment("Action: ARCH_SW_CIL_0750");
    testStep("STEP", "Check if CPU stopped at line Rte_Call_pclMotor_Ip_raw_raw_Get(&u16MotorCurrentTensRaw);. --> CPU is Stopped");
    debugger_isCPUStoppedAtFunction("cil_Update_07Cx_Block11_InfosToSend");
    ////EvalManStepEqual("Expected Test Result", debugger_result,  "CPU is Stopped");
    
    debugger_run();
    
    testCaseComment("Action: ARCH_SW_CIL_0762");
    testStep("STEP", "Check if CPU stopped at line Rte_Call_pclMotor_I_Get_mA(&s32ScaledMotorCurrent);. --> CPU is Stopped");
    debugger_isCPUStoppedAtFunction("cil_Update_07Cx_Block11_InfosToSend");
    ////EvalManStepEqual("Expected Test Result", debugger_result,  "CPU is Stopped");
    
    
    testStep("STEP", "Set a breakpoint at the last line of function cil_Update_07Cx_Block11_InfosToSend.");
    debugger_setRelativeFunctionBpAtLine("cil_Update_07Cx_Block11_InfosToSend", 55);
    
    debugger_run();
    
    testCaseComment("Action: ARCH_SW_CIL_0721");
    testStep("STEP", "Evaluate if variable cil_stMeasurementFrameContent.Meas_RBTM_FL_01 and signal Meas_RBTM_FL_01_ST3 are equal. --> Variable cil_stMeasurementFrameContent.Meas_RBTM_FL_01 is equal to signal Meas_RBTM_FL_01_ST3");
    result = debugger_readGlobalVariable("uint8", "cil_stMeasurementFrameContent,,app.elf", 0);
    EvalManStepEqual("Expected Test Result", result, $Meas_RBTM_FL_01_ST3.raw64);
        
    testCaseComment("Action: ARCH_SW_CIL_0721");
    testStep("STEP", "Evaluate if variable cil_stMeasurementFrameContent.Meas_RBTM_FL_02 and signal Meas_RBTM_FL_02_ST3 are equal. --> Variable cil_stMeasurementFrameContent.Meas_RBTM_FL_02 is equal to signal Meas_RBTM_FL_02_ST3");
    result = debugger_readGlobalVariable("uint8", "cil_stMeasurementFrameContent,,app.elf", 1);
    EvalManStepEqual("Expected Test Result", result, $Meas_RBTM_FL_02_ST3.raw64);
    
    testCaseComment("Action: ARCH_SW_CIL_0721");
    testStep("STEP", "Evaluate if variable cil_stMeasurementFrameContent.Meas_RBTM_FL_03 and signal Meas_RBTM_FL_03_ST3 are equal. --> Variable cil_stMeasurementFrameContent.Meas_RBTM_FL_03 is equal to signal Meas_RBTM_FL_03_ST3");
    result = debugger_readGlobalVariable("uint8", "cil_stMeasurementFrameContent,,app.elf", 2);
    EvalManStepEqual("Expected Test Result", result, $Meas_RBTM_FL_03_ST3.raw64);
    
    testCaseComment("Action: ARCH_SW_CIL_0721");
    testStep("STEP", "Evaluate if variable cil_stMeasurementFrameContent.Meas_RBTM_FL_04 and signal Meas_RBTM_FL_04_ST3 are equal. --> Variable cil_stMeasurementFrameContent.Meas_RBTM_FL_04 is equal to signal Meas_RBTM_FL_04_ST3");
    result = debugger_readGlobalVariable("uint8", "cil_stMeasurementFrameContent,,app.elf", 3);
    EvalManStepEqual("Expected Test Result", result, $Meas_RBTM_FL_04_ST3.raw64);
    
    testCaseComment("Action: ARCH_SW_CIL_0721");
    testStep("STEP", "Evaluate if variable cil_stMeasurementFrameContent.Meas_RBTM_FL_05 and signal Meas_RBTM_FL_05_ST3 are equal. --> Variable cil_stMeasurementFrameContent.Meas_RBTM_FL_05 is equal to signal Meas_RBTM_FL_05_ST3");
    result = debugger_readGlobalVariable("uint8", "cil_stMeasurementFrameContent,,app.elf", 4);
    EvalManStepEqual("Expected Test Result", result, $Meas_RBTM_FL_05_ST3.raw64);
      
    testCaseComment("Action: ARCH_SW_CIL_0721");
    testStep("STEP", "Evaluate if variable cil_stMeasurementFrameContent.Meas_RBTM_FL_06 and signal Meas_RBTM_FL_06_ST3 are equal. --> Variable cil_stMeasurementFrameContent.Meas_RBTM_FL_06 is equal to signal Meas_RBTM_FL_06_ST3");
    result = debugger_readGlobalVariable("uint8", "cil_stMeasurementFrameContent,,app.elf", 5);
    EvalManStepEqual("Expected Test Result", result, $Meas_RBTM_FL_06_ST3.raw64);
  
    testCaseComment("Action: ARCH_SW_CIL_0721");
    testStep("STEP", "Evaluate if variable cil_stMeasurementFrameContent.Meas_RBTM_FL_07 and signal Meas_RBTM_FL_07_ST3 are equal. --> Variable cil_stMeasurementFrameContent.Meas_RBTM_FL_07 is equal to signal Meas_RBTM_FL_07_ST3");
    result = debugger_readGlobalVariable("uint8", "cil_stMeasurementFrameContent,,app.elf", 6);
    EvalManStepEqual("Expected Test Result", result, $Meas_RBTM_FL_07_ST3.raw64);
  
    testCaseComment("Action: ARCH_SW_CIL_0721");
    testStep("STEP", "Evaluate if variable cil_stMeasurementFrameContent.Meas_RBTM_FL_08 and signal Meas_RBTM_FL_08_ST3 are equal. --> Variable cil_stMeasurementFrameContent.Meas_RBTM_FL_08 is equal to signal Meas_RBTM_FL_08_ST3");
    result = debugger_readGlobalVariable("uint8", "cil_stMeasurementFrameContent,,app.elf", 7);
    EvalManStepEqual("Expected Test Result", result, $Meas_RBTM_FL_08_ST3.raw64);
  
  
  testCaseComment("Postcondition");
  testStep("STEP", "Return ECU to default values");
  RunPostTs(); 
}


testcase SW_IT_CIL_Update_07Cx_Block10_01()
{
  //***********************************Test report header*********************************
  testReportAddMiscInfoBlock("AUTOLIV ELECTRONICS document");
  TestReportAddMiscInfo("Nightly test", "No");
  TestReportAddMiscInfo("Test type", "Requirement-Based test");
  TestReportAddMiscInfo("Regression Test", "No");
  TestReportAddMiscInfo("Fault injection method used", "No");
  TestReportAddMiscInfo("Resource usage evaluation", "No");
  TestReportAddMiscInfo("Priority", "No");
  TestReportAddMiscInfo("Safety relevant", "No");
  
  AddRequirementInfo("Requirement under test", "ARCH_SW_CIL_0720, ARCH_SW_CIL_0753, ARCH_SW_CIL_0754, ARCH_SW_CIL_0755");
  AddRequirementInfo("ARCH_SW_CIL_0720", "If selected, the content of the measurement frame - block #10 shall be encoded and provided to CAN.");
  AddRequirementInfo("ARCH_SW_CIL_0753", "AdcIf_runGetHBS_A_V_(Ext)* shall be called to get the voltage of the HBS ‘A’ monitoring signal.");
  AddRequirementInfo("ARCH_SW_CIL_0754", "AdcIf_runGetHBS_B_V_(Ext)* shall be called to get the voltage of the HBS ‘B’ monitoring signal.");
  AddRequirementInfo("ARCH_SW_CIL_0755", "AdcIf_runGetHS1_V_(Ext)* shall be called to get the sampled value of the HS_SW signal.");
  //***************************************************************************************
    
  testCaseComment("Preconditions");
  testStep("STEP", "Bench Initialization");
  RunPreTs();

//    AuthenticateECU(2);
    EnterDiagnosticSession("development");
    
    testStep("STEP", "Activate Measurement Frame block 10.");
    ActivateMeasurementFrame(10);
    
    testStep("STEP", "Set a breakpoint in function cil_Update_07Cx_Block10_InfosToSend at line Rte_Call_pclHBS_A_V_raw_Get(&u16HBSAVoltageRaw);.");
    debugger_setRelativeFunctionBpAtLine("cil_Update_07Cx_Block10_InfosToSend", 16);
    testStep("STEP", "Set a breakpoint in function cil_Update_07Cx_Block10_InfosToSend at line Rte_Call_pclHBS_B_V_raw_Get(&u16HBSBVoltageRaw);.");
    debugger_setRelativeFunctionBpAtLine("cil_Update_07Cx_Block10_InfosToSend", 22);
    testStep("STEP", "Set a breakpoint in function cil_Update_07Cx_Block10_InfosToSend at line Rte_Call_pclHS1_V_raw_Get(&u16HS1_V_raw);.");
    debugger_setRelativeFunctionBpAtLine("cil_Update_07Cx_Block10_InfosToSend", 28);
    
    testCaseComment("Action: ARCH_SW_CIL_0753");
    testStep("STEP", "Check if CPU stopped at line Rte_Call_pclHBS_A_V_raw_Get(&u16HBSAVoltageRaw);. --> CPU is Stopped");
    debugger_isCPUStoppedAtFunction("cil_Update_07Cx_Block10_InfosToSend");    ////EvalManStepEqual("Expected Test Result", debugger_result,  "CPU is Stopped");
    
    debugger_run();
    
    testCaseComment("Action: ARCH_SW_CIL_0754");
    testStep("STEP", "Check if CPU stopped at line Rte_Call_pclHBS_B_V_raw_Get(&u16HBSBVoltageRaw);. --> CPU is Stopped");
    debugger_isCPUStoppedAtFunction("cil_Update_07Cx_Block10_InfosToSend");
    ////EvalManStepEqual("Expected Test Result", debugger_result,  "CPU is Stopped");
    
    debugger_run();
    
    testCaseComment("Action: ARCH_SW_CIL_0755");
    testStep("STEP", "Check if CPU stopped at line Rte_Call_pclHS1_V_raw_Get(&u16HS1_V_raw);. --> CPU is Stopped");
    debugger_isCPUStoppedAtFunction("cil_Update_07Cx_Block10_InfosToSend");
    ////EvalManStepEqual("Expected Test Result", debugger_result,  "CPU is Stopped");
    
    
    testStep("STEP", "Set a breakpoint at the last line of function cil_Update_07Cx_Block10_InfosToSend.");
    debugger_setRelativeFunctionBpAtLine("cil_Update_07Cx_Block10_InfosToSend", 52);
    
    debugger_run();
    
    testCaseComment("Action: ARCH_SW_CIL_0720");
    testStep("STEP", "Evaluate if variable cil_stMeasurementFrameContent.Meas_RBTM_FL_01 and signal Meas_RBTM_FL_01_ST3 are equal. --> Variable cil_stMeasurementFrameContent.Meas_RBTM_FL_01 is equal to signal Meas_RBTM_FL_01_ST3");
    result = debugger_readGlobalVariable("uint8", "cil_stMeasurementFrameContent,,app.elf", 0);
    EvalManStepEqual("Expected Test Result", result, $Meas_RBTM_FL_01_ST3.raw64);
        
    testCaseComment("Action: ARCH_SW_CIL_0720");
    testStep("STEP", "Evaluate if variable cil_stMeasurementFrameContent.Meas_RBTM_FL_02 and signal Meas_RBTM_FL_02_ST3 are equal. --> Variable cil_stMeasurementFrameContent.Meas_RBTM_FL_02 is equal to signal Meas_RBTM_FL_02_ST3");
    result = debugger_readGlobalVariable("uint8", "cil_stMeasurementFrameContent,,app.elf", 1);
    EvalManStepEqual("Expected Test Result", result, $Meas_RBTM_FL_02_ST3.raw64);
    
    testCaseComment("Action: ARCH_SW_CIL_0720");
    testStep("STEP", "Evaluate if variable cil_stMeasurementFrameContent.Meas_RBTM_FL_03 and signal Meas_RBTM_FL_03_ST3 are equal. --> Variable cil_stMeasurementFrameContent.Meas_RBTM_FL_03 is equal to signal Meas_RBTM_FL_03_ST3");
    result = debugger_readGlobalVariable("uint8", "cil_stMeasurementFrameContent,,app.elf", 2);
    EvalManStepEqual("Expected Test Result", result, $Meas_RBTM_FL_03_ST3.raw64);
    
    testCaseComment("Action: ARCH_SW_CIL_0720");
    testStep("STEP", "Evaluate if variable cil_stMeasurementFrameContent.Meas_RBTM_FL_04 and signal Meas_RBTM_FL_04_ST3 are equal. --> Variable cil_stMeasurementFrameContent.Meas_RBTM_FL_04 is equal to signal Meas_RBTM_FL_04_ST3");
    result = debugger_readGlobalVariable("uint8", "cil_stMeasurementFrameContent,,app.elf", 3);
    EvalManStepEqual("Expected Test Result", result, $Meas_RBTM_FL_04_ST3.raw64);
    
    testCaseComment("Action: ARCH_SW_CIL_0720");
    testStep("STEP", "Evaluate if variable cil_stMeasurementFrameContent.Meas_RBTM_FL_05 and signal Meas_RBTM_FL_05_ST3 are equal. --> Variable cil_stMeasurementFrameContent.Meas_RBTM_FL_05 is equal to signal Meas_RBTM_FL_05_ST3");
    result = debugger_readGlobalVariable("uint8", "cil_stMeasurementFrameContent,,app.elf", 4);
    EvalManStepEqual("Expected Test Result", result, $Meas_RBTM_FL_05_ST3.raw64);
      
    testCaseComment("Action: ARCH_SW_CIL_0720");
    testStep("STEP", "Evaluate if variable cil_stMeasurementFrameContent.Meas_RBTM_FL_06 and signal Meas_RBTM_FL_06_ST3 are equal. --> Variable cil_stMeasurementFrameContent.Meas_RBTM_FL_06 is equal to signal Meas_RBTM_FL_06_ST3");
    result = debugger_readGlobalVariable("uint8", "cil_stMeasurementFrameContent,,app.elf", 5);
    EvalManStepEqual("Expected Test Result", result, $Meas_RBTM_FL_06_ST3.raw64);
  
    testCaseComment("Action: ARCH_SW_CIL_0720");
    testStep("STEP", "Evaluate if variable cil_stMeasurementFrameContent.Meas_RBTM_FL_07 and signal Meas_RBTM_FL_07_ST3 are equal. --> Variable cil_stMeasurementFrameContent.Meas_RBTM_FL_07 is equal to signal Meas_RBTM_FL_07_ST3");
    result = debugger_readGlobalVariable("uint8", "cil_stMeasurementFrameContent,,app.elf", 6);
    EvalManStepEqual("Expected Test Result", result, $Meas_RBTM_FL_07_ST3.raw64);
  
    testCaseComment("Action: ARCH_SW_CIL_0720");
    testStep("STEP", "Evaluate if variable cil_stMeasurementFrameContent.Meas_RBTM_FL_08 and signal Meas_RBTM_FL_08_ST3 are equal. --> Variable cil_stMeasurementFrameContent.Meas_RBTM_FL_08 is equal to signal Meas_RBTM_FL_08_ST3");
    result = debugger_readGlobalVariable("uint8", "cil_stMeasurementFrameContent,,app.elf", 7);
    EvalManStepEqual("Expected Test Result", result, $Meas_RBTM_FL_08_ST3.raw64);
  
    
  testCaseComment("Postcondition");
  testStep("STEP", "Return ECU to default values");
  RunPostTs(); 
}


testcase SW_IT_CIL_Update_07Cx_Block09_01()
{
  //***********************************Test report header*********************************
  testReportAddMiscInfoBlock("AUTOLIV ELECTRONICS document");
  TestReportAddMiscInfo("Nightly test", "No");
  TestReportAddMiscInfo("Test type", "Requirement-Based test");
  TestReportAddMiscInfo("Regression Test", "No");
  TestReportAddMiscInfo("Fault injection method used", "No");
  TestReportAddMiscInfo("Resource usage evaluation", "No");
  TestReportAddMiscInfo("Priority", "No");
  TestReportAddMiscInfo("Safety relevant", "No");
  
  AddRequirementInfo("Requirement under test", "ARCH_SW_CIL_0719, ARCH_SW_CIL_0752");
  AddRequirementInfo("ARCH_SW_CIL_0719", "If selected, the content of the measurement frame - block #10 shall be encoded and provided to CAN.");
  AddRequirementInfo("ARCH_SW_CIL_0752", "AdcIf_runGetKL30_V_(Ext)* shall be called to get the sample value of the battery voltage.");
  //***************************************************************************************
    
  testCaseComment("Preconditions");
  testStep("STEP", "Bench Initialization");
  RunPreTs();
  

//    AuthenticateECU(2);
    EnterDiagnosticSession("development");
    
    testStep("STEP", "Activate Measurement Frame block 9.");
    ActivateMeasurementFrame(9);
    
    testStep("STEP", "Set a breakpoint in function cil_Update_07Cx_Block09_InfosToSend at line Rte_Call_pclKL30_V_raw_Get(&u16KL30_V_raw);.");
    debugger_setRelativeFunctionBpAtLine("cil_Update_07Cx_Block09_InfosToSend", 26);
    
    testCaseComment("Action: ARCH_SW_CIL_0752");
    testStep("STEP", "Check if CPU stopped at line Rte_Call_pclKL30_V_raw_Get(&u16KL30_V_raw);. --> CPU is Stopped");
debugger_isCPUStoppedAtFunction("cil_Update_07Cx_Block09_InfosToSend");    ////EvalManStepEqual("Expected Test Result", debugger_result,  "CPU is Stopped");
    
    testStep("STEP", "Set a breakpoint at the last line of function cil_Update_07Cx_Block09_InfosToSend.");
    debugger_setRelativeFunctionBpAtLine("cil_Update_07Cx_Block09_InfosToSend", 50);
    
    debugger_run();
    
    testCaseComment("Action: ARCH_SW_CIL_0719");
    testStep("STEP", "Evaluate if variable cil_stMeasurementFrameContent.Meas_RBTM_FL_01 and signal Meas_RBTM_FL_01_ST3 are equal. --> Variable cil_stMeasurementFrameContent.Meas_RBTM_FL_01 is equal to signal Meas_RBTM_FL_01_ST3");
    result = debugger_readGlobalVariable("uint8", "cil_stMeasurementFrameContent,,app.elf", 0);
    EvalManStepEqual("Expected Test Result", result, $Meas_RBTM_FL_01_ST3.raw64);
        
    testCaseComment("Action: ARCH_SW_CIL_0719");
    testStep("STEP", "Evaluate if variable cil_stMeasurementFrameContent.Meas_RBTM_FL_02 and signal Meas_RBTM_FL_02_ST3 are equal. --> Variable cil_stMeasurementFrameContent.Meas_RBTM_FL_02 is equal to signal Meas_RBTM_FL_02_ST3");
    result = debugger_readGlobalVariable("uint8", "cil_stMeasurementFrameContent,,app.elf", 1);
    EvalManStepEqual("Expected Test Result", result, $Meas_RBTM_FL_02_ST3.raw64);
    
    testCaseComment("Action: ARCH_SW_CIL_0719");
    testStep("STEP", "Evaluate if variable cil_stMeasurementFrameContent.Meas_RBTM_FL_03 and signal Meas_RBTM_FL_03_ST3 are equal. --> Variable cil_stMeasurementFrameContent.Meas_RBTM_FL_03 is equal to signal Meas_RBTM_FL_03_ST3");
    result = debugger_readGlobalVariable("uint8", "cil_stMeasurementFrameContent,,app.elf", 2);
    EvalManStepEqual("Expected Test Result", result, $Meas_RBTM_FL_03_ST3.raw64);
    
    testCaseComment("Action: ARCH_SW_CIL_0719");
    testStep("STEP", "Evaluate if variable cil_stMeasurementFrameContent.Meas_RBTM_FL_04 and signal Meas_RBTM_FL_04_ST3 are equal. --> Variable cil_stMeasurementFrameContent.Meas_RBTM_FL_04 is equal to signal Meas_RBTM_FL_04_ST3");
    result = debugger_readGlobalVariable("uint8", "cil_stMeasurementFrameContent,,app.elf", 3);
    EvalManStepEqual("Expected Test Result", result, $Meas_RBTM_FL_04_ST3.raw64);
    
    testCaseComment("Action: ARCH_SW_CIL_0719");
    testStep("STEP", "Evaluate if variable cil_stMeasurementFrameContent.Meas_RBTM_FL_05 and signal Meas_RBTM_FL_05_ST3 are equal. --> Variable cil_stMeasurementFrameContent.Meas_RBTM_FL_05 is equal to signal Meas_RBTM_FL_05_ST3");
    result = debugger_readGlobalVariable("uint8", "cil_stMeasurementFrameContent,,app.elf", 4);
    EvalManStepEqual("Expected Test Result", result, $Meas_RBTM_FL_05_ST3.raw64);
      
    testCaseComment("Action: ARCH_SW_CIL_0719");
    testStep("STEP", "Evaluate if variable cil_stMeasurementFrameContent.Meas_RBTM_FL_06 and signal Meas_RBTM_FL_06_ST3 are equal. --> Variable cil_stMeasurementFrameContent.Meas_RBTM_FL_06 is equal to signal Meas_RBTM_FL_06_ST3");
    result = debugger_readGlobalVariable("uint8", "cil_stMeasurementFrameContent,,app.elf", 5);
    EvalManStepEqual("Expected Test Result", result, $Meas_RBTM_FL_06_ST3.raw64);
  
    testCaseComment("Action: ARCH_SW_CIL_0719");
    testStep("STEP", "Evaluate if variable cil_stMeasurementFrameContent.Meas_RBTM_FL_07 and signal Meas_RBTM_FL_07_ST3 are equal. --> Variable cil_stMeasurementFrameContent.Meas_RBTM_FL_07 is equal to signal Meas_RBTM_FL_07_ST3");
    result = debugger_readGlobalVariable("uint8", "cil_stMeasurementFrameContent,,app.elf", 6);
    EvalManStepEqual("Expected Test Result", result, $Meas_RBTM_FL_07_ST3.raw64);
  
    testCaseComment("Action: ARCH_SW_CIL_0719");
    testStep("STEP", "Evaluate if variable cil_stMeasurementFrameContent.Meas_RBTM_FL_08 and signal Meas_RBTM_FL_08_ST3 are equal. --> Variable cil_stMeasurementFrameContent.Meas_RBTM_FL_08 is equal to signal Meas_RBTM_FL_08_ST3");
    result = debugger_readGlobalVariable("uint8", "cil_stMeasurementFrameContent,,app.elf", 7);
    EvalManStepEqual("Expected Test Result", result, $Meas_RBTM_FL_08_ST3.raw64);
   
  
  testCaseComment("Postcondition");
  testStep("STEP", "Return ECU to default values");
  RunPostTs(); 
}


testcase SW_IT_CIL_Update_07Cx_Block08_01()
{
  //***********************************Test report header*********************************
  testReportAddMiscInfoBlock("AUTOLIV ELECTRONICS document");
  TestReportAddMiscInfo("Nightly test", "No");
  TestReportAddMiscInfo("Test type", "Requirement-Based test");
  TestReportAddMiscInfo("Regression Test", "No");
  TestReportAddMiscInfo("Fault injection method used", "No");
  TestReportAddMiscInfo("Resource usage evaluation", "No");
  TestReportAddMiscInfo("Priority", "No");
  TestReportAddMiscInfo("Safety relevant", "No");
  
  AddRequirementInfo("Requirement under test", "ARCH_SW_CIL_0718, ARCH_SW_CIL_0763, ARCH_SW_CIL_0703, ARCH_SW_CIL_0700");
  AddRequirementInfo("ARCH_SW_CIL_0718", "If selected, the content of the measurement frame - block #8 shall be encoded and provided to CAN.");
  AddRequirementInfo("ARCH_SW_CIL_0763", "PAL_runGetPWMOrder shall be called to get the current applied motor power order.");
  //***************************************************************************************
    
  testCaseComment("Preconditions");
  testStep("STEP", "Bench Initialization");
  RunPreTs();

  
//    AuthenticateECU(2);
    EnterDiagnosticSession("development");
    
    testStep("STEP", "Activate Measurement Frame block 8.");
    ActivateMeasurementFrame(8);
    
    testStep("STEP", "Set a breakpoint in function cil_Update_07Cx_Block08_InfosToSend at line Rte_Call_pclMotor_P_GetPowerOrder(&s16PWMDutyCycle);.");
    debugger_setRelativeFunctionBpAtLine("cil_Update_07Cx_Block08_InfosToSend", 13);
    
    testCaseComment("Action: ARCH_SW_CIL_0763, ARCH_SW_CIL_0700, ARCH_SW_CIL_0703");
    testStep("STEP", "Check if CPU stopped at line Rte_Call_pclMotor_P_GetPowerOrder(&s16PWMDutyCycle);. --> CPU is Stopped");
debugger_isCPUStoppedAtFunction("cil_Update_07Cx_Block08_InfosToSend");    ////EvalManStepEqual("Expected Test Result", debugger_result,  "CPU is Stopped");
    
    testStep("STEP", "Set a breakpoint at the last line of function cil_Update_07Cx_Block08_InfosToSend.");
    debugger_setRelativeFunctionBpAtLine("cil_Update_07Cx_Block08_InfosToSend", 66);
    
    debugger_run();
    
    testCaseComment("Action: ARCH_SW_CIL_0718");
    testStep("STEP", "Evaluate if variable cil_stMeasurementFrameContent.Meas_RBTM_FL_01 and signal Meas_RBTM_FL_01_ST3 are equal. --> Variable cil_stMeasurementFrameContent.Meas_RBTM_FL_01 is equal to signal Meas_RBTM_FL_01_ST3");
    result = debugger_readGlobalVariable("uint8", "cil_stMeasurementFrameContent,,app.elf", 0);
    EvalManStepEqual("Expected Test Result", result, $Meas_RBTM_FL_01_ST3.raw64);
        
    testCaseComment("Action: ARCH_SW_CIL_0718");
    testStep("STEP", "Evaluate if variable cil_stMeasurementFrameContent.Meas_RBTM_FL_02 and signal Meas_RBTM_FL_02_ST3 are equal. --> Variable cil_stMeasurementFrameContent.Meas_RBTM_FL_02 is equal to signal Meas_RBTM_FL_02_ST3");
    result = debugger_readGlobalVariable("uint8", "cil_stMeasurementFrameContent,,app.elf", 1);
    EvalManStepEqual("Expected Test Result", result, $Meas_RBTM_FL_02_ST3.raw64);
    
    testCaseComment("Action: ARCH_SW_CIL_0718");
    testStep("STEP", "Evaluate if variable cil_stMeasurementFrameContent.Meas_RBTM_FL_03 and signal Meas_RBTM_FL_03_ST3 are equal. --> Variable cil_stMeasurementFrameContent.Meas_RBTM_FL_03 is equal to signal Meas_RBTM_FL_03_ST3");
    result = debugger_readGlobalVariable("uint8", "cil_stMeasurementFrameContent,,app.elf", 2);
    EvalManStepEqual("Expected Test Result", result, $Meas_RBTM_FL_03_ST3.raw64);
    
    testCaseComment("Action: ARCH_SW_CIL_0718");
    testStep("STEP", "Evaluate if variable cil_stMeasurementFrameContent.Meas_RBTM_FL_04 and signal Meas_RBTM_FL_04_ST3 are equal. --> Variable cil_stMeasurementFrameContent.Meas_RBTM_FL_04 is equal to signal Meas_RBTM_FL_04_ST3");
    result = debugger_readGlobalVariable("uint8", "cil_stMeasurementFrameContent,,app.elf", 3);
    EvalManStepEqual("Expected Test Result", result, $Meas_RBTM_FL_04_ST3.raw64);
    
    testCaseComment("Action: ARCH_SW_CIL_0718");
    testStep("STEP", "Evaluate if variable cil_stMeasurementFrameContent.Meas_RBTM_FL_05 and signal Meas_RBTM_FL_05_ST3 are equal. --> Variable cil_stMeasurementFrameContent.Meas_RBTM_FL_05 is equal to signal Meas_RBTM_FL_05_ST3");
    result = debugger_readGlobalVariable("uint8", "cil_stMeasurementFrameContent,,app.elf", 4);
    EvalManStepEqual("Expected Test Result", result, $Meas_RBTM_FL_05_ST3.raw64);
      
    testCaseComment("Action: ARCH_SW_CIL_0718");
    testStep("STEP", "Evaluate if variable cil_stMeasurementFrameContent.Meas_RBTM_FL_06 and signal Meas_RBTM_FL_06_ST3 are equal. --> Variable cil_stMeasurementFrameContent.Meas_RBTM_FL_06 is equal to signal Meas_RBTM_FL_06_ST3");
    result = debugger_readGlobalVariable("uint8", "cil_stMeasurementFrameContent,,app.elf", 5);
    EvalManStepEqual("Expected Test Result", result, $Meas_RBTM_FL_06_ST3.raw64);
  
    testCaseComment("Action: ARCH_SW_CIL_0718");
    testStep("STEP", "Evaluate if variable cil_stMeasurementFrameContent.Meas_RBTM_FL_07 and signal Meas_RBTM_FL_07_ST3 are equal. --> Variable cil_stMeasurementFrameContent.Meas_RBTM_FL_07 is equal to signal Meas_RBTM_FL_07_ST3");
    result = debugger_readGlobalVariable("uint8", "cil_stMeasurementFrameContent,,app.elf", 6);
    EvalManStepEqual("Expected Test Result", result, $Meas_RBTM_FL_07_ST3.raw64);
  
    testCaseComment("Action: ARCH_SW_CIL_0718");
    testStep("STEP", "Evaluate if variable cil_stMeasurementFrameContent.Meas_RBTM_FL_08 and signal Meas_RBTM_FL_08_ST3 are equal. --> Variable cil_stMeasurementFrameContent.Meas_RBTM_FL_08 is equal to signal Meas_RBTM_FL_08_ST3");
    result = debugger_readGlobalVariable("uint8", "cil_stMeasurementFrameContent,,app.elf", 7);
    EvalManStepEqual("Expected Test Result", result, $Meas_RBTM_FL_08_ST3.raw64);
  
  
  testCaseComment("Postcondition");
  testStep("STEP", "Return ECU to default values");
  RunPostTs(); 
}


testcase SW_IT_CIL_Update_07Cx_Block07_01()
{
  //***********************************Test report header*********************************
  testReportAddMiscInfoBlock("AUTOLIV ELECTRONICS document");
  TestReportAddMiscInfo("Nightly test", "No");
  TestReportAddMiscInfo("Test type", "Requirement-Based test");
  TestReportAddMiscInfo("Regression Test", "No");
  TestReportAddMiscInfo("Fault injection method used", "No");
  TestReportAddMiscInfo("Resource usage evaluation", "No");
  TestReportAddMiscInfo("Priority", "No");
  TestReportAddMiscInfo("Safety relevant", "No");
  
  AddRequirementInfo("Requirement under test", "ARCH_SW_CIL_0717, ARCH_SW_CIL_0767");
  AddRequirementInfo("ARCH_SW_CIL_0717", "If selected, the content of the measurement frame - block #7 shall be encoded and provided to CAN.");
  AddRequirementInfo("ARCH_SW_CIL_0767", "PMP_runGetFilteredTemperature_deg shall be called to get the filtered value in °C of the temperature");
  //***************************************************************************************
    
  testCaseComment("Preconditions");
  testStep("STEP", "Bench Initialization");
  RunPreTs();

  
//    AuthenticateECU(2);
    EnterDiagnosticSession("development");
    
    testStep("STEP", "Activate Measurement Frame block 7.");
    ActivateMeasurementFrame(7);
    
    testStep("STEP", "Set a breakpoint in function cil_Update_07Cx_Block07_InfosToSend at line Rte_Call_pclECU_T_GetFiltered_deg(&s16Temperature_Deg);.");
    debugger_setRelativeFunctionBpAtLine("cil_Update_07Cx_Block07_InfosToSend", 19);
    
    testCaseComment("Action: ARCH_SW_CIL_0767");
    testStep("STEP", "Check if CPU stopped at line Rte_Call_pclECU_T_GetFiltered_deg(&s16Temperature_Deg);. --> CPU is Stopped");
debugger_isCPUStoppedAtFunction("cil_Update_07Cx_Block07_InfosToSend");    ////EvalManStepEqual("Expected Test Result", debugger_result,  "CPU is Stopped");
    
    testStep("STEP", "Set a breakpoint at the last line of function cil_Update_07Cx_Block07_InfosToSend.");
    debugger_setRelativeFunctionBpAtLine("cil_Update_07Cx_Block07_InfosToSend", 52);
    
    debugger_run();
    
    testCaseComment("Action: ARCH_SW_CIL_0717");
    testStep("STEP", "Evaluate if variable cil_stMeasurementFrameContent.Meas_RBTM_FL_01 and signal Meas_RBTM_FL_01_ST3 are equal. --> Variable cil_stMeasurementFrameContent.Meas_RBTM_FL_01 is equal to signal Meas_RBTM_FL_01_ST3");
    result = debugger_readGlobalVariable("uint8", "cil_stMeasurementFrameContent,,app.elf", 0);
    EvalManStepEqual("Expected Test Result", result, $Meas_RBTM_FL_01_ST3.raw64);
        
    testCaseComment("Action: ARCH_SW_CIL_0717");
    testStep("STEP", "Evaluate if variable cil_stMeasurementFrameContent.Meas_RBTM_FL_02 and signal Meas_RBTM_FL_02_ST3 are equal. --> Variable cil_stMeasurementFrameContent.Meas_RBTM_FL_02 is equal to signal Meas_RBTM_FL_02_ST3");
    result = debugger_readGlobalVariable("uint8", "cil_stMeasurementFrameContent,,app.elf", 1);
    EvalManStepEqual("Expected Test Result", result, $Meas_RBTM_FL_02_ST3.raw64);
    
    testCaseComment("Action: ARCH_SW_CIL_0717");
    testStep("STEP", "Evaluate if variable cil_stMeasurementFrameContent.Meas_RBTM_FL_03 and signal Meas_RBTM_FL_03_ST3 are equal. --> Variable cil_stMeasurementFrameContent.Meas_RBTM_FL_03 is equal to signal Meas_RBTM_FL_03_ST3");
    result = debugger_readGlobalVariable("uint8", "cil_stMeasurementFrameContent,,app.elf", 2);
    EvalManStepEqual("Expected Test Result", result, $Meas_RBTM_FL_03_ST3.raw64);
    
    testCaseComment("Action: ARCH_SW_CIL_0717");
    testStep("STEP", "Evaluate if variable cil_stMeasurementFrameContent.Meas_RBTM_FL_04 and signal Meas_RBTM_FL_04_ST3 are equal. --> Variable cil_stMeasurementFrameContent.Meas_RBTM_FL_04 is equal to signal Meas_RBTM_FL_04_ST3");
    result = debugger_readGlobalVariable("uint8", "cil_stMeasurementFrameContent,,app.elf", 3);
    EvalManStepEqual("Expected Test Result", result, $Meas_RBTM_FL_04_ST3.raw64);
    
    testCaseComment("Action: ARCH_SW_CIL_0717");
    testStep("STEP", "Evaluate if variable cil_stMeasurementFrameContent.Meas_RBTM_FL_05 and signal Meas_RBTM_FL_05_ST3 are equal. --> Variable cil_stMeasurementFrameContent.Meas_RBTM_FL_05 is equal to signal Meas_RBTM_FL_05_ST3");
    result = debugger_readGlobalVariable("uint8", "cil_stMeasurementFrameContent,,app.elf", 4);
    EvalManStepEqual("Expected Test Result", result, $Meas_RBTM_FL_05_ST3.raw64);
      
    testCaseComment("Action: ARCH_SW_CIL_0717");
    testStep("STEP", "Evaluate if variable cil_stMeasurementFrameContent.Meas_RBTM_FL_06 and signal Meas_RBTM_FL_06_ST3 are equal. --> Variable cil_stMeasurementFrameContent.Meas_RBTM_FL_06 is equal to signal Meas_RBTM_FL_06_ST3");
    result = debugger_readGlobalVariable("uint8", "cil_stMeasurementFrameContent,,app.elf", 5);
    EvalManStepEqual("Expected Test Result", result, $Meas_RBTM_FL_06_ST3.raw64);
  
    testCaseComment("Action: ARCH_SW_CIL_0717");
    testStep("STEP", "Evaluate if variable cil_stMeasurementFrameContent.Meas_RBTM_FL_07 and signal Meas_RBTM_FL_07_ST3 are equal. --> Variable cil_stMeasurementFrameContent.Meas_RBTM_FL_07 is equal to signal Meas_RBTM_FL_07_ST3");
    result = debugger_readGlobalVariable("uint8", "cil_stMeasurementFrameContent,,app.elf", 6);
    EvalManStepEqual("Expected Test Result", result, $Meas_RBTM_FL_07_ST3.raw64);
  
    testCaseComment("Action: ARCH_SW_CIL_0717");
    testStep("STEP", "Evaluate if variable cil_stMeasurementFrameContent.Meas_RBTM_FL_08 and signal Meas_RBTM_FL_08_ST3 are equal. --> Variable cil_stMeasurementFrameContent.Meas_RBTM_FL_08 is equal to signal Meas_RBTM_FL_08_ST3");
    result = debugger_readGlobalVariable("uint8", "cil_stMeasurementFrameContent,,app.elf", 7);
    EvalManStepEqual("Expected Test Result", result, $Meas_RBTM_FL_08_ST3.raw64);
  
  
  testCaseComment("Postcondition");
  testStep("STEP", "Return ECU to default values");
  RunPostTs(); 
}



testcase SW_IT_CIL_Update_07Cx_Block06_01()
{
  //***********************************Test report header*********************************
  testReportAddMiscInfoBlock("AUTOLIV ELECTRONICS document");
  TestReportAddMiscInfo("Nightly test", "No");
  TestReportAddMiscInfo("Test type", "Requirement-Based test");
  TestReportAddMiscInfo("Regression Test", "No");
  TestReportAddMiscInfo("Fault injection method used", "No");
  TestReportAddMiscInfo("Resource usage evaluation", "No");
  TestReportAddMiscInfo("Priority", "No");
  TestReportAddMiscInfo("Safety relevant", "No");
  
  AddRequirementInfo("Requirement under test", "ARCH_SW_CIL_0716, ARCH_SW_CIL_0759, ARCH_SW_CIL_0756");
  AddRequirementInfo("ARCH_SW_CIL_0716", "If selected, the content of the measurement frame - block #6 shall be encoded and provided to CAN.");
  AddRequirementInfo("ARCH_SW_CIL_0759", "BMM_runGetSpeed_deg_s shall be called to get the seat belt speed in deg/s.");
  AddRequirementInfo("ARCH_SW_CIL_0756", "ATM_runGetTestResult shall be called to get the status of specific auto-tests.");
  //***************************************************************************************
    
  testCaseComment("Preconditions");
  testStep("STEP", "Bench Initialization");
  RunPreTs();
  

//    AuthenticateECU(2);
    EnterDiagnosticSession("development");
    
    testStep("STEP", "Activate Measurement Frame block 6.");
    ActivateMeasurementFrame(6);
    
    testStep("STEP", "Set a breakpoint in function cil_Update_07Cx_Block06_InfosToSend at line Rte_Call_pclBelt_S_GetSpeed_deg_s(&s32BobbinSpeed);.");
    debugger_setRelativeFunctionBpAtLine("cil_Update_07Cx_Block06_InfosToSend", 18);
    testStep("STEP", "Set a breakpoint in function cil_Update_07Cx_Block06_InfosToSend at line Rte_Call_pclAutotestServices_GetTestResult(ATM_KU8_ID_TEST_HALL_EFFECT_SENSORS,&u8HESTestResult);.");
    debugger_setRelativeFunctionBpAtLine("cil_Update_07Cx_Block06_InfosToSend", 25);
    
    testCaseComment("Action: ARCH_SW_CIL_0759");
    testStep("STEP", "Check if CPU stopped at line Rte_Call_pclBelt_S_GetSpeed_deg_s(&s32BobbinSpeed);. --> CPU is Stopped");
    debugger_isCPUStoppedAtFunction("cil_Update_07Cx_Block06_InfosToSend");    ////EvalManStepEqual("Expected Test Result", debugger_result,  "CPU is Stopped");
    
    debugger_run();
    
    testCaseComment("Action: ARCH_SW_CIL_0756");
    testStep("STEP", "Check if CPU stopped at line Rte_Call_pclAutotestServices_GetTestResult(ATM_KU8_ID_TEST_HALL_EFFECT_SENSORS,&u8HESTestResult);. --> CPU is Stopped");
    debugger_isCPUStoppedAtFunction("cil_Update_07Cx_Block06_InfosToSend");
    ////EvalManStepEqual("Expected Test Result", debugger_result,  "CPU is Stopped");
    
    testStep("STEP", "Set a breakpoint at the last line of function cil_Update_07Cx_Block06_InfosToSend.");
    debugger_setRelativeFunctionBpAtLine("cil_Update_07Cx_Block06_InfosToSend", 66);
    
    debugger_run();
    
    testCaseComment("Action: ARCH_SW_CIL_0716");
    testStep("STEP", "Evaluate if variable cil_stMeasurementFrameContent.Meas_RBTM_FL_01 and signal Meas_RBTM_FL_01_ST3 are equal. --> Variable cil_stMeasurementFrameContent.Meas_RBTM_FL_01 is equal to signal Meas_RBTM_FL_01_ST3");
    result = debugger_readGlobalVariable("uint8", "cil_stMeasurementFrameContent,,app.elf", 0);
    EvalManStepEqual("Expected Test Result", result, $Meas_RBTM_FL_01_ST3.raw64);
        
    testCaseComment("Action: ARCH_SW_CIL_0716");
    testStep("STEP", "Evaluate if variable cil_stMeasurementFrameContent.Meas_RBTM_FL_02 and signal Meas_RBTM_FL_02_ST3 are equal. --> Variable cil_stMeasurementFrameContent.Meas_RBTM_FL_02 is equal to signal Meas_RBTM_FL_02_ST3");
    result = debugger_readGlobalVariable("uint8", "cil_stMeasurementFrameContent,,app.elf", 1);
    EvalManStepEqual("Expected Test Result", result, $Meas_RBTM_FL_02_ST3.raw64);
    
    testCaseComment("Action: ARCH_SW_CIL_0716");
    testStep("STEP", "Evaluate if variable cil_stMeasurementFrameContent.Meas_RBTM_FL_03 and signal Meas_RBTM_FL_03_ST3 are equal. --> Variable cil_stMeasurementFrameContent.Meas_RBTM_FL_03 is equal to signal Meas_RBTM_FL_03_ST3");
    result = debugger_readGlobalVariable("uint8", "cil_stMeasurementFrameContent,,app.elf", 2);
    EvalManStepEqual("Expected Test Result", result, $Meas_RBTM_FL_03_ST3.raw64);
    
    testCaseComment("Action: ARCH_SW_CIL_0716");
    testStep("STEP", "Evaluate if variable cil_stMeasurementFrameContent.Meas_RBTM_FL_04 and signal Meas_RBTM_FL_04_ST3 are equal. --> Variable cil_stMeasurementFrameContent.Meas_RBTM_FL_04 is equal to signal Meas_RBTM_FL_04_ST3");
    result = debugger_readGlobalVariable("uint8", "cil_stMeasurementFrameContent,,app.elf", 3);
    EvalManStepEqual("Expected Test Result", result, $Meas_RBTM_FL_04_ST3.raw64);
    
    testCaseComment("Action: ARCH_SW_CIL_0716");
    testStep("STEP", "Evaluate if variable cil_stMeasurementFrameContent.Meas_RBTM_FL_05 and signal Meas_RBTM_FL_05_ST3 are equal. --> Variable cil_stMeasurementFrameContent.Meas_RBTM_FL_05 is equal to signal Meas_RBTM_FL_05_ST3");
    result = debugger_readGlobalVariable("uint8", "cil_stMeasurementFrameContent,,app.elf", 4);
    EvalManStepEqual("Expected Test Result", result, $Meas_RBTM_FL_05_ST3.raw64);
      
    testCaseComment("Action: ARCH_SW_CIL_0716");
    testStep("STEP", "Evaluate if variable cil_stMeasurementFrameContent.Meas_RBTM_FL_06 and signal Meas_RBTM_FL_06_ST3 are equal. --> Variable cil_stMeasurementFrameContent.Meas_RBTM_FL_06 is equal to signal Meas_RBTM_FL_06_ST3");
    result = debugger_readGlobalVariable("uint8", "cil_stMeasurementFrameContent,,app.elf", 5);
    EvalManStepEqual("Expected Test Result", result, $Meas_RBTM_FL_06_ST3.raw64);
  
    testCaseComment("Action: ARCH_SW_CIL_0716");
    testStep("STEP", "Evaluate if variable cil_stMeasurementFrameContent.Meas_RBTM_FL_07 and signal Meas_RBTM_FL_07_ST3 are equal. --> Variable cil_stMeasurementFrameContent.Meas_RBTM_FL_07 is equal to signal Meas_RBTM_FL_07_ST3");
    result = debugger_readGlobalVariable("uint8", "cil_stMeasurementFrameContent,,app.elf", 6);
    EvalManStepEqual("Expected Test Result", result, $Meas_RBTM_FL_07_ST3.raw64);
  
    testCaseComment("Action: ARCH_SW_CIL_0716");
    testStep("STEP", "Evaluate if variable cil_stMeasurementFrameContent.Meas_RBTM_FL_08 and signal Meas_RBTM_FL_08_ST3 are equal. --> Variable cil_stMeasurementFrameContent.Meas_RBTM_FL_08 is equal to signal Meas_RBTM_FL_08_ST3");
    result = debugger_readGlobalVariable("uint8", "cil_stMeasurementFrameContent,,app.elf", 7);
    EvalManStepEqual("Expected Test Result", result, $Meas_RBTM_FL_08_ST3.raw64);

  
  testCaseComment("Postcondition");
  testStep("STEP", "Return ECU to default values");
  RunPostTs(); 
}


testcase SW_IT_CIL_Update_07Cx_Block05_01()
{
  //***********************************Test report header*********************************
  testReportAddMiscInfoBlock("AUTOLIV ELECTRONICS document");
  TestReportAddMiscInfo("Nightly test", "No");
  TestReportAddMiscInfo("Test type", "Requirement-Based test");
  TestReportAddMiscInfo("Regression Test", "No");
  TestReportAddMiscInfo("Fault injection method used", "No");
  TestReportAddMiscInfo("Resource usage evaluation", "No");
  TestReportAddMiscInfo("Priority", "No");
  TestReportAddMiscInfo("Safety relevant", "No");
  
  AddRequirementInfo("Requirement under test", "ARCH_SW_CIL_0715, ARCH_SW_CIL_0765, ARCH_SW_CIL_0766");
  AddRequirementInfo("ARCH_SW_CIL_0715", "If selected, the content of the measurement frame - block #5 shall be encoded and provided to CAN.");
  AddRequirementInfo("ARCH_SW_CIL_0765", "PMP_runGetMotorVp_(Ext)* shall be called to get the voltage on the ‘P’ pin of the motor.");
  AddRequirementInfo("ARCH_SW_CIL_0766", "PMP_runGetMotorVn_(Ext)* shall be called to get the voltage on the ‘N’ pin of the motor.");
  //***************************************************************************************
    
  testCaseComment("Preconditions");
  testStep("STEP", "Bench Initialization");
  RunPreTs();

  
//    AuthenticateECU(2);
    EnterDiagnosticSession("development");
    
    testStep("STEP", "Activate Measurement Frame block 5.");
    ActivateMeasurementFrame(5);
    
    testStep("STEP", "Set a breakpoint in function cil_Update_07Cx_Block05_InfosToSend at line Rte_Call_pclMotor_Vp_Get(&u16MotorPlus);.");
    debugger_setRelativeFunctionBpAtLine("cil_Update_07Cx_Block05_InfosToSend", 60);
    testStep("STEP", "Set a breakpoint in function cil_Update_07Cx_Block05_InfosToSend at line Rte_Call_pclMotor_Vn_Get(&u16MotorMinus);.");
    debugger_setRelativeFunctionBpAtLine("cil_Update_07Cx_Block05_InfosToSend", 75);
    
    testCaseComment("Action: ARCH_SW_CIL_0765");
    testStep("STEP", "Check if CPU stopped at line Rte_Call_pclMotor_Vp_Get(&u16MotorPlus);. --> CPU is Stopped");
    debugger_isCPUStoppedAtFunction("cil_Update_07Cx_Block05_InfosToSend");    ////EvalManStepEqual("Expected Test Result", debugger_result,  "CPU is Stopped");
    
    debugger_run();
    
    testCaseComment("Action: ARCH_SW_CIL_0766");
    testStep("STEP", "Check if CPU stopped at line Rte_Call_pclMotor_Vn_Get(&u16MotorMinus);. --> CPU is Stopped");
    debugger_isCPUStoppedAtFunction("cil_Update_07Cx_Block05_InfosToSend");
    ////EvalManStepEqual("Expected Test Result", debugger_result,  "CPU is Stopped");
    
    testStep("STEP", "Set a breakpoint at the last line of function cil_Update_07Cx_Block05_InfosToSend.");
    debugger_setRelativeFunctionBpAtLine("cil_Update_07Cx_Block05_InfosToSend", 112);
    
    debugger_run();
    
    testCaseComment("Action: ARCH_SW_CIL_0715");
    testStep("STEP", "Evaluate if variable cil_stMeasurementFrameContent.Meas_RBTM_FL_01 and signal Meas_RBTM_FL_01_ST3 are equal. --> Variable cil_stMeasurementFrameContent.Meas_RBTM_FL_01 is equal to signal Meas_RBTM_FL_01_ST3");
    result = debugger_readGlobalVariable("uint8", "cil_stMeasurementFrameContent,,app.elf", 0);
    EvalManStepEqual("Expected Test Result", result, $Meas_RBTM_FL_01_ST3.raw64);
  
    testCaseComment("Action: ARCH_SW_CIL_0715");
    testStep("STEP", "Evaluate if variable cil_stMeasurementFrameContent.Meas_RBTM_FL_02 and signal Meas_RBTM_FL_02_ST3 are equal. --> Variable cil_stMeasurementFrameContent.Meas_RBTM_FL_02 is equal to signal Meas_RBTM_FL_02_ST3");
    result = debugger_readGlobalVariable("uint8", "cil_stMeasurementFrameContent,,app.elf", 1);
    EvalManStepEqual("Expected Test Result", result, $Meas_RBTM_FL_02_ST3.raw64);
    
    testCaseComment("Action: ARCH_SW_CIL_0715");
    testStep("STEP", "Evaluate if variable cil_stMeasurementFrameContent.Meas_RBTM_FL_03 and signal Meas_RBTM_FL_03_ST3 are equal. --> Variable cil_stMeasurementFrameContent.Meas_RBTM_FL_03 is equal to signal Meas_RBTM_FL_03_ST3");
    result = debugger_readGlobalVariable("uint8", "cil_stMeasurementFrameContent,,app.elf", 2);
    EvalManStepEqual("Expected Test Result", result, $Meas_RBTM_FL_03_ST3.raw64);
    
    testCaseComment("Action: ARCH_SW_CIL_0716");
    testStep("STEP", "Evaluate if variable cil_stMeasurementFrameContent.Meas_RBTM_FL_04 and signal Meas_RBTM_FL_04_ST3 are equal. --> Variable cil_stMeasurementFrameContent.Meas_RBTM_FL_04 is equal to signal Meas_RBTM_FL_04_ST3");
    result = debugger_readGlobalVariable("uint8", "cil_stMeasurementFrameContent,,app.elf", 3);
    EvalManStepEqual("Expected Test Result", result, $Meas_RBTM_FL_04_ST3.raw64);
    
    testCaseComment("Action: ARCH_SW_CIL_0715");
    testStep("STEP", "Evaluate if variable cil_stMeasurementFrameContent.Meas_RBTM_FL_05 and signal Meas_RBTM_FL_05_ST3 are equal. --> Variable cil_stMeasurementFrameContent.Meas_RBTM_FL_05 is equal to signal Meas_RBTM_FL_05_ST3");
    result = debugger_readGlobalVariable("uint8", "cil_stMeasurementFrameContent,,app.elf", 4);
    EvalManStepEqual("Expected Test Result", result, $Meas_RBTM_FL_05_ST3.raw64);
      
    testCaseComment("Action: ARCH_SW_CIL_0715");
    testStep("STEP", "Evaluate if variable cil_stMeasurementFrameContent.Meas_RBTM_FL_06 and signal Meas_RBTM_FL_06_ST3 are equal. --> Variable cil_stMeasurementFrameContent.Meas_RBTM_FL_06 is equal to signal Meas_RBTM_FL_06_ST3");
    result = debugger_readGlobalVariable("uint8", "cil_stMeasurementFrameContent,,app.elf", 5);
    EvalManStepEqual("Expected Test Result", result, $Meas_RBTM_FL_06_ST3.raw64);
  
    testCaseComment("Action: ARCH_SW_CIL_0715");
    testStep("STEP", "Evaluate if variable cil_stMeasurementFrameContent.Meas_RBTM_FL_07 and signal Meas_RBTM_FL_07_ST3 are equal. --> Variable cil_stMeasurementFrameContent.Meas_RBTM_FL_07 is equal to signal Meas_RBTM_FL_07_ST3");
    result = debugger_readGlobalVariable("uint8", "cil_stMeasurementFrameContent,,app.elf", 6);
    EvalManStepEqual("Expected Test Result", result, $Meas_RBTM_FL_07_ST3.raw64);
  
    testCaseComment("Action: ARCH_SW_CIL_0715");
    testStep("STEP", "Evaluate if variable cil_stMeasurementFrameContent.Meas_RBTM_FL_08 and signal Meas_RBTM_FL_08_ST3 are equal. --> Variable cil_stMeasurementFrameContent.Meas_RBTM_FL_08 is equal to signal Meas_RBTM_FL_08_ST3");
    result = debugger_readGlobalVariable("uint8", "cil_stMeasurementFrameContent,,app.elf", 7);
    EvalManStepEqual("Expected Test Result", result, $Meas_RBTM_FL_08_ST3.raw64);
  
  
  testCaseComment("Postcondition");
  testStep("STEP", "Return ECU to default values");
  RunPostTs(); 
}



testcase SW_IT_CIL_Update_07Cx_Block04_01()
{
  //***********************************Test report header*********************************
  testReportAddMiscInfoBlock("AUTOLIV ELECTRONICS document");
  TestReportAddMiscInfo("Nightly test", "No");
  TestReportAddMiscInfo("Test type", "Requirement-Based test");
  TestReportAddMiscInfo("Regression Test", "No");
  TestReportAddMiscInfo("Fault injection method used", "No");
  TestReportAddMiscInfo("Resource usage evaluation", "No");
  TestReportAddMiscInfo("Priority", "No");
  TestReportAddMiscInfo("Safety relevant", "No");
  
  AddRequirementInfo("Requirement under test", "ARCH_SW_CIL_0714");
  AddRequirementInfo("ARCH_SW_CIL_0714", "If selected, the content of the measurement frame - block #4 shall be encoded and provided to CAN.");
  //***************************************************************************************
    
  testCaseComment("Preconditions");
  testStep("STEP", "Bench Initialization");
  RunPreTs();
  

//    AuthenticateECU(2);
    EnterDiagnosticSession("development");
    
    testStep("STEP", "Activate Measurement Frame block 4.");
    ActivateMeasurementFrame(4);
    
    testStep("STEP", "Set a breakpoint at the last line of function cil_Update_07Cx_Block04_InfosToSend.");
    debugger_setRelativeFunctionBpAtLine("cil_Update_07Cx_Block04_InfosToSend", 8);
    
    testCaseComment("Action: ARCH_SW_CIL_0714");
    testStep("STEP", "Evaluate if variable cil_stMeasurementFrameContent.Meas_RBTM_FL_01 and signal Meas_RBTM_FL_01_ST3 are equal. --> Variable cil_stMeasurementFrameContent.Meas_RBTM_FL_01 is equal to signal Meas_RBTM_FL_01_ST3");
    result = debugger_readGlobalVariable("uint8", "cil_stMeasurementFrameContent,,app.elf", 0);
    EvalManStepEqual("Expected Test Result", result, $Meas_RBTM_FL_01_ST3.raw64);
  
    testCaseComment("Action: ARCH_SW_CIL_0714");
    testStep("STEP", "Evaluate if variable cil_stMeasurementFrameContent.Meas_RBTM_FL_02 and signal Meas_RBTM_FL_02_ST3 are equal. --> Variable cil_stMeasurementFrameContent.Meas_RBTM_FL_02 is equal to signal Meas_RBTM_FL_02_ST3");
    result = debugger_readGlobalVariable("uint8", "cil_stMeasurementFrameContent,,app.elf", 1);
    EvalManStepEqual("Expected Test Result", result, $Meas_RBTM_FL_02_ST3.raw64);
    
    testCaseComment("Action: ARCH_SW_CIL_0714");
    testStep("STEP", "Evaluate if variable cil_stMeasurementFrameContent.Meas_RBTM_FL_03 and signal Meas_RBTM_FL_03_ST3 are equal. --> Variable cil_stMeasurementFrameContent.Meas_RBTM_FL_03 is equal to signal Meas_RBTM_FL_03_ST3");
    result = debugger_readGlobalVariable("uint8", "cil_stMeasurementFrameContent,,app.elf", 2);
    EvalManStepEqual("Expected Test Result", result, $Meas_RBTM_FL_03_ST3.raw64);
    
    testCaseComment("Action: ARCH_SW_CIL_0714");
    testStep("STEP", "Evaluate if variable cil_stMeasurementFrameContent.Meas_RBTM_FL_04 and signal Meas_RBTM_FL_04_ST3 are equal. --> Variable cil_stMeasurementFrameContent.Meas_RBTM_FL_04 is equal to signal Meas_RBTM_FL_04_ST3");
    result = debugger_readGlobalVariable("uint8", "cil_stMeasurementFrameContent,,app.elf", 3);
    EvalManStepEqual("Expected Test Result", result, $Meas_RBTM_FL_04_ST3.raw64);
    
    testCaseComment("Action: ARCH_SW_CIL_0714");
    testStep("STEP", "Evaluate if variable cil_stMeasurementFrameContent.Meas_RBTM_FL_05 and signal Meas_RBTM_FL_05_ST3 are equal. --> Variable cil_stMeasurementFrameContent.Meas_RBTM_FL_05 is equal to signal Meas_RBTM_FL_05_ST3");
    result = debugger_readGlobalVariable("uint8", "cil_stMeasurementFrameContent,,app.elf", 4);
    EvalManStepEqual("Expected Test Result", result, $Meas_RBTM_FL_05_ST3.raw64);
      
    testCaseComment("Action: ARCH_SW_CIL_0714");
    testStep("STEP", "Evaluate if variable cil_stMeasurementFrameContent.Meas_RBTM_FL_06 and signal Meas_RBTM_FL_06_ST3 are equal. --> Variable cil_stMeasurementFrameContent.Meas_RBTM_FL_06 is equal to signal Meas_RBTM_FL_06_ST3");
    result = debugger_readGlobalVariable("uint8", "cil_stMeasurementFrameContent,,app.elf", 5);
    EvalManStepEqual("Expected Test Result", result, $Meas_RBTM_FL_06_ST3.raw64);
  
    testCaseComment("Action: ARCH_SW_CIL_0714");
    testStep("STEP", "Evaluate if variable cil_stMeasurementFrameContent.Meas_RBTM_FL_07 and signal Meas_RBTM_FL_07_ST3 are equal. --> Variable cil_stMeasurementFrameContent.Meas_RBTM_FL_07 is equal to signal Meas_RBTM_FL_07_ST3");
    result = debugger_readGlobalVariable("uint8", "cil_stMeasurementFrameContent,,app.elf", 6);
    EvalManStepEqual("Expected Test Result", result, $Meas_RBTM_FL_07_ST3.raw64);
  
    testCaseComment("Action: ARCH_SW_CIL_0714");
    testStep("STEP", "Evaluate if variable cil_stMeasurementFrameContent.Meas_RBTM_FL_08 and signal Meas_RBTM_FL_08_ST3 are equal. --> Variable cil_stMeasurementFrameContent.Meas_RBTM_FL_08 is equal to signal Meas_RBTM_FL_08_ST3");
    result = debugger_readGlobalVariable("uint8", "cil_stMeasurementFrameContent,,app.elf", 7);
    EvalManStepEqual("Expected Test Result", result, $Meas_RBTM_FL_08_ST3.raw64);
  

  testCaseComment("Postcondition");
  testStep("STEP", "Return ECU to default values");
  RunPostTs(); 
}


testcase SW_IT_CIL_Update_07Cx_Block03_01()
{
  //***********************************Test report header*********************************
  testReportAddMiscInfoBlock("AUTOLIV ELECTRONICS document");
  TestReportAddMiscInfo("Nightly test", "No");
  TestReportAddMiscInfo("Test type", "Requirement-Based test");
  TestReportAddMiscInfo("Regression Test", "No");
  TestReportAddMiscInfo("Fault injection method used", "No");
  TestReportAddMiscInfo("Resource usage evaluation", "No");
  TestReportAddMiscInfo("Priority", "No");
  TestReportAddMiscInfo("Safety relevant", "No");
  
  AddRequirementInfo("Requirement under test", "ARCH_SW_CIL_0713, ARCH_SW_CIL_0768");
  AddRequirementInfo("ARCH_SW_CIL_0713", "If selected, the content of the measurement frame - block #3 shall be encoded and provided to CAN.");
  AddRequirementInfo("ARCH_SW_CIL_0768", "PMP_runGetFilteredTemperature shall be called to get the value of the low reference voltage in V.");
  //***************************************************************************************
    
  testCaseComment("Preconditions");
  testStep("STEP", "Bench Initialization");
  RunPreTs(); 

  
//    AuthenticateECU(2);
    EnterDiagnosticSession("development");
    
    testStep("STEP", "Activate Measurement Frame block 3.");
    ActivateMeasurementFrame(3);
    
    testStep("STEP", "Set a breakpoint in function cil_Update_07Cx_Block03_InfosToSend at line Rte_Call_pclECU_T_GetFiltered(&u16Temperature);.");
    debugger_setRelativeFunctionBpAtLine("cil_Update_07Cx_Block03_InfosToSend", 28);
    
    testCaseComment("Action: ARCH_SW_CIL_0768");
    testStep("STEP", "Check if CPU stopped at line Rte_Call_pclECU_T_GetFiltered(&u16Temperature);. --> CPU is Stopped");
debugger_isCPUStoppedAtFunction("cil_Update_07Cx_Block03_InfosToSend");    ////EvalManStepEqual("Expected Test Result", debugger_result,  "CPU is Stopped");
    
    testStep("STEP", "Set a breakpoint at the last line of function cil_Update_07Cx_Block03_InfosToSend.");
    debugger_setRelativeFunctionBpAtLine("cil_Update_07Cx_Block03_InfosToSend", 51);
    
    debugger_run();
    
    testCaseComment("Action: ARCH_SW_CIL_0713");
    testStep("STEP", "Evaluate if variable cil_stMeasurementFrameContent.Meas_RBTM_FL_01 and signal Meas_RBTM_FL_01_ST3 are equal. --> Variable cil_stMeasurementFrameContent.Meas_RBTM_FL_01 is equal to signal Meas_RBTM_FL_01_ST3");
    result = debugger_readGlobalVariable("uint8", "cil_stMeasurementFrameContent,,app.elf", 0);
    EvalManStepEqual("Expected Test Result", result, $Meas_RBTM_FL_01_ST3.raw64);
  
    testCaseComment("Action: ARCH_SW_CIL_0713");
    testStep("STEP", "Evaluate if variable cil_stMeasurementFrameContent.Meas_RBTM_FL_02 and signal Meas_RBTM_FL_02_ST3 are equal. --> Variable cil_stMeasurementFrameContent.Meas_RBTM_FL_02 is equal to signal Meas_RBTM_FL_02_ST3");
    result = debugger_readGlobalVariable("uint8", "cil_stMeasurementFrameContent,,app.elf", 1);
    EvalManStepEqual("Expected Test Result", result, $Meas_RBTM_FL_02_ST3.raw64);
    
    testCaseComment("Action: ARCH_SW_CIL_0713");
    testStep("STEP", "Evaluate if variable cil_stMeasurementFrameContent.Meas_RBTM_FL_03 and signal Meas_RBTM_FL_03_ST3 are equal. --> Variable cil_stMeasurementFrameContent.Meas_RBTM_FL_03 is equal to signal Meas_RBTM_FL_03_ST3");
    result = debugger_readGlobalVariable("uint8", "cil_stMeasurementFrameContent,,app.elf", 2);
    EvalManStepEqual("Expected Test Result", result, $Meas_RBTM_FL_03_ST3.raw64);
    
    testCaseComment("Action: ARCH_SW_CIL_0713");
    testStep("STEP", "Evaluate if variable cil_stMeasurementFrameContent.Meas_RBTM_FL_04 and signal Meas_RBTM_FL_04_ST3 are equal. --> Variable cil_stMeasurementFrameContent.Meas_RBTM_FL_04 is equal to signal Meas_RBTM_FL_04_ST3");
    result = debugger_readGlobalVariable("uint8", "cil_stMeasurementFrameContent,,app.elf", 3);
    EvalManStepEqual("Expected Test Result", result, $Meas_RBTM_FL_04_ST3.raw64);
    
    testCaseComment("Action: ARCH_SW_CIL_0713");
    testStep("STEP", "Evaluate if variable cil_stMeasurementFrameContent.Meas_RBTM_FL_05 and signal Meas_RBTM_FL_05_ST3 are equal. --> Variable cil_stMeasurementFrameContent.Meas_RBTM_FL_05 is equal to signal Meas_RBTM_FL_05_ST3");
    result = debugger_readGlobalVariable("uint8", "cil_stMeasurementFrameContent,,app.elf", 4);
    EvalManStepEqual("Expected Test Result", result, $Meas_RBTM_FL_05_ST3.raw64);
      
    testCaseComment("Action: ARCH_SW_CIL_0713");
    testStep("STEP", "Evaluate if variable cil_stMeasurementFrameContent.Meas_RBTM_FL_06 and signal Meas_RBTM_FL_06_ST3 are equal. --> Variable cil_stMeasurementFrameContent.Meas_RBTM_FL_06 is equal to signal Meas_RBTM_FL_06_ST3");
    result = debugger_readGlobalVariable("uint8", "cil_stMeasurementFrameContent,,app.elf", 5);
    EvalManStepEqual("Expected Test Result", result, $Meas_RBTM_FL_06_ST3.raw64);
  
    testCaseComment("Action: ARCH_SW_CIL_0713");
    testStep("STEP", "Evaluate if variable cil_stMeasurementFrameContent.Meas_RBTM_FL_07 and signal Meas_RBTM_FL_07_ST3 are equal. --> Variable cil_stMeasurementFrameContent.Meas_RBTM_FL_07 is equal to signal Meas_RBTM_FL_07_ST3");
    result = debugger_readGlobalVariable("uint8", "cil_stMeasurementFrameContent,,app.elf", 6);
    EvalManStepEqual("Expected Test Result", result, $Meas_RBTM_FL_07_ST3.raw64);
  
    testCaseComment("Action: ARCH_SW_CIL_0713");
    testStep("STEP", "Evaluate if variable cil_stMeasurementFrameContent.Meas_RBTM_FL_08 and signal Meas_RBTM_FL_08_ST3 are equal. --> Variable cil_stMeasurementFrameContent.Meas_RBTM_FL_08 is equal to signal Meas_RBTM_FL_08_ST3");
    result = debugger_readGlobalVariable("uint8", "cil_stMeasurementFrameContent,,app.elf", 7);
    EvalManStepEqual("Expected Test Result", result, $Meas_RBTM_FL_08_ST3.raw64);
    

  testCaseComment("Postcondition");
  testStep("STEP", "Return ECU to default values");
  RunPostTs(); 
}



testcase SW_IT_CIL_Update_07Cx_Block02_01()
{
  //***********************************Test report header*********************************
  testReportAddMiscInfoBlock("AUTOLIV ELECTRONICS document");
  TestReportAddMiscInfo("Nightly test", "No");
  TestReportAddMiscInfo("Test type", "Requirement-Based test");
  TestReportAddMiscInfo("Regression Test", "No");
  TestReportAddMiscInfo("Fault injection method used", "No");
  TestReportAddMiscInfo("Resource usage evaluation", "No");
  TestReportAddMiscInfo("Priority", "No");
  TestReportAddMiscInfo("Safety relevant", "No");
  
  AddRequirementInfo("Requirement under test", "ARCH_SW_CIL_0712, ARCH_SW_CIL_0764");
  AddRequirementInfo("ARCH_SW_CIL_0712", "If selected, the content of the measurement frame - block #2 shall be encoded and provided to CAN.");
  AddRequirementInfo("ARCH_SW_CIL_0764", "PMP_runGetBatteryVoltage_(Ext)* shall be called to get the battery voltage.");
  //***************************************************************************************
    
  testCaseComment("Preconditions");
  testStep("STEP", "Bench Initialization");
  RunPreTs();
  

//    AuthenticateECU(2);
    EnterDiagnosticSession("development");
    
    testStep("STEP", "Activate Measurement Frame block 2.");
    ActivateMeasurementFrame(2);
    
    testStep("STEP", "Set a breakpoint in function cil_Update_07Cx_Block02_InfosToSend at line Rte_Call_pclKL30_V_Get(&u16ScaledKL30Voltage);.");
    debugger_setRelativeFunctionBpAtLine("cil_Update_07Cx_Block02_InfosToSend", 18);
    
    testCaseComment("Action: ARCH_SW_CIL_0764");
    testStep("STEP", "Check if CPU stopped at line Rte_Call_pclKL30_V_Get(&u16ScaledKL30Voltage);. --> CPU is Stopped");
debugger_isCPUStoppedAtFunction("cil_Update_07Cx_Block02_InfosToSend");    ////EvalManStepEqual("Expected Test Result", debugger_result,  "CPU is Stopped");
    
    testStep("STEP", "Set a breakpoint at the last line of function cil_Update_07Cx_Block02_InfosToSend.");
    debugger_setRelativeFunctionBpAtLine("cil_Update_07Cx_Block02_InfosToSend", 47);
    
    debugger_run();
    
    testCaseComment("Action: ARCH_SW_CIL_0712");
    testStep("STEP", "Evaluate if variable cil_stMeasurementFrameContent.Meas_RBTM_FL_01 and signal Meas_RBTM_FL_01_ST3 are equal. --> Variable cil_stMeasurementFrameContent.Meas_RBTM_FL_01 is equal to signal Meas_RBTM_FL_01_ST3");
    result = debugger_readGlobalVariable("uint8", "cil_stMeasurementFrameContent,,app.elf", 0);
    EvalManStepEqual("Expected Test Result", result, $Meas_RBTM_FL_01_ST3.raw64);
  
    testCaseComment("Action: ARCH_SW_CIL_0712");
    testStep("STEP", "Evaluate if variable cil_stMeasurementFrameContent.Meas_RBTM_FL_02 and signal Meas_RBTM_FL_02_ST3 are equal. --> Variable cil_stMeasurementFrameContent.Meas_RBTM_FL_02 is equal to signal Meas_RBTM_FL_02_ST3");
    result = debugger_readGlobalVariable("uint8", "cil_stMeasurementFrameContent,,app.elf", 1);
    EvalManStepEqual("Expected Test Result", result, $Meas_RBTM_FL_02_ST3.raw64);
    
    testCaseComment("Action: ARCH_SW_CIL_0712");
    testStep("STEP", "Evaluate if variable cil_stMeasurementFrameContent.Meas_RBTM_FL_03 and signal Meas_RBTM_FL_03_ST3 are equal. --> Variable cil_stMeasurementFrameContent.Meas_RBTM_FL_03 is equal to signal Meas_RBTM_FL_03_ST3");
    result = debugger_readGlobalVariable("uint8", "cil_stMeasurementFrameContent,,app.elf", 2);
    EvalManStepEqual("Expected Test Result", result, $Meas_RBTM_FL_03_ST3.raw64);
    
    testCaseComment("Action: ARCH_SW_CIL_0712");
    testStep("STEP", "Evaluate if variable cil_stMeasurementFrameContent.Meas_RBTM_FL_04 and signal Meas_RBTM_FL_04_ST3 are equal. --> Variable cil_stMeasurementFrameContent.Meas_RBTM_FL_04 is equal to signal Meas_RBTM_FL_04_ST3");
    result = debugger_readGlobalVariable("uint8", "cil_stMeasurementFrameContent,,app.elf", 3);
    EvalManStepEqual("Expected Test Result", result, $Meas_RBTM_FL_04_ST3.raw64);
    
    testCaseComment("Action: ARCH_SW_CIL_0712");
    testStep("STEP", "Evaluate if variable cil_stMeasurementFrameContent.Meas_RBTM_FL_05 and signal Meas_RBTM_FL_05_ST3 are equal. --> Variable cil_stMeasurementFrameContent.Meas_RBTM_FL_05 is equal to signal Meas_RBTM_FL_05_ST3");
    result = debugger_readGlobalVariable("uint8", "cil_stMeasurementFrameContent,,app.elf", 4);
    EvalManStepEqual("Expected Test Result", result, $Meas_RBTM_FL_05_ST3.raw64);
      
    testCaseComment("Action: ARCH_SW_CIL_0712");
    testStep("STEP", "Evaluate if variable cil_stMeasurementFrameContent.Meas_RBTM_FL_06 and signal Meas_RBTM_FL_06_ST3 are equal. --> Variable cil_stMeasurementFrameContent.Meas_RBTM_FL_06 is equal to signal Meas_RBTM_FL_06_ST3");
    result = debugger_readGlobalVariable("uint8", "cil_stMeasurementFrameContent,,app.elf", 5);
    EvalManStepEqual("Expected Test Result", result, $Meas_RBTM_FL_06_ST3.raw64);
  
    testCaseComment("Action: ARCH_SW_CIL_0712");
    testStep("STEP", "Evaluate if variable cil_stMeasurementFrameContent.Meas_RBTM_FL_07 and signal Meas_RBTM_FL_07_ST3 are equal. --> Variable cil_stMeasurementFrameContent.Meas_RBTM_FL_07 is equal to signal Meas_RBTM_FL_07_ST3");
    result = debugger_readGlobalVariable("uint8", "cil_stMeasurementFrameContent,,app.elf", 6);
    EvalManStepEqual("Expected Test Result", result, $Meas_RBTM_FL_07_ST3.raw64);
  
    testCaseComment("Action: ARCH_SW_CIL_0712");
    testStep("STEP", "Evaluate if variable cil_stMeasurementFrameContent.Meas_RBTM_FL_08 and signal Meas_RBTM_FL_08_ST3 are equal. --> Variable cil_stMeasurementFrameContent.Meas_RBTM_FL_08 is equal to signal Meas_RBTM_FL_08_ST3");
    result = debugger_readGlobalVariable("uint8", "cil_stMeasurementFrameContent,,app.elf", 7);
    EvalManStepEqual("Expected Test Result", result, $Meas_RBTM_FL_08_ST3.raw64);
 
  
  testCaseComment("Postcondition");
  testStep("STEP", "Return ECU to default values");
  RunPostTs(); 
}


testcase SW_IT_CIL_Update_07Cx_Block01_01()
{
  //***********************************Test report header*********************************
  testReportAddMiscInfoBlock("AUTOLIV ELECTRONICS document");
  TestReportAddMiscInfo("Nightly test", "No");
  TestReportAddMiscInfo("Test type", "Requirement-Based test");
  TestReportAddMiscInfo("Regression Test", "No");
  TestReportAddMiscInfo("Fault injection method used", "No");
  TestReportAddMiscInfo("Resource usage evaluation", "No");
  TestReportAddMiscInfo("Priority", "No");
  TestReportAddMiscInfo("Safety relevant", "No");
  
  AddRequirementInfo("Requirement under test", "ARCH_SW_CIL_0711, ARCH_SW_CIL_0701, ARCH_SW_CIL_0702");
  AddRequirementInfo("ARCH_SW_CIL_0711", "If selected, the content of the measurement frame - block #1 shall be encoded and provided to CAN.");
  AddRequirementInfo("ARCH_SW_CIL_0701", "If selected, the content of the measurement frame - block #1 shall be encoded and provided to CAN.");
  AddRequirementInfo("ARCH_SW_CIL_0702", "If selected, the content of the measurement frame - block #1 shall be encoded and provided to CAN.");
  //***************************************************************************************
    
  testCaseComment("Preconditions");
  testStep("STEP", "Bench Initialization");
  RunPreTs();
  

//    AuthenticateECU(2);
    EnterDiagnosticSession("development");
    
    testStep("STEP", "Activate Measurement Frame block 1.");
    ActivateMeasurementFrame(1);
    
    testStep("STEP", "Set a breakpoint at the last line of function cil_Update_07Cx_Block01_InfosToSend.");
    debugger_setRelativeFunctionBpAtLine("cil_Update_07Cx_Block01_InfosToSend", 52);
    
    testCaseComment("Action: ARCH_SW_CIL_0711, ARCH_SW_CIL_0701, ARCH_SW_CIL_0702");
    testStep("STEP", "Evaluate if variable cil_stMeasurementFrameContent.Meas_RBTM_FL_01 and signal Meas_RBTM_FL_01_ST3 are equal. --> Variable cil_stMeasurementFrameContent.Meas_RBTM_FL_01 is equal to signal Meas_RBTM_FL_01_ST3");
    result = debugger_readGlobalVariable("uint8", "cil_stMeasurementFrameContent,,app.elf", 0);
    EvalManStepEqual("Expected Test Result", result, $Meas_RBTM_FL_01_ST3.raw64);
  
    testCaseComment("Action: ARCH_SW_CIL_0711");
    testStep("STEP", "Evaluate if variable cil_stMeasurementFrameContent.Meas_RBTM_FL_02 and signal Meas_RBTM_FL_02_ST3 are equal. --> Variable cil_stMeasurementFrameContent.Meas_RBTM_FL_02 is equal to signal Meas_RBTM_FL_02_ST3");
    result = debugger_readGlobalVariable("uint8", "cil_stMeasurementFrameContent,,app.elf", 1);
    EvalManStepEqual("Expected Test Result", result, $Meas_RBTM_FL_02_ST3.raw64);
    
    testCaseComment("Action: ARCH_SW_CIL_0711");
    testStep("STEP", "Evaluate if variable cil_stMeasurementFrameContent.Meas_RBTM_FL_03 and signal Meas_RBTM_FL_03_ST3 are equal. --> Variable cil_stMeasurementFrameContent.Meas_RBTM_FL_03 is equal to signal Meas_RBTM_FL_03_ST3");
    result = debugger_readGlobalVariable("uint8", "cil_stMeasurementFrameContent,,app.elf", 2);
    EvalManStepEqual("Expected Test Result", result, $Meas_RBTM_FL_03_ST3.raw64);
    
    testCaseComment("Action: ARCH_SW_CIL_0711");
    testStep("STEP", "Evaluate if variable cil_stMeasurementFrameContent.Meas_RBTM_FL_04 and signal Meas_RBTM_FL_04_ST3 are equal. --> Variable cil_stMeasurementFrameContent.Meas_RBTM_FL_04 is equal to signal Meas_RBTM_FL_04_ST3");
    result = debugger_readGlobalVariable("uint8", "cil_stMeasurementFrameContent,,app.elf", 3);
    EvalManStepEqual("Expected Test Result", result, $Meas_RBTM_FL_04_ST3.raw64);
    
    testCaseComment("Action: ARCH_SW_CIL_0711");
    testStep("STEP", "Evaluate if variable cil_stMeasurementFrameContent.Meas_RBTM_FL_05 and signal Meas_RBTM_FL_05_ST3 are equal. --> Variable cil_stMeasurementFrameContent.Meas_RBTM_FL_05 is equal to signal Meas_RBTM_FL_05_ST3");
    result = debugger_readGlobalVariable("uint8", "cil_stMeasurementFrameContent,,app.elf", 4);
    EvalManStepEqual("Expected Test Result", result, $Meas_RBTM_FL_05_ST3.raw64);
      
    testCaseComment("Action: ARCH_SW_CIL_0711");
    testStep("STEP", "Evaluate if variable cil_stMeasurementFrameContent.Meas_RBTM_FL_06 and signal Meas_RBTM_FL_06_ST3 are equal. --> Variable cil_stMeasurementFrameContent.Meas_RBTM_FL_06 is equal to signal Meas_RBTM_FL_06_ST3");
    result = debugger_readGlobalVariable("uint8", "cil_stMeasurementFrameContent,,app.elf", 5);
    EvalManStepEqual("Expected Test Result", result, $Meas_RBTM_FL_06_ST3.raw64);
  
    testCaseComment("Action: ARCH_SW_CIL_0711");
    testStep("STEP", "Evaluate if variable cil_stMeasurementFrameContent.Meas_RBTM_FL_07 and signal Meas_RBTM_FL_07_ST3 are equal. --> Variable cil_stMeasurementFrameContent.Meas_RBTM_FL_07 is equal to signal Meas_RBTM_FL_07_ST3");
    result = debugger_readGlobalVariable("uint8", "cil_stMeasurementFrameContent,,app.elf", 6);
    EvalManStepEqual("Expected Test Result", result, $Meas_RBTM_FL_07_ST3.raw64);
  
    testCaseComment("Action: ARCH_SW_CIL_0711");
    testStep("STEP", "Evaluate if variable cil_stMeasurementFrameContent.Meas_RBTM_FL_08 and signal Meas_RBTM_FL_08_ST3 are equal. --> Variable cil_stMeasurementFrameContent.Meas_RBTM_FL_08 is equal to signal Meas_RBTM_FL_08_ST3");
    result = debugger_readGlobalVariable("uint8", "cil_stMeasurementFrameContent,,app.elf", 7);
    EvalManStepEqual("Expected Test Result", result, $Meas_RBTM_FL_08_ST3.raw64);

  
  testCaseComment("Postcondition");
  testStep("STEP", "Return ECU to default values");
  RunPostTs(); 
}



