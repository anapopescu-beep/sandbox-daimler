AUTOSAR XML (schema 00046)
# Copyright (C) Infineon Technologies (2020)
# All rights reserved.
package /AUTOSAR_Can_17_McmCan/BswModuleDescriptions
  bsw module description Can: category=BSW_MODULE, module-id=80  # CAN Driver
    provided-entrys:
      Can_Init
      Can_SetBaudrate
      Can_SetControllerMode
      Can_DisableControllerInterrupts
      Can_EnableControllerInterrupts
      Can_Write
      Can_GetControllerErrorState
      Can_GetControllerMode
      Can_GetControllerRxErrorCounter
      Can_GetControllerTxErrorCounter
      Can_MainFunction_Write
      Can_MainFunction_Mode
      Can_MainFunction_Read
      Can_SetIcomConfiguration
      Can_DeInit
      Can_GetVersionInfo
      Can_IsrTransmitHandler
      Can_IsrReceiveHandler
      Can_IsrBusOffHandler
    bsw module dependency DetDependency: target-module-id=15, required-entrys=Det_ReportRuntimeError
    bsw module dependency CanIfDependency: target-module-id=60
      required-entrys:
        CanIf_RxIndication
        CanIf_ControllerBusOff
        CanIf_TxConfirmation
        CanIf_CurrentIcomConfiguration
        CanIf_ControllerModeIndication
        CanIf_TriggerTransmit
    bsw module dependency McalLibDependency: target-module-id=255
      required-entrys:
        Mcal_GetCpuIndex
        Mcal_WritePeripEndInitProtReg
        Mcal_SetBitAtomic
        Mcal_DelayTickResolution
        Mcal_DelayGetTick
    bsw internal behavior CanBehavior
      exclusive area IcomMsgCntrVal
      exclusive area CanWrMO
      13 x bsw called entity:
        Can_GetControllerErrorState: reentrancy-level=MULTICORE-REENTRANT, implemented-entry=Can_GetControllerErrorState
        Can_GetControllerMode: reentrancy-level=NON-REENTRANT, implemented-entry=Can_GetControllerMode
        Can_GetControllerRxErrorCounter: reentrancy-level=MULTICORE-REENTRANT, implemented-entry=Can_GetControllerRxErrorCounter
        Can_GetControllerTxErrorCounter: reentrancy-level=MULTICORE-REENTRANT, implemented-entry=Can_GetControllerTxErrorCounter
        Can_Init: reentrancy-level=NON-REENTRANT, implemented-entry=Can_Init
        Can_SetBaudrate: reentrancy-level=MULTICORE-REENTRANT, implemented-entry=Can_SetBaudrate
        Can_DisableControllerInterrupts: reentrancy-level=MULTICORE-REENTRANT, implemented-entry=Can_DisableControllerInterrupts
        Can_EnableControllerInterrupts: reentrancy-level=MULTICORE-REENTRANT, implemented-entry=Can_EnableControllerInterrupts
        Can_Write: can-enter-exclusive-area=CanWrMO, reentrancy-level=MULTICORE-REENTRANT, runs-inside-exclusive-area=CanWrMO, implemented-entry=Can_Write
        Can_SetControllerMode: reentrancy-level=NON-REENTRANT, implemented-entry=Can_SetControllerMode
        Can_SetIcomConfiguration: can-enter-exclusive-area=IcomMsgCntrVal, reentrancy-level=MULTICORE-REENTRANT, implemented-entry=Can_SetIcomConfiguration
        Can_DeInit: reentrancy-level=NON-REENTRANT, implemented-entry=Can_DeInit
        Can_GetVersionInfo: reentrancy-level=MULTICORE-REENTRANT, implemented-entry=Can_GetVersionInfo
      bsw schedulable entity Can_MainFunction_Write: minimum-start-interval=0.005, reentrancy-level=NON-REENTRANT, implemented-entry=Can_MainFunction_Write
      bsw interrupt entity Can_IsrTransmitHandler: reentrancy-level=MULTICORE-REENTRANT, implemented-entry=Can_IsrTransmitHandler
      bsw interrupt entity Can_IsrReceiveHandler: can-enter-exclusive-area=IcomMsgCntrVal, reentrancy-level=MULTICORE-REENTRANT, implemented-entry=Can_IsrReceiveHandler
      bsw interrupt entity Can_IsrBusOffHandler: reentrancy-level=MULTICORE-REENTRANT, implemented-entry=Can_IsrBusOffHandler
      bsw schedulable entity Can_MainFunction_Read: can-enter-exclusive-area=IcomMsgCntrVal, minimum-start-interval=0.005, reentrancy-level=NON-REENTRANT, implemented-entry=Can_MainFunction_Read
      bsw schedulable entity Can_MainFunction_Mode: minimum-start-interval=0.005, reentrancy-level=NON-REENTRANT, implemented-entry=Can_MainFunction_Mode
      5 x bsw timing event:
        TimingEvent_Can_17_McmCan_MainFunction_Mode: starts-on-event=Can_MainFunction_Mode, period=0.001
        TimingEvent_Can_17_McmCan_MainFunction_BusOff: starts-on-event=Can_MainFunction_BusOff, period=0.01
        TimingEvent_Can_17_McmCan_MainFunction_Wakeup: starts-on-event=Can_MainFunction_Wakeup, period=0.01
        TimingEvent_Can_17_McmCan_MainFunction_Read: starts-on-event=Can_MainFunction_Read, period=0.005
        TimingEvent_Can_17_McmCan_MainFunction_Write: starts-on-event=Can_MainFunction_Write, period=0.005
package /AUTOSAR_Can_17_McmCan/BswModuleEntrys
  19 x bsw module entry, all with is-synchronous=true, sw-service-impl-policy=STANDARD:
    Can_Init: service-id=0, is-reentrant=false, call-type=REGULAR, execution-context=TASK
      sw service arg Config: category=DATA_REFERENCE, sw-pointer-target-props={target-category=TYPE_REFERENCE, implementation-data-type=Can_17_McmCan_ConfigType}
    Can_SetControllerMode: service-id=3, is-reentrant=false, call-type=REGULAR, execution-context=TASK
      return type Return: implementation-data-type=Std_ReturnType
      sw service arg Controller: implementation-data-type=uint8
      sw service arg Transition: implementation-data-type=Can_ControllerStateType
    Can_DisableControllerInterrupts: service-id=4, is-reentrant=true, call-type=REGULAR, execution-context=TASK
      sw service arg Controller: implementation-data-type=uint8
    Can_EnableControllerInterrupts: service-id=5, is-reentrant=true, call-type=REGULAR, execution-context=TASK
      sw service arg Controller: implementation-data-type=uint8
    Can_SetBaudrate: service-id=15, is-reentrant=true, call-type=REGULAR, execution-context=TASK
      sw service arg Controller: implementation-data-type=uint8
      sw service arg BaudRateConfigID: implementation-data-type=uint16
    Can_DeInit: service-id=16, is-reentrant=false, call-type=REGULAR, execution-context=TASK
    Can_GetVersionInfo: service-id=7, is-reentrant=true, call-type=REGULAR, execution-context=TASK
      sw service arg versioninfo: category=DATA_REFERENCE, sw-pointer-target-props={target-category=TYPE_REFERENCE, implementation-data-type=Std_VersionInfoType}
    Can_SetIcomConfiguration: service-id=33, is-reentrant=true, call-type=REGULAR, execution-context=TASK
      sw service arg Controller: implementation-data-type=uint8
      sw service arg ConfigurationId: implementation-data-type=IcomConfigIdType
    Can_Write: service-id=6, is-reentrant=true, call-type=REGULAR, execution-context=TASK
      return type Return: implementation-data-type=Std_ReturnType
      sw service arg Hth: implementation-data-type=Can_HwHandleType
      sw service arg PduInfo: category=DATA_REFERENCE, sw-pointer-target-props={target-category=TYPE_REFERENCE, implementation-data-type=Can_PduType}
    Can_GetControllerMode: service-id=18, is-reentrant=false, call-type=REGULAR, execution-context=TASK
      return type Return: implementation-data-type=Std_ReturnType
      sw service arg Controller: implementation-data-type=uint8
      sw service arg ControllerModePtr: category=DATA_REFERENCE, sw-pointer-target-props={target-category=TYPE_REFERENCE, implementation-data-type=Can_ControllerStateType}
    Can_GetControllerErrorState: service-id=17, is-reentrant=true, call-type=REGULAR, execution-context=TASK
      return type Return: implementation-data-type=Std_ReturnType
      sw service arg Controller: implementation-data-type=uint8
      sw service arg ErrorStatePtr: category=DATA_REFERENCE, sw-pointer-target-props={target-category=TYPE_REFERENCE, implementation-data-type=Can_ErrorStateType}
    Can_GetControllerRxErrorCounter: service-id=48, is-reentrant=true, call-type=REGULAR, execution-context=TASK
      return type Return: implementation-data-type=Std_ReturnType
      sw service arg Controller: implementation-data-type=uint8
      sw service arg RxErrorCounterPtr: category=DATA_REFERENCE, sw-pointer-target-props={target-category=TYPE_REFERENCE, implementation-data-type=uint8}
    Can_GetControllerTxErrorCounter: service-id=49, is-reentrant=true, call-type=REGULAR, execution-context=TASK
      return type Return: implementation-data-type=Std_ReturnType
      sw service arg Controller: implementation-data-type=uint8
      sw service arg TxErrorCounterPtr: category=DATA_REFERENCE, sw-pointer-target-props={target-category=TYPE_REFERENCE, implementation-data-type=uint8}
    Can_MainFunction_Mode: service-id=12, is-reentrant=false, call-type=SCHEDULED, execution-context=TASK
    Can_MainFunction_Read: service-id=8, is-reentrant=false, call-type=SCHEDULED, execution-context=TASK
    Can_MainFunction_Write: service-id=1, is-reentrant=false, call-type=SCHEDULED, execution-context=TASK
    Can_IsrTransmitHandler: role=Can_IsrTransmitHandler, is-reentrant=true, call-type=INTERRUPT, execution-context=INTERRUPT-CAT-1
      sw service arg HwKernelId: implementation-data-type=uint8
      sw service arg NodeIdIndex: implementation-data-type=uint8
    Can_IsrReceiveHandler: role=Can_IsrReceiveHandler, is-reentrant=true, call-type=INTERRUPT, execution-context=INTERRUPT-CAT-1
      sw service arg HwKernelId: implementation-data-type=uint8
      sw service arg NodeIdIndex: implementation-data-type=uint8
    Can_IsrBusOffHandler: role=Can_IsrBusOffHandler, is-reentrant=true, call-type=INTERRUPT, execution-context=INTERRUPT-CAT-1
      sw service arg HwKernelId: implementation-data-type=uint8
      sw service arg NodeIdIndex: implementation-data-type=uint8
package /AUTOSAR_Can_17_McmCan/Implementations
  bsw implementation Can: programming-language=C, sw-version=20.0.1, vendor-id=17, ar-release-version=4.4.0, behavior=CanBehavior, vendor-api-infix=McmCan, vendor-specific-module-def=Can
    code-descriptors:
      code Files
        artifact-descriptors:
          short-label=ssc::inc::Can_17_McmCan.h, category=SWHDR
          short-label=ssc::src::Can_17_McmCan.c, category=SWSRC
    generated-artifacts:
      5 x dependency on artifact:
        Can_Cfg_h: artifact-descriptor={short-label=generate::inc:Can_17_McmCan_Cfg.h, category=SWTEMPLATE}, usages=COMPILE
        Can_PBcfg_h: artifact-descriptor={short-label=generate::template::inc::Can_17_McmCan_PBcfg.h, category=SWTEMPLATE}, usages=EXECUTE
        Can_PBCfg_c: artifact-descriptor={short-label=generate::src::Can_17_McmCan_PBcfg.c, category=SWTEMPLATE}, usages=EXECUTE
        Can_xdm: artifact-descriptor={short-label=config::Can_17_McmCan.xdm, category=SWTOOL}, usages=CODEGENERATION
        Can_bmd: artifact-descriptor={short-label=autosar::TC33x::TC332x::Can_17_McmCan.bmd, category=SWTOOL}, usages=CODEGENERATION
    resource consumption ResourceConsumption
      8 x memory section, all with alignment=UNSPECIFIED:
        VAR_CLEARED_QM_CORE0_UNSPECIFIED: sw-addrmethod=VAR_CLEARED
        VAR_INIT_QM_CORE0_UNSPECIFIED: sw-addrmethod=VAR_INIT
        VAR_CLEARED_QM_GLOBAL_UNSPECIFIED: sw-addrmethod=VAR_CLEARED
        CONST_QM_GLOBAL_UNSPECIFIED: sw-addrmethod=CONST
        CONST_QM_CORE0_UNSPECIFIED: sw-addrmethod=CONST
        CONFIG_DATA_QM_GLOBAL_UNSPECIFIED: sw-addrmethod=CONFIG_DATA
        CONFIG_DATA_QM_CORE0_UNSPECIFIED: sw-addrmethod=CONFIG_DATA
        CODE_QM_GLOBAL: sw-addrmethod=CODE
      section name prefix CAN_17_MCMCAN
package /AUTOSAR_Can_17_McmCan/ImplementationDataTypes
  34 x impl type, all with type-emitter=BSW:
    Can_17_McmCan_LPduRxCalloutFnPtrType: category=FUNCTION_REFERENCE, sw-pointer-target-props=Can_LpduCallout
    Can_17_Mcmcan_DrvStateMachine: compu {0=CAN_17_MCMCA_UNINIT, 1=CAN_17_MCMCAN_READY}, implementation-data-type=uint32, additional-native-type-qualifier=enum
    Can_17_McmCan_EventIndicesType: compu {0=CAN_17_MCMCAN_TX_PROCESSING_MODE, 1=CAN_17_MCMCAN_RX_PROCESSING_MODE, 2=CAN_17_MCMCAN_BO_PROCESSING_MODE, 3=CAN_17_MCMCAN_WU_PROCESSING_MODE}, implementation-data-type=uint32, additional-native-type-qualifier=enum
    Can_17_McmCan_IDType: compu {0=CAN_17_MCMCAN_ID_STANDARD, 1=CAN_17_MCMCAN_ID_MIXED, 2=CAN_17_MCMCAN_ID_EXTENDED}, implementation-data-type=uint32, additional-native-type-qualifier=enum
    Can_17_McmCan_MOMapType: compu {0=CAN_17_MCMCAN_TX_STARTINDEX, 1=CAN_17_MCMCAN_TX_TOTAL_MSGCFG, 2=CAN_17_MCMCAN_RX_SID_STARTINDEX, 3=CAN_17_MCMCAN_TOTAL_SIDCFG, 4=CAN_17_MCMCAN_RX_XID_STARTINDEX, 5=CAN_17_MCMCAN_TOTAL_XIDCFG}, implementation-data-type=uint32, additional-native-type-qualifier=enum
    Can_17_McmCan_MsgRamMapType: compu {0=CAN_17_MCMCAN_FLSSA, 1=CAN_17_MCMCAN_FLSEA, 2=CAN_17_MCMCAN_F0SA, 3=CAN_17_MCMCAN_F1SA, 4=CAN_17_MCMCAN_RBSA, 5=CAN_17_MCMCAN_EFSA, 6=CAN_17_MCMCAN_TBSA}, implementation-data-type=uint32, additional-native-type-qualifier=enum
    Can_17_McmCan_ProcessingType: compu {0=CAN_17_MCMCAN_POLLING, 1=CAN_17_MCMCAN_INTERRUPT, 2=CAN_17_MCMCAN_MIXED}, implementation-data-type=uint32, additional-native-type-qualifier=enum
    Can_17_McmCan_RxFIFOProcessingType: compu {0=CAN_17_MCMCAN_RX_FIFO_POLLING, 1=CAN_17_MCMCAN_RX_FIFO_INTERRUPT, 2=CAN_17_MCMCAN_RX_FIFO_NOT_CONFIGURED}, implementation-data-type=uint32, additional-native-type-qualifier=enum
    Can_17_McmCan_TxBufferType: compu {0=CAN_17_MCMCAN_TX_DED_BUFFER, 1=CAN_17_MCMCAN_TX_QUEUE}, implementation-data-type=uint32, additional-native-type-qualifier=enum
    Can_17_McmCan_RxBufferType: compu {0=CAN_17_MCMCAN_RX_DED_BUFFER, 1=CAN_17_MCMCAN_RX_FIFO0, 2=CAN_17_MCMCAN_RX_FIFO1, 3=CAN_17_MCMCAN_RX_ALL}, implementation-data-type=uint32, additional-native-type-qualifier=enum
    Can_17_McmCan_IcomSignalOperType: compu {0=CAN_17_MCMCAN_ICOM_OPER_AND, 1=CAN_17_MCMCAN_ICOM_OPER_EQUAL, 2=CAN_17_MCMCAN_ICOM_OPER_GREATER, 3=CAN_17_MCMCAN_ICOM_OPER_SMALLER, 4=CAN_17_MCMCAN_ICOM_OPER_XOR}, implementation-data-type=uint32, additional-native-type-qualifier=enum
    Can_17_McmCan_ControllerBaudrateConfigType: category=STRUCTURE
      element CanBaudrateCfg: implementation-data-type=uint16
      element CanControllerBaudrate: implementation-data-type=uint32
    Can_17_McmCan_IcomConfigType: category=STRUCTURE
      element CanIcomFirstMsgIndx: implementation-data-type=uint16
      element CanIcomNoOfMsgIndx: implementation-data-type=uint16
      element CanIcomWakeOnBusOff: implementation-data-type=boolean
    Can_17_McmCan_IcomRxMsgConfigType: category=STRUCTURE
      7 x element, all with category=TYPE_REFERENCE:
        CanIcomMsgId: implementation-data-type=Can_IdType
        CanIcomMaskRef: implementation-data-type=Can_IdType
        CanIcomCntrVal: implementation-data-type=uint16
        CanIcomDLC: implementation-data-type=uint8
        CanIcomFirstSignalIndx: implementation-data-type=uint8
        CanIcomNoOfSignalIndx: implementation-data-type=uint8
        CanIcomLengthErr: implementation-data-type=boolean
    Can_17_McmCan_IcomRxMsgSignalConfigType: category=STRUCTURE
      element CanIcomSignalMask: array-size=8, array-size-semantics=FIXED-SIZE, implementation-data-type=uint8
      element CanIcomSignalValue: array-size=8, array-size-semantics=FIXED-SIZE, implementation-data-type=uint8
      element CanIcomSignalOper: implementation-data-type=Can_17_McmCan_IcomSignalOperType
    Can_17_McmCan_McmModuleConfigType: category=STRUCTURE
      element CanBaseAddressPtr: implementation-data-type=uint32
      element CanUsedHwCfgIndx: array-size=4, array-size-semantics=FIXED-SIZE, implementation-data-type=boolean
    Can_17_McmCan_ControllerMsgRAMConfigType: category=STRUCTURE
      7 x element, all with category=TYPE_REFERENCE:
        CanControllerMsgRAMMap: array-size=7, array-size-semantics=FIXED-SIZE, implementation-data-type=uint32
        CanTxDedBuffCount: implementation-data-type=uint8
        CanTxEvntFIFOSize: implementation-data-type=uint8
        CanRxFIFO0Size: implementation-data-type=uint8
        CanRxFIFO0Threshold: implementation-data-type=uint8
        CanRxFIFO1Size: implementation-data-type=uint8
        CanRxFIFO1Threshold: implementation-data-type=uint8
    Can_17_McmCan_SIDFilterConfigType: category=STRUCTURE
      5 x element, all with category=TYPE_REFERENCE:
        CanSIDFiltEleS0: implementation-data-type=uint32
        CanSidHwObjId: implementation-data-type=Can_HwHandleType
        HwControllerId: implementation-data-type=uint8
        CanSidBufferType: implementation-data-type=Can_17_McmCan_RxBufferType
        CanSidPNSupport: implementation-data-type=boolean
    Can_17_McmCan_XIDFilterConfigType: category=STRUCTURE
      6 x element, all with category=TYPE_REFERENCE:
        CanXIDFiltEleF0: implementation-data-type=uint32
        CanXIDFiltEleF1: implementation-data-type=uint32
        CanXidHwObjId: implementation-data-type=Can_HwHandleType
        HwControllerId: implementation-data-type=uint8
        CanXidBufferType: implementation-data-type=Can_17_McmCan_RxBufferType
        CanXidPNSupport: implementation-data-type=boolean
    Can_17_McmCan_TxHwObjectConfigType: category=STRUCTURE
      6 x element, all with category=TYPE_REFERENCE:
        CanTxHwObjId: implementation-data-type=Can_HwHandleType
        CanTxBuffIndx: implementation-data-type=uint8
        HwControllerId: implementation-data-type=uint8
        CanTxHwObjIdType: implementation-data-type=uint8
        CanTxBufferType: implementation-data-type=Can_17_McmCan_TxBufferType
        CanTrigTxStatus: implementation-data-type=boolean
    Can_17_McmCan_EventHandlingType: category=STRUCTURE
      4 x element, all with category=TYPE_REFERENCE, implementation-data-type=Can_17_McmCan_ProcessingType:
        CanTxProcessing
        CanRxProcessing
        CanBusoffProcessing
        CanWakeupProcessing
    Can_17_McmCan_HthMaskObjectConfigType: category=STRUCTURE
      element CanTxBufferMaskvalue: implementation-data-type=uint32
      element CanPerHthHwObjId: implementation-data-type=Can_HwHandleType
      element HwControllerId: implementation-data-type=uint8
    Can_17_McmCan_PeriodHthMaskConfigType: category=STRUCTURE
      element CanPerHthStartIndx: implementation-data-type=Can_HwHandleType
      element CanPerHthEndIndx: implementation-data-type=Can_HwHandleType
    Can_17_McmCan_HrhMaskObjectConfigType: category=STRUCTURE
      5 x element, all with category=TYPE_REFERENCE:
        CanPerRxbufferMaskvalue0: implementation-data-type=uint32
        CanPerRxbufferMaskvalue1: implementation-data-type=uint32
        CanPerHrhHwObjId: implementation-data-type=Can_HwHandleType
        HwControllerId: implementation-data-type=uint8
        CanPerHrhBufferType: implementation-data-type=Can_17_McmCan_RxBufferType
    Can_17_McmCan_PeriodHrhMaskConfigType: category=STRUCTURE
      element CanPerHrhStartIndx: implementation-data-type=Can_HwHandleType
      element CanPerHrhEndIndx: implementation-data-type=Can_HwHandleType
    Can_17_McmCan_ControllerConfigType: category=STRUCTURE
      15 x element, all with category=TYPE_REFERENCE:
        CanNodeAddressPtr: implementation-data-type=uint32
        CanNPCRValue: implementation-data-type=uint32
        CanControllerMOMap: array-size=6, array-size-semantics=FIXED-SIZE, implementation-data-type=uint16
        CanDefaultBRCfgIndx: implementation-data-type=uint16
        CanBaudrateCfgIndx: implementation-data-type=uint16
        CanNoOfBaudrateCfg: implementation-data-type=uint16
        CanKernelHwId: implementation-data-type=uint8
        CanControllerHwId: implementation-data-type=uint8
        CanControllerLogicalId: implementation-data-type=uint8
        CanRxFIFO0ProcessingConfig: implementation-data-type=Can_17_McmCan_RxFIFOProcessingType
        CanRxFIFO1ProcessingConfig: implementation-data-type=Can_17_McmCan_RxFIFOProcessingType
        CanHrhNDAT1PollingMask: implementation-data-type=uint32
        CanHrhNDAT2PollingMask: implementation-data-type=uint32
        CanTxPollingObjectMask: implementation-data-type=uint32
        CanEnableInterruptMask: implementation-data-type=uint32
    Can_17_McmCan_ControllerIndexType: implementation-data-type=uint8
    Can_17_McmCan_HthPeriodIndexType: implementation-data-type=uint8
    Can_17_McmCan_HrhPeriodIndexType: implementation-data-type=uint8
    Can_17_McmCan_HthIndexType: category=STRUCTURE
      element CanHthCoreAssigned: implementation-data-type=uint8
      element CanHthLogicContIndex: implementation-data-type=uint8
      element CanHthCoreSpecIndex: implementation-data-type=uint16
    Can_17_McmCan_LogicalControllerIndexType: category=STRUCTURE
      4 x element, all with category=TYPE_REFERENCE, implementation-data-type=uint8:
        CanLCoreAssigned
        CanLCoreSpecContIndex
        CanLContPhyIndex
        CanLKerPhyIndex
    Can_17_McmCan_PhyControllerIndexType: category=STRUCTURE
      element CanPLogicContIndex: implementation-data-type=uint8
      element CanPCoreSpecContIndex: implementation-data-type=uint8
      element CanPCoreAssigned: implementation-data-type=uint8
    Can_17_McmCan_CoreConfigType: category=STRUCTURE
      15 x element:
        CanCoreContCnt: implementation-data-type=uint8
        CanControllerIndexingPtr: category=DATA_REFERENCE, sw-pointer-target-props={target-category=TYPE_REFERENCE, implementation-data-type=Can_17_McmCan_ControllerIndexType}
        CanControllerConfigPtr: category=DATA_REFERENCE, sw-pointer-target-props={target-category=TYPE_REFERENCE, implementation-data-type=Can_17_McmCan_ControllerConfigType}
        CanControllerMsgRAMMapConfigPtr: category=DATA_REFERENCE, sw-pointer-target-props={target-category=TYPE_REFERENCE, implementation-data-type=Can_17_McmCan_ControllerMsgRAMConfigType}
        CanEventHandlingConfigPtr: category=DATA_REFERENCE, sw-pointer-target-props={target-category=TYPE_REFERENCE, implementation-data-type=Can_17_McmCan_EventHandlingType}
        CanBaudrateConfigPtr: category=DATA_REFERENCE, sw-pointer-target-props={target-category=TYPE_REFERENCE, implementation-data-type=Can_17_McmCan_ControllerBaudrateConfigType}
        CanTxHwObjectConfigPtr: category=DATA_REFERENCE, sw-pointer-target-props={target-category=TYPE_REFERENCE, implementation-data-type=Can_17_McmCan_TxHwObjectConfigType}
        CanSIDFilterConfigPtr: category=DATA_REFERENCE, sw-pointer-target-props={target-category=TYPE_REFERENCE, implementation-data-type=Can_17_McmCan_SIDFilterConfigType}
        CanXIDFilterConfigPtr: category=DATA_REFERENCE, sw-pointer-target-props={target-category=TYPE_REFERENCE, implementation-data-type=Can_17_McmCan_XIDFilterConfigType}
        CanHthPeriodIndexPtr: category=DATA_REFERENCE, sw-pointer-target-props={target-category=TYPE_REFERENCE, implementation-data-type=Can_17_McmCan_HthPeriodIndexType}
        CanHthMaskObjectConfigPtr: category=DATA_REFERENCE, sw-pointer-target-props={target-category=TYPE_REFERENCE, implementation-data-type=Can_17_McmCan_HthMaskObjectConfigType}
        CanPeriodHthMaskConfigPtr: category=DATA_REFERENCE, sw-pointer-target-props={target-category=TYPE_REFERENCE, implementation-data-type=Can_17_McmCan_PeriodHthMaskConfigType}
        CanHrhPeriodIndexPtr: category=DATA_REFERENCE, sw-pointer-target-props={target-category=TYPE_REFERENCE, implementation-data-type=Can_17_McmCan_HrhPeriodIndexType}
        CanHrhMaskObjectConfigPtr: category=DATA_REFERENCE, sw-pointer-target-props={target-category=TYPE_REFERENCE, implementation-data-type=Can_17_McmCan_HrhMaskObjectConfigType}
        CanPeriodHrhMaskConfigPtr: category=DATA_REFERENCE, sw-pointer-target-props={target-category=TYPE_REFERENCE, implementation-data-type=Can_17_McmCan_PeriodHrhMaskConfigType}
    Can_17_McmCan_ConfigType: category=STRUCTURE
      13 x element:
        CanCoreConfigPtr: category=DATA_REFERENCE, array-size=1, array-size-semantics=FIXED-SIZE, sw-pointer-target-props={target-category=TYPE_REFERENCE, implementation-data-type=Can_17_McmCan_CoreConfigType}
        CanNoOfKernel: implementation-data-type=uint8
        CanNoOfHrh: implementation-data-type=Can_HwHandleType
        CanTotalHwObj: implementation-data-type=Can_HwHandleType
        CanTriggerTransmitEnable: implementation-data-type=boolean
        CanMCMModuleConfigPtr: category=DATA_REFERENCE, sw-pointer-target-props={target-category=TYPE_REFERENCE, implementation-data-type=Can_17_McmCan_McmModuleConfigType}
        CanPhyControllerIndexPtr: category=DATA_REFERENCE, sw-pointer-target-props={target-category=TYPE_REFERENCE, implementation-data-type=Can_17_McmCan_PhyControllerIndexType}
        CanLogicalControllerIndexPtr: category=DATA_REFERENCE, sw-pointer-target-props={target-category=TYPE_REFERENCE, implementation-data-type=Can_17_McmCan_LogicalControllerIndexType}
        CanHthIndexPtr: category=DATA_REFERENCE, sw-pointer-target-props={target-category=TYPE_REFERENCE, implementation-data-type=Can_17_McmCan_HthIndexType}
        CanIcomConfigPtr: category=DATA_REFERENCE, sw-pointer-target-props={target-category=TYPE_REFERENCE, implementation-data-type=Can_17_McmCan_IcomConfigType}
        CanIcomMsgConfigPtr: category=DATA_REFERENCE, sw-pointer-target-props={target-category=TYPE_REFERENCE, implementation-data-type=Can_17_McmCan_IcomRxMsgConfigType}
        CanIcomRxSignalConfigPtr: category=DATA_REFERENCE, sw-pointer-target-props={target-category=TYPE_REFERENCE, implementation-data-type=Can_17_McmCan_IcomRxMsgSignalConfigType}
        CanLPduRxCalloutFuncPtr: implementation-data-type=Can_17_McmCan_LPduRxCalloutFnPtrType
