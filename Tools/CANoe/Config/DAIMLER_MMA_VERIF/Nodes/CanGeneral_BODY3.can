/*@!Encoding:1252*/
includes
{
  // Import required CAPL include files
  //--- begin generated part --- Block start #Hdr_Includes#; do not delete this line and do not add application code in this code block!
  /* #ChannelStart# |CAN1| #BusStart# |BODY3| */
  /* #ChannelEnd# |CAN1| #BusEnd# |BODY3| */
  //--- end generated part --- Block end #Hdr_Includes#; do not delete this line! Add application code below this line.
  //--- begin generated part --- Block start #Body_Includes#; do not delete this line and do not add application code in this code block!
  /* #ChannelStart# |CAN1| #BusStart# |BODY3| */
  /* #ChannelEnd# |CAN1| #BusEnd# |BODY3| */
  //--- end generated part --- Block end #Body_Includes#; do not delete this line! Add application code below this line.
}

variables
{
  // Define global variables for this CAPL file

  /*--- #GenHeader Begin# --- begin generated comment ---
  | Generated on Monday, April 15, 2019, 12:43:46
  | By ModelGenerator for Daimler 1.0.0.4, ModelGeneratorDaimlerDLL 1.2.0.40
  | Package Daimler 3.2.8
  | Target Bus: BODY3; Channel: CAN1; DB Cluster: BODY3;
  | From Database: STAR_3_BODY3_CAN_2019_05a_AR43.arxml
  | CANoe Version 11.0.81.0
    --- #GenHeader End  # --- end generated comment --- */

  char gECU[256] = "CanGeneral_BODY3";
  //--- begin generated part --- Block start #Hdr_GlobalVariables#; do not delete this line and do not add application code in this code block!
  /* #ChannelStart# |CAN1| #BusStart# |BODY3| */
  /* #ChannelEnd# |CAN1| #BusEnd# |BODY3| */
  //--- end generated part --- Block end #Hdr_GlobalVariables#; do not delete this line! Add application code below this line.
  //--- begin generated part --- Block start #Body_GlobalVariables#; do not delete this line and do not add application code in this code block!
  /* #ChannelStart# |CAN1| #BusStart# |BODY3| */
  int gCAN1Channel = 1;
  /* #ChannelEnd# |CAN1| #BusEnd# |BODY3| */
  //--- end generated part --- Block end #Body_GlobalVariables#; do not delete this line! Add application code below this line.
}

on preStart
{
  // Initialize CAPL includes and node's modules/DLLs
  //--- begin generated part --- Block start #Hdr_OnInit#; do not delete this line and do not add application code in this code block!
  /* #ChannelStart# |CAN1| #BusStart# |BODY3| */
  /* #ChannelEnd# |CAN1| #BusEnd# |BODY3| */
  //--- end generated part --- Block end #Hdr_OnInit#; do not delete this line! Add application code below this line.
  //--- begin generated part --- Block start #Body_OnInit#; do not delete this line and do not add application code in this code block!
  /* #ChannelStart# |CAN1| #BusStart# |BODY3| */
  if (@sysvar::IL::Klemme15 > 0)
  {
    if (@sysvar::ModelGlobal::ISw_Stat < 2)
    {
      @sysvar::ModelGlobal::ISw_Stat = 2;
    }
  }
  else
  {
    if (@sysvar::ModelGlobal::ISw_Stat >= 2)
    {
      @sysvar::ModelGlobal::ISw_Stat = 0;
    }
  }
  /* #ChannelEnd# |CAN1| #BusEnd# |BODY3| */
  //--- end generated part --- Block end #Body_OnInit#; do not delete this line! Add application code below this line.
}

on start
{
  // Start CAPL includes and node's modules/DLLs
  //--- begin generated part --- Block start #Hdr_OnStart#; do not delete this line and do not add application code in this code block!
  /* #ChannelStart# |CAN1| #BusStart# |BODY3| */
  /* #ChannelEnd# |CAN1| #BusEnd# |BODY3| */
  //--- end generated part --- Block end #Hdr_OnStart#; do not delete this line! Add application code below this line.
  //--- begin generated part --- Block start #Body_OnStart#; do not delete this line and do not add application code in this code block!
  /* #ChannelStart# |CAN1| #BusStart# |BODY3| */
  if (@sysvar::ModelGlobal::OpenPanels > 0) openPanel("MainPanel");
  /* #ChannelEnd# |CAN1| #BusEnd# |BODY3| */
  //--- end generated part --- Block end #Body_OnStart#; do not delete this line! Add application code below this line.
}

on preStop
{
  // Prepare stopping
  //--- begin generated part --- Block start #Hdr_OnStopping#; do not delete this line and do not add application code in this code block!
  /* #ChannelStart# |CAN1| #BusStart# |BODY3| */
  /* #ChannelEnd# |CAN1| #BusEnd# |BODY3| */
  //--- end generated part --- Block end #Hdr_OnStopping#; do not delete this line! Add application code below this line.
  //--- begin generated part --- Block start #Body_OnStopping#; do not delete this line and do not add application code in this code block!
  /* #ChannelStart# |CAN1| #BusStart# |BODY3| */
  /* #ChannelEnd# |CAN1| #BusEnd# |BODY3| */
  //--- end generated part --- Block end #Body_OnStopping#; do not delete this line! Add application code below this line.
}

on stopMeasurement
{
  // Stop actions
  //--- begin generated part --- Block start #Hdr_OnStop#; do not delete this line and do not add application code in this code block!
  /* #ChannelStart# |CAN1| #BusStart# |BODY3| */
  /* #ChannelEnd# |CAN1| #BusEnd# |BODY3| */
  //--- end generated part --- Block end #Hdr_OnStop#; do not delete this line! Add application code below this line.
  //--- begin generated part --- Block start #Body_OnStop#; do not delete this line and do not add application code in this code block!
  /* #ChannelStart# |CAN1| #BusStart# |BODY3| */
  /* #ChannelEnd# |CAN1| #BusEnd# |BODY3| */
  //--- end generated part --- Block end #Body_OnStop#; do not delete this line! Add application code below this line.
}

on sysvar_update sysvar::IL::Klemme15
{
  // Handle system state variable
  //--- begin generated part --- Block start #Hdr_KL15_Klemme15#; do not delete this line and do not add application code in this code block!
  /* #ChannelStart# |CAN1| #BusStart# |BODY3| */
  /* #ChannelEnd# |CAN1| #BusEnd# |BODY3| */
  //--- end generated part --- Block end #Hdr_KL15_Klemme15#; do not delete this line! Add application code below this line.
  //--- begin generated part --- Block start #Body_KL15_Klemme15#; do not delete this line and do not add application code in this code block!
  /* #ChannelStart# |CAN1| #BusStart# |BODY3| */
  if (@this != 0)
  {
    if (@sysvar::ModelGlobal::ISw_Stat < 2)
    {
      @sysvar::ModelGlobal::ISw_Stat = 2;
    }
  }
  else
  {
    if (@sysvar::ModelGlobal::ISw_Stat >= 2)
    {
      @sysvar::ModelGlobal::ISw_Stat = 1;
    }
  }
  /* #ChannelEnd# |CAN1| #BusEnd# |BODY3| */
  //--- end generated part --- Block end #Body_KL15_Klemme15#; do not delete this line! Add application code below this line.
}

on sysvar_update sysvar::IL::StartWithoutSending
{
  // Handle system state variable
  //--- begin generated part --- Block start #Hdr_StartManner_StartWithoutSending#; do not delete this line and do not add application code in this code block!
  /* #ChannelStart# |CAN1| #BusStart# |BODY3| */
  /* #ChannelEnd# |CAN1| #BusEnd# |BODY3| */
  //--- end generated part --- Block end #Hdr_StartManner_StartWithoutSending#; do not delete this line! Add application code below this line.
  //--- begin generated part --- Block start #Body_StartManner_StartWithoutSending#; do not delete this line and do not add application code in this code block!
  /* #ChannelStart# |CAN1| #BusStart# |BODY3| */
  /* #ChannelEnd# |CAN1| #BusEnd# |BODY3| */
  //--- end generated part --- Block end #Body_StartManner_StartWithoutSending#; do not delete this line! Add application code below this line.
}

on sysvar_update sysvar::ModelGlobal::OpenPanels
{
  // Handle system state variable
  //--- begin generated part --- Block start #Hdr_DoOpenPanels_OpenPanels#; do not delete this line and do not add application code in this code block!
  /* #ChannelStart# |CAN1| #BusStart# |BODY3| */
  /* #ChannelEnd# |CAN1| #BusEnd# |BODY3| */
  //--- end generated part --- Block end #Hdr_DoOpenPanels_OpenPanels#; do not delete this line! Add application code below this line.
  //--- begin generated part --- Block start #Body_DoOpenPanels_OpenPanels#; do not delete this line and do not add application code in this code block!
  /* #ChannelStart# |CAN1| #BusStart# |BODY3| */
  if (@sysvar::ModelGlobal::OpenPanels > 0) openPanel("MainPanel");
  /* #ChannelEnd# |CAN1| #BusEnd# |BODY3| */
  //--- end generated part --- Block end #Body_DoOpenPanels_OpenPanels#; do not delete this line! Add application code below this line.
}

on sysvar_update sysvar::ModelGlobal::ISw_Stat
{
  // Handle system state variable
  qword aValidValuesList[6] = { 0, 1, 2, 4, 5, 7};
  int i;
  qword lastValue = 0;
  int aValidValuesListSize = 6;
  //--- begin generated part --- Block start #Hdr_ISw_Stat_ISw_Stat#; do not delete this line and do not add application code in this code block!
  /* #ChannelStart# |CAN1| #BusStart# |BODY3| */
  /* #ChannelEnd# |CAN1| #BusEnd# |BODY3| */
  //--- end generated part --- Block end #Hdr_ISw_Stat_ISw_Stat#; do not delete this line! Add application code below this line.
  if (aValidValuesListSize > 0)
  {
    if (@sysvar::ModelGlobal::ISw_Stat >= aValidValuesList[0])
    {
      if (@sysvar::ModelGlobal::ISw_Stat > aValidValuesList[aValidValuesListSize-1])
      {
        //write("1 ISw_Stat set to %d, change to %d", @sysvar::ModelGlobal::ISw_Stat, aValidValuesList[aValidValuesListSize-1]);
        @sysvar::ModelGlobal::ISw_Stat = aValidValuesList[aValidValuesListSize-1];
        return;
      }
      else
      {
        if (@sysvar::ModelGlobal::ISw_Stat != aValidValuesList[0])
        {
          for (i=0; i < aValidValuesListSize-1; i++)
          {
            if ((@sysvar::ModelGlobal::ISw_Stat > aValidValuesList[i]) && (@sysvar::ModelGlobal::ISw_Stat <= aValidValuesList[i+1]))
            {
              if (@sysvar::ModelGlobal::ISw_Stat == aValidValuesList[i+1])
              {
                break;
              }
              else
              {
                if (@sysvar::ModelGlobal::ISw_Stat < lastValue)
                {
                  //write("2 ISw_Stat set to %d, change to %d", @sysvar::ModelGlobal::ISw_Stat, aValidValuesList[i]);
                  @sysvar::ModelGlobal::ISw_Stat = aValidValuesList[i];
                  return;
                  break;
                }
                else
                {
                  //write("3 ISw_Stat set to %d, change to %d", @sysvar::ModelGlobal::ISw_Stat, aValidValuesList[i+1]);
                  @sysvar::ModelGlobal::ISw_Stat = aValidValuesList[i+1];
                  return;
                  break;
                }
              }
            }
          }
        }
      }
    }
    else
    {
      //write("4 ISw_Stat set to %d, change to %d", @sysvar::ModelGlobal::ISw_Stat, aValidValuesList[0]);
      @sysvar::ModelGlobal::ISw_Stat = aValidValuesList[0];
      return;
    }
  }
  lastValue = @sysvar::ModelGlobal::ISw_Stat;
  //--- begin generated part --- Block start #Body_ISw_Stat_ISw_Stat#; do not delete this line and do not add application code in this code block!
  /* #ChannelStart# |CAN1| #BusStart# |BODY3| */
  if ((@this >= 2) && (@this <= 7))
  {
    @sysvar::IL::Klemme15 = 1;
  }
  else
  {
    @sysvar::IL::Klemme15 = 0;
  }
  if (@this < 2)
  {
  }
  /* #ChannelEnd# |CAN1| #BusEnd# |BODY3| */
  //--- end generated part --- Block end #Body_ISw_Stat_ISw_Stat#; do not delete this line! Add application code below this line.
}

on sysvar sysvar::ModelGlobal::ISw_Stat
{
  // Handle system state variable
  //--- begin generated part --- Block start #Hdr_ISw_Stat_ISw_Stat#; do not delete this line and do not add application code in this code block!
  /* #ChannelStart# |CAN1| #BusStart# |BODY3| */
  /* #ChannelEnd# |CAN1| #BusEnd# |BODY3| */
  //--- end generated part --- Block end #Hdr_ISw_Stat_ISw_Stat#; do not delete this line! Add application code below this line.
  //--- begin generated part --- Block start #Body_ISw_Stat_ISw_Stat#; do not delete this line and do not add application code in this code block!
  /* #ChannelStart# |CAN1| #BusStart# |BODY3| */
  if ((@sysvar::IL::StartWithoutSending > 0) && (this.time_ns > 0))
  {
    //write("********** Reset start manner at time %g ", this.time_ns / 1000000000.0);
    @sysvar::IL::StartWithoutSending = 0;
  }
  /* #ChannelEnd# |CAN1| #BusEnd# |BODY3| */
  //--- end generated part --- Block end #Body_ISw_Stat_ISw_Stat#; do not delete this line! Add application code below this line.
}

//--- begin generated part --- Block start <#Helper_Functions#> do not delete this line and do not add application code in this code block!
/* #ChannelStart# |CAN1| #BusStart# |BODY3| */
on signal BODY3::Ign_Stat_ST3::ISw_Stat_ST3
{
  // Handle signal for system state variable
  if (this != @sysvar::ModelGlobal::ISw_Stat)
  {
    if (!isSimulated())
    {
      // ATTENTION: Only one (!) real bus should control the global state for all other buses!
      @sysvar::ModelGlobal::ISw_Stat = this;
    }
  }
}

/* #ChannelEnd# |CAN1| #BusEnd# |BODY3| */
//--- end generated part --- Block end <#Helper_Functions#> do not delete this line! Add application code below this line.

//--- begin generated part --- Block start <#SysVar_Handler#> do not delete this line and do not add application code in this code block!
/* #ChannelStart# |CAN1| #BusStart# |BODY3| */
/* #ChannelEnd# |CAN1| #BusEnd# |BODY3| */
//--- end generated part --- Block end <#SysVar_Handler#> do not delete this line! Add application code below this line.

//--- begin generated part --- Block start <#MsgUpdateFcns#> do not delete this line and do not add application code in this code block!
/* #ChannelStart# |CAN1| #BusStart# |BODY3| */
/* #ChannelEnd# |CAN1| #BusEnd# |BODY3| */
//--- end generated part --- Block end <#MsgUpdateFcns#> do not delete this line! Add application code below this line.

