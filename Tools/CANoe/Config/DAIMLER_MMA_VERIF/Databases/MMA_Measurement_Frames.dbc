VERSION ""

NS_ :

BS_:

BU_:
VAL_TABLE_ BlockID_values 24 "Measurement Block 24" 23 "Measurement Block 23" 22 "Measurement Block 22" 21 "Measurement Block 21" 20 "Measurement Block 20" 19 "Measurement Block 19" 18 "Measurement Block 18" 17 "Measurement Block 17" 16 "Measurement Block 16" 15 "Measurement Block 15" 14 "Measurement Block 14" 13 "Measurement Block 13" 12 "Measurement Block 12" 11 "Measurement Block 11" 10 "Measurement Block 10" 9 "Measurement Block 09" 8 "Measurement Block 08" 7 "Measurement Block 07" 6 "Measurement Block 06" 5 "Measurement Block 05" 4 "Measurement Block 04" 3 "Measurement Block 03" 2 "Measurement Block 02" 1 "Measurement Block 01" ;

BO_ 2564924560 MMA_FL_Measurement_Frame: 8 Vector__XXX
 SG_ FL_03_01_PCM_PrecrashSeverity m3 : 15|8@0+ (1,0) [0|0] "" Vector__XXX
 SG_ FL_11_0607_Motor_current m11 : 55|16@0+ (1,0) [0|0] "mA" Vector__XXX
 SG_ FL_11_05_CurrentCycleStepNb m11 : 47|8@0+ (1,0) [0|0] "" Vector__XXX
 SG_ FL_11_0304_ADC_IS_Tensioning m11 : 27|12@0+ (1,0) [0|0] "LSB" Vector__XXX
 SG_ FL_11_0102_ADC_IS_Releasing m11 : 11|12@0+ (1,0) [0|0] "LSB" Vector__XXX
 SG_ FL_10_0607_ADC_MotorMonitoring m10 : 55|16@0+ (0.0322258,0) [0|0] "V" Vector__XXX
 SG_ FL_10_0405_ADC_Hall_B_Supply m10 : 39|16@0+ (0.0048828125,0) [0|0] "V" Vector__XXX
 SG_ FL_10_0203_ADC_Hall_A_Supply m10 : 23|16@0+ (0.0048828125,0) [0|0] "V" Vector__XXX
 SG_ FL_09_0607_ADC_KL30_Voltage m9 : 55|16@0+ (0.0322258,0) [0|0] "V" Vector__XXX
 SG_ FL_09_0405_ADC_TensioningCurrent m9 : 39|16@0+ (1,0) [0|0] "LSB" Vector__XXX
 SG_ FL_09_0203_ADC_ReleaseCurrent m9 : 23|16@0+ (1,0) [0|0] "LSB" Vector__XXX
 SG_ FL_08_06_Applied_Motor_Power m8 : 55|8@0- (1,0) [-100|100] "% PWM" Vector__XXX
 SG_ FL_08_05_CurrentCycleStepNb m8 : 47|8@0+ (1,0) [0|0] "" Vector__XXX
 SG_ FL_08_04_CurrentCycleNb m8 : 39|8@0- (1,0) [0|0] "" Vector__XXX
 SG_ FL_08_03_FLS_Output m8 : 31|8@0- (1,0) [0|0] "" Vector__XXX
 SG_ FL_08_02_PCM_ReqCycle m8 : 23|8@0+ (1,0) [0|0] "" Vector__XXX
 SG_ FL_08_01_PCM_Source m8 : 15|8@0- (1,0) [0|0] "" Vector__XXX
 SG_ FL_07_0506_HES_B_SupplyVoltage m7 : 47|16@0+ (0.0048828125,0) [0|0] "V" Vector__XXX
 SG_ FL_07_0304_HES_A_SupplyVoltage m7 : 31|16@0+ (0.0048828125,0) [0|0] "V" Vector__XXX
 SG_ FL_07_0102_InternalTemperature m7 : 15|16@0+ (0.2325,-53) [0|0] "°C" Vector__XXX
 SG_ FL_06_0607_Belt_payout m6 : 55|16@0- (1,0) [0|0] "°" Vector__XXX
 SG_ FL_06_05_HES_Status m6 : 47|8@0+ (1,0) [0|0] "" Vector__XXX
 SG_ FL_06_0104_Belt_Speed m6 : 15|32@0- (1,0) [0|0] "°/s" Vector__XXX
 SG_ FL_05_0607_Bobbin_position m5 : 55|16@0- (1,0) [0|0] "°" Vector__XXX
 SG_ FL_05_05_Vminus_rescaled m5 : 47|8@0+ (0.1,0) [0|0] "V" Vector__XXX
 SG_ FL_05_04_Vplus_rescaled m5 : 39|8@0+ (0.1,0) [0|0] "V" Vector__XXX
 SG_ FL_05_0203_Motor_current m5 : 23|16@0+ (1,0) [0|0] "mA" Vector__XXX
 SG_ FL_05_01_Applied_Power m5 : 15|8@0- (1,0) [0|0] "% PWM" Vector__XXX
 SG_ FL_04_0607_ADC_KL30b m4 : 55|16@0+ (0.0322258,0) [0|0] "V" Vector__XXX
 SG_ FL_04_0405_ADC_GND_1 m4 : 39|16@0+ (0.0322258,0) [0|0] "V" Vector__XXX
 SG_ FL_04_0203_ADC_GND_0 m4 : 23|16@0+ (0.0322258,0) [0|0] "V" Vector__XXX
 SG_ FL_03_0607_ADC_MUX_output m3 : 55|16@0+ (1,0) [0|0] "LSB" Vector__XXX
 SG_ FL_03_0405_ADC_Motor_Vminus m3 : 39|16@0+ (0.027077,0) [0|0] "V" Vector__XXX
 SG_ FL_03_0203_ADC_Motor_Vplus m3 : 23|16@0+ (0.027077,0) [0|0] "V" Vector__XXX
 SG_ FL_02_07_EcuM_State m2 : 63|8@0- (1,0) [0|0] "" Vector__XXX
 SG_ FL_02_0506_Motor_current m2 : 47|16@0+ (1,0) [0|0] "mA" Vector__XXX
 SG_ FL_02_0304_KL30b_local m2 : 31|16@0+ (1,0) [0|0] "mV" Vector__XXX
 SG_ FL_02_0102_KL30_local m2 : 15|16@0+ (1,0) [0|0] "mV" Vector__XXX
 SG_ FL_01_0607_ADC_IS_Releasing m1 : 51|12@0+ (1,0) [0|0] "LSB" Vector__XXX
 SG_ FL_01_0405_ADC_IS_Tensioning m1 : 35|12@0+ (1,0) [0|0] "LSB" Vector__XXX
 SG_ FL_01_03_PCM_Output m1 : 31|8@0+ (1,0) [0|0] "" Vector__XXX
 SG_ FL_01_02_CurrentBeltCycleStepNb m1 : 23|8@0+ (1,0) [0|0] "" Vector__XXX
 SG_ FL_01_01_CurrentBeltCycleNb m1 : 15|8@0+ (1,0) [0|0] "" Vector__XXX
 SG_ BlockID_FL M : 7|8@0+ (1,0) [0|0] "" Vector__XXX

BO_ 2564924816 MMA_FR_Measurement_Frame: 8 Vector__XXX
 SG_ FR_03_01_PCM_PrecrashSeverity m3 : 15|8@0+ (1,0) [0|0] "" Vector__XXX
 SG_ FR_11_0607_Motor_current m11 : 55|16@0+ (1,0) [0|0] "mA" Vector__XXX
 SG_ FR_11_05_CurrentCycleStepNb m11 : 47|8@0+ (1,0) [0|0] "" Vector__XXX
 SG_ FR_11_0304_ADC_IS_Tensioning m11 : 27|12@0+ (1,0) [0|0] "LSB" Vector__XXX
 SG_ FR_11_0102_ADC_IS_Releasing m11 : 11|12@0+ (1,0) [0|0] "LSB" Vector__XXX
 SG_ FR_10_0607_ADC_MotorMonitoring m10 : 55|16@0+ (0.0322258,0) [0|0] "V" Vector__XXX
 SG_ FR_10_0405_ADC_Hall_B_Supply m10 : 39|16@0+ (0.0048828125,0) [0|0] "V" Vector__XXX
 SG_ FR_10_0203_ADC_Hall_A_Supply m10 : 23|16@0+ (0.0048828125,0) [0|0] "V" Vector__XXX
 SG_ FR_09_0607_ADC_KL30_Voltage m9 : 55|16@0+ (0.0322258,0) [0|0] "V" Vector__XXX
 SG_ FR_09_0405_ADC_TensioningCurrent m9 : 39|16@0+ (1,0) [0|0] "LSB" Vector__XXX
 SG_ FR_09_0203_ADC_ReleaseCurrent m9 : 23|16@0+ (1,0) [0|0] "LSB" Vector__XXX
 SG_ FR_08_06_Applied_Motor_Power m8 : 55|8@0- (1,0) [-100|100] "% PWM" Vector__XXX
 SG_ FR_08_05_CurrentCycleStepNb m8 : 47|8@0+ (1,0) [0|0] "" Vector__XXX
 SG_ FR_08_04_CurrentCycleNb m8 : 39|8@0- (1,0) [0|0] "" Vector__XXX
 SG_ FR_08_03_FLS_Output m8 : 31|8@0- (1,0) [0|0] "" Vector__XXX
 SG_ FR_08_02_PCM_ReqCycle m8 : 23|8@0+ (1,0) [0|0] "" Vector__XXX
 SG_ FR_08_01_PCM_Source m8 : 15|8@0- (1,0) [0|0] "" Vector__XXX
 SG_ FR_07_0506_HES_B_SupplyVoltage m7 : 47|16@0+ (0.0048828125,0) [0|0] "V" Vector__XXX
 SG_ FR_07_0304_HES_A_SupplyVoltage m7 : 31|16@0+ (0.0048828125,0) [0|0] "V" Vector__XXX
 SG_ FR_07_0102_InternalTemperature m7 : 15|16@0+ (0.2325,-53) [0|0] "°C" Vector__XXX
 SG_ FR_06_0607_Belt_payout m6 : 55|16@0- (1,0) [0|0] "°" Vector__XXX
 SG_ FR_06_05_HES_Status m6 : 47|8@0+ (1,0) [0|0] "" Vector__XXX
 SG_ FR_06_0104_Belt_Speed m6 : 15|32@0- (1,0) [0|0] "°/s" Vector__XXX
 SG_ FR_05_0607_Bobbin_position m5 : 55|16@0- (1,0) [0|0] "°" Vector__XXX
 SG_ FR_05_05_Vminus_rescaled m5 : 47|8@0+ (0.1,0) [0|0] "V" Vector__XXX
 SG_ FR_05_04_Vplus_rescaled m5 : 39|8@0+ (0.1,0) [0|0] "V" Vector__XXX
 SG_ FR_05_0203_Motor_current m5 : 23|16@0+ (1,0) [0|0] "mA" Vector__XXX
 SG_ FR_05_01_Applied_Power m5 : 15|8@0- (1,0) [0|0] "% PWM" Vector__XXX
 SG_ FR_04_0607_ADC_KL30b m4 : 55|16@0+ (0.0322258,0) [0|0] "V" Vector__XXX
 SG_ FR_04_0405_ADC_GND_1 m4 : 39|16@0+ (0.0322258,0) [0|0] "V" Vector__XXX
 SG_ FR_04_0203_ADC_GND_0 m4 : 23|16@0+ (0.0322258,0) [0|0] "V" Vector__XXX
 SG_ FR_03_0607_ADC_MUX_output m3 : 55|16@0+ (1,0) [0|0] "LSB" Vector__XXX
 SG_ FR_03_0405_ADC_Motor_Vminus m3 : 39|16@0+ (0.027077,0) [0|0] "V" Vector__XXX
 SG_ FR_03_0203_ADC_Motor_Vplus m3 : 23|16@0+ (0.027077,0) [0|0] "V" Vector__XXX
 SG_ FR_02_07_EcuM_State m2 : 63|8@0- (1,0) [0|0] "" Vector__XXX
 SG_ FR_02_0506_Motor_current m2 : 47|16@0+ (1,0) [0|0] "mA" Vector__XXX
 SG_ FR_02_0304_KL30b_local m2 : 31|16@0+ (1,0) [0|0] "mV" Vector__XXX
 SG_ FR_02_0102_KL30_local m2 : 15|16@0+ (1,0) [0|0] "mV" Vector__XXX
 SG_ FR_01_0607_ADC_IS_Releasing m1 : 51|12@0+ (1,0) [0|0] "LSB" Vector__XXX
 SG_ FR_01_0405_ADC_IS_Tensioning m1 : 35|12@0+ (1,0) [0|0] "LSB" Vector__XXX
 SG_ FR_01_03_PCM_Output m1 : 31|8@0+ (1,0) [0|0] "" Vector__XXX
 SG_ FR_01_02_CurrentBeltCycleStepNb m1 : 23|8@0+ (1,0) [0|0] "" Vector__XXX
 SG_ FR_01_01_CurrentBeltCycleNb m1 : 15|8@0+ (1,0) [0|0] "" Vector__XXX
 SG_ BlockID_FR M : 7|8@0+ (1,0) [0|0] "" Vector__XXX

CM_ "Do only use for ReMA BMW as additional database to evaluate the Measurement Frame content with CANoe or CANape";
CM_ SG_ 2564924560 FL_11_0607_Motor_current "Motor current in mA, not signed.";
CM_ SG_ 2564924560 FL_11_0304_ADC_IS_Tensioning "Value does reflect the current A/D register value (12bit conversion - 10bit resolution) for the Current Sense used in tensioning direction.";
CM_ SG_ 2564924560 FL_11_0102_ADC_IS_Releasing "Value does reflect the current A/D register value (12bit conversion - 10bit resolution) for the Current Sense used in releasing direction.";
CM_ SG_ 2564924560 FL_10_0607_ADC_MotorMonitoring "As seen at AD converter input (from 0 to 1023)
Supply Voltage HS1 (high side switch on KL30 to polarize the motor in static mode)";
CM_ SG_ 2564924560 FL_10_0405_ADC_Hall_B_Supply "As seen at AD converter input (from 0 to 1023)";
CM_ SG_ 2564924560 FL_10_0203_ADC_Hall_A_Supply "As seen at AD converter input (from 0 to 1023)";
CM_ SG_ 2564924560 FL_09_0607_ADC_KL30_Voltage "As seen at AD converter input (from 0 to 1023)";
CM_ SG_ 2564924560 FL_09_0405_ADC_TensioningCurrent "As seen at AD converter input (from 0 to 1023)";
CM_ SG_ 2564924560 FL_09_0203_ADC_ReleaseCurrent "As seen at AD converter input (from 0 to 1023)";
CM_ SG_ 2564924560 FL_08_04_CurrentCycleNb "Currently executed cycle number";
CM_ SG_ 2564924560 FL_08_03_FLS_Output "BFS Output (belt function decision, i.e. real profile to launch) - not used yet";
CM_ SG_ 2564924560 FL_08_02_PCM_ReqCycle "PreCrashSeverity";
CM_ SG_ 2564924560 FL_08_01_PCM_Source "VDA Output - to be defined (not used yet)";
CM_ SG_ 2564924560 FL_07_0506_HES_B_SupplyVoltage "Drop from 5V does reflect the Hall Sensor B consumption accross a 147 Ohm resistor.";
CM_ SG_ 2564924560 FL_07_0304_HES_A_SupplyVoltage "Drop from 5V does reflect the Hall Sensor A consumption accross a 147 Ohm resistor.";
CM_ SG_ 2564924560 FL_07_0102_InternalTemperature "Evaluated internal temperature based on SBC MUX output";
CM_ SG_ 2564924560 FL_06_0607_Belt_payout "Resolution shall be checked (mm)
Value starts at 0mm at SW init.";
CM_ SG_ 2564924560 FL_06_05_HES_Status "Value table to be documented";
CM_ SG_ 2564924560 FL_06_0104_Belt_Speed "Resolution is not properly defined (mm/s)";
CM_ SG_ 2564924560 FL_05_0607_Bobbin_position "Value since last reset (always considered as 0° at SW init)";
CM_ SG_ 2564924560 FL_05_05_Vminus_rescaled "AD value rescaled on 8 bits";
CM_ SG_ 2564924560 FL_05_04_Vplus_rescaled "AD value rescaled on 8 bits";
CM_ SG_ 2564924560 FL_05_01_Applied_Power "Positive value => tensioning direction
Negative value => releasing direction";
CM_ SG_ 2564924560 FL_04_0607_ADC_KL30b "Raw value of KL30b as measured at the AD converter (from 0 to 1023)";
CM_ SG_ 2564924560 FL_04_0405_ADC_GND_1 "GND voltage as measured on MCU AD1.";
CM_ SG_ 2564924560 FL_04_0203_ADC_GND_0 "GND voltage as measured on MCU AD0.";
CM_ SG_ 2564924560 FL_03_0607_ADC_MUX_output "SBC MUX output as seen by MCU AD converter, from 0 to 1023 (10 bit resolution)
Default usage is image of SBC temperature sensor.";
CM_ SG_ 2564924560 FL_03_0405_ADC_Motor_Vminus "Raw value from AD converter from 0 to 1023 (10 bit resolution), scaled on 0-33V";
CM_ SG_ 2564924560 FL_03_0203_ADC_Motor_Vplus "Raw value from AD converter from 0 to 1023 (10 bit resolution), scaled on 0-33V";
CM_ SG_ 2564924560 FL_02_07_EcuM_State "To be defined.
Not used yet.";
CM_ SG_ 2564924560 FL_02_0506_Motor_current "Motor current in mA, not signed.";
CM_ SG_ 2564924560 FL_02_0304_KL30b_local "KL30b voltage as measured by the ECU

Resolution still to be defined";
CM_ SG_ 2564924560 FL_02_0102_KL30_local "KL30 voltage as measured by the ECU

Resolution to be confirmed";
CM_ SG_ 2564924560 FL_01_0607_ADC_IS_Releasing "Value does reflect the current A/D register value (12bit conversion - 10bit resolution) for the Current Sense used in releasing direction.";
CM_ SG_ 2564924560 FL_01_0405_ADC_IS_Tensioning "Value does reflect the current A/D register value (12bit conversion - 10bit resolution) for the Current Sense used in tensioning direction.";
CM_ SG_ 2564924816 FR_11_0607_Motor_current "Motor current in mA, not signed.";
CM_ SG_ 2564924816 FR_11_0304_ADC_IS_Tensioning "Value does reflect the current A/D register value (12bit conversion - 10bit resolution) for the Current Sense used in tensioning direction.";
CM_ SG_ 2564924816 FR_11_0102_ADC_IS_Releasing "Value does reflect the current A/D register value (12bit conversion - 10bit resolution) for the Current Sense used in releasing direction.";
CM_ SG_ 2564924816 FR_10_0607_ADC_MotorMonitoring "As seen at AD converter input (from 0 to 1023)
Supply Voltage HS1 (high side switch on KL30 to polarize the motor in static mode)";
CM_ SG_ 2564924816 FR_10_0405_ADC_Hall_B_Supply "As seen at AD converter input (from 0 to 1023)";
CM_ SG_ 2564924816 FR_10_0203_ADC_Hall_A_Supply "As seen at AD converter input (from 0 to 1023)";
CM_ SG_ 2564924816 FR_09_0607_ADC_KL30_Voltage "As seen at AD converter input (from 0 to 1023)";
CM_ SG_ 2564924816 FR_09_0405_ADC_TensioningCurrent "As seen at AD converter input (from 0 to 1023)";
CM_ SG_ 2564924816 FR_09_0203_ADC_ReleaseCurrent "As seen at AD converter input (from 0 to 1023)";
CM_ SG_ 2564924816 FR_08_04_CurrentCycleNb "Currently executed cycle number";
CM_ SG_ 2564924816 FR_08_03_FLS_Output "BFS Output (belt function decision, i.e. real profile to launch) - not used yet";
CM_ SG_ 2564924816 FR_08_02_PCM_ReqCycle "PreCrashSeverity";
CM_ SG_ 2564924816 FR_08_01_PCM_Source "VDA Output - to be defined (not used yet)";
CM_ SG_ 2564924816 FR_07_0506_HES_B_SupplyVoltage "Drop from 5V does reflect the Hall Sensor B consumption accross a 147 Ohm resistor.";
CM_ SG_ 2564924816 FR_07_0304_HES_A_SupplyVoltage "Drop from 5V does reflect the Hall Sensor A consumption accross a 147 Ohm resistor.";
CM_ SG_ 2564924816 FR_07_0102_InternalTemperature "Evaluated internal temperature based on SBC MUX output";
CM_ SG_ 2564924816 FR_06_0607_Belt_payout "Resolution shall be checked (mm)
Value starts at 0mm at SW init.";
CM_ SG_ 2564924816 FR_06_05_HES_Status "Value table to be documented";
CM_ SG_ 2564924816 FR_06_0104_Belt_Speed "Resolution is not properly defined (mm/s)";
CM_ SG_ 2564924816 FR_05_0607_Bobbin_position "Value since last reset (always considered as 0° at SW init)";
CM_ SG_ 2564924816 FR_05_05_Vminus_rescaled "AD value rescaled on 8 bits";
CM_ SG_ 2564924816 FR_05_04_Vplus_rescaled "AD value rescaled on 8 bits";
CM_ SG_ 2564924816 FR_05_01_Applied_Power "Positive value => tensioning direction
Negative value => releasing direction";
CM_ SG_ 2564924816 FR_04_0607_ADC_KL30b "Raw value of KL30b as measured at the AD converter (from 0 to 1023)";
CM_ SG_ 2564924816 FR_04_0405_ADC_GND_1 "GND voltage as measured on MCU AD1.";
CM_ SG_ 2564924816 FR_04_0203_ADC_GND_0 "GND voltage as measured on MCU AD0.";
CM_ SG_ 2564924816 FR_03_0607_ADC_MUX_output "SBC MUX output as seen by MCU AD converter, from 0 to 1023 (10 bit resolution)
Default usage is image of SBC temperature sensor.";
CM_ SG_ 2564924816 FR_03_0405_ADC_Motor_Vminus "Raw value from AD converter from 0 to 1023 (10 bit resolution), scaled on 0-33V";
CM_ SG_ 2564924816 FR_03_0203_ADC_Motor_Vplus "Raw value from AD converter from 0 to 1023 (10 bit resolution), scaled on 0-33V";
CM_ SG_ 2564924816 FR_02_07_EcuM_State "To be defined.
Not used yet.";
CM_ SG_ 2564924816 FR_02_0506_Motor_current "Motor current in mA, not signed.";
CM_ SG_ 2564924816 FR_02_0304_KL30b_local "KL30b voltage as measured by the ECU

Resolution still to be defined";
CM_ SG_ 2564924816 FR_02_0102_KL30_local "KL30 voltage as measured by the ECU

Resolution to be confirmed";
CM_ SG_ 2564924816 FR_01_0607_ADC_IS_Releasing "Value does reflect the current A/D register value (12bit conversion - 10bit resolution) for the Current Sense used in releasing direction.";
CM_ SG_ 2564924816 FR_01_0405_ADC_IS_Tensioning "Value does reflect the current A/D register value (12bit conversion - 10bit resolution) for the Current Sense used in tensioning direction.";
BA_DEF_  "BusType" STRING ;
BA_DEF_DEF_  "BusType" "CAN";
