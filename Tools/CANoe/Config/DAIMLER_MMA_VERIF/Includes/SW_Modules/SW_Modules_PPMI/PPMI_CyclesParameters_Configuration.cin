/*@!Encoding:1252*/
includes
{
  
}

variables
{
  // DEFAULT CYCLE CONFIGURATION VALUES.
  byte bDefaultCycleValues[420] = { // Updated for R6.0
        0x46, 0x19, 0x00, 0x1D, 0x00, 0x01, 0x02, 0xFF, 0xFF, 0xFF, 0xFF, 0xFF, //Pre-Safe level 1 (Strong tensioning)
				0x46, 0x19, 0x00, 0x1D, 0x03, 0x01, 0x02, 0xFF, 0xFF, 0xFF, 0xFF, 0xFF, //Pre-Safe level 3 (Strong tensioning)
				0x46, 0x19, 0x00, 0x1D, 0x04, 0x05, 0x01, 0x02, 0xFF, 0xFF, 0xFF, 0xFF, //Pre-Safe level 4 (Strong tensioning)
				0x46, 0x19, 0x00, 0x1D, 0x06, 0x07, 0x01, 0x02, 0xFF, 0xFF, 0xFF, 0xFF, //Pre-Safe level 5 (Strong tensioning)
				0x46, 0x19, 0x00, 0x1D, 0x06, 0x07, 0x01, 0x02, 0xFF, 0xFF, 0xFF, 0xFF, //Pre-Safe level 6 (Strong tensioning)
				0x46, 0x19, 0x00, 0x1D, 0x06, 0x07, 0x01, 0x02, 0xFF, 0xFF, 0xFF, 0xFF, //Pre-Safe level 7 (Strong tensioning)
				0x46, 0x19, 0x00, 0xFF, 0x06, 0x07, 0x08, 0x02, 0xFF, 0xFF, 0xFF, 0xFF, //Pre-Safe level 8 (Strong tensioning)
				0x46, 0x19, 0x00, 0x1D, 0x06, 0x07, 0x01, 0x02, 0xFF, 0xFF, 0xFF, 0xFF, //Pre-Safe level 9 (Strong tensioning)
				0x46, 0x19, 0x00, 0x1D, 0x06, 0x07, 0x01, 0x02, 0xFF, 0xFF, 0xFF, 0xFF, //Pre-Safe level 10 (Strong tensioning)
				0x46, 0x19, 0x00, 0x1D, 0x06, 0x07, 0x01, 0x02, 0xFF, 0xFF, 0xFF, 0xFF, //Pre-Safe level 11 (Strong tensioning)
				0x46, 0x19, 0x00, 0x1D, 0x06, 0x07, 0x01, 0x02, 0xFF, 0xFF, 0xFF, 0xFF, //Pre-Safe level 12 (Strong tensioning)
				0x46, 0x19, 0x00, 0x1D, 0x06, 0x07, 0x01, 0x02, 0xFF, 0xFF, 0xFF, 0xFF, //Pre-Safe level 13 (Strong tensioning)
				0x46, 0x19, 0x00, 0x1D, 0x06, 0x07, 0x01, 0x02, 0xFF, 0xFF, 0xFF, 0xFF, //Pre-Safe level 14 (Strong tensioning)
				0x46, 0x19, 0x00, 0x1D, 0x06, 0x07, 0x01, 0x02, 0xFF, 0xFF, 0xFF, 0xFF, //Pre-Safe level 15 (Strong tensioning)
				0x46, 0x19, 0x00, 0x1D, 0x06, 0x07, 0x01, 0x02, 0xFF, 0xFF, 0xFF, 0xFF, //Curve 1 (Smooth tensioning)
				0x46, 0x19, 0x00, 0x1D, 0x06, 0x07, 0x01, 0x02, 0xFF, 0xFF, 0xFF, 0xFF, //Curve 2 (Smooth tensioning)
				0x46, 0x19, 0x00, 0x1D, 0x06, 0x07, 0x01, 0x02, 0xFF, 0xFF, 0xFF, 0xFF, //Curve 3 (Smooth tensioning)
				0x46, 0x19, 0x00, 0x1D, 0x06, 0x07, 0x01, 0x02, 0xFF, 0xFF, 0xFF, 0xFF, //Curve 4 (Smooth tensioning)
				0x29, 0x20, 0x00, 0x1D, 0x0A, 0x0B, 0xFF, 0xFF, 0xFF, 0xFF, 0xFF, 0xFF, //Haptic 1-1 (Warning 1)
				0x46, 0x19, 0x00, 0x1D, 0x0C, 0x0D, 0xFF, 0xFF, 0xFF, 0xFF, 0xFF, 0xFF, //Haptic 1-2 (Warning 1)
				0x29, 0x20, 0x00, 0x1D, 0x0A, 0x0B, 0xFF, 0xFF, 0xFF, 0xFF, 0xFF, 0xFF, //Haptic 2-1 (Warning 2)
				0x46, 0x19, 0x00, 0x1D, 0x0C, 0x0D, 0xFF, 0xFF, 0xFF, 0xFF, 0xFF, 0xFF, //Haptic 2-2 (Warning 2)
				0x29, 0x20, 0x00, 0x1D, 0x0A, 0x0B, 0xFF, 0xFF, 0xFF, 0xFF, 0xFF, 0xFF, //Haptic 3-1 (Warning 3)
				0x46, 0x19, 0x00, 0x1D, 0x0C, 0x0D, 0xFF, 0xFF, 0xFF, 0xFF, 0xFF, 0xFF, //Haptic 3-2 (Warning 3)
				0x29, 0x20, 0x00, 0x1D, 0x0A, 0x0B, 0xFF, 0xFF, 0xFF, 0xFF, 0xFF, 0xFF, //Haptic 4-1 (Warning 4)
				0x46, 0x19, 0x00, 0x1D, 0x0C, 0x0D, 0xFF, 0xFF, 0xFF, 0xFF, 0xFF, 0xFF, //Haptic 4-2 (Warning 4)
				0x28, 0x21, 0x00, 0x1D, 0x5C, 0x5D, 0x5E, 0x5F, 0x60, 0x61, 0x62, 0xFF, //BSR 1 (Comfort)
				0x28, 0x21, 0x00, 0x1D, 0x5C, 0x5D, 0x5E, 0x5F, 0x60, 0x61, 0x62, 0xFF, //BSR 2 (Comfort)
				0x28, 0x21, 0x00, 0x1D, 0x5C, 0x5D, 0x5E, 0x5F, 0x60, 0x61, 0x62, 0xFF, //BSR 3 (Comfort)
				0x29, 0x20, 0x00, 0xFF, 0x74, 0x75, 0x76, 0xFF, 0xFF, 0xFF, 0xFF, 0xFF, //Smooth Release
				0x29, 0x20, 0x00, 0xFF, 0x74, 0x75, 0x76, 0xFF, 0xFF, 0xFF, 0xFF, 0xFF, //Hard Release
				0x29, 0x20, 0x00, 0xFF, 0x74, 0x75, 0x76, 0xFF, 0xFF, 0xFF, 0xFF, 0xFF, //Backup Release
				0x29, 0x20, 0x00, 0xFF, 0x74, 0x75, 0x76, 0xFF, 0xFF, 0xFF, 0xFF, 0xFF, //Start-up Release
				0x47, 0x15, 0x80, 0xFF, 0x80, 0x81, 0x82, 0x83, 0x84, 0x85, 0x86, 0x87, //ANG
				0x34, 0x15, 0x00, 0xFF, 0x88, 0x89, 0x8A, 0x8B, 0x8C, 0x8D, 0x8E, 0xFF}; //AEE 
  
  // DEFAULT STEPS LIBRARY.
  byte bDefaultStepsLibrary[1160] = { // Updated for R5.0
       0x00, 0xC8, 0x38, 0x84, 0xF0, 0x00, 0xFF, 0xFF, //Library 1(Tensioning + Haptic)
       0x0D, 0xAC, 0x1A, 0x09, 0x00, 0x00, 0xFF, 0xFF, //Library 1(Tensioning + Haptic)
       0x00, 0x0A, 0x00, 0x84, 0x00, 0x00, 0xFF, 0xFF, //Library 1(Tensioning + Haptic)
       0x00, 0x28, 0x38, 0x84, 0xF4, 0x00, 0xFF, 0xFF, //Library 1(Tensioning + Haptic)
       0x00, 0x0A, 0x2C, 0x84, 0xF0, 0x00, 0xFF, 0xFF, //Library 1(Tensioning + Haptic)
       0x00, 0x28, 0x20, 0x01, 0x00, 0x00, 0xFF, 0xFF, //Library 1(Tensioning + Haptic)
       0x00, 0x02, 0x38, 0x84, 0xF4, 0x00, 0xFF, 0xFF, //Library 1(Tensioning + Haptic)
       0x00, 0x28, 0x30, 0x01, 0x00, 0x00, 0xFF, 0xFF, //Library 1(Tensioning + Haptic)
       0x01, 0xC0, 0x1A, 0x09, 0x00, 0x00, 0xFF, 0xFF, //Library 1(Tensioning + Haptic)
       0xFF, 0xFF, 0xFF, 0xFF, 0xFF, 0xFF, 0xFF, 0xFF, //Library 1(Tensioning + Haptic)
       0x00, 0x14, 0x0E, 0x84, 0x00, 0x00, 0xFF, 0xFF, //Library 1(Tensioning + Haptic)
       0x01, 0xF4, 0x0E, 0x14, 0x60, 0x20, 0xFF, 0xFF, //Library 1(Tensioning + Haptic)
       0x00, 0x02, 0x14, 0x04, 0x00, 0x00, 0xFF, 0xFF, //Library 1(Tensioning + Haptic)
       0x00, 0x04, 0x04, 0x04, 0x00, 0x00, 0xFF, 0xFF, //Library 1(Tensioning + Haptic)
       0xFF, 0xFF, 0xFF, 0xFF, 0xFF, 0xFF, 0xFF, 0xFF, //Library 1(Tensioning + Haptic)
       0xFF, 0xFF, 0xFF, 0xFF, 0xFF, 0xFF, 0xFF, 0xFF, //Library 1(Tensioning + Haptic)
       0xFF, 0xFF, 0xFF, 0xFF, 0xFF, 0xFF, 0xFF, 0xFF, //Library 1(Tensioning + Haptic)
       0xFF, 0xFF, 0xFF, 0xFF, 0xFF, 0xFF, 0xFF, 0xFF, //Library 1(Tensioning + Haptic)
       0xFF, 0xFF, 0xFF, 0xFF, 0xFF, 0xFF, 0xFF, 0xFF, //Library 1(Tensioning + Haptic)
       0xFF, 0xFF, 0xFF, 0xFF, 0xFF, 0xFF, 0xFF, 0xFF, //Library 1(Tensioning + Haptic)
       0xFF, 0xFF, 0xFF, 0xFF, 0xFF, 0xFF, 0xFF, 0xFF, //Library 1(Tensioning + Haptic)
       0xFF, 0xFF, 0xFF, 0xFF, 0xFF, 0xFF, 0xFF, 0xFF, //Library 1(Tensioning + Haptic)
       0xFF, 0xFF, 0xFF, 0xFF, 0xFF, 0xFF, 0xFF, 0xFF, //Library 1(Tensioning + Haptic)
       0xFF, 0xFF, 0xFF, 0xFF, 0xFF, 0xFF, 0xFF, 0xFF, //Library 1(Tensioning + Haptic)
       0xFF, 0xFF, 0xFF, 0xFF, 0xFF, 0xFF, 0xFF, 0xFF, //Library 1(Tensioning + Haptic)
       0xFF, 0xFF, 0xFF, 0xFF, 0xFF, 0xFF, 0xFF, 0xFF, //Library 1(Tensioning + Haptic)
       0xFF, 0xFF, 0xFF, 0xFF, 0xFF, 0xFF, 0xFF, 0xFF, //Library 1(Tensioning + Haptic)
       0xFF, 0xFF, 0xFF, 0xFF, 0xFF, 0xFF, 0xFF, 0xFF, //Library 1(Tensioning + Haptic)
       0xFF, 0xFF, 0xFF, 0xFF, 0xFF, 0xFF, 0xFF, 0xFF, //Library 1(Tensioning + Haptic)
       0xFF, 0xFF, 0xFF, 0xFF, 0xFF, 0xFF, 0xFF, 0xFF, //Library 1(Tensioning + Haptic)
       0xFF, 0xFF, 0xFF, 0xFF, 0xFF, 0xFF, 0xFF, 0xFF, //Library 1(Tensioning + Haptic)
       0xFF, 0xFF, 0xFF, 0xFF, 0xFF, 0xFF, 0xFF, 0xFF, //Library 1(Tensioning + Haptic)
       0xFF, 0xFF, 0xFF, 0xFF, 0xFF, 0xFF, 0xFF, 0xFF, //Library 1(Tensioning + Haptic)
       0xFF, 0xFF, 0xFF, 0xFF, 0xFF, 0xFF, 0xFF, 0xFF, //Library 1(Tensioning + Haptic)
       0xFF, 0xFF, 0xFF, 0xFF, 0xFF, 0xFF, 0xFF, 0xFF, //Library 1(Tensioning + Haptic)
       0xFF, 0xFF, 0xFF, 0xFF, 0xFF, 0xFF, 0xFF, 0xFF, //Library 1(Tensioning + Haptic)
       0xFF, 0xFF, 0xFF, 0xFF, 0xFF, 0xFF, 0xFF, 0xFF, //Library 1(Tensioning + Haptic)
       0xFF, 0xFF, 0xFF, 0xFF, 0xFF, 0xFF, 0xFF, 0xFF, //Library 1(Tensioning + Haptic)
       0xFF, 0xFF, 0xFF, 0xFF, 0xFF, 0xFF, 0xFF, 0xFF, //Library 1(Tensioning + Haptic)
       0xFF, 0xFF, 0xFF, 0xFF, 0xFF, 0xFF, 0xFF, 0xFF, //Library 1(Tensioning + Haptic)
       0xFF, 0xFF, 0xFF, 0xFF, 0xFF, 0xFF, 0xFF, 0xFF, //Library 1(Tensioning + Haptic)
       0xFF, 0xFF, 0xFF, 0xFF, 0xFF, 0xFF, 0xFF, 0xFF, //Library 1(Tensioning + Haptic)
       0xFF, 0xFF, 0xFF, 0xFF, 0xFF, 0xFF, 0xFF, 0xFF, //Library 1(Tensioning + Haptic)
       0xFF, 0xFF, 0xFF, 0xFF, 0xFF, 0xFF, 0xFF, 0xFF, //Library 1(Tensioning + Haptic)
       0xFF, 0xFF, 0xFF, 0xFF, 0xFF, 0xFF, 0xFF, 0xFF, //Library 1(Tensioning + Haptic)
       0xFF, 0xFF, 0xFF, 0xFF, 0xFF, 0xFF, 0xFF, 0xFF, //Library 1(Tensioning + Haptic)
       0xFF, 0xFF, 0xFF, 0xFF, 0xFF, 0xFF, 0xFF, 0xFF, //Library 1(Tensioning + Haptic)
       0xFF, 0xFF, 0xFF, 0xFF, 0xFF, 0xFF, 0xFF, 0xFF, //Library 1(Tensioning + Haptic)
       0xFF, 0xFF, 0xFF, 0xFF, 0xFF, 0xFF, 0xFF, 0xFF, //Library 1(Tensioning + Haptic)
       0xFF, 0xFF, 0xFF, 0xFF, 0xFF, 0xFF, 0xFF, 0xFF, //Library 1(Tensioning + Haptic)
       0xFF, 0xFF, 0xFF, 0xFF, 0xFF, 0xFF, 0xFF, 0xFF, //Library 1(Tensioning + Haptic)
       0xFF, 0xFF, 0xFF, 0xFF, 0xFF, 0xFF, 0xFF, 0xFF, //Library 1(Tensioning + Haptic)
       0xFF, 0xFF, 0xFF, 0xFF, 0xFF, 0xFF, 0xFF, 0xFF, //Library 1(Tensioning + Haptic)
       0xFF, 0xFF, 0xFF, 0xFF, 0xFF, 0xFF, 0xFF, 0xFF, //Library 1(Tensioning + Haptic)
       0xFF, 0xFF, 0xFF, 0xFF, 0xFF, 0xFF, 0xFF, 0xFF, //Library 1(Tensioning + Haptic)
       0xFF, 0xFF, 0xFF, 0xFF, 0xFF, 0xFF, 0xFF, 0xFF, //Library 1(Tensioning + Haptic)
       0xFF, 0xFF, 0xFF, 0xFF, 0xFF, 0xFF, 0xFF, 0xFF, //Library 1(Tensioning + Haptic)
       0xFF, 0xFF, 0xFF, 0xFF, 0xFF, 0xFF, 0xFF, 0xFF, //Library 1(Tensioning + Haptic)
       0xFF, 0xFF, 0xFF, 0xFF, 0xFF, 0xFF, 0xFF, 0xFF, //Library 1(Tensioning + Haptic)
       0xFF, 0xFF, 0xFF, 0xFF, 0xFF, 0xFF, 0xFF, 0xFF, //Library 1(Tensioning + Haptic)
       0xFF, 0xFF, 0xFF, 0xFF, 0xFF, 0xFF, 0xFF, 0xFF, //Library 1(Tensioning + Haptic)
       0xFF, 0xFF, 0xFF, 0xFF, 0xFF, 0xFF, 0xFF, 0xFF, //Library 1(Tensioning + Haptic)
       0xFF, 0xFF, 0xFF, 0xFF, 0xFF, 0xFF, 0xFF, 0xFF, //Library 1(Tensioning + Haptic)
       0xFF, 0xFF, 0xFF, 0xFF, 0xFF, 0xFF, 0xFF, 0xFF, //Library 1(Tensioning + Haptic)
       0xFF, 0xFF, 0xFF, 0xFF, 0xFF, 0xFF, 0xFF, 0xFF, //Library 1(Tensioning + Haptic)
       0xFF, 0xFF, 0xFF, 0xFF, 0xFF, 0xFF, 0xFF, 0xFF, //Library 1(Tensioning + Haptic)
       0xFF, 0xFF, 0xFF, 0xFF, 0xFF, 0xFF, 0xFF, 0xFF, //Library 1(Tensioning + Haptic)
       0xFF, 0xFF, 0xFF, 0xFF, 0xFF, 0xFF, 0xFF, 0xFF, //Library 1(Tensioning + Haptic)
       0xFF, 0xFF, 0xFF, 0xFF, 0xFF, 0xFF, 0xFF, 0xFF, //Library 1(Tensioning + Haptic)
       0xFF, 0xFF, 0xFF, 0xFF, 0xFF, 0xFF, 0xFF, 0xFF, //Library 1(Tensioning + Haptic)
       0xFF, 0xFF, 0xFF, 0xFF, 0xFF, 0xFF, 0xFF, 0xFF, //Library 1(Tensioning + Haptic)
       0xFF, 0xFF, 0xFF, 0xFF, 0xFF, 0xFF, 0xFF, 0xFF, //Library 1(Tensioning + Haptic)
       0xFF, 0xFF, 0xFF, 0xFF, 0xFF, 0xFF, 0xFF, 0xFF, //Library 1(Tensioning + Haptic)
       0xFF, 0xFF, 0xFF, 0xFF, 0xFF, 0xFF, 0xFF, 0xFF, //Library 1(Tensioning + Haptic)
       0xFF, 0xFF, 0xFF, 0xFF, 0xFF, 0xFF, 0xFF, 0xFF, //Library 1(Tensioning + Haptic)
       0xFF, 0xFF, 0xFF, 0xFF, 0xFF, 0xFF, 0xFF, 0xFF, //Library 1(Tensioning + Haptic)
       0xFF, 0xFF, 0xFF, 0xFF, 0xFF, 0xFF, 0xFF, 0xFF, //Library 1(Tensioning + Haptic)
       0xFF, 0xFF, 0xFF, 0xFF, 0xFF, 0xFF, 0xFF, 0xFF, //Library 1(Tensioning + Haptic)
       0xFF, 0xFF, 0xFF, 0xFF, 0xFF, 0xFF, 0xFF, 0xFF, //Library 1(Tensioning + Haptic)
       0xFF, 0xFF, 0xFF, 0xFF, 0xFF, 0xFF, 0xFF, 0xFF, //Library 1(Tensioning + Haptic)
       0xFF, 0xFF, 0xFF, 0xFF, 0xFF, 0xFF, 0xFF, 0xFF, //Library 1(Tensioning + Haptic)
       0xFF, 0xFF, 0xFF, 0xFF, 0xFF, 0xFF, 0xFF, 0xFF, //Library 1(Tensioning + Haptic)
       0xFF, 0xFF, 0xFF, 0xFF, 0xFF, 0xFF, 0xFF, 0xFF, //Library 1(Tensioning + Haptic)
       0xFF, 0xFF, 0xFF, 0xFF, 0xFF, 0xFF, 0xFF, 0xFF, //Library 1(Tensioning + Haptic)
       0xFF, 0xFF, 0xFF, 0xFF, 0xFF, 0xFF, 0xFF, 0xFF, //Library 1(Tensioning + Haptic)
       0xFF, 0xFF, 0xFF, 0xFF, 0xFF, 0xFF, 0xFF, 0xFF, //Library 1(Tensioning + Haptic)
       0xFF, 0xFF, 0xFF, 0xFF, 0xFF, 0xFF, 0xFF, 0xFF, //Library 1(Tensioning + Haptic)
       0xFF, 0xFF, 0xFF, 0xFF, 0xFF, 0xFF, 0xFF, 0xFF, //Library 1(Tensioning + Haptic)
       0xFF, 0xFF, 0xFF, 0xFF, 0xFF, 0xFF, 0xFF, 0xFF, //Library 1(Tensioning + Haptic)
       0xFF, 0xFF, 0xFF, 0xFF, 0xFF, 0xFF, 0xFF, 0xFF, //Library 1(Tensioning + Haptic)
       0xFF, 0xFF, 0xFF, 0xFF, 0xFF, 0xFF, 0xFF, 0xFF, //Library 1(Tensioning + Haptic)
       0xFF, 0xFF, 0xFF, 0xFF, 0xFF, 0xFF, 0xFF, 0xFF, //Library 1(Tensioning + Haptic)
       0x00, 0x02, 0x03, 0x04, 0x00, 0x00, 0xFF, 0xFF, //Library 2(BSR)
       0x00, 0x46, 0x0C, 0x84, 0x38, 0x10, 0xFF, 0xFF, //Library 2(BSR)
       0x00, 0x82, 0x0C, 0x84, 0x38, 0x10, 0xFF, 0xFF, //Library 2(BSR)
       0x01, 0xF4, 0x08, 0x81, 0x18, 0x10, 0xFF, 0xFF, //Library 2(BSR)
       0x03, 0xE8, 0x0C, 0x14, 0x38, 0x00, 0xFF, 0xFF, //Library 2(BSR)
       0x00, 0x64, 0x0E, 0x84, 0x64, 0x10, 0xFF, 0xFF, //Library 2(BSR)
       0x00, 0x0A, 0x00, 0x84, 0x00, 0x00, 0xFF, 0xFF, //Library 2(BSR)
       0xFF, 0xFF, 0xFF, 0xFF, 0xFF, 0xFF, 0xFF, 0xFF, //Library 2(BSR)
       0xFF, 0xFF, 0xFF, 0xFF, 0xFF, 0xFF, 0xFF, 0xFF, //Library 2(BSR)
       0xFF, 0xFF, 0xFF, 0xFF, 0xFF, 0xFF, 0xFF, 0xFF, //Library 2(BSR)
       0xFF, 0xFF, 0xFF, 0xFF, 0xFF, 0xFF, 0xFF, 0xFF, //Library 2(BSR)
       0xFF, 0xFF, 0xFF, 0xFF, 0xFF, 0xFF, 0xFF, 0xFF, //Library 2(BSR)
       0xFF, 0xFF, 0xFF, 0xFF, 0xFF, 0xFF, 0xFF, 0xFF, //Library 2(BSR)
       0xFF, 0xFF, 0xFF, 0xFF, 0xFF, 0xFF, 0xFF, 0xFF, //Library 2(BSR)
       0xFF, 0xFF, 0xFF, 0xFF, 0xFF, 0xFF, 0xFF, 0xFF, //Library 2(BSR)
       0xFF, 0xFF, 0xFF, 0xFF, 0xFF, 0xFF, 0xFF, 0xFF, //Library 2(BSR)
       0xFF, 0xFF, 0xFF, 0xFF, 0xFF, 0xFF, 0xFF, 0xFF, //Library 2(BSR)
       0xFF, 0xFF, 0xFF, 0xFF, 0xFF, 0xFF, 0xFF, 0xFF, //Library 2(BSR)
       0xFF, 0xFF, 0xFF, 0xFF, 0xFF, 0xFF, 0xFF, 0xFF, //Library 2(BSR)
       0xFF, 0xFF, 0xFF, 0xFF, 0xFF, 0xFF, 0xFF, 0xFF, //Library 2(BSR)
       0xFF, 0xFF, 0xFF, 0xFF, 0xFF, 0xFF, 0xFF, 0xFF, //Library 2(BSR)
       0xFF, 0xFF, 0xFF, 0xFF, 0xFF, 0xFF, 0xFF, 0xFF, //Library 2(BSR)
       0xFF, 0xFF, 0xFF, 0xFF, 0xFF, 0xFF, 0xFF, 0xFF, //Library 2(BSR)
       0xFF, 0xFF, 0xFF, 0xFF, 0xFF, 0xFF, 0xFF, 0xFF, //Library 2(BSR)
       0x00, 0x0A, 0xF5, 0x84, 0x00, 0x10, 0xFF, 0xFF, //Library 4(Release)
       0x00, 0x32, 0xF5, 0x04, 0x00, 0x10, 0xFF, 0xFF, //Library 4(Release)
       0x00, 0x0A, 0x00, 0x80, 0x00, 0x00, 0xFF, 0xFF, //Library 4(Release)
       0xFF, 0xFF, 0xFF, 0xFF, 0xFF, 0xFF, 0xFF, 0xFF, //Library 4(Release)
       0xFF, 0xFF, 0xFF, 0xFF, 0xFF, 0xFF, 0xFF, 0xFF, //Library 4(Release)
       0xFF, 0xFF, 0xFF, 0xFF, 0xFF, 0xFF, 0xFF, 0xFF, //Library 4(Release)
       0xFF, 0xFF, 0xFF, 0xFF, 0xFF, 0xFF, 0xFF, 0xFF, //Library 4(Release)
       0xFF, 0xFF, 0xFF, 0xFF, 0xFF, 0xFF, 0xFF, 0xFF, //Library 4(Release)
       0xFF, 0xFF, 0xFF, 0xFF, 0xFF, 0xFF, 0xFF, 0xFF, //Library 4(Release)
       0xFF, 0xFF, 0xFF, 0xFF, 0xFF, 0xFF, 0xFF, 0xFF, //Library 4(Release)
       0xFF, 0xFF, 0xFF, 0xFF, 0xFF, 0xFF, 0xFF, 0xFF, //Library 4(Release)
       0xFF, 0xFF, 0xFF, 0xFF, 0xFF, 0xFF, 0xFF, 0xFF, //Library 4(Release)
       0x00, 0x08, 0x16, 0x04, 0x00, 0x00, 0xFF, 0xFF, //Library 5(Production)
       0x01, 0x6A, 0x46, 0x01, 0x00, 0x00, 0xFF, 0xFF, //Library 5(Production)
       0x00, 0x28, 0x00, 0x81, 0x00, 0x00, 0xFF, 0xFF, //Library 5(Production)
       0x00, 0x14, 0x20, 0x04, 0x00, 0x00, 0xFF, 0xFF, //Library 5(Production)
       0x00, 0x78, 0x0C, 0x04, 0x00, 0x00, 0xFF, 0xFF, //Library 5(Production)
       0x00, 0x0A, 0xF4, 0x84, 0x00, 0x00, 0xFF, 0xFF, //Library 5(Production)
       0x00, 0x1E, 0xF4, 0x04, 0x00, 0x00, 0xFF, 0xFF, //Library 5(Production)
       0x00, 0x0A, 0x00, 0x80, 0x00, 0x00, 0xFF, 0xFF, //Library 5(Production)
       0x00, 0x0A, 0x00, 0x00, 0x00, 0x00, 0xFF, 0xFF, //Library 5(Production)
       0x00, 0x19, 0x64, 0x00, 0x00, 0x00, 0xFF, 0xFF, //Library 5(Production)
       0x00, 0x19, 0x28, 0x00, 0x00, 0x00, 0xFF, 0xFF, //Library 5(Production)
       0x00, 0x19, 0x14, 0x00, 0x00, 0x00, 0xFF, 0xFF, //Library 5(Production)
       0x00, 0x32, 0xFF, 0x00, 0x00, 0x00, 0xFF, 0xFF, //Library 5(Production)
       0x00, 0x19, 0xCE, 0x00, 0x00, 0x00, 0xFF, 0xFF, //Library 5(Production)
       0x00, 0x19, 0xEC, 0x00, 0x00, 0x00, 0xFF, 0xFF, //Library 5(Production)
       0xFF, 0xFF, 0xFF, 0xFF, 0xFF, 0xFF, 0xFF, 0xFF, //Library 5(Production)
       0xFF, 0xFF, 0xFF, 0xFF, 0xFF, 0xFF, 0xFF, 0xFF}; //Library 5(Production)
}

