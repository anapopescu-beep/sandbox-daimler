/*@!Encoding:1252*/
includes
{
  
}

variables
{
}

on sysvar_update sysvar::ThermalChamber::sysTCOnButton
{
If (@this == 1)
{
@sysvar::ThermalChamber::sysTCTrigger=1;

}
}

on sysvar_update sysvar::ThermalChamber::sysTCOffButton
{
If (@this == 1)
{
@sysvar::ThermalChamber::sysTCTrigger=1;

}
}

on sysvar_update sysvar::ThermalChamber::sysGetTCSetpointButton
{
If (@this == 1)
{
@sysvar::ThermalChamber::sysTCTrigger=1;

}
}

on sysvar_update sysvar::ThermalChamber::sysSetTCSetpointButton
{
If (@this == 1)
{
@sysvar::ThermalChamber::sysTCTrigger=1;

}
}

on sysvar_update sysvar::ThermalChamber::sysGetTCTempButton
{
If (@this == 1)
{
@sysvar::ThermalChamber::sysTCTrigger=1;

}
}

on sysvar sysvar::ThermalChamber::sysTempLiveUpdate
{
If (@this == 1)
{
@sysvar::ThermalChamber::sysTCTrigger=1;
}
}