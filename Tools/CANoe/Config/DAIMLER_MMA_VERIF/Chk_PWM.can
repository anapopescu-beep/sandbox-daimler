/*@!Encoding:1252*/
/***********************************AUTOLIV ELECTRONICS document********************************
Module Notes: 
************************************************************************************************
Mks Information:
$Author: Miodrag Jelic (miodrag.jelic) $ 
$Date: 2022/12/06 09:48:34CET $
$ProjectName: e:/MKSProjects/SBE/PP/DAIMLER_MMA/Phase_02/View_Development/Tools/CANoe/Config/DAIMLER_MMA_VERIF/project.pj $
***********************************************************************************************/

includes
{
  #include "\Includes\Project_configuration.cin"
 // #include "..\Includes\Project_functions_AGR.cin"

}

variables
{
  const VI_SUCCESS = 0;
}

/// <#00/[Check_PWM]>
testcase Check_PWM()
{  
  //testCaseComment("Preconditions");
  //testStep("STEP", "Bench Initialization");
  //RunPreTs();
 
  testwaitforTimeout(3000);
  EvalManStepEqual("Check first value of RGS_VL_Status",  "True", "False");
   
  //testCaseComment("Postcondition");
  //testStep("STEP", "Return ECU to default values");
  //RunPostTs();  
}
// $$$$$$$$$$$$$$$$$$$$$$$$$$$$$$$$$$$ END OF <#00/[Check_PWM]> $$$$$$$$$$$$$$$$$$$$$$$$$$$$$$$$$$$ //