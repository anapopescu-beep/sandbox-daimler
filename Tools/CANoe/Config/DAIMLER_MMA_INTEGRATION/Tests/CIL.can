/*@!Encoding:1252*/
/*------------------------------------------------------------------------------
                                IMPORT LIBRARY
 ------------------------------------------------------------------------------*/
/* To include all the libraries used by the .capl script. */
/* WARNING: Some things such as diagnostic functions are different from project
to project, change those according to your project requirements */
includes
{

  #include "..\Includes\SW_Modules\SW_Modules_Project\Project_Includes_Configuration.cin"
  #include "..\Includes\WinIdea_Includes\Debugger_Defines.cin"
  #include "..\Includes\WinIdea_Includes\Debugger_Functions.cin"
  
  
}

variables
{
  byte bWriteStepsLibraryRequest[3] = {0x2E, 0xFD, 0x2A};
  char signal_value[24];
  char buffer[24];
  
  diagRequest RBTMFL174.Tensioning_Cycle_BSR_Read req_Tensioning_Cycle_BSR_Read;
  diagRequest RBTMFL174.Tensioning_Cycle_BSR_Write req_Tensioning_Cycle_BSR_Write;
  
  diagRequest RBTMFL174.Measurement_Frames_Configuration_Read req_Measurement_Frames_Configuration_Read;
  diagRequest RBTMFL174.Measurement_Frames_Configuration_Write req_Measurement_Frames_Configuration_Write;
  
}



testcase InitTestModule()
{
  ConfigureTestModuleInformation(PVI);
  InitCycleParameters();
  strncpy(cLogPath, "S:\\Tools\\CANoe\\Config\\DAIMLER_MMA_INTEGRATION\\Logs\\CIL\\",  elcount(cLogPath));

  debugger_run();
  // Wait for ECU initialization in case PSU was set to off before RunPreTS().

  WaitECUInitialization();

  // Change ECU to left system side.

  if(testWaitForMessage(getMessageID("RBTM_FL_Stat_ST3"), 1100) == 1)

  {

   testStep(@sysvar::CORE::sysLevelOfDetailStep, "", "ECU is already set to left system side.");

   SetDiagTarget("RBTMFL174"); // Set diag target to left side.

   @sysvar::ProjectConfiguration::sysMeasurementFrameID = MeasurementFrameFL.id;

  }

  else

  {

   SetDiagTarget("RBTMFR174"); // Set diag target to right side.

   // Change ECU side.

   ChangeECUSide("left");

  }

  $Bckl_Sw_D_Stat_ST3  = 0; // Buckle switch driver state: 0    = "STAT_OK".

  $Bckl_Sw_FP_Stat_ST3 = 0; // Buckle switch passenger state: 0 = "STAT_OK".

  testWaitForSignalUpdate(Bckl_Sw_D_Stat_ST3, 42);

  SetSecTickCount();

  Wait(500);

}


/*------------------------------------------------------------------------------
                                TEST EXECUTION
------------------------------------------------------------------------------*/
  
  /*------------------------- Test scenario start ------------------------------*/

testcase SW_IT_CIL_Ign_Stat_ST3_01()
{
  //***********************************Test report header*********************************
  testReportAddMiscInfoBlock("AUTOLIV ELECTRONICS document");
  TestReportAddMiscInfo("Nightly test", "No");
  TestReportAddMiscInfo("Test type", "Requirement-Based test");
  TestReportAddMiscInfo("Regression Test", "No");
  TestReportAddMiscInfo("Fault injection method used", "No");
  TestReportAddMiscInfo("Resource usage evaluation", "No");
  TestReportAddMiscInfo("Priority", "No");
  TestReportAddMiscInfo("Safety relevant", "No");
  
  AddRequirementInfo("Requirement under test", "ARCH_SW_CIL_0005");
  AddRequirementInfo("ARCH_SW_CIL_0005", "Frame Ign_Stat_ST3 shall be manipulated to read all it’s signals and send the values through application.");
  //***************************************************************************************
    
  testCaseComment("Preconditions");
  testStep("STEP", "Bench Initialization");

  debugger_deleteAllBreakpoints();
  
  debugger_reset();
  
  debugger_run();
  
  testWaitForTimeout(2000);

  RunPreTs();
  //====================================================
  
  testStep("STEP", "Start Development Session."); 
  AuthenticateECU(2); // Development_Enhanced
  EnterDiagnosticSession("development");
    
  testStep("STEP", "Set signal ISw_Stat_ST3 from frame Ign_Stat_ST3 to I_C03_ISW_STAT_IGN_ON (0x4).");
  setSignal(BODY3::ISw_Stat_ST3, 4); // I_C03_ISW_STAT_IGN_ON
  testWaitForTimeout(1000);
  
  testStep("STEP", "Set a breakpoint in function cil_ManageInputSignals.");
  debugger_setBpAtLine("s:\\Components\\Application\\Autoliv\\CIL\\Implementation\\src\\CIL_CANToAppli.c", "1318");
  
  testCaseComment("Action: ARCH_SW_CIL_0005");
  testStep("STEP", "Read variable cil_u8IgnitionSignal --> 0x4.");
  debugger_readVariable("uint8", "cil_u8IgnitionSignal,,app.elf", "0");
  ExpectedTestResult(debugger_result, "0x4", "0x4");
  
  //====================================================
  testCaseComment("Postcondition");
  testStep("STEP", "Return ECU to default values");
  
  debugger_deleteAllBreakpoints();
  
  debugger_run();
  
  RunPostTs(); 
  
  debugger_stop();
}


testcase SW_IT_CIL_Bckl_Sw_FP_Stat_ST3_01()
{
  //***********************************Test report header*********************************
  testReportAddMiscInfoBlock("AUTOLIV ELECTRONICS document");
  TestReportAddMiscInfo("Nightly test", "No");
  TestReportAddMiscInfo("Test type", "Requirement-Based test");
  TestReportAddMiscInfo("Regression Test", "No");
  TestReportAddMiscInfo("Fault injection method used", "No");
  TestReportAddMiscInfo("Resource usage evaluation", "No");
  TestReportAddMiscInfo("Priority", "No");
  TestReportAddMiscInfo("Safety relevant", "No");
  
  AddRequirementInfo("Requirement under test", "ARCH_SW_CIL_0007, ARCH_SW_CIL_0008, ARCH_SW_CIL_0028");
  AddRequirementInfo("ARCH_SW_CIL_0007", "Frame Bckl_Sw_Fx_Stat_ST3 shall be manipulated to read all it’s signals and send the values through application.");
  AddRequirementInfo("ARCH_SW_CIL_0008", "Signal Bckl_Sw_D_Stat_ST3 shall be send though application when it’s needed.");
  AddRequirementInfo("ARCH_SW_CIL_0028", "If value for Bckl_Sw_D_Stat_ST3 is not 0 (is 1,2,3) then cycle request should be inhibitted/aborted.");
  //***************************************************************************************
    
  testCaseComment("Preconditions");
  testStep("STEP", "Bench Initialization");

  debugger_deleteAllBreakpoints();
  debugger_reset();
  debugger_run();


  RunPreTs();
  //====================================================
  
  testStep("STEP", "Start Development Session."); 
  AuthenticateECU(2); // Development_Enhanced
  EnterDiagnosticSession("development");
    
  testStep("STEP", "Set signal Bckl_Sw_D_Stat_ST3 from frame Bckl_Sw_Fx_Stat_ST3 to 0x1.");
  setSignal(BODY3::Bckl_Sw_Fx_Stat_ST3::Bckl_Sw_D_Stat_ST3, 1);
  testWaitForTimeout(1000);
  
  testStep("STEP", "Set a breakpoint in function cil_ManageInputSignals.");
  debugger_setBpAtLine("s:\\Components\\Application\\Autoliv\\CIL\\Implementation\\src\\CIL_CANToAppli.c", "1318");
  
  testCaseComment("Action: ARCH_SW_CIL_0008");
  testStep("STEP", "Check if CPU stopped at cil_ManageInputSignals function. --> CPU stopped at BP");
  debugger_waitUntilBPisReached("1000");
  ExpectedTestResult(debugger_result,IS_CPU_STOP_AT_BP_SUCCESFUL, "CPU stopped at BP");
  
  debugger_deleteAllBreakpoints();
  debugger_run();
  
  testStep("STEP", "Set a breakpoint in function cil_ManageAbortingConditions.");
  debugger_setRelativeFunctionBpAtLine("cil_ManageAbortingConditions", "118");
  
  testCaseComment("Action: ARCH_SW_CIL_0028");
  testStep("STEP", "Check if CPU stopped at cil_ManageAbortingConditions function. --> CPU stopped at BP");
  debugger_waitUntilBPisReached("1000");
  ExpectedTestResult(debugger_result,IS_CPU_STOP_AT_BP_SUCCESFUL, "CPU stopped at BP");
  
  testCaseComment("Action: ARCH_SW_CIL_0007");
  testStep("STEP", "Read variable cil_u8BcklSwStatSignal --> I_C02_BCKL_SW_STAT_NOT (0x1).");
  debugger_readVariable("uint8", "cil_u8BcklSwStatSignal,,app.elf", "0");
  ExpectedTestResult(debugger_result, "0x1", "0x1");
  
  //====================================================
  testCaseComment("Postcondition");
  testStep("STEP", "Return ECU to default values");
  
  debugger_deleteAllBreakpoints();
  
  
  RunPostTs(); 
  
  debugger_stop();
}


testcase SW_IT_CIL_RBTM_FL_Stat_ST3_01()
{
    //***********************************Test report header*********************************
  testReportAddMiscInfoBlock("AUTOLIV ELECTRONICS document");
  TestReportAddMiscInfo("Nightly test", "No");
  TestReportAddMiscInfo("Test type", "Requirement-Based test");
  TestReportAddMiscInfo("Regression Test", "No");
  TestReportAddMiscInfo("Fault injection method used", "No");
  TestReportAddMiscInfo("Resource usage evaluation", "No");
  TestReportAddMiscInfo("Priority", "No");
  TestReportAddMiscInfo("Safety relevant", "No");
  
  AddRequirementInfo("Requirement under test", "ARCH_SW_CIL_0010, ARCH_SW_CIL_0065, ARCH_SW_CIL_0066, ARCH_SW_CIL_0067; ARCH_SW_CIL_0068");
  AddRequirementInfo("ARCH_SW_CIL_0010", "Signals from frame RBTM_FL/FR_Stat_ST3 shall be written with information from application.");
  AddRequirementInfo("ARCH_SW_CIL_0066", "Signal RBTM _FL/FR Actv_Lvl_ST35 shall be written and send to CAN.");
  AddRequirementInfo("ARCH_SW_CIL_0067", "The signal RBTM _FL/FR Actv_Lvl_ST35 shall be initialized with the value 0x3F(“SNA-Init”).");
  AddRequirementInfo("ARCH_SW_CIL_0068", "If BSR1(cycle 26) is executed (and his next cycle ) then RBTM _FL/FR Actv_Lvl_ST35 should be 0x13 = “BSR1” no matter the source of the request: API interface, PRE-SAFE interface.");

  //***************************************************************************************
    
  testCaseComment("Preconditions");
  testStep("STEP", "Bench Initialization");

  debugger_deleteAllBreakpoints();
  debugger_reset();
  debugger_run();

  RunPreTs();
  //====================================================
  
  testStep("STEP", "Set a breakpoint in function cil_ManageAbortingConditions.");
  debugger_setBpAtLine("s:\\Components\\Application\\Autoliv\\CIL\\Implementation\\src\\CIL_AppliToCAN.c", "553");
 
  testStep("STEP", "Set signal Presf_Lvl_ST3 to I_C04_PRESF_LVL_V2_LVL1 (0x1).");
  setSignal(BODY3::Presf_Lvl_ST3, I_C04_PRESF_LVL_V2_LVL1);
  
  testCaseComment("Action: ARCH_SW_CIL_0010, ARCH_SW_CIL_0065, ARCH_SW_CIL_0066, ARCH_SW_CIL_0067; ARCH_SW_CIL_0068");
  testStep("STEP", "Set variable CIL_u8Actv_Lvl to 0x1.--> Successfully overwritten variable CIL_u8Actv_Lvl.");
  debugger_readVariable("uint8", "CIL_u8Actv_Lvl,,app.elf", "0");
  ExpectedTestResult(debugger_result, "0x3e", "0x3e");
  
  //====================================================
  testCaseComment("Postcondition");
  testStep("STEP", "Return ECU to default values");
  
  debugger_deleteAllBreakpoints();
  setSignal(BODY3::Presf_Lvl_ST3, I_C04_PRESF_LVL_V2_NOLVL);
  RunPostTs(); 
  
  debugger_stop();
}


testcase SW_IT_CIL_Impact3_ST3_01()
{
  //***********************************Test report header*********************************
  testReportAddMiscInfoBlock("AUTOLIV ELECTRONICS document");
  TestReportAddMiscInfo("Nightly test", "No");
  TestReportAddMiscInfo("Test type", "Requirement-Based test");
  TestReportAddMiscInfo("Regression Test", "No");
  TestReportAddMiscInfo("Fault injection method used", "No");
  TestReportAddMiscInfo("Resource usage evaluation", "No");
  TestReportAddMiscInfo("Priority", "No");
  TestReportAddMiscInfo("Safety relevant", "No");
  
  AddRequirementInfo("Requirement under test", "ARCH_SW_CIL_0030, ARCH_SW_CIL_0035");
  AddRequirementInfo("ARCH_SW_CIL_0030", "Frame Impact3_ST3 shall be manipulated to read all it’s signals and send the values through application.");
  AddRequirementInfo("ARCH_SW_CIL_0035", "Signal Impact_X_ST3 shall be send though application when it’s needed.");
  //***************************************************************************************
    
  testCaseComment("Preconditions");
  testStep("STEP", "Bench Initialization");

  debugger_deleteAllBreakpoints();
  debugger_reset();
  debugger_run();

  RunPreTs();
  //====================================================
  
  testStep("STEP", "Start Development Session."); 
  AuthenticateECU(2); // Development_Enhanced
  EnterDiagnosticSession("development");
    
  testStep("STEP", "Set signal Impact_X_ST3 from frame Impact3_ST3 to 0x1.");
  setSignal(BODY3::Impact3_ST3::Impact_X_ST3, 1);
  testWaitForTimeout(1000);
  
  testStep("STEP", "Set a breakpoint in function cil_ManageInputSignals.");
  debugger_setBpAtLine("s:\\Components\\Application\\Autoliv\\CIL\\Implementation\\src\\CIL_CANToAppli.c", "1318");
  
  testCaseComment("Action: ARCH_SW_CIL_0030, ARCH_SW_CIL_0035");
  testStep("STEP", "Read variable cil_stInputSignalsPresfRec.bImpactXType --> 0x1.");
  debugger_readVariable("uint8", "cil_stInputSignalsPresfRec,,app.elf", "3");
  ExpectedTestResult(debugger_result, "0x1", "0x1");
  
  //====================================================
  testCaseComment("Postcondition");
  testStep("STEP", "Return ECU to default values");
  
  debugger_deleteAllBreakpoints();
  
  RunPostTs(); 
  
  debugger_stop();
}

testcase SW_IT_CIL_Impact2_ST3_01()
{
  //***********************************Test report header*********************************
  testReportAddMiscInfoBlock("AUTOLIV ELECTRONICS document");
  TestReportAddMiscInfo("Nightly test", "No");
  TestReportAddMiscInfo("Test type", "Requirement-Based test");
  TestReportAddMiscInfo("Regression Test", "No");
  TestReportAddMiscInfo("Fault injection method used", "No");
  TestReportAddMiscInfo("Resource usage evaluation", "No");
  TestReportAddMiscInfo("Priority", "No");
  TestReportAddMiscInfo("Safety relevant", "No");
  
  AddRequirementInfo("Requirement under test", "ARCH_SW_CIL_0039, ARCH_SW_CIL_0037, ARCH_SW_CIL_0038, ARCH_SW_CIL_0034, ARCH_SW_CIL_0183");
  AddRequirementInfo("ARCH_SW_CIL_0039", "Frame Impact2_ST3 shall be manipulated to read all it’s signals and send the values through application.");
  AddRequirementInfo("ARCH_SW_CIL_0037", "Signal Impact_Y_ST3 shall be removed from application.");
  AddRequirementInfo("ARCH_SW_CIL_0038", "All values for Impact Y shall be ignored.");
  //***************************************************************************************
    
  testCaseComment("Preconditions");
  testStep("STEP", "Bench Initialization");

  debugger_deleteAllBreakpoints();
  debugger_reset();
  debugger_run();

  RunPreTs();
  //====================================================
  
  testStep("STEP", "Start Development Session."); 
  AuthenticateECU(2); // Development_Enhanced
  EnterDiagnosticSession("development");
    
  testStep("STEP", "Set signal Impact_Y_ST3 from frame Impact2_ST3 to 0x1.");
  setSignal(BODY3::Impact2_ST3::Impact_Y_ST3, 1);
  testWaitForTimeout(1000);

  testCaseComment("Action: ARCH_SW_CIL_0039, ARCH_SW_CIL_0034");
  testStep("STEP", "Set a breakpoint in function CIL_ComNotification_ORC_Impact2_Pr5_ST3_b9l09rrslyv7vj3o92j69irnd_2f5ae8ac_Rx.");
  debugger_setRelativeFunctionBpAtLine("CIL_ComNotification_ORC_Impact2_Pr5_ST3_b9l09rrslyv7vj3o92j69irnd_2f5ae8ac_Rx", "0");

  debugger_run();
  
  testCaseComment("Action: ARCH_SW_CIL_0038, ARCH_SW_CIL_0037, ARCH_SW_CIL_0183");
  testStep("STEP", "Read variable cil_stImpactSignalsStatus2.bImpactXType --> 0x1.");
  debugger_readVariable("uint8", "cil_stImpactSignalsStatus2,,app.elf", "0");
  ExpectedTestResult(debugger_result, "0x1", "0x1");
  
  //====================================================
  testCaseComment("Postcondition");
  testStep("STEP", "Return ECU to default values");
  
  debugger_deleteAllBreakpoints();
  RunPostTs(); 
  
  debugger_stop();
}

testcase SW_IT_CIL_NVP_u16HWARepetition_01()
{
  //***********************************Test report header*********************************
  testReportAddMiscInfoBlock("AUTOLIV ELECTRONICS document");
  TestReportAddMiscInfo("Nightly test", "No");
  TestReportAddMiscInfo("Test type", "Requirement-Based test");
  TestReportAddMiscInfo("Regression Test", "No");
  TestReportAddMiscInfo("Fault injection method used", "No");
  TestReportAddMiscInfo("Resource usage evaluation", "No");
  TestReportAddMiscInfo("Priority", "No");
  TestReportAddMiscInfo("Safety relevant", "No");
  
  AddRequirementInfo("Requirement under test", "ARCH_SW_CIL_0047");
  AddRequirementInfo("ARCH_SW_CIL_0047", "CIL component shall ensure repetition of vibration phase (cycle 19) of HWA for 1 second.");
  //***************************************************************************************
    
  testCaseComment("Preconditions");
  testStep("STEP", "Bench Initialization");

  debugger_deleteAllBreakpoints();
  debugger_reset();
  debugger_run();

  RunPreTs();
  //====================================================
  
  testStep("STEP", "Start Development Session."); 
  AuthenticateECU(2); // Development_Enhanced
  EnterDiagnosticSession("development");
  
  testStep("STEP", "Set a breakpoint in function cil_ManageInputSignals.");
  debugger_setRelativeFunctionBpAtLine("cil_ManageInputSignals", "0");
  
  testStep("STEP", "Set a breakpoint in function cil_ManageHaptic.");
  debugger_setBpAtLine("s:\\Components\\Application\\Autoliv\\CIL\\Implementation\\src\\CIL_CANToAppli.c", "1373");
  
  testCaseComment("Action: ARCH_SW_CIL_0047");
  testStep("STEP", "Read variable NVP_BLOCK_ID_HWA_REPETITION_RamBlockData.NVP_u16HWARepetition --> 0x64.");
  debugger_readVariable("uint8", "NVP_BLOCK_ID_HWA_REPETITION_RamBlockData,,app.elf", "0");
  ExpectedTestResult(debugger_result, "0x64", "0x64");

  //====================================================
  testCaseComment("Postcondition");
  testStep("STEP", "Return ECU to default values");
  
  debugger_deleteAllBreakpoints();
  
  RunPostTs(); 
  
  debugger_stop();
}

testcase SW_IT_CIL_SBeltTens_SP_Lvl_ST3_01()
{
 //***********************************Test report header*********************************
  testReportAddMiscInfoBlock("AUTOLIV ELECTRONICS document");
  TestReportAddMiscInfo("Nightly test", "No");
  TestReportAddMiscInfo("Test type", "Requirement-Based test");
  TestReportAddMiscInfo("Regression Test", "No");
  TestReportAddMiscInfo("Fault injection method used", "No");
  TestReportAddMiscInfo("Resource usage evaluation", "No");
  TestReportAddMiscInfo("Priority", "No");
  TestReportAddMiscInfo("Safety relevant", "No");
  
  AddRequirementInfo("Requirement under test", "ARCH_SW_CIL_0050, ARCH_SW_CIL_0051, ARCH_SW_CIL_0116");
  AddRequirementInfo("ARCH_SW_CIL_0050", "Frame SBeltTens_SP_Lvl_ST3 shall be manipulated to read all it’s signals and send the values through application.");
  AddRequirementInfo("ARCH_SW_CIL_0051", "Signal RBTMFL_SP_Lvl_Rq_ST35 shall be send though application when it’s needed.");
  AddRequirementInfo("ARCH_SW_CIL_0116", "If Signal RBTMFL_SP_Lvl_Rq_ST35 is different than 0 than next cycle release for previous API requested profiles is inhibitted");
  //***************************************************************************************

  testCaseComment("Preconditions");
  testStep("STEP", "Bench Initialization");

  debugger_deleteAllBreakpoints();
  debugger_reset();
  debugger_run();

  RunPreTs();
  //====================================================
  
  testStep("STEP", "Start Development Session."); 
  AuthenticateECU(2); // Development_Enhanced
  EnterDiagnosticSession("development");
    
  testStep("STEP", "Set signal RBTMFL_SP_Lvl_Rq_ST35 from frame SBeltTens_SP_Lvl_ST3 to 0x1.");
  setSignal(BODY3::SBeltTens_SP_Lvl_ST3::RBTMFL_SP_Lvl_Rq_ST35, 1);
  testWaitForTimeout(1000);
  
  testStep("STEP", "Set a breakpoint in function cil_ManageInputSignals.");
  debugger_setBpAtLine("s:\\Components\\Application\\Autoliv\\CIL\\Implementation\\src\\CIL_CANToAppli.c", "1318");
  
  testCaseComment("Action: ARCH_SW_CIL_0050, ARCH_SW_CIL_0051, ARCH_SW_CIL_0116");
  testStep("STEP", "Read variable cil_u8APIActivationRequest --> 0x1.");
  debugger_readVariable("uint8", "cil_u8APIActivationRequest,,app.elf", "1");
  ExpectedTestResult(debugger_result, "0x1", "0x1");
  
  //====================================================
  testCaseComment("Postcondition");
  testStep("STEP", "Return ECU to default values");
  
  debugger_deleteAllBreakpoints();
  
  RunPostTs(); 
  
  debugger_stop();
}


testcase SW_IT_CIL_BeltAdj_UI_Set_Rq_ST3_01()
{
 //***********************************Test report header*********************************
  testReportAddMiscInfoBlock("AUTOLIV ELECTRONICS document");
  TestReportAddMiscInfo("Nightly test", "No");
  TestReportAddMiscInfo("Test type", "Requirement-Based test");
  TestReportAddMiscInfo("Regression Test", "No");
  TestReportAddMiscInfo("Fault injection method used", "No");
  TestReportAddMiscInfo("Resource usage evaluation", "No");
  TestReportAddMiscInfo("Priority", "No");
  TestReportAddMiscInfo("Safety relevant", "No");
  
  AddRequirementInfo("Requirement under test", "ARCH_SW_CIL_0094, ARCH_SW_CIL_0095, ARCH_SW_CIL_0096, ARCH_SW_CIL_0014");
  AddRequirementInfo("ARCH_SW_CIL_0094", "Frame BeltAdj_UI_Set_Rq_ST3 shall be manipulated to read all it’s signals and send the values through application.");
  AddRequirementInfo("ARCH_SW_CIL_0095", "Signal PS_Curve_FL_Rq_HU_ST3 shall be send though application when it’s needed(0,1,2,3)");
  AddRequirementInfo("ARCH_SW_CIL_0096", "Signal PS_Curve_FR_Rq_HU_ST3 shall be send though application when it’s needed(0,1,2,3)");
  AddRequirementInfo("ARCH_SW_CIL_0096", "Signal PS_Curve_FR_Rq_HU_ST3 shall be send though application when it’s needed(0,1,2,3)");
  AddRequirementInfo("ARCH_SW_CIL_0014", "Signals from frame BeltAdj_FL/FR_Stat_ST3 shall be written with information from application.");
  //***************************************************************************************
    
  testCaseComment("Preconditions");
  testStep("STEP", "Bench Initialization");

  debugger_deleteAllBreakpoints();
  debugger_reset();
  debugger_run();

  RunPreTs();
  //====================================================
  
  testStep("STEP", "Start Development Session."); 
  AuthenticateECU(2); // Development_Enhanced
  EnterDiagnosticSession("development");
    
  testStep("STEP", "Set signal PS_Curve_FL_Rq_HU_ST3 from frame BeltAdj_UI_Set_Rq_ST3 to 0x1.");
  setSignal(BODY3::BeltAdj_UI_Set_Rq_ST3::PS_Curve_FL_Rq_HU_ST3, 1);
  testWaitForTimeout(1000);
  
  testStep("STEP", "Set signal PS_Curve_FR_Rq_HU_ST3 from frame BeltAdj_UI_Set_Rq_ST3 to 0x1.");
  setSignal(BODY3::BeltAdj_UI_Set_Rq_ST3::PS_Curve_FR_Rq_HU_ST3, 1);
  testWaitForTimeout(1000);
  
  testStep("STEP", "Set a breakpoint in function cil_ManageInputSignals.");
  debugger_setBpAtLine("s:\\Components\\Application\\Autoliv\\CIL\\Implementation\\src\\CIL_CANToAppli.c", "1318");
  
  testCaseComment("Action: ARCH_SW_CIL_0094, ARCH_SW_CIL_0095, ARCH_SW_CIL_0096, ARCH_SW_CIL_0014");
  testStep("STEP", "Read variable CIL_u8PSCurve --> 0x1.");
  debugger_readVariable("uint8", "CIL_u8PSCurve,,app.elf", "0");
  ExpectedTestResult(debugger_result, "0x1", "0x1");
  
  //====================================================
  testCaseComment("Postcondition");
  testStep("STEP", "Return ECU to default values");
  
  debugger_deleteAllBreakpoints();
  
  RunPostTs(); 
  
  debugger_stop();
}


testcase SW_IT_CIL_PT4_PTCoor4_ST3_01()
{
 //***********************************Test report header*********************************
  testReportAddMiscInfoBlock("AUTOLIV ELECTRONICS document");
  TestReportAddMiscInfo("Nightly test", "No");
  TestReportAddMiscInfo("Test type", "Requirement-Based test");
  TestReportAddMiscInfo("Regression Test", "No");
  TestReportAddMiscInfo("Fault injection method used", "No");
  TestReportAddMiscInfo("Resource usage evaluation", "No");
  TestReportAddMiscInfo("Priority", "No");
  TestReportAddMiscInfo("Safety relevant", "No");
  
  AddRequirementInfo("Requirement under test", "ARCH_SW_CIL_0150, ARCH_SW_CIL_0151");
  AddRequirementInfo("ARCH_SW_CIL_0150", "Frame PT4_PTCoor4_ST3 shall be manipulated to read all it’s signals and send the values through application.");
  AddRequirementInfo("ARCH_SW_CIL_0151", "Frame PT4_PTCoor4_ST3 shall be manipulated to read all it’s signals and send the values through application.");
  //***************************************************************************************
    
  testCaseComment("Preconditions");
  testStep("STEP", "Bench Initialization");

  debugger_deleteAllBreakpoints();
  debugger_reset();
  debugger_run();

  RunPreTs();
  //====================================================
  
  testStep("STEP", "Start Development Session."); 
  AuthenticateECU(2); // Development_Enhanced
  EnterDiagnosticSession("development");
    
  testStep("STEP", "Set signal PT4_PTCoor_PT_Rdy_ST3 to I_C02_PT_RDY_V2_PT_RDY.");
  setSignal(BODY3::PT4_PTCoor4_ST3::PT4_PTCoor_PT_Rdy_ST3, 1);
  testWaitForTimeout(1000);
  
  testStep("STEP", "Set a breakpoint in function cil_ManageInputSignals at line cil_ManageInhibitConditions();.");
  debugger_setBpAtLine("s:\\Components\\Application\\Autoliv\\CIL\\Implementation\\src\\CIL_CANToAppli.c", "1302");
  
  testCaseComment("Action: ARCH_SW_CIL_0150, ARCH_SW_CIL_0151");
  testStep("STEP", "Read variable cil_stPTCoor4Pr5St3 --> 0x1.");
  debugger_readVariable("uint8", "cil_stPTCoor4Pr5St3,,app.elf", "0");
  ExpectedTestResult(debugger_result, "0x1", "0x1");
  
  //====================================================
  testCaseComment("Postcondition");
  testStep("STEP", "Return ECU to default values");
  
  debugger_deleteAllBreakpoints();
  
  RunPostTs(); 
  
  debugger_stop();
}


testcase SW_IT_CIL_PT4_PTCoor_DrvPosn_Stat_ST3_01()
{
 //***********************************Test report header*********************************
  testReportAddMiscInfoBlock("AUTOLIV ELECTRONICS document");
  TestReportAddMiscInfo("Nightly test", "No");
  TestReportAddMiscInfo("Test type", "Requirement-Based test");
  TestReportAddMiscInfo("Regression Test", "No");
  TestReportAddMiscInfo("Fault injection method used", "No");
  TestReportAddMiscInfo("Resource usage evaluation", "No");
  TestReportAddMiscInfo("Priority", "No");
  TestReportAddMiscInfo("Safety relevant", "No");
  
  AddRequirementInfo("Requirement under test", "ARCH_SW_CIL_0153, ARCH_SW_CIL_0154");
  AddRequirementInfo("ARCH_SW_CIL_0153", "Frame PT4_PTCoor_DrvPosn_Stat_ST3 shall be manipulated to read all it’s signals and send the values through application.");
  AddRequirementInfo("ARCH_SW_CIL_0154", "Signal PT4_PTCoor_DrvPosn_Stat_ST3 shall be send through application when it’s needed (1,2,3,4, 15).");
  //***************************************************************************************
    
  testCaseComment("Preconditions");
  testStep("STEP", "Bench Initialization");

  debugger_deleteAllBreakpoints();
  debugger_reset();
  debugger_run();

  RunPreTs();
  //====================================================
  
  testStep("STEP", "Start Development Session."); 
  AuthenticateECU(2); // Development_Enhanced
  EnterDiagnosticSession("development");
    
  testStep("STEP", "Set signal PT4_PTCoor_DrvPosn_Stat_ST3 to I_C04_DRVPOSN_ST3_D.");
  setSignal(BODY3::PT4_PTCoor_DrvPosn_Stat_ST3, 1);
  testWaitForTimeout(1000);
  
  testStep("STEP", "Set a breakpoint in function cil_ManageInputSignals at line cil_ManageInhibitConditions();.");
  debugger_setBpAtLine("s:\\Components\\Application\\Autoliv\\CIL\\Implementation\\src\\CIL_CANToAppli.c", "1302");
  
  testCaseComment("Action: ARCH_SW_CIL_0153, ARCH_SW_CIL_0154");
  testStep("STEP", "Read variable cil_stPTCoorDrvPos.PT4_PTCoor_DrvPosn_Stat_ST3 --> 0x1.");
  debugger_readVariable("uint8", "cil_stPTCoorDrvPos,,app.elf", "0");
  ExpectedTestResult(debugger_result, "0x1", "0x1");
  
  //====================================================
  testCaseComment("Postcondition");
  testStep("STEP", "Return ECU to default values");
  
  debugger_deleteAllBreakpoints();
  
  RunPostTs(); 
  
  debugger_stop();
}

testcase SW_IT_CIL_BeltHdOvr_State_ST3_01()
{
 //***********************************Test report header*********************************
  testReportAddMiscInfoBlock("AUTOLIV ELECTRONICS document");
  TestReportAddMiscInfo("Nightly test", "No");
  TestReportAddMiscInfo("Test type", "Requirement-Based test");
  TestReportAddMiscInfo("Regression Test", "No");
  TestReportAddMiscInfo("Fault injection method used", "No");
  TestReportAddMiscInfo("Resource usage evaluation", "No");
  TestReportAddMiscInfo("Priority", "No");
  TestReportAddMiscInfo("Safety relevant", "No");
  
  AddRequirementInfo("Requirement under test", "ARCH_SW_CIL_0157, ARCH_SW_CIL_0158, ARCH_SW_CIL_0159, ARCH_SW_CIL_0185, ARCH_SW_CIL_0186, ARCH_SW_CIL_0156");
  AddRequirementInfo("ARCH_SW_CIL_0157", "Frame BeltHdOvr_FL_State_ST3 shall be manipulated to read all it’s signals and send the values through application.");
  AddRequirementInfo("ARCH_SW_CIL_0159", "Frame BeltHdOvr_FR_State_ST3 shall be manipulated to read all it’s signals and send the values through application.");
  AddRequirementInfo("ARCH_SW_CIL_0158", "Signal BeltHdOvr_FL_Stat_ST3 shall be send though application when it’s needed (0,1,2,3).");
  AddRequirementInfo("ARCH_SW_CIL_0185", "If values for this signal are different than 0x00= RETRACT (Belt hand over retracted).Then all BSR cycles are inhibitted/aborted if signal is enabled in the coding.");
  AddRequirementInfo("ARCH_SW_CIL_0186", "If values for this signal are different than 0x00= RETRACT (Belt hand over retracted).Then all BSR cycles are inhibitted/aborted if signal is enabled in the coding.");
  //***************************************************************************************
    
  testCaseComment("Preconditions");
  testStep("STEP", "Bench Initialization");

  debugger_deleteAllBreakpoints();
  debugger_reset();
  debugger_run();

  RunPreTs();
  //====================================================
  
  testStep("STEP", "Start Development Session."); 
  AuthenticateECU(2); // Development_Enhanced
  EnterDiagnosticSession("development");
    
  testStep("STEP", "Set signal BeltHdOvr_FL_Stat_ST3 from frame BeltHdOvr_FL_State_ST3 to I_C02_BELTHDOVR_STAT_OUT_OF_END.");
  setSignal(BODY3::BeltHdOvr_FL_State_ST3::BeltHdOvr_FL_Stat_ST3, 1);
  testWaitForTimeout(1000);
  
  testStep("STEP", "Set a breakpoint in function cil_ManageInputSignals at line cil_ManageInhibitConditions();.");
  debugger_setBpAtLine("s:\\Components\\Application\\Autoliv\\CIL\\Implementation\\src\\CIL_CANToAppli.c", "1302");
  
  testCaseComment("Action: ARCH_SW_CIL_0157, ARCH_SW_CIL_0156");
  testStep("STEP", "Read variable cil_u8BeltHandover --> 0x1.");
  debugger_readVariable("uint8", "cil_u8BeltHandover,,app.elf", "0");
  ExpectedTestResult(debugger_result, "0x1", "0x1");
  
  debugger_deleteAllBreakpoints();
  debugger_reset();
  debugger_run();
  
  testStep("STEP", "Set signal BeltHdOvr_FR_Stat_ST3 from frame BeltHdOvr_FR_State_ST3 to I_C02_BELTHDOVR_STAT_OUT_OF_END.");
  setSignal(BODY3::BeltHdOvr_FR_State_ST3::BeltHdOvr_FR_Stat_ST3, 2);
  testWaitForTimeout(500);
  
  testStep("STEP", "Set a breakpoint in function cil_ManageInputSignals at line cil_ManageInhibitConditions();.");
  debugger_setBpAtLine("s:\\Components\\Application\\Autoliv\\CIL\\Implementation\\src\\CIL_CANToAppli.c", "1302");
  
  testCaseComment("Action: ARCH_SW_CIL_0159, ARCH_SW_CIL_0158, ARCH_SW_CIL_0186, ARCH_SW_CIL_0185");
  testStep("STEP", "Read variable cil_u8BeltHandover --> 0x1.");
  debugger_readVariable("uint8", "cil_u8BeltHandover,,app.elf", "0");
  ExpectedTestResult(debugger_result, "0x1", "0x1");
  
  //====================================================
  testCaseComment("Postcondition");
  testStep("STEP", "Return ECU to default values");
  
  debugger_deleteAllBreakpoints();
  
  RunPostTs(); 
  
  debugger_stop();
}


testcase SW_IT_CIL_EVC_CfgList_01_08_Pr5_ST3_01()
{
  //***********************************Test report header*********************************
  testReportAddMiscInfoBlock("AUTOLIV ELECTRONICS document");
  TestReportAddMiscInfo("Nightly test", "No");
  TestReportAddMiscInfo("Test type", "Requirement-Based test");
  TestReportAddMiscInfo("Regression Test", "No");
  TestReportAddMiscInfo("Fault injection method used", "No");
  TestReportAddMiscInfo("Resource usage evaluation", "No");
  TestReportAddMiscInfo("Priority", "No");
  TestReportAddMiscInfo("Safety relevant", "No");
  
  AddRequirementInfo("Requirement under test", "ARCH_SW_CIL_0161");
  AddRequirementInfo("ARCH_SW_CIL_0161", "Frame EVC_CfgList_01_08_Pr5_ST3 shall be manipulated to read all it’s signals and send the values through application.");
  //***************************************************************************************
    
  testCaseComment("Preconditions");
  testStep("STEP", "Bench Initialization");

  debugger_deleteAllBreakpoints();
  debugger_reset();
  debugger_run();

  RunPreTs();
  //====================================================
  
  testStep("STEP", "Start Development Session."); 
  AuthenticateECU(2); // Development_Enhanced
  EnterDiagnosticSession("development");
    
  testStep("STEP", "Set signal BeltHdOvr_FL_Stat_ST3 from frame EVC_CfgList_01_08_Pr5_ST3 to 0x1.");
  setSignal(BODY3::EVC_CfgList_01_08_Pr5_ST3::EVC_CfgList_01_08_Stat_ST3, 1);
  testWaitForTimeout(1000);
  
  testStep("STEP", "Set a breakpoint in function cil_ManageInputSignals.");
  debugger_setBpAtLine("s:\\Components\\Application\\Autoliv\\CIL\\Implementation\\src\\CIL_CANToAppli.c", "1318");
  
  testCaseComment("Action: ARCH_SW_CIL_0161");
  testStep("STEP", "Read variable cil_evcCfgList0108 --> 0x1.");
  debugger_readVariable("uint8", "cil_evcCfgList0108,,app.elf", "0");
  ExpectedTestResult(debugger_result, "0x1", "0x1");
  
  //====================================================
  testCaseComment("Postcondition");
  testStep("STEP", "Return ECU to default values");
  
  debugger_deleteAllBreakpoints();
  
  RunPostTs(); 
  
  debugger_stop();
}


testcase SW_IT_CIL_Bckl_Sw_Fx_Stat_Pr5_ST3_01()
{
  //***********************************Test report header*********************************
  testReportAddMiscInfoBlock("AUTOLIV ELECTRONICS document");
  TestReportAddMiscInfo("Nightly test", "No");
  TestReportAddMiscInfo("Test type", "Requirement-Based test");
  TestReportAddMiscInfo("Regression Test", "No");
  TestReportAddMiscInfo("Fault injection method used", "No");
  TestReportAddMiscInfo("Resource usage evaluation", "No");
  TestReportAddMiscInfo("Priority", "No");
  TestReportAddMiscInfo("Safety relevant", "No");
  
  AddRequirementInfo("Requirement under test", "ARCH_SW_CIL_0400, ARCH_SW_CIL_0410, ARCH_SW_CIL_0411");
  AddRequirementInfo("ARCH_SW_CIL_0400", "This function shall be called by Com when the signal group for Buckle is received on Can.");
  //***************************************************************************************
    
  testCaseComment("Preconditions");
  testStep("STEP", "Bench Initialization");

  debugger_deleteAllBreakpoints();
  debugger_reset();
  debugger_run();

  RunPreTs();
  //====================================================
  
  testStep("STEP", "Start Development Session."); 
  AuthenticateECU(2); // Development_Enhanced
  EnterDiagnosticSession("development");
    
  testStep("STEP", "Set signal Rsrv1_Bckl_Sw_Fx_Stat_ST3 to 0x1.");
  setSignal(BODY3::Rsrv1_Bckl_Sw_Fx_Stat_ST3, 1);
  testWaitForTimeout(1000);
  
  testStep("STEP", "Set a breakpoint in function CIL_ComNotification_Bckl_Sw_Fx_Stat_Pr5_ST3_dihag5a55iw4h5qk539fx0kup_4c948f24_Rx.");
  debugger_setRelativeFunctionBpAtLine("CIL_ComNotification_Bckl_Sw_Fx_Stat_Pr5_ST3_dihag5a55iw4h5qk539fx0kup_4c948f24_Rx", "4");
  
  testCaseComment("Action: ARCH_SW_CIL_0400, ARCH_SW_CIL_0410, ARCH_SW_CIL_0411");
  testStep("STEP", "Read variable stBcklSwStatFrame --> 0x1.");
  debugger_readVariable("uint8", "stBcklSwStatFrame,,app.elf", "0");
  ExpectedTestResult(debugger_result, "0x1", "0x1");
  
  //====================================================
  testCaseComment("Postcondition");
  testStep("STEP", "Return ECU to default values");
  
  debugger_deleteAllBreakpoints();
  RunPostTs(); 
  
  debugger_stop();
}

testcase SW_IT_CIL_Ign_Stat_Pr5_ST3_01()
{
  //***********************************Test report header*********************************
  testReportAddMiscInfoBlock("AUTOLIV ELECTRONICS document");
  TestReportAddMiscInfo("Nightly test", "No");
  TestReportAddMiscInfo("Test type", "Requirement-Based test");
  TestReportAddMiscInfo("Regression Test", "No");
  TestReportAddMiscInfo("Fault injection method used", "No");
  TestReportAddMiscInfo("Resource usage evaluation", "No");
  TestReportAddMiscInfo("Priority", "No");
  TestReportAddMiscInfo("Safety relevant", "No");
  
  AddRequirementInfo("Requirement under test", "ARCH_SW_CIL_0401, ARCH_SW_CIL_0006");
  AddRequirementInfo("ARCH_SW_CIL_0401", "This function shall be called by Com when the signal group for Ignition is received on Can.");
  //***************************************************************************************
    
  testCaseComment("Preconditions");
  testStep("STEP", "Bench Initialization");

  debugger_deleteAllBreakpoints();
  debugger_reset();
  debugger_run();

  RunPreTs();
  //====================================================
  
  testStep("STEP", "Start Development Session."); 
  AuthenticateECU(2); // Development_Enhanced
  EnterDiagnosticSession("development");
    
  testStep("STEP", "Set signal ISw_Stat_ST3 to 0x1.");
  setSignal(BODY3::ISw_Stat_ST3, 1);
  testWaitForTimeout(1000);
  
  testStep("STEP", "Set a breakpoint in function CIL_ComNotification_Ign_Stat_Pr5_ST3_csgs1dv6drms80o1i9p49677w_7bdae87d_Rx.");
  debugger_setRelativeFunctionBpAtLine("CIL_ComNotification_Ign_Stat_Pr5_ST3_csgs1dv6drms80o1i9p49677w_7bdae87d_Rx", "6");
  
  testCaseComment("Action: ARCH_SW_CIL_0401, ARCH_SW_CIL_0006");
  testStep("STEP", "Read variable cil_stIgnStatFrame --> 0x1.");
  debugger_readVariable("uint8", "cil_stIgnStatFrame,,app.elf", "0");
  ExpectedTestResult(debugger_result, "0x1", "0x1");
  
  //====================================================
  testCaseComment("Postcondition");
  testStep("STEP", "Return ECU to default values");
  
  debugger_deleteAllBreakpoints();
  
  RunPostTs(); 
  
  debugger_stop();
}

testcase SW_IT_CIL_Impact2_Pr5_ST3_01()
{
  //***********************************Test report header*********************************
  testReportAddMiscInfoBlock("AUTOLIV ELECTRONICS document");
  TestReportAddMiscInfo("Nightly test", "No");
  TestReportAddMiscInfo("Test type", "Requirement-Based test");
  TestReportAddMiscInfo("Regression Test", "No");
  TestReportAddMiscInfo("Fault injection method used", "No");
  TestReportAddMiscInfo("Resource usage evaluation", "No");
  TestReportAddMiscInfo("Priority", "No");
  TestReportAddMiscInfo("Safety relevant", "No");
  
  AddRequirementInfo("Requirement under test", "ARCH_SW_CIL_0402, ARCH_SW_CIL_0190");
  AddRequirementInfo("ARCH_SW_CIL_0402", "This function shall be called by Com when the signal group for Impact2 is received on Can.");
  //***************************************************************************************
    
  testCaseComment("Preconditions");
  testStep("STEP", "Bench Initialization");

  debugger_deleteAllBreakpoints();
  debugger_reset();
  debugger_run();

  RunPreTs();
  //====================================================
  
  testStep("STEP", "Start Development Session."); 
  AuthenticateECU(2); // Development_Enhanced
  EnterDiagnosticSession("development");
    
  testStep("STEP", "Set signal Impact_Y_ST3 to 0x1.");
  setSignal(BODY3::Impact_Y_ST3, 1);
  testWaitForTimeout(1000);
  
  testStep("STEP", "Set a breakpoint in function CIL_ComNotification_ORC_Impact2_Pr5_ST3_b9l09rrslyv7vj3o92j69irnd_2f5ae8ac_Rx.");
  debugger_setRelativeFunctionBpAtLine("CIL_ComNotification_ORC_Impact2_Pr5_ST3_b9l09rrslyv7vj3o92j69irnd_2f5ae8ac_Rx", "0");
  
  testCaseComment("Action: ARCH_SW_CIL_0402, ARCH_SW_CIL_0190");
  testStep("STEP", "Read variable cil_stImpactSignalsStatus2 --> 0x1.");
  debugger_readVariable("uint8", "cil_stImpactSignalsStatus2,,app.elf", "0");
  ExpectedTestResult(debugger_result, "0x1", "0x1");
  
  //====================================================
  testCaseComment("Postcondition");
  testStep("STEP", "Return ECU to default values");
  
  debugger_deleteAllBreakpoints();
  RunPostTs(); 
  
  debugger_stop();
}


testcase SW_IT_CIL_Impact3_Pr5_ST3_01()
{
  //***********************************Test report header*********************************
  testReportAddMiscInfoBlock("AUTOLIV ELECTRONICS document");
  TestReportAddMiscInfo("Nightly test", "No");
  TestReportAddMiscInfo("Test type", "Requirement-Based test");
  TestReportAddMiscInfo("Regression Test", "No");
  TestReportAddMiscInfo("Fault injection method used", "No");
  TestReportAddMiscInfo("Resource usage evaluation", "No");
  TestReportAddMiscInfo("Priority", "No");
  TestReportAddMiscInfo("Safety relevant", "No");
  
  AddRequirementInfo("Requirement under test", "ARCH_SW_CIL_0403, ARCH_SW_CIL_0033");
  AddRequirementInfo("ARCH_SW_CIL_0403", "This function shall be called by Com when the signal group for Impact3 is received on Can.");
  //***************************************************************************************
    
  testCaseComment("Preconditions");
  testStep("STEP", "Bench Initialization");

  debugger_deleteAllBreakpoints();
  debugger_reset();
  debugger_run();

  RunPreTs();
  //====================================================
  
  testStep("STEP", "Start Development Session."); 
  AuthenticateECU(2); // Development_Enhanced
  EnterDiagnosticSession("development");
    
  testStep("STEP", "Set signal Impact_F1_ST3 to 0x1.");
  setSignal(BODY3::Impact_F1_ST3, 1);
  testWaitForTimeout(1000);
  
  testStep("STEP", "Set a breakpoint in function CIL_ComNotification_ORC_Impact3_Pr5_ST3_c4pqnkonfjwv3uiohsxhe9dwu_1bc89a3a_Rx.");
  debugger_setRelativeFunctionBpAtLine("CIL_ComNotification_ORC_Impact3_Pr5_ST3_c4pqnkonfjwv3uiohsxhe9dwu_1bc89a3a_Rx", "0");
  
  testCaseComment("Action: ARCH_SW_CIL_0403, ARCH_SW_CIL_0033");
  testStep("STEP", "Read variable cil_stImpactSignalsStatus3 --> 0x1.");
  debugger_readVariable("uint8", "cil_stImpactSignalsStatus3,,app.elf", "0");
  ExpectedTestResult(debugger_result, "0x1", "0x1");
  
  //====================================================
  testCaseComment("Postcondition");
  testStep("STEP", "Return ECU to default values");
  
  debugger_deleteAllBreakpoints();
  
  RunPostTs(); 
  
  debugger_stop();
}

testcase SW_IT_CIL_PresfAct_Adj_Pr5_ST3_01()
{
  //***********************************Test report header*********************************
  testReportAddMiscInfoBlock("AUTOLIV ELECTRONICS document");
  TestReportAddMiscInfo("Nightly test", "No");
  TestReportAddMiscInfo("Test type", "Requirement-Based test");
  TestReportAddMiscInfo("Regression Test", "No");
  TestReportAddMiscInfo("Fault injection method used", "No");
  TestReportAddMiscInfo("Resource usage evaluation", "No");
  TestReportAddMiscInfo("Priority", "No");
  TestReportAddMiscInfo("Safety relevant", "No");
  
  AddRequirementInfo("Requirement under test", "ARCH_SW_CIL_0404, ARCH_SW_CIL_0118");
  AddRequirementInfo("ARCH_SW_CIL_0404", "This function shall be called by Com when the signal group for Presafe is received on Can.");
  //***************************************************************************************
    
  testCaseComment("Preconditions");
  testStep("STEP", "Bench Initialization");

  debugger_deleteAllBreakpoints();
  debugger_reset();
  debugger_run();

  RunPreTs();
  //====================================================
  
  testStep("STEP", "Start Development Session."); 
  AuthenticateECU(2); // Development_Enhanced
  EnterDiagnosticSession("development");
    
  testStep("STEP", "Set signal Impact_F1_ST3 to 0x1.");
  setSignal(BODY3::PresfAct_Adj_Rq_ST3, 1);
  testWaitForTimeout(1000);
  
  testStep("STEP", "Set a breakpoint in function CIL_ComNotification_PresfAct_Adj_Pr5_ST3_2joar1a41xrgjqab60epnbplm_25141edc_Rx.");
  debugger_setRelativeFunctionBpAtLine("CIL_ComNotification_PresfAct_Adj_Pr5_ST3_2joar1a41xrgjqab60epnbplm_25141edc_Rx", "4");
  
  testCaseComment("Action: ARCH_SW_CIL_0404, ARCH_SW_CIL_0118");
  testStep("STEP", "Read variable cil_stPresfActAdjFrame --> 0x1.");
  debugger_readVariable("uint8", "cil_stPresfActAdjFrame,,app.elf", "0");
  ExpectedTestResult(debugger_result, "0x1", "0x1");
  
  //====================================================
  testCaseComment("Postcondition");
  testStep("STEP", "Return ECU to default values");
  
  debugger_deleteAllBreakpoints();
  
  RunPostTs(); 
  
  debugger_stop();
}

testcase SW_IT_CIL_SBeltTens_SP_Lvl_Pr5_ST3_01()
{
  //***********************************Test report header*********************************
  testReportAddMiscInfoBlock("AUTOLIV ELECTRONICS document");
  TestReportAddMiscInfo("Nightly test", "No");
  TestReportAddMiscInfo("Test type", "Requirement-Based test");
  TestReportAddMiscInfo("Regression Test", "No");
  TestReportAddMiscInfo("Fault injection method used", "No");
  TestReportAddMiscInfo("Resource usage evaluation", "No");
  TestReportAddMiscInfo("Priority", "No");
  TestReportAddMiscInfo("Safety relevant", "No");
  
  AddRequirementInfo("Requirement under test", "ARCH_SW_CIL_0405");
  AddRequirementInfo("ARCH_SW_CIL_0405", "This function shall be called by Com when the signal group for API is received on Can.");
  //***************************************************************************************
    
  testCaseComment("Preconditions");
  testStep("STEP", "Bench Initialization");

  debugger_deleteAllBreakpoints();
  debugger_reset();
  debugger_run();

  RunPreTs();
  //====================================================
  
  testStep("STEP", "Start Development Session."); 
  AuthenticateECU(2); // Development_Enhanced
  EnterDiagnosticSession("development");
    
  testStep("STEP", "Set signal RBTMFL_SP_Lvl_Rq_ST35 to 0x1.");
  setSignal(BODY3::RBTMFL_SP_Lvl_Rq_ST35, 1);
  testWaitForTimeout(1000);
  
  testStep("STEP", "Set a breakpoint in function CIL_ComNotification_SBeltTens_SP_Lvl_Pr5_ST3_4tqpkri37441o5ht9g9ekmyzh_4719328f_Rx.");
  debugger_setRelativeFunctionBpAtLine("CIL_ComNotification_SBeltTens_SP_Lvl_Pr5_ST3_4tqpkri37441o5ht9g9ekmyzh_4719328f_Rx", "4");
  
  testCaseComment("Action: ARCH_SW_CIL_0405");
  testStep("STEP", "Check if CPU stopped in function CIL_ComNotification_SBeltTens_SP_Lvl_Pr5_ST3_4tqpkri37441o5ht9g9ekmyzh_4719328f_Rx --> CPU stopped at BP");
  debugger_waitUntilBPisReached("1000");
  ExpectedTestResult(debugger_result,IS_CPU_STOP_AT_BP_SUCCESFUL, "CPU stopped at BP");
  
  //====================================================
  testCaseComment("Postcondition");
  testStep("STEP", "Return ECU to default values");
  
  debugger_deleteAllBreakpoints();
  
  RunPostTs(); 
  
  debugger_stop();
}

testcase SW_IT_CIL_PT4_PTCoor4_Pr5_ST3_01()
{
  //***********************************Test report header*********************************
  testReportAddMiscInfoBlock("AUTOLIV ELECTRONICS document");
  TestReportAddMiscInfo("Nightly test", "No");
  TestReportAddMiscInfo("Test type", "Requirement-Based test");
  TestReportAddMiscInfo("Regression Test", "No");
  TestReportAddMiscInfo("Fault injection method used", "No");
  TestReportAddMiscInfo("Resource usage evaluation", "No");
  TestReportAddMiscInfo("Priority", "No");
  TestReportAddMiscInfo("Safety relevant", "No");
  
  AddRequirementInfo("Requirement under test", "ARCH_SW_CIL_0406");
  AddRequirementInfo("ARCH_SW_CIL_0406", "This function shall be called by Com when the signal group for PT Coor 4 is received on Can.");
  //***************************************************************************************
    
  testCaseComment("Preconditions");
  testStep("STEP", "Bench Initialization");

  debugger_deleteAllBreakpoints();
  debugger_reset();
  debugger_run();

  RunPreTs();
  //====================================================
  
  testStep("STEP", "Start Development Session."); 
  AuthenticateECU(2); // Development_Enhanced
  EnterDiagnosticSession("development");
    
  testStep("STEP", "Set signal PT4_PTCoor_PT_Rdy_ST3 to 0x1.");
  setSignal(BODY3::PT4_PTCoor_PT_Rdy_ST3, 1);
  testWaitForTimeout(1000);
  
  testStep("STEP", "Set a breakpoint in function CIL_ComNotification_PT4_PTCoor4_Pr5_ST3_af4fxb1ykieox3itqdfzs0kpb_2277a854_Rx.");
  debugger_setRelativeFunctionBpAtLine("CIL_ComNotification_PT4_PTCoor4_Pr5_ST3_af4fxb1ykieox3itqdfzs0kpb_2277a854_Rx", "0");
  
  testCaseComment("Action: ARCH_SW_CIL_0406");
  testStep("STEP", "Read variable cil_stPTCoor4Pr5St3 --> 0x1.");
  debugger_readVariable("uint8", "cil_stPTCoor4Pr5St3,,app.elf", "0");
  ExpectedTestResult(debugger_result, "0x1", "0x1");
  
  //====================================================
  testCaseComment("Postcondition");
  testStep("STEP", "Return ECU to default values");
  
  debugger_deleteAllBreakpoints();
  
  RunPostTs(); 
  
  debugger_stop();
}

testcase SW_IT_CIL_BeltHdOvr_FR_Stat_ST3_01()
{
  //***********************************Test report header*********************************
  testReportAddMiscInfoBlock("AUTOLIV ELECTRONICS document");
  TestReportAddMiscInfo("Nightly test", "No");
  TestReportAddMiscInfo("Test type", "Requirement-Based test");
  TestReportAddMiscInfo("Regression Test", "No");
  TestReportAddMiscInfo("Fault injection method used", "No");
  TestReportAddMiscInfo("Resource usage evaluation", "No");
  TestReportAddMiscInfo("Priority", "No");
  TestReportAddMiscInfo("Safety relevant", "No");
  
  AddRequirementInfo("Requirement under test", "ARCH_SW_CIL_0407");
  AddRequirementInfo("ARCH_SW_CIL_0407", "This function shall be called by Com when the signal for Belt Handover Stat Front Right is received on Can.");
  //***************************************************************************************
    
  testCaseComment("Preconditions");
  testStep("STEP", "Bench Initialization");

  debugger_deleteAllBreakpoints();
  debugger_reset();
  debugger_run();

  RunPreTs();
  //====================================================
  
  testStep("STEP", "Start Development Session."); 
  AuthenticateECU(2); // Development_Enhanced
  EnterDiagnosticSession("development");
    
  testStep("STEP", "Set signal BeltHdOvr_FR_Stat_ST3 to 0x1.");
  setSignal(BODY3::BeltHdOvr_FR_State_ST3::BeltHdOvr_FR_Stat_ST3, 1);
  testWaitForTimeout(1000);
  
  testStep("STEP", "Set a breakpoint in function Rte_Read_CIL_AC_CommunicationInteractionLayer_R_BeltHdOvr_XX_Stat_ST3_BeltHdOvr_XX_Stat_ST3.");
  debugger_setRelativeFunctionBpAtLine("Rte_Read_CIL_AC_CommunicationInteractionLayer_R_BeltHdOvr_XX_Stat_ST3_BeltHdOvr_XX_Stat_ST3", "0");
  
  testCaseComment("Action: ARCH_SW_CIL_0407");
  testStep("STEP", "Check if CPU stopped in function Rte_Read_CIL_AC_CommunicationInteractionLayer_R_BeltHdOvr_XX_Stat_ST3_BeltHdOvr_XX_Stat_ST3. --> CPU stopped at BP");
  debugger_waitUntilBPisReached("1000");
  ExpectedTestResult(debugger_result,IS_CPU_STOP_AT_BP_SUCCESFUL, "CPU stopped at BP");
  
  //====================================================
  testCaseComment("Postcondition");
  testStep("STEP", "Return ECU to default values");
  
  debugger_deleteAllBreakpoints();
  
  RunPostTs(); 
  
  debugger_stop();
}

testcase SW_IT_CIL_BeltHdOvr_FL_Stat_ST3_01()
{
  //***********************************Test report header*********************************
  testReportAddMiscInfoBlock("AUTOLIV ELECTRONICS document");
  TestReportAddMiscInfo("Nightly test", "No");
  TestReportAddMiscInfo("Test type", "Requirement-Based test");
  TestReportAddMiscInfo("Regression Test", "No");
  TestReportAddMiscInfo("Fault injection method used", "No");
  TestReportAddMiscInfo("Resource usage evaluation", "No");
  TestReportAddMiscInfo("Priority", "No");
  TestReportAddMiscInfo("Safety relevant", "No");
  
  AddRequirementInfo("Requirement under test", "ARCH_SW_CIL_0408");
  AddRequirementInfo("ARCH_SW_CIL_0408", "This function shall be called by Com when the signal for Belt Handover Stat Front Left is received on Can.");
  //***************************************************************************************
    
  testCaseComment("Preconditions");
  testStep("STEP", "Bench Initialization");

  debugger_deleteAllBreakpoints();
  debugger_reset();
  debugger_run();

  RunPreTs();
  //====================================================
  
  testStep("STEP", "Start Development Session."); 
  AuthenticateECU(2); // Development_Enhanced
  EnterDiagnosticSession("development");
    
  testStep("STEP", "Set signal BeltHdOvr_FL_Stat_ST3 to 0x1.");
  setSignal(BODY3::BeltHdOvr_FL_State_ST3::BeltHdOvr_FL_Stat_ST3, 1);
  testWaitForTimeout(1000);
  
  testStep("STEP", "Set a breakpoint in function CIL_ComNotification_BeltHdOvr_FL_Stat_ST3_3489841d_Rx.");
  debugger_setRelativeFunctionBpAtLine("CIL_ComNotification_BeltHdOvr_FL_Stat_ST3_3489841d_Rx", "4");
  
  testCaseComment("Action: ARCH_SW_CIL_0408");
  testStep("STEP", "Read variable cil_u8BeltHandover --> 0x1.");
  debugger_readVariable("uint8", "cil_u8BeltHandover,,app.elf", "0");
  ExpectedTestResult(debugger_result, "0x1", "0x1");
  
  //====================================================
  testCaseComment("Postcondition");
  testStep("STEP", "Return ECU to default values");
  
  debugger_deleteAllBreakpoints();
  
  RunPostTs(); 
  
  debugger_stop();
}

testcase SW_IT_CIL_EVC_CfgList_01_08_Pr5_ST3_02()
{
  //***********************************Test report header*********************************
  testReportAddMiscInfoBlock("AUTOLIV ELECTRONICS document");
  TestReportAddMiscInfo("Nightly test", "No");
  TestReportAddMiscInfo("Test type", "Requirement-Based test");
  TestReportAddMiscInfo("Regression Test", "No");
  TestReportAddMiscInfo("Fault injection method used", "No");
  TestReportAddMiscInfo("Resource usage evaluation", "No");
  TestReportAddMiscInfo("Priority", "No");
  TestReportAddMiscInfo("Safety relevant", "No");
  
  AddRequirementInfo("Requirement under test", "ARCH_SW_CIL_0409");
  AddRequirementInfo("ARCH_SW_CIL_0409", "This function shall be called by Com when the signal group for EVC Config List 01-08 is received on Can.");
  //***************************************************************************************
    
  testCaseComment("Preconditions");
  testStep("STEP", "Bench Initialization");

  debugger_deleteAllBreakpoints();
  debugger_reset();
  debugger_run();

  RunPreTs();
  //====================================================
  
  testStep("STEP", "Start Development Session."); 
  AuthenticateECU(2); // Development_Enhanced
  EnterDiagnosticSession("development");
    
  testStep("STEP", "Set signal EVC_CfgList_01_08_Stat_ST3 to 0x1.");
  setSignal(BODY3::EVC_CfgList_01_08_Stat_ST3, 1);
  testWaitForTimeout(1000);
  
  testStep("STEP", "Set a breakpoint in function CIL_ComNotification_EVC_CfgList_01_08_Pr5_ST3_co3q1mwsf7pwxo2ix5jryc04x_3a43a00a_Rx.");
  debugger_setRelativeFunctionBpAtLine("CIL_ComNotification_EVC_CfgList_01_08_Pr5_ST3_co3q1mwsf7pwxo2ix5jryc04x_3a43a00a_Rx", "4");
  
  testCaseComment("Action: ARCH_SW_CIL_0409");
  testStep("STEP", "Read variable cil_evcCfgList0108 --> 0x1.");
  debugger_readVariable("uint8", "cil_evcCfgList0108,,app.elf", "0");
  ExpectedTestResult(debugger_result, "0x1", "0x1");
  
  //====================================================
  testCaseComment("Postcondition");
  testStep("STEP", "Return ECU to default values");
  
  debugger_deleteAllBreakpoints();
  
  RunPostTs(); 
  
  debugger_stop();
}

testcase SW_IT_CIL_TriggerProfiles_01()
{
  //***********************************Test report header*********************************
  testReportAddMiscInfoBlock("AUTOLIV ELECTRONICS document");
  TestReportAddMiscInfo("Nightly test", "No");
  TestReportAddMiscInfo("Test type", "Requirement-Based test");
  TestReportAddMiscInfo("Regression Test", "No");
  TestReportAddMiscInfo("Fault injection method used", "No");
  TestReportAddMiscInfo("Resource usage evaluation", "No");
  TestReportAddMiscInfo("Priority", "No");
  TestReportAddMiscInfo("Safety relevant", "No");
  
  AddRequirementInfo("Requirement under test", "ARCH_SW_CIL_0001, ARCH_SW_CIL_0002, ARCH_SW_CIL_0003, ARCH_SW_CIL_0022, ARCH_SW_CIL_0052, ARCH_SW_CIL_0059");
  AddRequirementInfo("ARCH_SW_CIL_0022", "If signal is received with value 1, then tensioning cycle 0 shall be requested.");
  AddRequirementInfo("ARCH_SW_CIL_0052", "If signal is received with value 1, then tensioning cycle 0 shall be requested.");
  AddRequirementInfo("ARCH_SW_CIL_0059", "If signal is received with value 1, then tensioning cycle 0 shall be requested.");
  AddRequirementInfo("ARCH_SW_CIL_0001", "Frame PresfAct_Adj_ST3 shall be manipulated to read all it’s signals and send the values through application.");
  AddRequirementInfo("ARCH_SW_CIL_0002", "Signal Presf_Lvl_ST3 shall be send though application when it’s needed.");
  //***************************************************************************************
    
  testCaseComment("Preconditions");
  testStep("STEP", "Bench Initialization");

  debugger_deleteAllBreakpoints();
  debugger_reset();
  debugger_run();

  RunPreTs();
  //====================================================
  
  testStep("STEP", "Start Development Session."); 
  AuthenticateECU(2); // Development_Enhanced
  EnterDiagnosticSession("development");
  
  testStep("STEP", "Set signal Presf_Lvl_ST3 to I_C04_PRESF_LVL_V2_LVL1 (0x1).");
  setSignal(BODY3::Presf_Lvl_ST3, I_C04_PRESF_LVL_V2_LVL1);
  testWaitForTimeout(500);
  
  testStep("STEP", "Set a breakpoint in function CIL_runCANToAppli at line cil_TriggerProfiles(CIL_stManagedCycle.u8CurrentRequestedCycle);.");
  debugger_setRelativeFunctionBpAtLine("CIL_runCANToAppli", "308");
  
  debugger_deleteAllBreakpoints();
  debugger_run();
  
  testStep("STEP", "Set a breakpoint in function cil_TriggerProfiles.");
  debugger_setRelativeFunctionBpAtLine("cil_TriggerProfiles", "93"); //154 ()
  
  testStep("STEP", "Set a breakpoint at the end of the function cil_RequestTensioning.");
  debugger_setBpAtLine("s:\\Components\\Application\\Autoliv\\CIL\\Implementation\\src\\CIL_CANToAppli.c", "1452");
  
  debugger_run();
  
  testCaseComment("Action: ARCH_SW_CIL_0022, ARCH_SW_CIL_0001, ARCH_SW_CIL_0002, ARCH_SW_CIL_0003");
  testStep("STEP", "Check if CPU stopped in function cil_RequestTensioning. --> CPU stopped at BP");
  debugger_waitUntilBPisReached("1000");
  ExpectedTestResult(debugger_result,IS_CPU_STOP_AT_BP_SUCCESFUL, "CPU stopped at BP");
    
  debugger_deleteAllBreakpoints();
  debugger_reset();
  debugger_run();
  
  testCaseComment("Action: ARCH_SW_CIL_0022, ARCH_SW_CIL_0052, ARCH_SW_CIL_0059");
  testStep("STEP", "Check if variable Rte_CIL_prrCrashSeverityLevel_u8PreCrashSeverityLevel is KU8_PRECRASH_SEVERITY_LEVEL_1 --> KU8_PRECRASH_SEVERITY_LEVEL_1.");
  debugger_readVariable("uint8", "Rte_CIL_prrCrashSeverityLevel_u8PreCrashSeverityLevel", "0");
  ExpectedTestResult(debugger_result, "0xff", "KU8_PRECRASH_SEVERITY_LEVEL_1");
  
  //====================================================
  testCaseComment("Postcondition");
  testStep("STEP", "Return ECU to default values");
  
  debugger_deleteAllBreakpoints();
  setSignal(BODY3::Presf_Lvl_ST3, I_C04_PRESF_LVL_V2_NOLVL);
  RunPostTs(); 
  
  debugger_stop();
}

testcase SW_IT_CIL_TriggerProfiles_02()
{
  //***********************************Test report header*********************************
  testReportAddMiscInfoBlock("AUTOLIV ELECTRONICS document");
  TestReportAddMiscInfo("Nightly test", "No");
  TestReportAddMiscInfo("Test type", "Requirement-Based test");
  TestReportAddMiscInfo("Regression Test", "No");
  TestReportAddMiscInfo("Fault injection method used", "No");
  TestReportAddMiscInfo("Resource usage evaluation", "No");
  TestReportAddMiscInfo("Priority", "No");
  TestReportAddMiscInfo("Safety relevant", "No");
  
  AddRequirementInfo("Requirement under test", "ARCH_SW_CIL_0023, ARCH_SW_CIL_0060, ARCH_SW_CIL_0300, ARCH_SW_CIL_0053, ARCH_SW_CIL_0113");
  AddRequirementInfo("ARCH_SW_CIL_0023", "If signal is received with value 2, then cycle 18,19(HWA) shall be requested.");
  AddRequirementInfo("ARCH_SW_CIL_0060", "If signal is received with value 2, then cycle 18(HWA) shall be requested.");
  //***************************************************************************************
    
  testCaseComment("Preconditions");
  testStep("STEP", "Bench Initialization");

  debugger_deleteAllBreakpoints();
  debugger_reset();
  debugger_run();

  RunPreTs();
  //====================================================

  testStep("STEP", "Start Development Session."); 
  AuthenticateECU(2); // Development_Enhanced
  EnterDiagnosticSession("development");
  
  testStep("STEP", "Set signal Presf_Lvl_ST3 to I_C04_PRESF_LVL_V2_LVL2 (0x2).");
  setSignal(BODY3::Presf_Lvl_ST3, I_C04_PRESF_LVL_V2_LVL2);
  testWaitForTimeout(500);
  
  testStep("STEP", "Set a breakpoint in the function cil_RequestTensioning at line Rte_Read_prrEnableCycle18_b8CycleValidity(&u8CycleValidityStatus);.");
  debugger_setRelativeFunctionBpAtLine("cil_TriggerProfiles", "114");
  
  testCaseComment("Action: ARCH_SW_CIL_0023, ARCH_SW_CIL_0060, ARCH_SW_CIL_0300, ARCH_SW_CIL_0053, ARCH_SW_CIL_0113");
  testStep("STEP", "Check if CPU stopped at Rte_Read_prrEnableCycle18_b8CycleValidity(&u8CycleValidityStatus). --> CPU stopped at BP");
  debugger_waitUntilBPisReached("1000");
//  ExpectedTestResult(debugger_result,IS_CPU_STOP_AT_BP_SUCCESFUL, "CPU stopped at BP");
  
  //====================================================
  testCaseComment("Postcondition");
  testStep("STEP", "Return ECU to default values");
  
  debugger_deleteAllBreakpoints();
  setSignal(BODY3::Presf_Lvl_ST3, I_C04_PRESF_LVL_V2_NOLVL);
  RunPostTs(); 
  
  debugger_stop();
}

testcase SW_IT_CIL_TriggerProfiles_03()
{
  //***********************************Test report header*********************************
  testReportAddMiscInfoBlock("AUTOLIV ELECTRONICS document");
  TestReportAddMiscInfo("Nightly test", "No");
  TestReportAddMiscInfo("Test type", "Requirement-Based test");
  TestReportAddMiscInfo("Regression Test", "No");
  TestReportAddMiscInfo("Fault injection method used", "No");
  TestReportAddMiscInfo("Resource usage evaluation", "No");
  TestReportAddMiscInfo("Priority", "No");
  TestReportAddMiscInfo("Safety relevant", "No");
  
  AddRequirementInfo("Requirement under test", "ARCH_SW_CIL_0042, ARCH_SW_CIL_0061, ARCH_SW_CIL_0054, ARCH_SW_CIL_0189");
  AddRequirementInfo("ARCH_SW_CIL_0042", "If signal is received with value 3, then tensioning cycle 1 shall be requested.");
  AddRequirementInfo("ARCH_SW_CIL_0061", "If signal is received with value 3, then tensioning cycle 1 shall be requested.");
  //***************************************************************************************
    
  testCaseComment("Preconditions");
  testStep("STEP", "Bench Initialization");

  debugger_deleteAllBreakpoints();
  debugger_reset();
  debugger_run();

  RunPreTs();
  //====================================================
  
  testStep("STEP", "Start Development Session."); 
  AuthenticateECU(2); // Development_Enhanced
  EnterDiagnosticSession("development");
  
  testStep("STEP", "Set signal Presf_Lvl_ST3 to I_C04_PRESF_LVL_V2_LVL3 (0x3).");
  setSignal(BODY3::Presf_Lvl_ST3, I_C04_PRESF_LVL_V2_LVL3);
  testWaitForTimeout(1000);
  
  testStep("STEP", "Set a breakpoint in function CIL_runCANToAppli at line cil_TriggerProfiles(CIL_stManagedCycle.u8CurrentRequestedCycle);.");
  debugger_setRelativeFunctionBpAtLine("CIL_runCANToAppli", "308");
  
  debugger_deleteAllBreakpoints();
  debugger_run();
  
  testStep("STEP", "Set a breakpoint in function cil_TriggerProfiles at line cil_RequestTensioning(KU8_PRECRASH_SEVERITY_LEVEL_2);.");
  debugger_setRelativeFunctionBpAtLine("cil_TriggerProfiles", "154");
  
  testStep("STEP", "Set a breakpoint at the end of the function cil_RequestTensioning.");
  debugger_setBpAtLine("s:\\Components\\Application\\Autoliv\\CIL\\Implementation\\src\\CIL_CANToAppli.c", "1452");
  
  debugger_run();
  
  testCaseComment("Action: ARCH_SW_CIL_0042, ARCH_SW_CIL_0189");
  testStep("STEP", "Check if CPU stopped in function cil_RequestTensioning. --> CPU stopped at BP");
  debugger_waitUntilBPisReached("1000");
//  ExpectedTestResult(debugger_result,IS_CPU_STOP_AT_BP_SUCCESFUL, "CPU stopped at BP");
  
  debugger_deleteAllBreakpoints();
  debugger_reset();
  debugger_run();
  
  testCaseComment("Action: ARCH_SW_CIL_0042, ARCH_SW_CIL_0061, ARCH_SW_CIL_0054");
  testStep("STEP", "Check if variable Rte_CIL_prrCrashSeverityLevel_u8PreCrashSeverityLevel is KU8_PRECRASH_SEVERITY_LEVEL_2 --> KU8_PRECRASH_SEVERITY_LEVEL_2.");
  debugger_readVariable("uint8", "Rte_CIL_prrCrashSeverityLevel_u8PreCrashSeverityLevel", "0");
  ExpectedTestResult(debugger_result, "0xff", "0x1");
  
  //====================================================
  testCaseComment("Postcondition");
  testStep("STEP", "Return ECU to default values");
  
  debugger_deleteAllBreakpoints();
  setSignal(BODY3::Presf_Lvl_ST3, I_C04_PRESF_LVL_V2_NOLVL);
  RunPostTs(); 
  
  debugger_stop();
}


testcase SW_IT_CIL_TriggerProfiles_04()
{
  //***********************************Test report header*********************************
  testReportAddMiscInfoBlock("AUTOLIV ELECTRONICS document");
  TestReportAddMiscInfo("Nightly test", "No");
  TestReportAddMiscInfo("Test type", "Requirement-Based test");
  TestReportAddMiscInfo("Regression Test", "No");
  TestReportAddMiscInfo("Fault injection method used", "No");
  TestReportAddMiscInfo("Resource usage evaluation", "No");
  TestReportAddMiscInfo("Priority", "No");
  TestReportAddMiscInfo("Safety relevant", "No");
  
  AddRequirementInfo("Requirement under test", "ARCH_SW_CIL_0043, ARCH_SW_CIL_0062, ARCH_SW_CIL_0055");
  AddRequirementInfo("ARCH_SW_CIL_0043", "If signal is received with value 4, then tensioning cycle 2 shall be requested.");
  AddRequirementInfo("ARCH_SW_CIL_0062", "If signal is received with value 4, then tensioning cycle 2 shall be requested.");
  //***************************************************************************************
    
  testCaseComment("Preconditions");
  testStep("STEP", "Bench Initialization");

  debugger_deleteAllBreakpoints();
  debugger_reset();
  debugger_run();

  RunPreTs();
  //====================================================
  
  testStep("STEP", "Start Development Session."); 
  AuthenticateECU(2); // Development_Enhanced
  EnterDiagnosticSession("development");
  
  testStep("STEP", "Set signal Presf_Lvl_ST3 to I_C04_PRESF_LVL_V2_LVL4 (0x4).");
  setSignal(BODY3::Presf_Lvl_ST3, I_C04_PRESF_LVL_V2_LVL4);
  testWaitForTimeout(500);
  
  testStep("STEP", "Set a breakpoint in function CIL_runCANToAppli at line cil_TriggerProfiles(CIL_stManagedCycle.u8CurrentRequestedCycle);.");
  debugger_setRelativeFunctionBpAtLine("CIL_runCANToAppli", "308");
  
  debugger_deleteAllBreakpoints();
  debugger_run();
  
  testStep("STEP", "Set a breakpoint in function cil_TriggerProfiles at line (void)Rte_Read_prrEnableCycle18_b8CycleValidity(&u8CycleValidityStatus);.");
  debugger_setRelativeFunctionBpAtLine("cil_TriggerProfiles", "169"); // for cil_RequestTensioning(KU8_PRECRASH_SEVERITY_LEVEL_3); bp should be set at 1678
  
  testStep("STEP", "Set a breakpoint at the end of the function cil_RequestTensioning.");
  debugger_setBpAtLine("s:\\Components\\Application\\Autoliv\\CIL\\Implementation\\src\\CIL_CANToAppli.c", "1452"); 
  
  debugger_run();
  
  testCaseComment("Action: ARCH_SW_CIL_0043, ARCH_SW_CIL_0055");
  testStep("STEP", "Check if CPU stopped in function cil_RequestTensioning. --> CPU stopped at BP");
  debugger_waitUntilBPisReached("1000");
//  ExpectedTestResult(debugger_result,IS_CPU_STOP_AT_BP_SUCCESFUL, "CPU stopped at BP");
  
  debugger_deleteAllBreakpoints();
  debugger_reset();
  debugger_run();
  
  testCaseComment("Action: ARCH_SW_CIL_0043, ARCH_SW_CIL_0062");
  testStep("STEP", "Check if variable Rte_CIL_prrCrashSeverityLevel_u8PreCrashSeverityLevel is KU8_PRECRASH_SEVERITY_LEVEL_3 --> KU8_PRECRASH_SEVERITY_LEVEL_3.");
  debugger_readVariable("uint8", "Rte_CIL_prrCrashSeverityLevel_u8PreCrashSeverityLevel", "0");
  ExpectedTestResult(debugger_result, "0xff", "0x2");

  //====================================================
  testCaseComment("Postcondition");
  testStep("STEP", "Return ECU to default values");
  
  debugger_deleteAllBreakpoints();
  setSignal(BODY3::Presf_Lvl_ST3, I_C04_PRESF_LVL_V2_NOLVL);
  RunPostTs(); 
  
  debugger_stop();
}

testcase SW_IT_CIL_TriggerProfiles_05()
{
  //***********************************Test report header*********************************
  testReportAddMiscInfoBlock("AUTOLIV ELECTRONICS document");
  TestReportAddMiscInfo("Nightly test", "No");
  TestReportAddMiscInfo("Test type", "Requirement-Based test");
  TestReportAddMiscInfo("Regression Test", "No");
  TestReportAddMiscInfo("Fault injection method used", "No");
  TestReportAddMiscInfo("Resource usage evaluation", "No");
  TestReportAddMiscInfo("Priority", "No");
  TestReportAddMiscInfo("Safety relevant", "No");
  
  AddRequirementInfo("Requirement under test", "ARCH_SW_CIL_0044, ARCH_SW_CIL_0063, ARCH_SW_CIL_0079, ARCH_SW_CIL_0056");
  AddRequirementInfo("ARCH_SW_CIL_0044", "If signal is received with value 5, then tensioning cycle 3 shall be requested.");
  AddRequirementInfo("ARCH_SW_CIL_0063", "If signal is received with value 5, then tensioning cycle 3 shall be requested.");
  AddRequirementInfo("ARCH_SW_CIL_0079", "If any cycle is requested on Presf Lvl ST3 signal any API_interface request will be inhibited.");
  //***************************************************************************************
    
  testCaseComment("Preconditions");
  testStep("STEP", "Bench Initialization");

  debugger_deleteAllBreakpoints();
  debugger_reset();
  debugger_run();
  
  RunPreTs();
  //====================================================
  
  testStep("STEP", "Start Development Session."); 
  AuthenticateECU(2); // Development_Enhanced
  EnterDiagnosticSession("development");
  
  testStep("STEP", "Set signal Presf_Lvl_ST3 to I_C04_PRESF_LVL_V2_LVL5 (0x5).");
  setSignal(BODY3::Presf_Lvl_ST3, I_C04_PRESF_LVL_V2_LVL5);
  testWaitForTimeout(500);
  
  testStep("STEP", "Set a breakpoint in function CIL_runCANToAppli at line cil_TriggerProfiles(CIL_stManagedCycle.u8CurrentRequestedCycle);.");
  debugger_setRelativeFunctionBpAtLine("CIL_runCANToAppli", "308");
  
  debugger_deleteAllBreakpoints();
  debugger_run();
  
  testStep("STEP", "Set a breakpoint in function cil_TriggerProfiles at line (void)Rte_Read_prrEnableCycle3_b8CycleValidity(&u8CycleValidityStatus);.");
  debugger_setRelativeFunctionBpAtLine("cil_TriggerProfiles", "191");
  
  testStep("STEP", "Set a breakpoint at the end of the function cil_RequestTensioning.");
  debugger_setBpAtLine("s:\\Components\\Application\\Autoliv\\CIL\\Implementation\\src\\CIL_CANToAppli.c", "1452"); 
  
  debugger_run();
  
  testCaseComment("Action: ARCH_SW_CIL_0044, ARCH_SW_CIL_0079");
  testStep("STEP", "Check if CPU stopped in function cil_RequestTensioning. --> CPU stopped at BP");
  debugger_waitUntilBPisReached("1000");
//  ExpectedTestResult(debugger_result,IS_CPU_STOP_AT_BP_SUCCESFUL, "CPU stopped at BP");
  
  debugger_deleteAllBreakpoints();
  debugger_reset();
  debugger_run();
  
  testCaseComment("Action: ARCH_SW_CIL_0044, ARCH_SW_CIL_0063, ARCH_SW_CIL_0056");
  testStep("STEP", "Check if variable Rte_CIL_prrCrashSeverityLevel_u8PreCrashSeverityLevel is KU8_PRECRASH_SEVERITY_LEVEL_4 --> KU8_PRECRASH_SEVERITY_LEVEL_4.");
  debugger_readVariable("uint8", "Rte_CIL_prrCrashSeverityLevel_u8PreCrashSeverityLevel", "0");
  ExpectedTestResult(debugger_result, "0xff", "0x3");
  
  //====================================================
  testCaseComment("Postcondition");
  testStep("STEP", "Return ECU to default values");
  
  debugger_deleteAllBreakpoints();
  setSignal(BODY3::Presf_Lvl_ST3, I_C04_PRESF_LVL_V2_NOLVL);
  RunPostTs(); 
  
  debugger_stop();
}


testcase SW_IT_CIL_TriggerProfiles_06()
{
  //***********************************Test report header*********************************
  testReportAddMiscInfoBlock("AUTOLIV ELECTRONICS document");
  TestReportAddMiscInfo("Nightly test", "No");
  TestReportAddMiscInfo("Test type", "Requirement-Based test");
  TestReportAddMiscInfo("Regression Test", "No");
  TestReportAddMiscInfo("Fault injection method used", "No");
  TestReportAddMiscInfo("Resource usage evaluation", "No");
  TestReportAddMiscInfo("Priority", "No");
  TestReportAddMiscInfo("Safety relevant", "No");
  
  AddRequirementInfo("Requirement under test", "ARCH_SW_CIL_0119, ARCH_SW_CIL_0137, ARCH_SW_CIL_0124");
  AddRequirementInfo("ARCH_SW_CIL_0119", "If signal is received with value 6, then tensioning cycle 4 shall be requested.");
  AddRequirementInfo("ARCH_SW_CIL_0137", "If signal is received with value 6, then tensioning cycle 4 shall be requested.");
  //***************************************************************************************
    
  testCaseComment("Preconditions");
  testStep("STEP", "Bench Initialization");

  debugger_deleteAllBreakpoints();
  debugger_reset();
  debugger_run();
  
  RunPreTs();
  //====================================================
  
  testStep("STEP", "Start Development Session."); 
  AuthenticateECU(2); // Development_Enhanced
  EnterDiagnosticSession("development");
  
  testStep("STEP", "Set signal Presf_Lvl_ST3 to I_C04_PRESF_LVL_V2_LVL6 (0x6).");
  setSignal(BODY3::Presf_Lvl_ST3, I_C04_PRESF_LVL_V2_LVL6);
  testWaitForTimeout(500);
  
  testStep("STEP", "Set a breakpoint in function CIL_runCANToAppli at line cil_TriggerProfiles(CIL_stManagedCycle.u8CurrentRequestedCycle);.");
  debugger_setRelativeFunctionBpAtLine("CIL_runCANToAppli", "308");
  
  debugger_deleteAllBreakpoints();
  debugger_run();
  
  testStep("STEP", "Set a breakpoint in function cil_TriggerProfiles at line if( (KU8_TRUE == u8CycleValidityStatus) &&.");
  debugger_setRelativeFunctionBpAtLine("cil_TriggerProfiles", "213");
  
  testStep("STEP", "Set a breakpoint at the end of the function cil_RequestTensioning.");
  debugger_setBpAtLine("s:\\Components\\Application\\Autoliv\\CIL\\Implementation\\src\\CIL_CANToAppli.c", "1452"); 
  
  debugger_run();
  
  testCaseComment("Action: ARCH_SW_CIL_0119, ARCH_SW_CIL_0124");
  testStep("STEP", "Check if CPU stopped in function cil_RequestTensioning. --> CPU stopped at BP");
  debugger_waitUntilBPisReached("1000");
//  ExpectedTestResult(debugger_result,IS_CPU_STOP_AT_BP_SUCCESFUL, "CPU stopped at BP");
  
  debugger_deleteAllBreakpoints();
  debugger_reset();
  debugger_run();
  
  testCaseComment("Action: ARCH_SW_CIL_0119, ARCH_SW_CIL_0137");
  testStep("STEP", "Check if variable Rte_CIL_prrCrashSeverityLevel_u8PreCrashSeverityLevel is KU8_PRECRASH_SEVERITY_LEVEL_5 --> KU8_PRECRASH_SEVERITY_LEVEL_5.");
  debugger_readVariable("uint8", "Rte_CIL_prrCrashSeverityLevel_u8PreCrashSeverityLevel", "0");
  ExpectedTestResult(debugger_result, "0xff", "0x4");
  
  
  //====================================================
  testCaseComment("Postcondition");
  testStep("STEP", "Return ECU to default values");
  
  debugger_deleteAllBreakpoints();
  setSignal(BODY3::Presf_Lvl_ST3, I_C04_PRESF_LVL_V2_NOLVL);
  RunPostTs(); 
  
  debugger_stop();
}

testcase SW_IT_CIL_TriggerProfiles_07()
{
  //***********************************Test report header*********************************
  testReportAddMiscInfoBlock("AUTOLIV ELECTRONICS document");
  TestReportAddMiscInfo("Nightly test", "No");
  TestReportAddMiscInfo("Test type", "Requirement-Based test");
  TestReportAddMiscInfo("Regression Test", "No");
  TestReportAddMiscInfo("Fault injection method used", "No");
  TestReportAddMiscInfo("Resource usage evaluation", "No");
  TestReportAddMiscInfo("Priority", "No");
  TestReportAddMiscInfo("Safety relevant", "No");
  
  AddRequirementInfo("Requirement under test", "ARCH_SW_CIL_0120, ARCH_SW_CIL_0125, ARCH_SW_CIL_0138, ARCH_SW_CIL_0352");
  AddRequirementInfo("ARCH_SW_CIL_0120", "If signal is received with value 7, then tensioning cycle 5 shall be requested.");
  AddRequirementInfo("ARCH_SW_CIL_0138", "If signal is received with value 7, then tensioning cycle 5 shall be requested.");
  AddRequirementInfo("ARCH_SW_CIL_0352", "Write Rte_CIL_prrCrashSeverityLevel_u8PreCrashSeverityLevel to determine the tensioning cycle requested.");
  //***************************************************************************************
    
  testCaseComment("Preconditions");
  testStep("STEP", "Bench Initialization");

  debugger_deleteAllBreakpoints();
  debugger_reset();
  debugger_run();
  
  RunPreTs();
  //====================================================
  
  testStep("STEP", "Start Development Session."); 
  AuthenticateECU(2); // Development_Enhanced
  EnterDiagnosticSession("development");
  
  testStep("STEP", "Set signal Presf_Lvl_ST3 to I_C04_PRESF_LVL_V2_LVL7 (0x7).");
  setSignal(BODY3::Presf_Lvl_ST3, I_C04_PRESF_LVL_V2_LVL7);
  testWaitForTimeout(500);
  
  testStep("STEP", "Set a breakpoint in function CIL_runCANToAppli at line cil_TriggerProfiles(CIL_stManagedCycle.u8CurrentRequestedCycle);.");
  debugger_setRelativeFunctionBpAtLine("CIL_runCANToAppli", "308");
  
  debugger_deleteAllBreakpoints();
  debugger_run();
  
  testStep("STEP", "Set a breakpoint in function cil_TriggerProfiles at line if( (KU8_TRUE == u8CycleValidityStatus) &&.");
  debugger_setRelativeFunctionBpAtLine("cil_TriggerProfiles", "231");
  
  testStep("STEP", "Set a breakpoint at the end of the function cil_RequestTensioning.");
  debugger_setBpAtLine("s:\\Components\\Application\\Autoliv\\CIL\\Implementation\\src\\CIL_CANToAppli.c", "1452"); 
  
  debugger_run();
  
  testCaseComment("Action: ARCH_SW_CIL_0120, ARCH_SW_CIL_0125");
  testStep("STEP", "Check if CPU stopped in function cil_RequestTensioning. --> CPU stopped at BP");
  debugger_waitUntilBPisReached("1000");
//  ExpectedTestResult(debugger_result,IS_CPU_STOP_AT_BP_SUCCESFUL, "CPU stopped at BP");
  
  debugger_deleteAllBreakpoints();
  debugger_reset();
  debugger_run();
  
  testCaseComment("Action: ARCH_SW_CIL_0120, ARCH_SW_CIL_0138, ARCH_SW_CIL_0352");
  testStep("STEP", "Check if variable Rte_CIL_prrCrashSeverityLevel_u8PreCrashSeverityLevel is KU8_PRECRASH_SEVERITY_LEVEL_6 --> KU8_PRECRASH_SEVERITY_LEVEL_6.");
  debugger_readVariable("uint8", "Rte_CIL_prrCrashSeverityLevel_u8PreCrashSeverityLevel", "0");
  ExpectedTestResult(debugger_result, "0xff", "0x5");
  
  //====================================================
  testCaseComment("Postcondition");
  testStep("STEP", "Return ECU to default values");
  
  debugger_deleteAllBreakpoints();
  setSignal(BODY3::Presf_Lvl_ST3, I_C04_PRESF_LVL_V2_NOLVL);  
  RunPostTs(); 
  
  debugger_stop();
}

testcase SW_IT_CIL_TriggerProfiles_08()
{
  //***********************************Test report header*********************************
  testReportAddMiscInfoBlock("AUTOLIV ELECTRONICS document");
  TestReportAddMiscInfo("Nightly test", "No");
  TestReportAddMiscInfo("Test type", "Requirement-Based test");
  TestReportAddMiscInfo("Regression Test", "No");
  TestReportAddMiscInfo("Fault injection method used", "No");
  TestReportAddMiscInfo("Resource usage evaluation", "No");
  TestReportAddMiscInfo("Priority", "No");
  TestReportAddMiscInfo("Safety relevant", "No");
  
  AddRequirementInfo("Requirement under test", "ARCH_SW_CIL_0121, ARCH_SW_CIL_0126, ARCH_SW_CIL_0139");
  AddRequirementInfo("ARCH_SW_CIL_0121", "If signal is received with value 8, then tensioning cycle 6 shall be requested.");
  AddRequirementInfo("ARCH_SW_CIL_0139", "If signal is received with value 8, then tensioning cycle 6 shall be requested.");
  AddRequirementInfo("ARCH_SW_CIL_0353", "Write Rte_CIL_psrCarAcceleration_b8IsCarAccelerationLow to permit the release cycle to be executed.");
  //***************************************************************************************
    
  testCaseComment("Preconditions");
  testStep("STEP", "Bench Initialization");

  debugger_deleteAllBreakpoints();
  debugger_reset();
  debugger_run();
  
  RunPreTs();
  //====================================================
  
  testStep("STEP", "Start Development Session."); 
  AuthenticateECU(2); // Development_Enhanced
  EnterDiagnosticSession("development");
  
  testStep("STEP", "Set signal Presf_Lvl_ST3 to I_C04_PRESF_LVL_V2_LVL8 (0x8).");
  setSignal(BODY3::Presf_Lvl_ST3, I_C04_PRESF_LVL_V2_LVL8);
  testWaitForTimeout(500);
  
  testStep("STEP", "Set a breakpoint in function CIL_runCANToAppli at line cil_TriggerProfiles(CIL_stManagedCycle.u8CurrentRequestedCycle);.");
  debugger_setRelativeFunctionBpAtLine("CIL_runCANToAppli", "308");
  
  debugger_deleteAllBreakpoints();
  debugger_run();
  
  testStep("STEP", "Set a breakpoint in function cil_TriggerProfiles at line (void)Rte_Read_prrEnableCycle6_b8CycleValidity(&u8CycleValidityStatus);.");
  debugger_setRelativeFunctionBpAtLine("cil_TriggerProfiles", "249");
  
  testStep("STEP", "Set a breakpoint at the end of the function cil_RequestTensioning.");
  debugger_setBpAtLine("s:\\Components\\Application\\Autoliv\\CIL\\Implementation\\src\\CIL_CANToAppli.c", "1452"); 
  
  debugger_run();
  
  testCaseComment("Action: ARCH_SW_CIL_0120, ARCH_SW_CIL_0126");
  testStep("STEP", "Check if CPU stopped in function cil_RequestTensioning. --> CPU stopped at BP");
  debugger_waitUntilBPisReached("1000");
//  ExpectedTestResult(debugger_result,IS_CPU_STOP_AT_BP_SUCCESFUL, "CPU stopped at BP");
  
  debugger_deleteAllBreakpoints();
  debugger_reset();
  debugger_run();
  
  testCaseComment("Action: ARCH_SW_CIL_0120, ARCH_SW_CIL_0139");
  testStep("STEP", "Check if variable Rte_CIL_prrCrashSeverityLevel_u8PreCrashSeverityLevel is KU8_PRECRASH_SEVERITY_LEVEL_7 --> KU8_PRECRASH_SEVERITY_LEVEL_7.");
  debugger_readVariable("uint8", "Rte_CIL_prrCrashSeverityLevel_u8PreCrashSeverityLevel", "0");
  ExpectedTestResult(debugger_result, "0xff", "0x6");
  
  testCaseComment("Action: ARCH_SW_CIL_0120, ARCH_SW_CIL_0139");
  testStep("STEP", "Check if variable Rte_CIL_psrCarAcceleration_b8IsCarAccelerationLow is KU8_FALSE --> KU8_FALSE.");
  debugger_readVariable("uint8", "Rte_CIL_psrCarAcceleration_b8IsCarAccelerationLow", "0");
  ExpectedTestResult(debugger_result, "0xaa", "0x55");
  
  //====================================================
  testCaseComment("Postcondition");
  testStep("STEP", "Return ECU to default values");
  
  debugger_deleteAllBreakpoints();
  setSignal(BODY3::Presf_Lvl_ST3, I_C04_PRESF_LVL_V2_NOLVL);
  RunPostTs(); 
  
  debugger_stop();
}


testcase SW_IT_CIL_ManageAbortingConditions_01()
{
  //***********************************Test report header*********************************
  testReportAddMiscInfoBlock("AUTOLIV ELECTRONICS document");
  TestReportAddMiscInfo("Nightly test", "No");
  TestReportAddMiscInfo("Test type", "Requirement-Based test");
  TestReportAddMiscInfo("Regression Test", "No");
  TestReportAddMiscInfo("Fault injection method used", "No");
  TestReportAddMiscInfo("Resource usage evaluation", "No");
  TestReportAddMiscInfo("Priority", "No");
  TestReportAddMiscInfo("Safety relevant", "No");
  
  AddRequirementInfo("Requirement under test", "ARCH_SW_CIL_0121, ARCH_SW_CIL_0184");
  AddRequirementInfo("ARCH_SW_CIL_0122", "SNA value for this signal is 0x0F, and for this no cycle should de played and already played cycles on PRE-safe should be aborted.");
  //***************************************************************************************
    
  testCaseComment("Preconditions");
  testStep("STEP", "Bench Initialization");

  debugger_deleteAllBreakpoints();
  debugger_reset();
  debugger_run();
  
  RunPreTs();
  //====================================================
  
  testStep("STEP", "Start Development Session."); 
  AuthenticateECU(2); // Development_Enhanced
  EnterDiagnosticSession("development");
  
  testStep("STEP", "Set signal Presf_Lvl_ST3 to I_C04_PRESF_LVL_V2_SNA (0x0F).");
  setSignal(BODY3::PresfAct_Adj_ST3::Presf_Lvl_ST3, I_C04_PRESF_LVL_V2_SNA);
  testWaitForTimeout(500);
  
  testStep("STEP", "Set a breakpoint in function cil_ManageAbortingConditions at line CIL_SET_ABORT_MASK_OFF (KU8_CIL_PresafeSNAAborting);.");
  debugger_setRelativeFunctionBpAtLine("cil_ManageAbortingConditions", "107");
  
  testCaseComment("Action: ARCH_SW_CIL_0122, ARCH_SW_CIL_0184");
  testStep("STEP", "Check if CPU stopped at line CIL_SET_ABORT_MASK_OFF (KU8_CIL_PresafeSNAAborting);. --> CPU stopped at BP");

  debugger_waitUntilBPisReached("1000");
//  ExpectedTestResult(debugger_result,IS_CPU_STOP_AT_BP_SUCCESFUL, "CPU stopped at BP");

  //====================================================
  testCaseComment("Postcondition");
  testStep("STEP", "Return ECU to default values");
  
  debugger_deleteAllBreakpoints();
  setSignal(BODY3::PresfAct_Adj_ST3::Presf_Lvl_ST3, I_C04_PRESF_LVL_V2_NOLVL);
  RunPostTs(); 
  
  debugger_stop();
}


testcase SW_IT_CIL_TriggerProfiles_09()
{
  //***********************************Test report header*********************************
  testReportAddMiscInfoBlock("AUTOLIV ELECTRONICS document");
  TestReportAddMiscInfo("Nightly test", "No");
  TestReportAddMiscInfo("Test type", "Requirement-Based test");
  TestReportAddMiscInfo("Regression Test", "No");
  TestReportAddMiscInfo("Fault injection method used", "No");
  TestReportAddMiscInfo("Resource usage evaluation", "No");
  TestReportAddMiscInfo("Priority", "No");
  TestReportAddMiscInfo("Safety relevant", "No");
  
  AddRequirementInfo("Requirement under test", "ARCH_SW_CIL_0024");
  AddRequirementInfo("ARCH_SW_CIL_0024", "If any other value than 1,2,3,4,5,6,7,8 is received for signal Presf_Lvl_ST3 then no cycle should be requested.");
  //***************************************************************************************
    
  testCaseComment("Preconditions");
  testStep("STEP", "Bench Initialization");

  debugger_deleteAllBreakpoints();
  debugger_reset();
  debugger_run();
  
  RunPreTs();
  //====================================================
  
  testStep("STEP", "Start Development Session."); 
  AuthenticateECU(2); // Development_Enhanced
  EnterDiagnosticSession("development");
  
  testStep("STEP", "Set signal Presf_Lvl_ST3 to 0x9.");
  setSignal(BODY3::Presf_Lvl_ST3, 0x9);
  testWaitForTimeout(500);
  
  testStep("STEP", "Set a breakpoint in function cil_TriggerProfiles where u8CycleRequest == KU8_NO_CYCLE.");
  debugger_setRelativeFunctionBpAtLine("cil_TriggerProfiles", "0");
  
  testCaseComment("Action: ARCH_SW_CIL_0121");
  testStep("STEP", "Check if CPU stopped at cil_TriggerProfiles function . --> CPU stopped at BP");
  debugger_waitUntilBPisReached("1000");
  ExpectedTestResult(debugger_result,IS_CPU_STOP_AT_BP_SUCCESFUL, "CPU stopped at BP");
  
  //====================================================
  testCaseComment("Postcondition");
  testStep("STEP", "Return ECU to default values");
  
  debugger_deleteAllBreakpoints();
  
  debugger_run();
  
  RunPostTs(); 
  
  debugger_stop();
}

testcase SW_IT_CIL_Presf_Enbl_ST3_01()
{
  //***********************************Test report header*********************************
  testReportAddMiscInfoBlock("AUTOLIV ELECTRONICS document");
  TestReportAddMiscInfo("Nightly test", "No");
  TestReportAddMiscInfo("Test type", "Requirement-Based test");
  TestReportAddMiscInfo("Regression Test", "No");
  TestReportAddMiscInfo("Fault injection method used", "No");
  TestReportAddMiscInfo("Resource usage evaluation", "No");
  TestReportAddMiscInfo("Priority", "No");
  TestReportAddMiscInfo("Safety relevant", "No");
  
  AddRequirementInfo("Requirement under test", "ARCH_SW_CIL_0025");
  AddRequirementInfo("ARCH_SW_CIL_0025", "If value for Signal Presf_Enbl_ST3 is not 1 (is 0 or 3) then cycle request coming from PRE-SAFE or ORC should be inhibitted/aborted ");
  //***************************************************************************************
    
  testCaseComment("Preconditions");
  testStep("STEP", "Bench Initialization");

  debugger_deleteAllBreakpoints();
  debugger_reset();
  debugger_run();
  
  RunPreTs();
  //====================================================
  
  testStep("STEP", "Start Development Session."); 
  AuthenticateECU(2); // Development_Enhanced
  EnterDiagnosticSession("development");
  
  testStep("STEP", "Set signal Presf_Enbl_ST3 to 0x0.");
  setSignal(BODY3::PresfAct_Adj_ST3::Presf_Enbl_ST3, 0x0);
  testWaitForTimeout(500);
  
  testStep("STEP", "Set a breakpoint in function cil_ManageInhibitConditions at line CIL_SET_INHIB_MASK_OFF (KU8_CIL_PresfEnableInhibition);.");
  debugger_setRelativeFunctionBpAtLine("cil_ManageInhibitConditions", "3");
  
  testStep("STEP", "Read variable cil_stPresfActAdjFrame.Presf_Enbl_ST3 --> 0x0.");
  debugger_readVariable("uint8", "cil_stPresfActAdjFrame,,app.elf", "3");
  ExpectedTestResult(debugger_result, "0x0", "0x0");
  
  testCaseComment("Action: ARCH_SW_CIL_0025");
  testStep("STEP", "Check if CPU stopped in function cil_ManageInhibitConditions at line CIL_SET_INHIB_MASK_OFF (KU8_CIL_PresfEnableInhibition);. --> CPU stopped at BP");
  debugger_waitUntilBPisReached("1000");
  ExpectedTestResult(debugger_result,IS_CPU_STOP_AT_BP_SUCCESFUL, "CPU stopped at BP");
  
  //====================================================
  testCaseComment("Postcondition");
  testStep("STEP", "Return ECU to default values");
  
  debugger_deleteAllBreakpoints();
  
  debugger_run();
  
  RunPostTs(); 
  
  debugger_stop();
}

testcase SW_IT_CIL_PresfAct_TensSupp_Rq_ST3_01()
{
  //***********************************Test report header*********************************
  testReportAddMiscInfoBlock("AUTOLIV ELECTRONICS document");
  TestReportAddMiscInfo("Nightly test", "No");
  TestReportAddMiscInfo("Test type", "Requirement-Based test");
  TestReportAddMiscInfo("Regression Test", "No");
  TestReportAddMiscInfo("Fault injection method used", "No");
  TestReportAddMiscInfo("Resource usage evaluation", "No");
  TestReportAddMiscInfo("Priority", "No");
  TestReportAddMiscInfo("Safety relevant", "No");
  
  AddRequirementInfo("Requirement under test", "ARCH_SW_CIL_0182, ARCH_SW_CIL_0048");
  AddRequirementInfo("ARCH_SW_CIL_0182", "Value for PresfAct_TensSupp_Rq_ST3 SNA is 7 and should not inhibit anything.");
  //***************************************************************************************
    
  testCaseComment("Preconditions");
  testStep("STEP", "Bench Initialization");

  debugger_deleteAllBreakpoints();
  debugger_reset();
  debugger_run();
  
  RunPreTs();
  //====================================================
  
  testStep("STEP", "Start Development Session."); 
  AuthenticateECU(2); // Development_Enhanced
  EnterDiagnosticSession("development");
  
  testStep("STEP", "Set a breakpoint in function CIL_ComNotification_PresfAct_Adj_Pr5_ST3_2joar1a41xrgjqab60epnbplm_25141edc_Rx().");
  debugger_setRelativeFunctionBpAtLine("CIL_ComNotification_PresfAct_Adj_Pr5_ST3_2joar1a41xrgjqab60epnbplm_25141edc_Rx", "4");
  
  testCaseComment("Action: ARCH_SW_CIL_0182, ARCH_SW_CIL_0048");
  testStep("STEP", "Read variable cil_stPresfActAdjFrame.PresfAct_TensSupp_Rq_ST3 --> 0x7.");
  debugger_readVariable("uint8", "cil_stPresfActAdjFrame,,app.elf", "10");
  ExpectedTestResult(debugger_result, "0x7", "0x7");
  
  //====================================================
  testCaseComment("Postcondition");
  testStep("STEP", "Return ECU to default values");
  
  debugger_deleteAllBreakpoints();
  
  debugger_run();
  
  RunPostTs(); 
  
  debugger_stop();
}

testcase SW_IT_CIL_PresfAct_TensSupp_Rq_ST3_02()
{
  //***********************************Test report header*********************************
  testReportAddMiscInfoBlock("AUTOLIV ELECTRONICS document");
  TestReportAddMiscInfo("Nightly test", "No");
  TestReportAddMiscInfo("Test type", "Requirement-Based test");
  TestReportAddMiscInfo("Regression Test", "No");
  TestReportAddMiscInfo("Fault injection method used", "No");
  TestReportAddMiscInfo("Resource usage evaluation", "No");
  TestReportAddMiscInfo("Priority", "No");
  TestReportAddMiscInfo("Safety relevant", "No");
  
  AddRequirementInfo("Requirement under test", "ARCH_SW_CIL_0049");
  AddRequirementInfo("ARCH_SW_CIL_0049", "If value for PresfAct_TensSupp_Rq_ST3 is not 0 on ECU’s current side (is 1,2,3) then cycle request coming from PRE-SAFE or ORC should be inhibitted/aborted.");
  //***************************************************************************************
    
  testCaseComment("Preconditions");
  testStep("STEP", "Bench Initialization");

  debugger_deleteAllBreakpoints();
  debugger_reset();
  debugger_run();
  
  RunPreTs();
  //====================================================
  
  testStep("STEP", "Start Development Session."); 
  AuthenticateECU(2); // Development_Enhanced
  EnterDiagnosticSession("development");
  
  testStep("STEP", "Set signal PresfAct_TensSupp_Rq_ST3 to 0x2.");
  setSignal(BODY3::PresfAct_Adj_ST3::PresfAct_TensSupp_Rq_ST3, 0x2);
  testWaitForTimeout(500);
  
  testStep("STEP", "Set a breakpoint in function cil_ManageInhibitConditions at line CIL_SET_ABORT_MASK_ON (KU8_CIL_TensSuppAborting);.");
  debugger_setRelativeFunctionBpAtLine("cil_ManageInhibitConditions", "13");
  
  testStep("STEP", "Read variable cil_stPresfActAdjFrame.PresfAct_TensSupp_Rq_ST3 --> 0x2.");
  debugger_readVariable("uint8", "cil_stPresfActAdjFrame,,app.elf", "10");
  ExpectedTestResult(debugger_result, "0x2", "0x2");
  
  testCaseComment("Action: ARCH_SW_CIL_0049");
  testStep("STEP", "Check if CPU stopped in function cil_ManageInhibitConditions at line CIL_SET_ABORT_MASK_ON (KU8_CIL_TensSuppAborting);. --> CPU stopped at BP");
  debugger_waitUntilBPisReached("1000");
//  ExpectedTestResult(debugger_result,IS_CPU_STOP_AT_BP_SUCCESFUL, "CPU stopped at BP");
  
  //====================================================
  testCaseComment("Postcondition");
  testStep("STEP", "Return ECU to default values");
  
  debugger_deleteAllBreakpoints();
  
  debugger_run();
  
  RunPostTs(); 
  
  debugger_stop();
}

testcase SW_IT_CIL_PresfAccelReset_NotExcd_ST3_01()
{
  //***********************************Test report header*********************************
  testReportAddMiscInfoBlock("AUTOLIV ELECTRONICS document");
  TestReportAddMiscInfo("Nightly test", "No");
  TestReportAddMiscInfo("Test type", "Requirement-Based test");
  TestReportAddMiscInfo("Regression Test", "No");
  TestReportAddMiscInfo("Fault injection method used", "No");
  TestReportAddMiscInfo("Resource usage evaluation", "No");
  TestReportAddMiscInfo("Priority", "No");
  TestReportAddMiscInfo("Safety relevant", "No");
  
  AddRequirementInfo("Requirement under test", "ARCH_SW_CIL_0004, ARCH_SW_CIL_0026");
  AddRequirementInfo("ARCH_SW_CIL_0004", "Signal PresfAccelReset_NotExcd_ST3 shall be send though application when it’s needed.");
  AddRequirementInfo("ARCH_SW_CIL_0026", "If value for PresfAccelReset_NotExcd_ST3 is not 2 (is 0 or ,1) the the release cycle will not be executed.");
  //***************************************************************************************
    
  testCaseComment("Preconditions");
  testStep("STEP", "Bench Initialization");

  debugger_deleteAllBreakpoints();
  debugger_reset();
  debugger_run();
  
  RunPreTs();
  //====================================================
  
  testStep("STEP", "Start Development Session."); 
  AuthenticateECU(2); // Development_Enhanced
  EnterDiagnosticSession("development");
  
  testStep("STEP", "Set signal PresfAccelReset_NotExcd_ST3 to 0x1.");
  setSignal(BODY3::PresfAct_Adj_ST3::PresfAccelReset_NotExcd_ST3, 0x1);
  testWaitForTimeout(500);
  
  testStep("STEP", "Set a breakpoint in function cil_ManageInhibitConditions.");
  debugger_setRelativeFunctionBpAtLine("cil_ManageInhibitConditions", "71");
  
  testCaseComment("Action: ARCH_SW_CIL_0004");
  testStep("STEP", "Read variable cil_stPresfActAdjFrame.PresfAccelReset_NotExcd_ST3 --> 0x1.");
  debugger_readVariable("uint8", "cil_stPresfActAdjFrame,,app.elf", "7");
  ExpectedTestResult(debugger_result, "0x1", "0x1");
  
  testCaseComment("Action: ARCH_SW_CIL_0026");
  testStep("STEP", "Check if CPU stopped in function cil_ManageInhibitConditions at line CIL_SET_INHIB_MASK_ON (KU8_CIL_AccLowInhibition);. --> CPU stopped at BP");
  debugger_waitUntilBPisReached("1000");
//  ExpectedTestResult(debugger_result,IS_CPU_STOP_AT_BP_SUCCESFUL, "CPU stopped at BP");
  
  //====================================================
  testCaseComment("Postcondition");
  testStep("STEP", "Return ECU to default values");
  
  debugger_deleteAllBreakpoints();
  
  debugger_run();
  
  RunPostTs(); 
  
  debugger_stop();
}


testcase SW_IT_CIL_PresfAccelReset_NotExcd_ST3_02()
{
  //***********************************Test report header*********************************
  testReportAddMiscInfoBlock("AUTOLIV ELECTRONICS document");
  TestReportAddMiscInfo("Nightly test", "No");
  TestReportAddMiscInfo("Test type", "Requirement-Based test");
  TestReportAddMiscInfo("Regression Test", "No");
  TestReportAddMiscInfo("Fault injection method used", "No");
  TestReportAddMiscInfo("Resource usage evaluation", "No");
  TestReportAddMiscInfo("Priority", "No");
  TestReportAddMiscInfo("Safety relevant", "No");
  
  AddRequirementInfo("Requirement under test", "ARCH_SW_CIL_0117");
  AddRequirementInfo("ARCH_SW_CIL_0117", "If value for PresfAccelReset_NotExcd_ST3 is 3 = SNA then value will be interpreted as 2 , as Release allowed.");
  //***************************************************************************************
    
  testCaseComment("Preconditions");
  testStep("STEP", "Bench Initialization");

  debugger_deleteAllBreakpoints();
  debugger_reset();
  debugger_run();
  
  RunPreTs();
  //====================================================
  
  testStep("STEP", "Start Development Session."); 
  AuthenticateECU(2); // Development_Enhanced
  EnterDiagnosticSession("development");
  
  testStep("STEP", "Set signal PresfAccelReset_NotExcd_ST3 to 0x3.");
  setSignal(BODY3::PresfAct_Adj_ST3::PresfAccelReset_NotExcd_ST3, 0x3);
  testWaitForTimeout(500);
  
  testStep("STEP", "Set a breakpoint in function cil_ManageInhibitConditions.");
  debugger_setRelativeFunctionBpAtLine("cil_ManageInhibitConditions", "71");
  
  testCaseComment("Action: ARCH_SW_CIL_0117");
  testStep("STEP", "Read variable cil_stPresfActAdjFrame.PresfAccelReset_NotExcd_ST3 --> 0x1.");
  debugger_readVariable("uint8", "cil_stPresfActAdjFrame,,app.elf", "7");
  ExpectedTestResult(debugger_result, "0x3", "0x3");
  
  testCaseComment("Action: ARCH_SW_CIL_0117");
  testStep("STEP", "Check if CPU stopped in function cil_ManageInhibitConditions at line CIL_SET_INHIB_MASK_ON (KU8_CIL_AccLowInhibition);. --> CPU stopped at BP");
  debugger_waitUntilBPisReached("1000");
//  ExpectedTestResult(debugger_result,IS_CPU_STOP_AT_BP_SUCCESFUL, "CPU stopped at BP");
  
  //====================================================
  testCaseComment("Postcondition");
  testStep("STEP", "Return ECU to default values");
  
  debugger_deleteAllBreakpoints();
  
  debugger_run();
  
  RunPostTs(); 
  
  debugger_stop();
}


testcase SW_IT_CIL_ISw_Stat_ST3_01()
{
  //***********************************Test report header*********************************
  testReportAddMiscInfoBlock("AUTOLIV ELECTRONICS document");
  TestReportAddMiscInfo("Nightly test", "No");
  TestReportAddMiscInfo("Test type", "Requirement-Based test");
  TestReportAddMiscInfo("Regression Test", "No");
  TestReportAddMiscInfo("Fault injection method used", "No");
  TestReportAddMiscInfo("Resource usage evaluation", "No");
  TestReportAddMiscInfo("Priority", "No");
  TestReportAddMiscInfo("Safety relevant", "No");
  
  AddRequirementInfo("Requirement under test", "ARCH_SW_CIL_0027, ARCH_SW_CIL_0123");
  AddRequirementInfo("ARCH_SW_CIL_0027", "If value for ISw_Stat_ST3 is not 4 (is  0,1,2,5 or 7 ) then cycle request should be inhibitted/aborted.");
  AddRequirementInfo("ARCH_SW_CIL_0123", "A NEW IGNITION RUN CYCLE happens when trasiition from any value to 0 – IGN_LOCK;");
  //***************************************************************************************
    
  testCaseComment("Preconditions");
  testStep("STEP", "Bench Initialization");

  debugger_deleteAllBreakpoints();
  debugger_reset();
  debugger_run();

  RunPreTs();
  //====================================================
  
  testStep("STEP", "Start Development Session.");
  AuthenticateECU(2); // Development_Enhanced
  EnterDiagnosticSession("development");
    
  testStep("STEP", "Set signal ISw_Stat_ST3 from frame Ign_Stat_ST3 to 0x0.");
  setSignal(BODY3::ISw_Stat_ST3, 0x0);
  testWaitForTimeout(1000);
  
  testStep("STEP", "Set a breakpoint in function cil_ManageAbortingConditions.");
  debugger_setRelativeFunctionBpAtLine("cil_ManageAbortingConditions", "0");
  
  testCaseComment("Action: ARCH_SW_CIL_0123");
  testStep("STEP", "Read variable cil_u8IgnitionSignal --> 0x0.");
  debugger_readVariable("uint8", "cil_u8IgnitionSignal,,app.elf", "0");
  ExpectedTestResult(debugger_result, "0x0", "0x0");
  
  testCaseComment("Action: ARCH_SW_CIL_0027");
  testStep("STEP", "Check if CPU stopped in function cil_ManageAbortingConditions. --> CPU stopped at BP");
  debugger_waitUntilBPisReached("1000");
  ExpectedTestResult(debugger_result,IS_CPU_STOP_AT_BP_SUCCESFUL, "CPU stopped at BP");
  
  //====================================================
  testCaseComment("Postcondition");
  testStep("STEP", "Return ECU to default values");
  
  debugger_deleteAllBreakpoints();
  
  debugger_run();
  
  RunPostTs(); 
  
  debugger_stop();
}

testcase SW_IT_CIL_Bckl_Sw_D_Stat_ST3_01()
{
  //***********************************Test report header*********************************
  testReportAddMiscInfoBlock("AUTOLIV ELECTRONICS document");
  TestReportAddMiscInfo("Nightly test", "No");
  TestReportAddMiscInfo("Test type", "Requirement-Based test");
  TestReportAddMiscInfo("Regression Test", "No");
  TestReportAddMiscInfo("Fault injection method used", "No");
  TestReportAddMiscInfo("Resource usage evaluation", "No");
  TestReportAddMiscInfo("Priority", "No");
  TestReportAddMiscInfo("Safety relevant", "No");
  
  AddRequirementInfo("Requirement under test", "ARCH_SW_CIL_0045, ARCH_SW_CIL_0078, ARCH_SW_CIL_0187, ARCH_SW_CIL_0155");
  AddRequirementInfo("ARCH_SW_CIL_0045", "If value for Bckl_Sw_D_Stat_ST3 is trasitioning from 1 to 0 then cycle 26 (BSR) shall be executed.");
  AddRequirementInfo("ARCH_SW_CIL_0078", "If value for Bckl_Sw_D_Stat_ST3 is trasitioning from 1 to 0 and BSR is being executed than any profile activation on API-interface request will be inhibited.");
  AddRequirementInfo("ARCH_SW_CIL_0187", "Values of 0 and 3 for tis signall shall inhibit all BSR profiles.");
  //***************************************************************************************
    
  testCaseComment("Preconditions");
  testStep("STEP", "Bench Initialization");

  debugger_deleteAllBreakpoints();
  debugger_reset();
  debugger_run();

  RunPreTs();
  //====================================================
  
  testStep("STEP", "Start Development Session.");
  AuthenticateECU(2); // Development_Enhanced
  EnterDiagnosticSession("development");
    
  testStep("STEP", "Set signal Bckl_Sw_D_Stat_ST3 to 0x1.");
  setSignal(BODY3::Bckl_Sw_D_Stat_ST3, 0x1);
  testWaitForTimeout(500);
  
  testStep("STEP", "Set signal Bckl_Sw_D_Stat_ST3 to 0x0.");
  setSignal(BODY3::Bckl_Sw_D_Stat_ST3, 0x0);
  testWaitForTimeout(500);
  
  testStep("STEP", "Set a breakpoint in function CIL_runCANToAppli at line if (KU8_TRUE == cil_u8BSRStarted).");
  debugger_setRelativeFunctionBpAtLine("CIL_runCANToAppli", "312");
  
  testCaseComment("Action: ARCH_SW_CIL_0045, ARCH_SW_CIL_0078, ARCH_SW_CIL_0187,ARCH_SW_CIL_0155");
  testStep("STEP", "Check if CPU stopped in function CIL_runCANToAppli at line if (KU8_TRUE == cil_u8BSRStarted);. --> CPU stopped at BP");
  debugger_waitUntilBPisReached("1000");
//  ExpectedTestResult(debugger_result,IS_CPU_STOP_AT_BP_SUCCESFUL, "CPU stopped at BP");
  
  //====================================================
  testCaseComment("Postcondition");
  testStep("STEP", "Return ECU to default values");
  
  debugger_deleteAllBreakpoints();
  
  debugger_run();
  
  RunPostTs(); 
  
  debugger_stop();
}


testcase SW_IT_CIL_Bckl_Sw_FP_Stat_ST3_03()
{
  //***********************************Test report header*********************************
  testReportAddMiscInfoBlock("AUTOLIV ELECTRONICS document");
  TestReportAddMiscInfo("Nightly test", "No");
  TestReportAddMiscInfo("Test type", "Requirement-Based test");
  TestReportAddMiscInfo("Regression Test", "No");
  TestReportAddMiscInfo("Fault injection method used", "No");
  TestReportAddMiscInfo("Resource usage evaluation", "No");
  TestReportAddMiscInfo("Priority", "No");
  TestReportAddMiscInfo("Safety relevant", "No");
  
  AddRequirementInfo("Requirement under test", "ARCH_SW_CIL_0009, ARCH_SW_CIL_0029");
  AddRequirementInfo("ARCH_SW_CIL_0009", "Signal Bckl_Sw_FP_Stat_ST3 shall be send though application when it’s needed.");
  AddRequirementInfo("ARCH_SW_CIL_0029", "If value for Bckl_Sw_FP_Stat_ST3 is not 0 (is  1,2,3) then cycle request should be inhibitted/aborted.");
  //***************************************************************************************
    
  testCaseComment("Preconditions");
  testStep("STEP", "Bench Initialization");

  debugger_deleteAllBreakpoints();
  debugger_reset();
  debugger_run();

  RunPreTs();
  //====================================================
  
  testStep("STEP", "Start Development Session.");
  AuthenticateECU(2); // Development_Enhanced
  EnterDiagnosticSession("development");
    
  testStep("STEP", "Set signal Bckl_Sw_FP_Stat_ST3 to 0x1.");
  setSignal(BODY3::Bckl_Sw_FP_Stat_ST3, 0x1);
  testWaitForTimeout(1000);
  
  testCaseComment("Action: ARCH_SW_CIL_0029");
  testStep("STEP", "Read variable stBcklSwStatFrame.Bckl_Sw_FP_Stat_ST3 --> 0x1.");
  debugger_readVariable("uint8", "stBcklSwStatFrame,,app.elf", "2");
  ExpectedTestResult(debugger_result, "0x1", "0x1");
  
  testStep("STEP", "Set a breakpoint in function cil_TriggerProfiles under I_C04_PRESF_LVL_V2_LVL1 case.");
  debugger_setRelativeFunctionBpAtLine("cil_TriggerProfiles", "95");
  
  testCaseComment("Action: ARCH_SW_CIL_0009");
  testStep("STEP", "Check if CPU stopped in function cil_TriggerProfiles under I_C04_PRESF_LVL_V2_LVL1 case. --> CPU stopped at BP");
  debugger_waitUntilBPisReached("1000");
//  ExpectedTestResult(debugger_result,IS_CPU_STOP_AT_BP_SUCCESFUL, "CPU stopped at BP");
  
  //====================================================
  testCaseComment("Postcondition");
  testStep("STEP", "Return ECU to default values");
  
  debugger_deleteAllBreakpoints();
  
  debugger_run();
  
  RunPostTs(); 
  
  debugger_stop();
}

testcase SW_IT_CIL_Bckl_Sw_FP_Stat_ST3_02()
{
  //***********************************Test report header*********************************
  testReportAddMiscInfoBlock("AUTOLIV ELECTRONICS document");
  TestReportAddMiscInfo("Nightly test", "No");
  TestReportAddMiscInfo("Test type", "Requirement-Based test");
  TestReportAddMiscInfo("Regression Test", "No");
  TestReportAddMiscInfo("Fault injection method used", "No");
  TestReportAddMiscInfo("Resource usage evaluation", "No");
  TestReportAddMiscInfo("Priority", "No");
  TestReportAddMiscInfo("Safety relevant", "No");
  
  AddRequirementInfo("Requirement under test", "ARCH_SW_CIL_0046, ARCH_SW_CIL_0077");
  AddRequirementInfo("ARCH_SW_CIL_0046", "If value for Bckl_Sw_FP_Stat_ST3 is transitioning from 1 to 0 then cycle 18 (BSR) shall be executed.");
  AddRequirementInfo("ARCH_SW_CIL_0077", "If value for Bckl_Sw_FP_Stat_ST3 is trasitioning from 1 to 0 and BSR is being executed than any profile activation on API-interface request will be inhibited..");
  //***************************************************************************************
    
  testCaseComment("Preconditions");
  testStep("STEP", "Bench Initialization");

  debugger_deleteAllBreakpoints();
  debugger_reset();
  debugger_run();

  RunPreTs();
  //====================================================
  
  testStep("STEP", "Start Development Session.");
  AuthenticateECU(2); // Development_Enhanced
  EnterDiagnosticSession("development");
    
  testStep("STEP", "Set signal Bckl_Sw_FP_Stat_ST3 to 0x1.");
  setSignal(BODY3::Bckl_Sw_FP_Stat_ST3, 0x1);
  testWaitForTimeout(1000);
  
  testStep("STEP", "Set signal Bckl_Sw_FP_Stat_ST3 to 0x0.");
  setSignal(BODY3::Bckl_Sw_FP_Stat_ST3, 0x0);
  testWaitForTimeout(1000);
  
  testStep("STEP", "Set a breakpoint in function cil_TriggerProfiles at line (void)Rte_Read_prrEnableCycle18_b8CycleValidity(&u8CycleValidityStatus);.");
  debugger_setRelativeFunctionBpAtLine("cil_TriggerProfiles", "114");
  
  testCaseComment("Action: ARCH_SW_CIL_0046, ARCH_SW_CIL_0077");
  testStep("STEP", "Check if CPU stopped in function cil_TriggerProfiles at line (void)Rte_Read_prrEnableCycle18_b8CycleValidity(&u8CycleValidityStatus);. --> CPU stopped at BP");
  debugger_waitUntilBPisReached("1000");
//  ExpectedTestResult(debugger_result,IS_CPU_STOP_AT_BP_SUCCESFUL, "CPU stopped at BP");
  
  //====================================================
  testCaseComment("Postcondition");
  testStep("STEP", "Return ECU to default values");
  
  debugger_deleteAllBreakpoints();
  
  debugger_run();
  
  RunPostTs(); 
  
  debugger_stop();
}

testcase SW_IT_CIL_Impact_RO_type1_ST3_01()
{
  //***********************************Test report header*********************************
  testReportAddMiscInfoBlock("AUTOLIV ELECTRONICS document");
  TestReportAddMiscInfo("Nightly test", "No");
  TestReportAddMiscInfo("Test type", "Requirement-Based test");
  TestReportAddMiscInfo("Regression Test", "No");
  TestReportAddMiscInfo("Fault injection method used", "No");
  TestReportAddMiscInfo("Resource usage evaluation", "No");
  TestReportAddMiscInfo("Priority", "No");
  TestReportAddMiscInfo("Safety relevant", "No");
  
  AddRequirementInfo("Requirement under test", "ARCH_SW_CIL_0031, ARCH_SW_CIL_0032");
  AddRequirementInfo("ARCH_SW_CIL_0031", "Signal Impact_RO_type1_ST3 shall be send though application when it’s needed.");
  AddRequirementInfo("ARCH_SW_CIL_0032", "If value for Impact_RO_type1_ST3 is 1 than ORC PRE-SAFE 8 (cycle 6) should be executed.");
  AddRequirementInfo("ARCH_SW_CIL_0181", "After ORC Request no profile will be executed until a new ignition cycle happens.");
  //***************************************************************************************
  
  testCaseComment("Preconditions");
  testStep("STEP", "Bench Initialization");

  debugger_deleteAllBreakpoints();
  debugger_reset();
  debugger_run();

  RunPreTs();
  //====================================================
 
  testStep("STEP", "Start Development Session."); 
  AuthenticateECU(2); // Development_Enhanced
  EnterDiagnosticSession("development");
    
  testStep("STEP", "Set signal Impact_RO_type1_ST3 to KU8_ONE.");
  setSignal(BODY3::Impact_RO_type1_ST3, 1);
  testWaitForTimeout(1000);
  
  testStep("STEP", "Set a breakpoint in function cil_ManageInputSignals at line cil_ManageInhibitConditions();.");
  debugger_setBpAtLine("s:\\Components\\Application\\Autoliv\\CIL\\Implementation\\src\\CIL_CANToAppli.c", "1311");
  
  testCaseComment("Action: ARCH_SW_CIL_0031");
  testStep("STEP", "Read variable cil_stImpactSignalsStatus3.Impact_RO_type1_ST3 --> 0x1.");
  debugger_readVariable("uint8", "cil_stImpactSignalsStatus3,,app.elf", "2");
  ExpectedTestResult(debugger_result, "0x1", "0x1"); 
  
  testStep("STEP", "Set a breakpoint in function cil_TriggerProfiles at line (void)Rte_Read_prrEnableCycle6_b8CycleValidity(&u8CycleValidityStatus);.");
  debugger_setRelativeFunctionBpAtLine("cil_TriggerProfiles", "249");
  
  debugger_run();
  
  testCaseComment("Action: ARCH_SW_CIL_0032, ARCH_SW_CIL_0181");
  testStep("STEP", "Check if CPU stopped at line (void)Rte_Read_prrEnableCycle6_b8CycleValidity(&u8CycleValidityStatus);. --> CPU stopped at BP");
  debugger_waitUntilBPisReached("1000");
//  ExpectedTestResult(debugger_result,IS_CPU_STOP_AT_BP_SUCCESFUL, "CPU stopped at BP");
  
  //====================================================
  testCaseComment("Postcondition");
  testStep("STEP", "Return ECU to default values");
  
  debugger_deleteAllBreakpoints();
  
  debugger_run();
  
  RunPostTs(); 
  
  debugger_stop();
}

testcase SW_IT_CIL_Impact_X_ST3_01()
{
  //***********************************Test report header*********************************
  testReportAddMiscInfoBlock("AUTOLIV ELECTRONICS document");
  TestReportAddMiscInfo("Nightly test", "No");
  TestReportAddMiscInfo("Test type", "Requirement-Based test");
  TestReportAddMiscInfo("Regression Test", "No");
  TestReportAddMiscInfo("Fault injection method used", "No");
  TestReportAddMiscInfo("Resource usage evaluation", "No");
  TestReportAddMiscInfo("Priority", "No");
  TestReportAddMiscInfo("Safety relevant", "No");
  
  AddRequirementInfo("Requirement under test", "ARCH_SW_CIL_0036");
  AddRequirementInfo("ARCH_SW_CIL_0036", "If Impact_X_ST3 is 1 then CRASH occurs and all profiles(including release) are aborted/inhibited until a new ignition cycle.");
  //***************************************************************************************
  
  testCaseComment("Preconditions");
  testStep("STEP", "Bench Initialization");

  debugger_deleteAllBreakpoints();
  debugger_reset();
  debugger_run();

  RunPreTs();
  //====================================================
 
  testStep("STEP", "Start Development Session."); 
  AuthenticateECU(2); // Development_Enhanced
  EnterDiagnosticSession("development");
    
  testStep("STEP", "Set signal Impact_X_ST3 from frame Impact3_ST3 to 0x1.");
  setSignal(BODY3::Impact3_ST3::Impact_X_ST3, 1);
  testWaitForTimeout(1000);
  
  testStep("STEP", "Set a breakpoint in function cil_ManageInputSignals.");
  debugger_setBpAtLine("s:\\Components\\Application\\Autoliv\\CIL\\Implementation\\src\\CIL_CANToAppli.c", "1318");
  
  testCaseComment("Action: ARCH_SW_CIL_0036");
  testStep("STEP", "Read variable cil_stInputSignalsPresfRec.bImpactXType --> 0x1.");
  debugger_readVariable("uint8", "cil_stInputSignalsPresfRec,,app.elf", "3");
  ExpectedTestResult(debugger_result, "0x1", "0x1");

  testStep("STEP", "Set a breakpoint in function cil_ManageAbortingConditions at line if(KU8_ONE == cil_stImpactSignalsStatus3.Impact_X_ST3){.");
  debugger_setRelativeFunctionBpAtLine("cil_ManageAbortingConditions", "88");
  
  debugger_run();
  
  testCaseComment("Action: ARCH_SW_CIL_0036");
  testStep("STEP", "Check if CPU stopped in function cil_ManageAbortingConditions at line if(KU8_ONE == cil_stImpactSignalsStatus3.Impact_X_ST3){. --> CPU stopped at BP");
  debugger_waitUntilBPisReached("1000");
  ExpectedTestResult(debugger_result,IS_CPU_STOP_AT_BP_SUCCESFUL, "CPU stopped at BP");
  
  //====================================================
  testCaseComment("Postcondition");
  testStep("STEP", "Return ECU to default values");
  
  debugger_deleteAllBreakpoints();
  
  debugger_run();
  
  RunPostTs(); 
  
  debugger_stop();
}

testcase SW_IT_CIL_TriggerProfiles_10()
{
  //***********************************Test report header*********************************
  testReportAddMiscInfoBlock("AUTOLIV ELECTRONICS document");
  TestReportAddMiscInfo("Nightly test", "No");
  TestReportAddMiscInfo("Test type", "Requirement-Based test");
  TestReportAddMiscInfo("Regression Test", "No");
  TestReportAddMiscInfo("Fault injection method used", "No");
  TestReportAddMiscInfo("Resource usage evaluation", "No");
  TestReportAddMiscInfo("Priority", "No");
  TestReportAddMiscInfo("Safety relevant", "No");
  
  AddRequirementInfo("Requirement under test", "ARCH_SW_CIL_0127, ARCH_SW_CIL_0140");
  AddRequirementInfo("ARCH_SW_CIL_0127", "If signal is received with value 9, then tensioning cycle 7 shall be requested.");
  AddRequirementInfo("ARCH_SW_CIL_0140", "If signal is received with value 9, then tensioning cycle 7 shall be requested.");
  //***************************************************************************************
    
  testCaseComment("Preconditions");
  testStep("STEP", "Bench Initialization");

  debugger_deleteAllBreakpoints();
  debugger_reset();
  debugger_run();
  
  RunPreTs();
  //====================================================
  
  testStep("STEP", "Start Development Session."); 
  AuthenticateECU(2); // Development_Enhanced
  EnterDiagnosticSession("development");
  
  testStep("STEP", "Set signal RBTMFL_SP_Lvl_Rq_ST35 to I_C06_RBTM_LVL_RQ_PROFILE9.");
  setSignal(BODY3::RBTMFL_SP_Lvl_Rq_ST35, 0x9);
  testWaitForTimeout(500);
  
  testStep("STEP", "Set a breakpoint in function CIL_runCANToAppli at line cil_TriggerProfiles(CIL_stManagedCycle.u8CurrentRequestedCycle);.");
  debugger_setRelativeFunctionBpAtLine("CIL_runCANToAppli", "308");
  
  debugger_deleteAllBreakpoints();
  debugger_run();
  
  testStep("STEP", "Set a breakpoint in function cil_TriggerProfiles at line if( (KU8_TRUE == u8CycleValidityStatus) &&.");
  debugger_setRelativeFunctionBpAtLine("cil_TriggerProfiles", "284");
  
  testStep("STEP", "Set a breakpoint at the end of the function cil_RequestTensioning.");
  debugger_setBpAtLine("s:\\Components\\Application\\Autoliv\\CIL\\Implementation\\src\\CIL_CANToAppli.c", "1452"); 
  
  testCaseComment("Action: ARCH_SW_CIL_0127");
  testStep("STEP", "Check if CPU stopped in function cil_RequestTensioning. --> CPU stopped at BP");
  debugger_waitUntilBPisReached("1000");
//  ExpectedTestResult(debugger_result,IS_CPU_STOP_AT_BP_SUCCESFUL, "CPU stopped at BP");
  
  debugger_deleteAllBreakpoints();
  debugger_reset();
  debugger_run();
  
  testCaseComment("Action: ARCH_SW_CIL_0127, ARCH_SW_CIL_0140");
  testStep("STEP", "Check if variable Rte_CIL_prrCrashSeverityLevel_u8PreCrashSeverityLevel is KU8_PRECRASH_SEVERITY_LEVEL_8 --> KU8_PRECRASH_SEVERITY_LEVEL_8.");
  debugger_readVariable("uint8", "Rte_CIL_prrCrashSeverityLevel_u8PreCrashSeverityLevel", "0");
  ExpectedTestResult(debugger_result, "0xff", "0x7");
  
  //====================================================
  testCaseComment("Postcondition");
  testStep("STEP", "Return ECU to default values");
  
  debugger_deleteAllBreakpoints();
  setSignal(BODY3::RBTMFL_SP_Lvl_Rq_ST35, 0x0);
  
  debugger_run();
  
  
  RunPostTs(); 
  
  debugger_stop();
}

testcase SW_IT_CIL_TriggerProfiles_11()
{
  //***********************************Test report header*********************************
  testReportAddMiscInfoBlock("AUTOLIV ELECTRONICS document");
  TestReportAddMiscInfo("Nightly test", "No");
  TestReportAddMiscInfo("Test type", "Requirement-Based test");
  TestReportAddMiscInfo("Regression Test", "No");
  TestReportAddMiscInfo("Fault injection method used", "No");
  TestReportAddMiscInfo("Resource usage evaluation", "No");
  TestReportAddMiscInfo("Priority", "No");
  TestReportAddMiscInfo("Safety relevant", "No");
  
  AddRequirementInfo("Requirement under test", "ARCH_SW_CIL_0128, ARCH_SW_CIL_0141");
  AddRequirementInfo("ARCH_SW_CIL_0128", "If signal is received with value 10, then tensioning cycle 8 shall be requested.");
  AddRequirementInfo("ARCH_SW_CIL_0141", "If signal is received with value 10, then tensioning cycle 8 shall be requested.");
  //***************************************************************************************
    
  testCaseComment("Preconditions");
  testStep("STEP", "Bench Initialization");

  debugger_deleteAllBreakpoints();
  debugger_reset();
  debugger_run();
  
  RunPreTs();
  //====================================================
  
  testStep("STEP", "Start Development Session."); 
  AuthenticateECU(2); // Development_Enhanced
  EnterDiagnosticSession("development");
  
  testStep("STEP", "Set signal RBTMFL_SP_Lvl_Rq_ST35 to I_C06_RBTM_LVL_RQ_PROFILE10.");
  setSignal(BODY3::RBTMFL_SP_Lvl_Rq_ST35, 0xA);
  testWaitForTimeout(500);
  
  testStep("STEP", "Set a breakpoint in function CIL_runCANToAppli at line cil_TriggerProfiles(CIL_stManagedCycle.u8CurrentRequestedCycle);.");
  debugger_setRelativeFunctionBpAtLine("CIL_runCANToAppli", "308");
  
  debugger_deleteAllBreakpoints();
  debugger_run();
  
  testStep("STEP", "Set a breakpoint in function cil_TriggerProfiles at line case I_C06_RBTM_LVL_RQ_PROFILE10:.");
  debugger_setRelativeFunctionBpAtLine("cil_TriggerProfiles", "298");
  
  testStep("STEP", "Set a breakpoint at the end of the function cil_RequestTensioning.");
  debugger_setBpAtLine("s:\\Components\\Application\\Autoliv\\CIL\\Implementation\\src\\CIL_CANToAppli.c", "1452"); 
  
  debugger_run();
  
  testCaseComment("Action: ARCH_SW_CIL_0128");
  testStep("STEP", "Check if CPU stopped in function cil_RequestTensioning. --> CPU stopped at BP");
  debugger_waitUntilBPisReached("1000");
//  ExpectedTestResult(debugger_result,IS_CPU_STOP_AT_BP_SUCCESFUL, "CPU stopped at BP");
  
  debugger_deleteAllBreakpoints();
  debugger_reset();
  debugger_run();
  
  testCaseComment("Action: ARCH_SW_CIL_0128, ARCH_SW_CIL_0141");
  testStep("STEP", "Check if variable Rte_CIL_prrCrashSeverityLevel_u8PreCrashSeverityLevel is KU8_PRECRASH_SEVERITY_LEVEL_9 --> KU8_PRECRASH_SEVERITY_LEVEL_9.");
  debugger_readVariable("uint8", "Rte_CIL_prrCrashSeverityLevel_u8PreCrashSeverityLevel", "0");
  ExpectedTestResult(debugger_result, "0xff", "0x8");
  
  //====================================================
  testCaseComment("Postcondition");
  testStep("STEP", "Return ECU to default values");
  
  debugger_deleteAllBreakpoints();
  setSignal(BODY3::RBTMFL_SP_Lvl_Rq_ST35, 0x0);
  
  debugger_run();
  
  RunPostTs(); 
  
  debugger_stop();
}


testcase SW_IT_CIL_TriggerProfiles_12() // ISSUE u8CycleValidityStatus cannot reach address in memory
{
  //***********************************Test report header*********************************
  testReportAddMiscInfoBlock("AUTOLIV ELECTRONICS document");
  TestReportAddMiscInfo("Nightly test", "No");
  TestReportAddMiscInfo("Test type", "Requirement-Based test");
  TestReportAddMiscInfo("Regression Test", "No");
  TestReportAddMiscInfo("Fault injection method used", "No");
  TestReportAddMiscInfo("Resource usage evaluation", "No");
  TestReportAddMiscInfo("Priority", "No");
  TestReportAddMiscInfo("Safety relevant", "No");
  
  AddRequirementInfo("Requirement under test", "ARCH_SW_CIL_0129, ARCH_SW_CIL_0142");
  AddRequirementInfo("ARCH_SW_CIL_0129", "If signal is received with value 11, then tensioning cycle 9 shall be requested.");
  AddRequirementInfo("ARCH_SW_CIL_0142", "If signal is received with value 11, then tensioning cycle 9 shall be requested.");
  //***************************************************************************************
    
  testCaseComment("Preconditions");
  testStep("STEP", "Bench Initialization");

  debugger_deleteAllBreakpoints();
  debugger_reset();
  debugger_run();
  
  RunPreTs();
  //====================================================
  
  testStep("STEP", "Start Development Session.");
  AuthenticateECU(2); // Development_Enhanced
  EnterDiagnosticSession("development");
  
  testStep("STEP", "Set signal RBTMFL_SP_Lvl_Rq_ST35 to I_C06_RBTM_LVL_RQ_PROFILE11.");
  setSignal(BODY3::RBTMFL_SP_Lvl_Rq_ST35, 0xB);
  testWaitForTimeout(500);
  
   testStep("STEP", "Set a breakpoint in function CIL_runCANToAppli at line cil_TriggerProfiles(CIL_stManagedCycle.u8CurrentRequestedCycle);.");
  debugger_setRelativeFunctionBpAtLine("CIL_runCANToAppli", "308");
  
  debugger_deleteAllBreakpoints();
  debugger_run();
  
  testStep("STEP", "Set a breakpoint in function cil_TriggerProfiles at line /* [COVERS: DSG_CIL_0035, DSG_CIL_0031] */:.");
  debugger_setRelativeFunctionBpAtLine("cil_TriggerProfiles", "334");
  
  testStep("STEP", "Set a breakpoint at the end of the function cil_RequestTensioning.");
  debugger_setBpAtLine("s:\\Components\\Application\\Autoliv\\CIL\\Implementation\\src\\CIL_CANToAppli.c", "1452"); 
  
  testCaseComment("Action: ARCH_SW_CIL_0129");
  testStep("STEP", "Check if CPU stopped in function cil_RequestTensioning. --> CPU stopped at BP");
  debugger_waitUntilBPisReached("1000");
//  ExpectedTestResult(debugger_result,IS_CPU_STOP_AT_BP_SUCCESFUL, "CPU stopped at BP");
  
  debugger_deleteAllBreakpoints();
  debugger_reset();
  debugger_run();
  
  testCaseComment("Action: ARCH_SW_CIL_0129, ARCH_SW_CIL_0142");
  testStep("STEP", "Check if variable Rte_CIL_prrCrashSeverityLevel_u8PreCrashSeverityLevel is KU8_PRECRASH_SEVERITY_LEVEL_10 --> KU8_PRECRASH_SEVERITY_LEVEL_10.");
  debugger_readVariable("uint8", "Rte_CIL_prrCrashSeverityLevel_u8PreCrashSeverityLevel", "0");
  ExpectedTestResult(debugger_result, "0xff", "0x9");
  //====================================================
  testCaseComment("Postcondition");
  testStep("STEP", "Return ECU to default values");
  
  debugger_deleteAllBreakpoints();
  setSignal(BODY3::RBTMFL_SP_Lvl_Rq_ST35, 0x0);
  
  debugger_run();
  
  RunPostTs(); 
  
  debugger_stop();
}

testcase SW_IT_CIL_TriggerProfiles_13()
{
  //***********************************Test report header*********************************
  testReportAddMiscInfoBlock("AUTOLIV ELECTRONICS document");
  TestReportAddMiscInfo("Nightly test", "No");
  TestReportAddMiscInfo("Test type", "Requirement-Based test");
  TestReportAddMiscInfo("Regression Test", "No");
  TestReportAddMiscInfo("Fault injection method used", "No");
  TestReportAddMiscInfo("Resource usage evaluation", "No");
  TestReportAddMiscInfo("Priority", "No");
  TestReportAddMiscInfo("Safety relevant", "No");
  
  AddRequirementInfo("Requirement under test", "ARCH_SW_CIL_0130, ARCH_SW_CIL_0143");
  AddRequirementInfo("ARCH_SW_CIL_0130", "If signal is received with value 12, then tensioning cycle 10 shall be requested.");
  AddRequirementInfo("ARCH_SW_CIL_0143", "If signal is received with value 12, then tensioning cycle 10 shall be requested.");
  //***************************************************************************************
    
  testCaseComment("Preconditions");
  testStep("STEP", "Bench Initialization");

  debugger_deleteAllBreakpoints();
  debugger_reset();
  debugger_run();
  
  RunPreTs();
  //====================================================
  
  testStep("STEP", "Start Development Session.");
  AuthenticateECU(2); // Development_Enhanced
  EnterDiagnosticSession("development");
  
  testStep("STEP", "Set signal RBTMFL_SP_Lvl_Rq_ST35 to I_C06_RBTM_LVL_RQ_PROFILE12.");
  setSignal(BODY3::RBTMFL_SP_Lvl_Rq_ST35, 0xC);
  testWaitForTimeout(500);
  
  testStep("STEP", "Set a breakpoint in function CIL_runCANToAppli at line cil_TriggerProfiles(CIL_stManagedCycle.u8CurrentRequestedCycle);.");
  debugger_setRelativeFunctionBpAtLine("CIL_runCANToAppli", "308");
  
  debugger_deleteAllBreakpoints();
  debugger_run();
  
  testStep("STEP", "Set a breakpoint in function cil_TriggerProfiles under case I_C06_RBTM_LVL_RQ_PROFILE12:.");
  debugger_setRelativeFunctionBpAtLine("cil_TriggerProfiles", "352");
  
  testStep("STEP", "Set a breakpoint at the end of the function cil_RequestTensioning.");
  debugger_setBpAtLine("s:\\Components\\Application\\Autoliv\\CIL\\Implementation\\src\\CIL_CANToAppli.c", "1452"); 
  
  testCaseComment("Action: ARCH_SW_CIL_0130");
  testStep("STEP", "Check if CPU stopped in function cil_RequestTensioning. --> CPU stopped at BP");
  debugger_waitUntilBPisReached("1000");
//  ExpectedTestResult(debugger_result,IS_CPU_STOP_AT_BP_SUCCESFUL, "CPU stopped at BP");
  
  debugger_deleteAllBreakpoints();
  debugger_reset();
  debugger_run();
  
  testCaseComment("Action: ARCH_SW_CIL_0130, ARCH_SW_CIL_0143");
  testStep("STEP", "Check if variable Rte_CIL_prrCrashSeverityLevel_u8PreCrashSeverityLevel is KU8_PRECRASH_SEVERITY_LEVEL_11 --> KU8_PRECRASH_SEVERITY_LEVEL_11.");
  debugger_readVariable("uint8", "Rte_CIL_prrCrashSeverityLevel_u8PreCrashSeverityLevel", "0");
  ExpectedTestResult(debugger_result, "0xff", "0xa");
  
  //====================================================
  testCaseComment("Postcondition");
  testStep("STEP", "Return ECU to default values");
  
  debugger_deleteAllBreakpoints();
  setSignal(BODY3::RBTMFL_SP_Lvl_Rq_ST35, 0x0);
  
  debugger_run();
  
  RunPostTs(); 
  
  debugger_stop();
}


testcase SW_IT_CIL_TriggerProfiles_14()
{
  //***********************************Test report header*********************************
  testReportAddMiscInfoBlock("AUTOLIV ELECTRONICS document");
  TestReportAddMiscInfo("Nightly test", "No");
  TestReportAddMiscInfo("Test type", "Requirement-Based test");
  TestReportAddMiscInfo("Regression Test", "No");
  TestReportAddMiscInfo("Fault injection method used", "No");
  TestReportAddMiscInfo("Resource usage evaluation", "No");
  TestReportAddMiscInfo("Priority", "No");
  TestReportAddMiscInfo("Safety relevant", "No");
  
  AddRequirementInfo("Requirement under test", "ARCH_SW_CIL_0131, ARCH_SW_CIL_0144");
  AddRequirementInfo("ARCH_SW_CIL_0131", "If signal is received with value 13, then tensioning cycle 11 shall be requested.");
  AddRequirementInfo("ARCH_SW_CIL_0144", "If signal is received with value 13, then tensioning cycle 11 shall be requested.");
  //***************************************************************************************
    
  testCaseComment("Preconditions");
  testStep("STEP", "Bench Initialization");

  debugger_deleteAllBreakpoints();
  debugger_reset();
  debugger_run();
  
  RunPreTs();
  //====================================================
  
  testStep("STEP", "Start Development Session.");
  AuthenticateECU(2); // Development_Enhanced
  EnterDiagnosticSession("development");
  
  testStep("STEP", "Set signal RBTMFL_SP_Lvl_Rq_ST35 to I_C06_RBTM_LVL_RQ_PROFILE13.");
  setSignal(BODY3::RBTMFL_SP_Lvl_Rq_ST35, 0xD);
  testWaitForTimeout(500);
  
  testStep("STEP", "Set a breakpoint in function CIL_runCANToAppli at line cil_TriggerProfiles(CIL_stManagedCycle.u8CurrentRequestedCycle);.");
  debugger_setRelativeFunctionBpAtLine("CIL_runCANToAppli", "308");
  
  debugger_deleteAllBreakpoints();
  debugger_run();
  
  testStep("STEP", "Set a breakpoint in function cil_TriggerProfiles under case I_C06_RBTM_LVL_RQ_PROFILE13:.");
  debugger_setRelativeFunctionBpAtLine("cil_TriggerProfiles", "355");
  
  testStep("STEP", "Set a breakpoint at the end of the function cil_RequestTensioning.");
  debugger_setBpAtLine("s:\\Components\\Application\\Autoliv\\CIL\\Implementation\\src\\CIL_CANToAppli.c", "1452"); 
  
  testCaseComment("Action: ARCH_SW_CIL_0131");
  testStep("STEP", "Check if CPU stopped in function cil_RequestTensioning. --> CPU stopped at BP");
  debugger_waitUntilBPisReached("1000");
//  ExpectedTestResult(debugger_result,IS_CPU_STOP_AT_BP_SUCCESFUL, "CPU stopped at BP");
  
  debugger_deleteAllBreakpoints();
  debugger_reset();
  debugger_run();
  
  testCaseComment("Action: ARCH_SW_CIL_0131, ARCH_SW_CIL_0144");
  testStep("STEP", "Check if variable Rte_CIL_prrCrashSeverityLevel_u8PreCrashSeverityLevel is KU8_PRECRASH_SEVERITY_LEVEL_12 --> KU8_PRECRASH_SEVERITY_LEVEL_12.");
  debugger_readVariable("uint8", "Rte_CIL_prrCrashSeverityLevel_u8PreCrashSeverityLevel", "0");
  ExpectedTestResult(debugger_result, "0xff", "0xb");
  
  //====================================================
  testCaseComment("Postcondition");
  testStep("STEP", "Return ECU to default values");
  
  debugger_deleteAllBreakpoints();
  setSignal(BODY3::RBTMFL_SP_Lvl_Rq_ST35, 0x0);
  
  debugger_run();
  
  RunPostTs(); 
  
  debugger_stop();
}


testcase SW_IT_CIL_TriggerProfiles_15()
{
  //***********************************Test report header*********************************
  testReportAddMiscInfoBlock("AUTOLIV ELECTRONICS document");
  TestReportAddMiscInfo("Nightly test", "No");
  TestReportAddMiscInfo("Test type", "Requirement-Based test");
  TestReportAddMiscInfo("Regression Test", "No");
  TestReportAddMiscInfo("Fault injection method used", "No");
  TestReportAddMiscInfo("Resource usage evaluation", "No");
  TestReportAddMiscInfo("Priority", "No");
  TestReportAddMiscInfo("Safety relevant", "No");
  
  AddRequirementInfo("Requirement under test", "ARCH_SW_CIL_0132, ARCH_SW_CIL_0145");
  AddRequirementInfo("ARCH_SW_CIL_0132", "If signal is received with value 14, then tensioning cycle 12 shall be requested.");
  AddRequirementInfo("ARCH_SW_CIL_0145", "If signal is received with value 14, then tensioning cycle 12 shall be requested.");
  //***************************************************************************************
    
  testCaseComment("Preconditions");
  testStep("STEP", "Bench Initialization");

  debugger_deleteAllBreakpoints();
  debugger_reset();
  debugger_run();
  
  RunPreTs();
  //====================================================
  
  testStep("STEP", "Start Development Session.");
  AuthenticateECU(2); // Development_Enhanced
  EnterDiagnosticSession("development");
  
  testStep("STEP", "Set signal RBTMFL_SP_Lvl_Rq_ST35 to I_C06_RBTM_LVL_RQ_PROFILE14.");
  setSignal(BODY3::RBTMFL_SP_Lvl_Rq_ST35, 0xE);
  testWaitForTimeout(500);
  
  testStep("STEP", "Set a breakpoint in function CIL_runCANToAppli at line cil_TriggerProfiles(CIL_stManagedCycle.u8CurrentRequestedCycle);.");
  debugger_setRelativeFunctionBpAtLine("CIL_runCANToAppli", "308");
  
  debugger_deleteAllBreakpoints();
  debugger_run();
  
  testStep("STEP", "Set a breakpoint in function cil_TriggerProfiles under case I_C06_RBTM_LVL_RQ_PROFILE14:.");
  debugger_setRelativeFunctionBpAtLine("cil_TriggerProfiles", "388");
  
  testStep("STEP", "Set a breakpoint at the end of the function cil_RequestTensioning.");
  debugger_setBpAtLine("s:\\Components\\Application\\Autoliv\\CIL\\Implementation\\src\\CIL_CANToAppli.c", "1452"); 
  
  testCaseComment("Action: ARCH_SW_CIL_0132");
  testStep("STEP", "Check if CPU stopped in function cil_RequestTensioning. --> CPU stopped at BP");
  debugger_waitUntilBPisReached("1000");
//  ExpectedTestResult(debugger_result,IS_CPU_STOP_AT_BP_SUCCESFUL, "CPU stopped at BP");
  
  debugger_deleteAllBreakpoints();
  debugger_reset();
  debugger_run();
  
  testCaseComment("Action: ARCH_SW_CIL_0132, ARCH_SW_CIL_0145");
  testStep("STEP", "Check if variable Rte_CIL_prrCrashSeverityLevel_u8PreCrashSeverityLevel is KU8_PRECRASH_SEVERITY_LEVEL_13 --> KU8_PRECRASH_SEVERITY_LEVEL_13.");
  debugger_readVariable("uint8", "Rte_CIL_prrCrashSeverityLevel_u8PreCrashSeverityLevel", "0");
  ExpectedTestResult(debugger_result, "0xff", "0xc");
  
  //====================================================
  testCaseComment("Postcondition");
  testStep("STEP", "Return ECU to default values");
  
  debugger_deleteAllBreakpoints();
  setSignal(BODY3::RBTMFL_SP_Lvl_Rq_ST35, 0x0);
  
  debugger_run();
  
  RunPostTs(); 
  
  debugger_stop();
}

testcase SW_IT_CIL_TriggerProfiles_16()
{
  //***********************************Test report header*********************************
  testReportAddMiscInfoBlock("AUTOLIV ELECTRONICS document");
  TestReportAddMiscInfo("Nightly test", "No");
  TestReportAddMiscInfo("Test type", "Requirement-Based test");
  TestReportAddMiscInfo("Regression Test", "No");
  TestReportAddMiscInfo("Fault injection method used", "No");
  TestReportAddMiscInfo("Resource usage evaluation", "No");
  TestReportAddMiscInfo("Priority", "No");
  TestReportAddMiscInfo("Safety relevant", "No");
  
  AddRequirementInfo("Requirement under test", "ARCH_SW_CIL_0133, ARCH_SW_CIL_0146, ARCH_SW_CIL_0058");
  AddRequirementInfo("ARCH_SW_CIL_0133", "If signal is received with value 15, then tensioning cycle 13 shall be requested.");
  AddRequirementInfo("ARCH_SW_CIL_0146", "If signal is received with value 15, then tensioning cycle 13 shall be requested.");
  AddRequirementInfo("ARCH_SW_CIL_0058", "Signal RBTMFR_SP_Lvl_Rq_ST35 shall be send though application when it’s needed.");
  //***************************************************************************************
    
  testCaseComment("Preconditions");
  testStep("STEP", "Bench Initialization");

  debugger_deleteAllBreakpoints();
  
  
  debugger_reset();
  debugger_run();
  
  RunPreTs();
  //====================================================
  
  testStep("STEP", "Start Development Session.");
  AuthenticateECU(2); // Development_Enhanced
  EnterDiagnosticSession("development");
  
  testStep("STEP", "Set signal RBTMFL_SP_Lvl_Rq_ST35 to I_C06_RBTM_LVL_RQ_PROFILE15.");
  setSignal(BODY3::RBTMFL_SP_Lvl_Rq_ST35, 0xF);
  testWaitForTimeout(500);
  
  testStep("STEP", "Set a breakpoint in function CIL_runCANToAppli at line cil_TriggerProfiles(CIL_stManagedCycle.u8CurrentRequestedCycle);.");
  debugger_setRelativeFunctionBpAtLine("CIL_runCANToAppli", "308");
  
  debugger_deleteAllBreakpoints();
  debugger_run();
  
  testStep("STEP", "Set a breakpoint in function cil_TriggerProfiles under case I_C06_RBTM_LVL_RQ_PROFILE15:.");
  debugger_setRelativeFunctionBpAtLine("cil_TriggerProfiles", "406");
  
  testStep("STEP", "Set a breakpoint at the end of the function cil_RequestTensioning.");
  debugger_setBpAtLine("s:\\Components\\Application\\Autoliv\\CIL\\Implementation\\src\\CIL_CANToAppli.c", "1452"); 
  
  testCaseComment("Action: ARCH_SW_CIL_0133, ARCH_SW_CIL_0146");
  testStep("STEP", "Check if CPU stopped in function cil_RequestTensioning. --> CPU stopped at BP");
  debugger_waitUntilBPisReached("1000");
//  ExpectedTestResult(debugger_result,IS_CPU_STOP_AT_BP_SUCCESFUL, "CPU stopped at BP");
  
  debugger_deleteAllBreakpoints();
  debugger_reset();
  debugger_run();
  
  testCaseComment("Action: ARCH_SW_CIL_0133, ARCH_SW_CIL_0058, ARCH_SW_CIL_0146");
  testStep("STEP", "Check if variable Rte_CIL_prrCrashSeverityLevel_u8PreCrashSeverityLevel is KU8_PRECRASH_SEVERITY_LEVEL_14 --> KU8_PRECRASH_SEVERITY_LEVEL_14.");
  debugger_readVariable("uint8", "Rte_CIL_prrCrashSeverityLevel_u8PreCrashSeverityLevel", "0");
  ExpectedTestResult(debugger_result, "0xff", "0xd");
  
  //====================================================
  testCaseComment("Postcondition");
  testStep("STEP", "Return ECU to default values");
  
  debugger_deleteAllBreakpoints();
  setSignal(BODY3::RBTMFL_SP_Lvl_Rq_ST35, 0x0);
  
  debugger_run();
  
  RunPostTs(); 
  
  debugger_stop();
}


testcase SW_IT_CIL_TriggerProfiles_17()
{
  //***********************************Test report header*********************************
  testReportAddMiscInfoBlock("AUTOLIV ELECTRONICS document");
  TestReportAddMiscInfo("Nightly test", "No");
  TestReportAddMiscInfo("Test type", "Requirement-Based test");
  TestReportAddMiscInfo("Regression Test", "No");
  TestReportAddMiscInfo("Fault injection method used", "No");
  TestReportAddMiscInfo("Resource usage evaluation", "No");
  TestReportAddMiscInfo("Priority", "No");
  TestReportAddMiscInfo("Safety relevant", "No");
  
  AddRequirementInfo("Requirement under test", "ARCH_SW_CIL_0092, ARCH_SW_CIL_0093");
  AddRequirementInfo("ARCH_SW_CIL_0092", "If signal is received with value 22, then tensioning Presafe curve 1, cycle 14, shall be requested.");
  AddRequirementInfo("ARCH_SW_CIL_0093", "If signal is received with value 22, then tensioning Presafe curve 1, cycle 14, shall be requested.");
  //***************************************************************************************
    
  testCaseComment("Preconditions");
  testStep("STEP", "Bench Initialization");

  debugger_deleteAllBreakpoints();
  debugger_reset();
  debugger_run();
  
  RunPreTs();
  //====================================================
  
  testStep("STEP", "Start Development Session.");
  AuthenticateECU(2); // Development_Enhanced
  EnterDiagnosticSession("development");
  
  testStep("STEP", "Set signal RBTMFL_SP_Lvl_Rq_ST35 to I_C06_RBTM_LVL_RQ_PROFILE22.");
  setSignal(BODY3::RBTMFL_SP_Lvl_Rq_ST35, 22);
  testWaitForTimeout(500);
  
  testStep("STEP", "Set a breakpoint in function CIL_runCANToAppli at line cil_TriggerProfiles(CIL_stManagedCycle.u8CurrentRequestedCycle);.");
  debugger_setRelativeFunctionBpAtLine("CIL_runCANToAppli", "308");
  
  debugger_deleteAllBreakpoints();
  debugger_run();
  
  testStep("STEP", "Set a breakpoint in function cil_TriggerProfiles under case I_C06_RBTM_LVL_RQ_PROFILE22:.");
  debugger_setRelativeFunctionBpAtLine("cil_TriggerProfiles", "422");
  
  testStep("STEP", "Set a breakpoint at the end of the function cil_RequestTensioning.");
  debugger_setBpAtLine("s:\\Components\\Application\\Autoliv\\CIL\\Implementation\\src\\CIL_CANToAppli.c", "1452"); 
  
  testCaseComment("Action: ARCH_SW_CIL_0092, ARCH_SW_CIL_0093");
  testStep("STEP", "Check if CPU stopped in function cil_RequestTensioning. --> CPU stopped at BP");
  debugger_waitUntilBPisReached("1000");
//  ExpectedTestResult(debugger_result,IS_CPU_STOP_AT_BP_SUCCESFUL, "CPU stopped at BP");
  
  debugger_deleteAllBreakpoints();
  debugger_reset();
  debugger_run();
  
  testCaseComment("Action: ARCH_SW_CIL_0092, ARCH_SW_CIL_0093");
  testStep("STEP", "Check if variable Rte_CIL_prrCrashSeverityLevel_u8PreCrashSeverityLevel is KU8_PRECRASH_SEVERITY_LEVEL_15 --> KU8_PRECRASH_SEVERITY_LEVEL_15.");
  debugger_readVariable("uint8", "Rte_CIL_prrCrashSeverityLevel_u8PreCrashSeverityLevel", "0");
  ExpectedTestResult(debugger_result, "0xff", "0xe");
  
  //====================================================
  testCaseComment("Postcondition");
  testStep("STEP", "Return ECU to default values");
  
  debugger_deleteAllBreakpoints();
  setSignal(BODY3::RBTMFL_SP_Lvl_Rq_ST35, 0);
  debugger_run();
  
  RunPostTs(); 
  
  debugger_stop();
}


testcase SW_IT_CIL_TriggerProfiles_18()
{
  //***********************************Test report header*********************************
  testReportAddMiscInfoBlock("AUTOLIV ELECTRONICS document");
  TestReportAddMiscInfo("Nightly test", "No");
  TestReportAddMiscInfo("Test type", "Requirement-Based test");
  TestReportAddMiscInfo("Regression Test", "No");
  TestReportAddMiscInfo("Fault injection method used", "No");
  TestReportAddMiscInfo("Resource usage evaluation", "No");
  TestReportAddMiscInfo("Priority", "No");
  TestReportAddMiscInfo("Safety relevant", "No");
  
  AddRequirementInfo("Requirement under test", "ARCH_SW_CIL_0134, ARCH_SW_CIL_0147");
  AddRequirementInfo("ARCH_SW_CIL_0134", "If signal is received with value 23, then tensioning Presafe curve 2, cycle 15, shall be requested.");
  AddRequirementInfo("ARCH_SW_CIL_0147", "If signal is received with value 23, then tensioning Presafe curve 2, cycle 15, shall be requested.");
  //***************************************************************************************
    
  testCaseComment("Preconditions");
  testStep("STEP", "Bench Initialization");

  debugger_deleteAllBreakpoints();
  debugger_reset();
  debugger_run();
  
  RunPreTs();
  //====================================================
  
  testStep("STEP", "Start Development Session.");
  AuthenticateECU(2); // Development_Enhanced
  EnterDiagnosticSession("development");
  
  testStep("STEP", "Set signal RBTMFL_SP_Lvl_Rq_ST35 to I_C06_RBTM_LVL_RQ_PROFILE23.");
  setSignal(BODY3::RBTMFL_SP_Lvl_Rq_ST35, 23);
  testWaitForTimeout(500);
  
  testStep("STEP", "Set a breakpoint in function CIL_runCANToAppli at line cil_TriggerProfiles(CIL_stManagedCycle.u8CurrentRequestedCycle);.");
  debugger_setRelativeFunctionBpAtLine("CIL_runCANToAppli", "308");
  
  debugger_deleteAllBreakpoints();
  debugger_run();
  
  testStep("STEP", "Set a breakpoint in function cil_TriggerProfiles under case I_C06_RBTM_LVL_RQ_PROFILE23:.");
  debugger_setRelativeFunctionBpAtLine("cil_TriggerProfiles", "445");
  
  testStep("STEP", "Set a breakpoint at the end of the function cil_RequestTensioning.");
  debugger_setBpAtLine("s:\\Components\\Application\\Autoliv\\CIL\\Implementation\\src\\CIL_CANToAppli.c", "1452"); 
  
  testCaseComment("Action: ARCH_SW_CIL_0134");
  testStep("STEP", "Check if CPU stopped in function cil_RequestTensioning. --> CPU stopped at BP");
  debugger_waitUntilBPisReached("1000");
//  ExpectedTestResult(debugger_result,IS_CPU_STOP_AT_BP_SUCCESFUL, "CPU stopped at BP");
  
  debugger_deleteAllBreakpoints();
  debugger_reset();
  debugger_run();
  
  testCaseComment("Action: ARCH_SW_CIL_0134, ARCH_SW_CIL_0147");
  testStep("STEP", "Check if variable Rte_CIL_prrCrashSeverityLevel_u8PreCrashSeverityLevel is KU8_PRECRASH_SEVERITY_LEVEL_16 --> KU8_PRECRASH_SEVERITY_LEVEL_16.");
  debugger_readVariable("uint8", "Rte_CIL_prrCrashSeverityLevel_u8PreCrashSeverityLevel", "0");
  ExpectedTestResult(debugger_result, "0xff", "0xf");
  
  //====================================================
  testCaseComment("Postcondition");
  testStep("STEP", "Return ECU to default values");
  
  debugger_deleteAllBreakpoints();
  setSignal(BODY3::RBTMFL_SP_Lvl_Rq_ST35, 0);
  
  debugger_run();
  
  RunPostTs(); 
  
  debugger_stop();
}


testcase SW_IT_CIL_TriggerProfiles_19()
{
  //***********************************Test report header*********************************
  testReportAddMiscInfoBlock("AUTOLIV ELECTRONICS document");
  TestReportAddMiscInfo("Nightly test", "No");
  TestReportAddMiscInfo("Test type", "Requirement-Based test");
  TestReportAddMiscInfo("Regression Test", "No");
  TestReportAddMiscInfo("Fault injection method used", "No");
  TestReportAddMiscInfo("Resource usage evaluation", "No");
  TestReportAddMiscInfo("Priority", "No");
  TestReportAddMiscInfo("Safety relevant", "No");
  
  AddRequirementInfo("Requirement under test", "ARCH_SW_CIL_0135, ARCH_SW_CIL_0148");
  AddRequirementInfo("ARCH_SW_CIL_0135", "If signal is received with value 24, then tensioning Presafe curve 3, cycle 16, shall be requested.");
  AddRequirementInfo("ARCH_SW_CIL_0148", "If signal is received with value 24, then tensioning Presafe curve 3, cycle 16, shall be requested.");
  //***************************************************************************************
    
  testCaseComment("Preconditions");
  testStep("STEP", "Bench Initialization");

  debugger_deleteAllBreakpoints();
  debugger_reset();
  debugger_run();
  
  RunPreTs();
  //====================================================
  
  testStep("STEP", "Start Development Session.");
  AuthenticateECU(2); // Development_Enhanced
  EnterDiagnosticSession("development");
  
  testStep("STEP", "Set signal RBTMFL_SP_Lvl_Rq_ST35 to I_C06_RBTM_LVL_RQ_PROFILE24.");
  setSignal(BODY3::RBTMFL_SP_Lvl_Rq_ST35, 24);
  testWaitForTimeout(500);
  
  testStep("STEP", "Set a breakpoint in function CIL_runCANToAppli at line cil_TriggerProfiles(CIL_stManagedCycle.u8CurrentRequestedCycle);.");
  debugger_setRelativeFunctionBpAtLine("CIL_runCANToAppli", "308");
  
  debugger_deleteAllBreakpoints();
  debugger_run();
  
  testStep("STEP", "Set a breakpoint in function cil_TriggerProfiles under case I_C06_RBTM_LVL_RQ_PROFILE24:.");
  debugger_setRelativeFunctionBpAtLine("cil_TriggerProfiles", "475");
  
  testStep("STEP", "Set a breakpoint at the end of the function cil_RequestTensioning.");
  debugger_setBpAtLine("s:\\Components\\Application\\Autoliv\\CIL\\Implementation\\src\\CIL_CANToAppli.c", "1452"); 
  
  testCaseComment("Action: ARCH_SW_CIL_0135");
  testStep("STEP", "Check if CPU stopped in function cil_RequestTensioning. --> CPU stopped at BP");
  debugger_waitUntilBPisReached("1000");
//  ExpectedTestResult(debugger_result,IS_CPU_STOP_AT_BP_SUCCESFUL, "CPU stopped at BP");
  
  debugger_deleteAllBreakpoints();
  debugger_reset();
  debugger_run();
  
  testCaseComment("Action: ARCH_SW_CIL_0135, ARCH_SW_CIL_0148");
  testStep("STEP", "Check if variable Rte_CIL_prrCrashSeverityLevel_u8PreCrashSeverityLevel is KU8_PRECRASH_SEVERITY_LEVEL_17 --> KU8_PRECRASH_SEVERITY_LEVEL_17.");
  debugger_readVariable("uint8", "Rte_CIL_prrCrashSeverityLevel_u8PreCrashSeverityLevel", "0");
  ExpectedTestResult(debugger_result, "0xff", "0x10");
  
  //====================================================
  testCaseComment("Postcondition");
  testStep("STEP", "Return ECU to default values");
  
  debugger_deleteAllBreakpoints();
  setSignal(BODY3::RBTMFL_SP_Lvl_Rq_ST35, 0);
  
  debugger_run();
  
  RunPostTs(); 
  
  debugger_stop();
}


testcase SW_IT_CIL_TriggerProfiles_20()
{
  //***********************************Test report header*********************************
  testReportAddMiscInfoBlock("AUTOLIV ELECTRONICS document");
  TestReportAddMiscInfo("Nightly test", "No");
  TestReportAddMiscInfo("Test type", "Requirement-Based test");
  TestReportAddMiscInfo("Regression Test", "No");
  TestReportAddMiscInfo("Fault injection method used", "No");
  TestReportAddMiscInfo("Resource usage evaluation", "No");
  TestReportAddMiscInfo("Priority", "No");
  TestReportAddMiscInfo("Safety relevant", "No");
  
  AddRequirementInfo("Requirement under test", "ARCH_SW_CIL_0136, ARCH_SW_CIL_0149");
  AddRequirementInfo("ARCH_SW_CIL_0136", "If signal is received with value 25, then tensioning Presafe curve 4, cycle 17, shall be requested.");
  AddRequirementInfo("ARCH_SW_CIL_0136", "If signal is received with value 25, then tensioning Presafe curve 4, cycle 17, shall be requested.");
  //***************************************************************************************
    
  testCaseComment("Preconditions");
  testStep("STEP", "Bench Initialization");

  debugger_deleteAllBreakpoints();
  debugger_reset();
  debugger_run();
  
  RunPreTs();
  //====================================================
  
  testStep("STEP", "Start Development Session.");
  AuthenticateECU(2); // Development_Enhanced
  EnterDiagnosticSession("development");
  
  testStep("STEP", "Set signal RBTMFL_SP_Lvl_Rq_ST35 to I_C06_RBTM_LVL_RQ_PROFILE25.");
  setSignal(BODY3::RBTMFL_SP_Lvl_Rq_ST35, 25);
  testWaitForTimeout(500);
  
  testStep("STEP", "Set a breakpoint in function CIL_runCANToAppli at line cil_TriggerProfiles(CIL_stManagedCycle.u8CurrentRequestedCycle);.");
  debugger_setRelativeFunctionBpAtLine("CIL_runCANToAppli", "308");
  
  debugger_deleteAllBreakpoints();
  debugger_run();
  
  testStep("STEP", "Set a breakpoint in function cil_TriggerProfiles under case I_C06_RBTM_LVL_RQ_PROFILE25:.");
  debugger_setRelativeFunctionBpAtLine("cil_TriggerProfiles", "488");
  
  testStep("STEP", "Set a breakpoint at the end of the function cil_RequestTensioning.");
  debugger_setBpAtLine("s:\\Components\\Application\\Autoliv\\CIL\\Implementation\\src\\CIL_CANToAppli.c", "1452"); 
  
  testCaseComment("Action: ARCH_SW_CIL_0136");
  testStep("STEP", "Check if CPU stopped in function cil_RequestTensioning. --> CPU stopped at BP");
  debugger_waitUntilBPisReached("1000");
//  ExpectedTestResult(debugger_result,IS_CPU_STOP_AT_BP_SUCCESFUL, "CPU stopped at BP");
  
  debugger_deleteAllBreakpoints();
  debugger_reset();
  debugger_run();
  
  testCaseComment("Action: ARCH_SW_CIL_0136, ARCH_SW_CIL_0149");
  testStep("STEP", "Check if variable Rte_CIL_prrCrashSeverityLevel_u8PreCrashSeverityLevel is KU8_PRECRASH_SEVERITY_LEVEL_18 --> KU8_PRECRASH_SEVERITY_LEVEL_18.");
  debugger_readVariable("uint8", "Rte_CIL_prrCrashSeverityLevel_u8PreCrashSeverityLevel", "0");
  ExpectedTestResult(debugger_result, "0xff", "0x11");
  
  //====================================================
  testCaseComment("Postcondition");
  testStep("STEP", "Return ECU to default values");
  
  debugger_deleteAllBreakpoints();
  setSignal(BODY3::RBTMFL_SP_Lvl_Rq_ST35, I_C04_PRESF_LVL_V2_NOLVL);
  
  debugger_run();
  
  RunPostTs(); 
  
  debugger_stop();
}

testcase SW_IT_CIL_TriggerProfiles_NOLVL_01()
{
  //***********************************Test report header*********************************
  testReportAddMiscInfoBlock("AUTOLIV ELECTRONICS document");
  TestReportAddMiscInfo("Nightly test", "No");
  TestReportAddMiscInfo("Test type", "Requirement-Based test");
  TestReportAddMiscInfo("Regression Test", "No");
  TestReportAddMiscInfo("Fault injection method used", "No");
  TestReportAddMiscInfo("Resource usage evaluation", "No");
  TestReportAddMiscInfo("Priority", "No");
  TestReportAddMiscInfo("Safety relevant", "No");
  
  AddRequirementInfo("Requirement under test", "ARCH_SW_CIL_0057, ARCH_SW_CIL_0080");
  AddRequirementInfo("ARCH_SW_CIL_0057", "If any other value than the ones mentioned above is received for signal RBTMFL_SP_Lvl_Rq_ST35 then no cycle should be requested.");
  AddRequirementInfo("ARCH_SW_CIL_0080", "A requested cycle will end if RBTMFL_SP_Lvl_Rq_ST35 signal is received on CAN with value 0.");
  //***************************************************************************************
    
  testCaseComment("Preconditions");
  testStep("STEP", "Bench Initialization");

  debugger_deleteAllBreakpoints();
  debugger_reset();
  debugger_run();
  
  RunPreTs();
  //====================================================
  
  testStep("STEP", "Start Development Session.");
  AuthenticateECU(2); // Development_Enhanced
  EnterDiagnosticSession("development");
  
  testStep("STEP", "Set signal RBTMFL_SP_Lvl_Rq_ST35 to I_C04_PRESF_LVL_V2_NOLVL.");
  setSignal(BODY3::RBTMFL_SP_Lvl_Rq_ST35, 0);
  testWaitForTimeout(500);
  
  testStep("STEP", "Set a breakpoint in function CIL_runCANToAppli at line cil_TriggerProfiles(CIL_stManagedCycle.u8CurrentRequestedCycle);.");
  debugger_setRelativeFunctionBpAtLine("CIL_runCANToAppli", "308");
  
  debugger_deleteAllBreakpoints();
  debugger_run();
  
  testStep("STEP", "Set a breakpoint in function cil_TriggerProfiles under case KU8_NO_CYCLE:.");
  debugger_setRelativeFunctionBpAtLine("cil_TriggerProfiles", "0");
  
  testCaseComment("Action: ARCH_SW_CIL_0057, ARCH_SW_CIL_0080");
  testStep("STEP", "Check if CPU stopped in function cil_RequestTensioning. --> CPU stopped at BP");
  debugger_waitUntilBPisReached("1000");
  ExpectedTestResult(debugger_result,IS_CPU_STOP_AT_BP_SUCCESFUL, "CPU stopped at BP");
  
  //====================================================
  testCaseComment("Postcondition");
  testStep("STEP", "Return ECU to default values");
  
  debugger_deleteAllBreakpoints();
  
  debugger_run();
  
  RunPostTs(); 
  
  debugger_stop();
}


testcase SW_IT_CIL_TriggerProfiles_NOLVL_02()
{
  //***********************************Test report header*********************************
  testReportAddMiscInfoBlock("AUTOLIV ELECTRONICS document");
  TestReportAddMiscInfo("Nightly test", "No");
  TestReportAddMiscInfo("Test type", "Requirement-Based test");
  TestReportAddMiscInfo("Regression Test", "No");
  TestReportAddMiscInfo("Fault injection method used", "No");
  TestReportAddMiscInfo("Resource usage evaluation", "No");
  TestReportAddMiscInfo("Priority", "No");
  TestReportAddMiscInfo("Safety relevant", "No");
  
  AddRequirementInfo("Requirement under test", "ARCH_SW_CIL_0064, ARCH_SW_CIL_0081");
  AddRequirementInfo("ARCH_SW_CIL_0064", "If any other value than 1,2,3,4,5 and 22 is received for signal RBTMFR_SP_Lvl_Rq_ST35 then no cycle should be requested.");
  AddRequirementInfo("ARCH_SW_CIL_0081", "A requested cycle will end if RBTMFR_SP_Lvl_Rq_ST35 signal is received on CAN with value 0.");
  //***************************************************************************************
    
  testCaseComment("Preconditions");
  testStep("STEP", "Bench Initialization");

  debugger_deleteAllBreakpoints();
  debugger_reset();
  debugger_run();
  
  RunPreTs();
  //====================================================
  
  testStep("STEP", "Start Development Session.");
  AuthenticateECU(2); // Development_Enhanced
  EnterDiagnosticSession("development");
  
  testStep("STEP", "Set signal RBTMFR_SP_Lvl_Rq_ST35 to I_C04_PRESF_LVL_V2_NOLVL.");
  setSignal(BODY3::RBTMFR_SP_Lvl_Rq_ST35, 0);
  testWaitForTimeout(500);
  
  testStep("STEP", "Set a breakpoint in function CIL_runCANToAppli at line cil_TriggerProfiles(CIL_stManagedCycle.u8CurrentRequestedCycle);.");
  debugger_setRelativeFunctionBpAtLine("CIL_runCANToAppli", "308");
  
  debugger_deleteAllBreakpoints();
  debugger_run();
  
  testStep("STEP", "Set a breakpoint in function cil_TriggerProfiles under case KU8_NO_CYCLE:.");
  debugger_setRelativeFunctionBpAtLine("cil_TriggerProfiles", "0");
  
  testCaseComment("Action: ARCH_SW_CIL_0064, ARCH_SW_CIL_0081");
  testStep("STEP", "Check if CPU stopped in function cil_RequestTensioning. --> CPU stopped at BP");
  debugger_waitUntilBPisReached("1000");
  ExpectedTestResult(debugger_result,IS_CPU_STOP_AT_BP_SUCCESFUL, "CPU stopped at BP");
  
  //====================================================
  testCaseComment("Postcondition");
  testStep("STEP", "Return ECU to default values");
  
  debugger_deleteAllBreakpoints();
  
  debugger_run();
  
  RunPostTs(); 
  
  debugger_stop();
}


testcase SW_IT_CIL_Presf_Enbl_ST3_02()
{
  //***********************************Test report header*********************************
  testReportAddMiscInfoBlock("AUTOLIV ELECTRONICS document");
  TestReportAddMiscInfo("Nightly test", "No");
  TestReportAddMiscInfo("Test type", "Requirement-Based test");
  TestReportAddMiscInfo("Regression Test", "No");
  TestReportAddMiscInfo("Fault injection method used", "No");
  TestReportAddMiscInfo("Resource usage evaluation", "No");
  TestReportAddMiscInfo("Priority", "No");
  TestReportAddMiscInfo("Safety relevant", "No");
  
  AddRequirementInfo("Requirement under test", "ARCH_SW_CIL_0114");
  AddRequirementInfo("ARCH_SW_CIL_0114", "If Presf_Enbl_ST3 is different than 0 (disable) than next cycle release for previous presafe requested profiles is inhibitted.");
  //***************************************************************************************
    
  testCaseComment("Preconditions");
  testStep("STEP", "Bench Initialization");

  debugger_deleteAllBreakpoints();
  debugger_reset();
  debugger_run();
  
  RunPreTs();
  //====================================================
  
  testStep("STEP", "Start Development Session."); 
  AuthenticateECU(2); // Development_Enhanced
  EnterDiagnosticSession("development");
  
  testStep("STEP", "Set signal Presf_Enbl_ST3 to I_C04_PRESF_LVL_V2_LVL1.");
  setSignal(BODY3::PresfAct_Adj_ST3::Presf_Enbl_ST3, I_C04_PRESF_LVL_V2_LVL1);
  testWaitForTimeout(500);
  
  testStep("STEP", "Set a breakpoint in function cil_ManageInhibitConditions at line CIL_SET_INHIB_MASK_OFF (KU8_CIL_PresfEnableInhibition);.");
  debugger_setRelativeFunctionBpAtLine("cil_ManageInhibitConditions", "3");
  
  testCaseComment("Action: ARCH_SW_CIL_0114");
  testStep("STEP", "Check if CPU stopped in function cil_ManageInhibitConditions at line CIL_SET_INHIB_MASK_OFF (KU8_CIL_PresfEnableInhibition);. --> CPU stopped at BP");
  debugger_waitUntilBPisReached("1000");
  ExpectedTestResult(debugger_result,IS_CPU_STOP_AT_BP_SUCCESFUL, "CPU stopped at BP");
  
  //====================================================
  testCaseComment("Postcondition");
  testStep("STEP", "Return ECU to default values");
  
  debugger_deleteAllBreakpoints();
  
  debugger_run();
  
  RunPostTs(); 
  
  debugger_stop();
}



testcase SW_IT_CIL_PresfAccelReset_NotExcd_ST3_03()
{
  //***********************************Test report header*********************************
  testReportAddMiscInfoBlock("AUTOLIV ELECTRONICS document");
  TestReportAddMiscInfo("Nightly test", "No");
  TestReportAddMiscInfo("Test type", "Requirement-Based test");
  TestReportAddMiscInfo("Regression Test", "No");
  TestReportAddMiscInfo("Fault injection method used", "No");
  TestReportAddMiscInfo("Resource usage evaluation", "No");
  TestReportAddMiscInfo("Priority", "No");
  TestReportAddMiscInfo("Safety relevant", "No");
  
  AddRequirementInfo("Requirement under test", "ARCH_SW_CIL_0115");
  AddRequirementInfo("ARCH_SW_CIL_0115", "If PresfAccelReset_NotExcd_ST3 is 2 - Acceleration low(Release Allowed) for at leat 300ms than smooth release shall be executed.(after eachy cycle configured).");
  //***************************************************************************************
    
  testCaseComment("Preconditions");
  testStep("STEP", "Bench Initialization");

  debugger_deleteAllBreakpoints();
  debugger_reset();
  debugger_run();
  
  RunPreTs();
  //====================================================
  
  testStep("STEP", "Start Development Session."); 
  AuthenticateECU(2); // Development_Enhanced
  EnterDiagnosticSession("development");
  
  testStep("STEP", "Set signal PresfAccelReset_NotExcd_ST3 to I_C04_PRESF_LVL_V2_LVL2.");
  setSignal(BODY3::PresfAct_Adj_ST3::PresfAccelReset_NotExcd_ST3, I_C04_PRESF_LVL_V2_LVL2);
  testWaitForTimeout(500);
  
  testStep("STEP", "Set a breakpoint in function cil_ManageInhibitConditions.");
  debugger_setRelativeFunctionBpAtLine("cil_ManageInhibitConditions", "61");
  
  testCaseComment("Action: ARCH_SW_CIL_0117");
  testStep("STEP", "Read variable cil_stPresfActAdjFrame.PresfAccelReset_NotExcd_ST3 --> I_C04_PRESF_LVL_V2_LVL2.");
  debugger_readVariable("uint8", "cil_stPresfActAdjFrame,,app.elf", "7");
  ExpectedTestResult(debugger_result, "0x2", "0x2");
  
  testCaseComment("Action: ARCH_SW_CIL_0117");
  testStep("STEP", "Check if CPU stopped in the statement 'if( (KU8_TWO == cil_stPresfActAdjFrame.PresfAccelReset_NotExcd_ST3)'. --> CPU stopped at BP");
  debugger_waitUntilBPisReached("1000");
//  ExpectedTestResult(debugger_result,IS_CPU_STOP_AT_BP_SUCCESFUL, "CPU stopped at BP");
  
  //====================================================
  testCaseComment("Postcondition");
  testStep("STEP", "Return ECU to default values");
  
  debugger_deleteAllBreakpoints();
  
  debugger_run();
  
  RunPostTs(); 
  
  debugger_stop();
}

testcase SW_IT_CIL_PresfAct_Adj_ST3_02()
{
  //***********************************Test report header*********************************
  testReportAddMiscInfoBlock("AUTOLIV ELECTRONICS document");
  TestReportAddMiscInfo("Nightly test", "No");
  TestReportAddMiscInfo("Test type", "Requirement-Based test");
  TestReportAddMiscInfo("Regression Test", "No");
  TestReportAddMiscInfo("Fault injection method used", "No");
  TestReportAddMiscInfo("Resource usage evaluation", "No");
  TestReportAddMiscInfo("Priority", "No");
  TestReportAddMiscInfo("Safety relevant", "No");
  
  AddRequirementInfo("Requirement under test", "ARCH_SW_CIL_0001, ARCH_SW_CIL_0152");
  AddRequirementInfo("ARCH_SW_CIL_0152", "Signal PT4_PTCoor_EngStartPN14_Stat_ST3 shall be send though application when it’s needed (0,1,2,3,7).");
  //***************************************************************************************
  
  testCaseComment("Preconditions");
  testStep("STEP", "Bench Initialization");

  debugger_deleteAllBreakpoints();
  debugger_reset();
  debugger_run();

  RunPreTs();
  //====================================================
  
  testStep("STEP", "Start Development Session.");
  AuthenticateECU(2); // Development_Enhanced
  EnterDiagnosticSession("development");
  
  testStep("STEP", "Set signal Presf_Lvl_ST3 to I_C04_PRESF_LVL_V2_LVL2.");
  setSignal(BODY3::PT4_PTCoor_EngStartPN14_Stat_ST3, I_C04_PRESF_LVL_V2_LVL2);
  testWaitForTimeout(500);
  
  testStep("STEP", "Set a breakpoint in function CIL_ComNotification_PT4_PTCoor4_Pr5_ST3_af4fxb1ykieox3itqdfzs0kpb_2277a854_Rx.");
  debugger_setRelativeFunctionBpAtLine("CIL_ComNotification_PT4_PTCoor4_Pr5_ST3_af4fxb1ykieox3itqdfzs0kpb_2277a854_Rx", "0");
  
  testCaseComment("Action: ARCH_SW_CIL_0001, ARCH_SW_CIL_0002");
  testStep("STEP", "Read variable cil_stPTCoor4Pr5St3 --> I_C04_PRESF_LVL_V2_LVL2.");
  debugger_readVariable("uint8", "cil_stPTCoor4Pr5St3,,app.elf", "1");
  ExpectedTestResult(debugger_result, "0x2", "0x2");
  
  //====================================================
  testCaseComment("Postcondition");
  testStep("STEP", "Return ECU to default values");
  
  debugger_deleteAllBreakpoints();
  
  debugger_run();
  
  RunPostTs();
  
  debugger_stop();
}


testcase SW_IT_CIL_BeltHdOvr_State_ST3_02()
{
 //***********************************Test report header*********************************
  testReportAddMiscInfoBlock("AUTOLIV ELECTRONICS document");
  TestReportAddMiscInfo("Nightly test", "No");
  TestReportAddMiscInfo("Test type", "Requirement-Based test");
  TestReportAddMiscInfo("Regression Test", "No");
  TestReportAddMiscInfo("Fault injection method used", "No");
  TestReportAddMiscInfo("Resource usage evaluation", "No");
  TestReportAddMiscInfo("Priority", "No");
  TestReportAddMiscInfo("Safety relevant", "No");
  
  AddRequirementInfo("Requirement under test", "ARCH_SW_CIL_0160");
  AddRequirementInfo("ARCH_SW_CIL_0160", "Signal BeltHdOvr_FR_Stat_ST3 shall be send though application when it’s needed (0,1,2,3) ");
  //***************************************************************************************
    
  testCaseComment("Preconditions");
  testStep("STEP", "Bench Initialization");

  debugger_deleteAllBreakpoints();
  debugger_reset();
  debugger_run();

  RunPreTs();
  //====================================================
  
  testStep("STEP", "Start Development Session."); 
  AuthenticateECU(2); // Development_Enhanced
  EnterDiagnosticSession("development");
  
  testStep("STEP", "Set signal BeltHdOvr_FR_Stat_ST3 from frame BeltHdOvr_FR_State_ST3 to I_C02_BELTHDOVR_STAT_OUT_OF_END.");
  setSignal(BODY3::BeltHdOvr_FR_State_ST3::BeltHdOvr_FR_Stat_ST3, 2);
  testWaitForTimeout(500);

  testCaseComment("Action: ARCH_SW_CIL_0160");
  testStep("STEP", "Set a breakpoint in function CIL_ComNotification_BeltHdOvr_FR_Stat_ST3_0eefd507_Rx.");
  debugger_setRelativeFunctionBpAtLine("CIL_ComNotification_BeltHdOvr_FR_Stat_ST3_0eefd507_Rx", "4");
  ExpectedTestResult(debugger_result,"BP set", "BP set");

  //====================================================
  testCaseComment("Postcondition");
  testStep("STEP", "Return ECU to default values");
  
  debugger_deleteAllBreakpoints();
  
  debugger_run();
  
  RunPostTs(); 
  
  debugger_stop();
}


testcase SW_IT_CIL_TriggerProfiles_21()
{
  //***********************************Test report header*********************************
  testReportAddMiscInfoBlock("AUTOLIV ELECTRONICS document");
  TestReportAddMiscInfo("Nightly test", "No");
  TestReportAddMiscInfo("Test type", "Requirement-Based test");
  TestReportAddMiscInfo("Regression Test", "No");
  TestReportAddMiscInfo("Fault injection method used", "No");
  TestReportAddMiscInfo("Resource usage evaluation", "No");
  TestReportAddMiscInfo("Priority", "No");
  TestReportAddMiscInfo("Safety relevant", "No");
  
  AddRequirementInfo("Requirement under test", "ARCH_SW_CIL_0188");
  AddRequirementInfo("ARCH_SW_CIL_0188", "Priority for PRE-safe cycles or PRE-safe over API Requests and ORC.");
  //***************************************************************************************
    
  testCaseComment("Preconditions");
  testStep("STEP", "Bench Initialization");

  debugger_deleteAllBreakpoints();
  debugger_reset();
  debugger_run();

  RunPreTs();
  //====================================================

  testStep("STEP", "Start Development Session."); 
  AuthenticateECU(2); // Development_Enhanced
  EnterDiagnosticSession("development");
  
  testStep("STEP", "Set signal Presf_Lvl_ST3 to I_C04_PRESF_LVL_V2_LVL1 (0x1).");
  setSignal(BODY3::Presf_Lvl_ST3, I_C04_PRESF_LVL_V2_LVL1);
  testWaitForTimeout(500);
  
  testStep("STEP", "Set a breakpoint in the function CIL_runCANToAppli at line 'if( (KU8_NO_CYCLE == cil_u8ORCActivationRequest)||('.");
  debugger_setRelativeFunctionBpAtLine("CIL_runCANToAppli", "116");
  
  debugger_reset();
  debugger_run();
  
  testCaseComment("Action: ARCH_SW_CIL_0188");
  testStep("STEP", "Check if CPU stopped at line 'if( (KU8_NO_CYCLE == cil_u8ORCActivationRequest)||('. --> CPU stopped at BP");
  debugger_waitUntilBPisReached("1000");
//  ExpectedTestResult(debugger_result,IS_CPU_STOP_AT_BP_SUCCESFUL, "CPU stopped at BP");
  
  //====================================================
  testCaseComment("Postcondition");
  testStep("STEP", "Return ECU to default values");
  
  debugger_deleteAllBreakpoints();
  setSignal(BODY3::Presf_Lvl_ST3, I_C04_PRESF_LVL_V2_NOLVL);
  
  debugger_run();
  
  RunPostTs(); 
  
  debugger_stop();
}


testcase SW_IT_CIL_Com_ReceiveSignalGroupArray_01()
{
  //***********************************Test report header*********************************
  testReportAddMiscInfoBlock("AUTOLIV ELECTRONICS document");
  TestReportAddMiscInfo("Nightly test", "No");
  TestReportAddMiscInfo("Test type", "Requirement-Based test");
  TestReportAddMiscInfo("Regression Test", "No");
  TestReportAddMiscInfo("Fault injection method used", "No");
  TestReportAddMiscInfo("Resource usage evaluation", "No");
  TestReportAddMiscInfo("Priority", "No");
  TestReportAddMiscInfo("Safety relevant", "No");
  
  AddRequirementInfo("Requirement under test", "ARCH_SW_CIL_0351");
  AddRequirementInfo("ARCH_SW_CIL_0351", "Com_ReceiveSignalGroupArray shall be called to read signals group.");
  //***************************************************************************************
    
  testCaseComment("Preconditions");
  testStep("STEP", "Bench Initialization");

  debugger_deleteAllBreakpoints();
  debugger_reset();
  debugger_run();

  RunPreTs();
  //====================================================

  testStep("STEP", "Start Development Session."); 
  AuthenticateECU(2); // Development_Enhanced
  EnterDiagnosticSession("development");
  
  testStep("STEP", "Set signal Presf_Lvl_ST3 to I_C04_PRESF_LVL_V2_LVL1 (0x1).");
  setSignal(BODY3::Presf_Lvl_ST3, I_C04_PRESF_LVL_V2_LVL1);
  testWaitForTimeout(500);
  
  testStep("STEP", "Set a breakpoint in the function Com_ReceiveSignalGroupArray.");
  debugger_setRelativeFunctionBpAtLine("Com_ReceiveSignalGroupArray", "0");
  
  debugger_reset();
  debugger_run();
  
  testCaseComment("Action: ARCH_SW_CIL_0351");
  testStep("STEP", "Check if CPU stopped in function Com_ReceiveSignalGroupArray(). --> CPU stopped at BP");
  debugger_waitUntilBPisReached("1000");
  ExpectedTestResult(debugger_result,IS_CPU_STOP_AT_BP_SUCCESFUL, "CPU stopped at BP");
  
  //====================================================
  testCaseComment("Postcondition");
  testStep("STEP", "Return ECU to default values");
  
  debugger_deleteAllBreakpoints();
  
  debugger_run();
  
  RunPostTs(); 
  
  debugger_stop();
}


testcase SW_IT_CIL_isCarCrashDetected_01()
{
  //***********************************Test report header*********************************
  testReportAddMiscInfoBlock("AUTOLIV ELECTRONICS document");
  TestReportAddMiscInfo("Nightly test", "No");
  TestReportAddMiscInfo("Test type", "Requirement-Based test");
  TestReportAddMiscInfo("Regression Test", "No");
  TestReportAddMiscInfo("Fault injection method used", "No");
  TestReportAddMiscInfo("Resource usage evaluation", "No");
  TestReportAddMiscInfo("Priority", "No");
  TestReportAddMiscInfo("Safety relevant", "No");
  
  AddRequirementInfo("Requirement under test", "ARCH_SW_CIL_0354");
  AddRequirementInfo("ARCH_SW_CIL_0354", "Write Rte_CIL_psrCustomerSpecific_b8IsCarCrashDetected to start the tensioning cycle requested.");
  //***************************************************************************************
    
  testCaseComment("Preconditions");
  testStep("STEP", "Bench Initialization");

  debugger_deleteAllBreakpoints();
  debugger_reset();
  debugger_run();

  RunPreTs();
  //====================================================

  testStep("STEP", "Start Development Session."); 
  AuthenticateECU(2); // Development_Enhanced
  EnterDiagnosticSession("development");
  
  testStep("STEP", "Set signal Presf_Lvl_ST3 to I_C04_PRESF_LVL_V2_LVL1 (0x1).");
  setSignal(BODY3::Presf_Lvl_ST3, I_C04_PRESF_LVL_V2_LVL1);
  testWaitForTimeout(500);
  
  testStep("STEP", "Set a breakpoint in the function CIL_runCANToAppli at line cil_TriggerProfiles(CIL_stManagedCycle.u8CurrentRequestedCycle);.");
  debugger_setRelativeFunctionBpAtLine("CIL_runCANToAppli", "308");
  
  testStep("STEP", "Set a breakpoint in the function cil_TriggerProfiles.");
  debugger_setRelativeFunctionBpAtLine("cil_TriggerProfiles", "0");
  
  debugger_run();
  
  testCaseComment("Action: ARCH_SW_CIL_0354");
  testStep("STEP", "Read variable Rte_CIL_psrCustomerSpecific_b8IsCarCrashDetected --> KU8_FALSE.");
  debugger_readVariable("uint8", "Rte_CIL_psrCustomerSpecific_b8IsCarCrashDetected,,app.elf", "0");
  ExpectedTestResult(debugger_result, "0x55", "0x55");
  
  //====================================================
  testCaseComment("Postcondition");
  testStep("STEP", "Return ECU to default values");
  
  debugger_deleteAllBreakpoints();
  setSignal(BODY3::Presf_Lvl_ST3, 0x0);
  
  debugger_run();
  
  RunPostTs(); 
  
  debugger_stop();
}


testcase SW_IT_CIL_PreCrashRequestEnable_01()
{
  //***********************************Test report header*********************************
  testReportAddMiscInfoBlock("AUTOLIV ELECTRONICS document");
  TestReportAddMiscInfo("Nightly test", "No");
  TestReportAddMiscInfo("Test type", "Requirement-Based test");
  TestReportAddMiscInfo("Regression Test", "No");
  TestReportAddMiscInfo("Fault injection method used", "No");
  TestReportAddMiscInfo("Resource usage evaluation", "No");
  TestReportAddMiscInfo("Priority", "No");
  TestReportAddMiscInfo("Safety relevant", "No");
  
  AddRequirementInfo("Requirement under test", "ARCH_SW_CIL_0355");
  AddRequirementInfo("ARCH_SW_CIL_0355", "Write Rte_CIL_psrCustomerSpecific_b8PreCrashRequestEnable to start the tensioning cycle requested.");
  //***************************************************************************************
    
  testCaseComment("Preconditions");
  testStep("STEP", "Bench Initialization");

  debugger_deleteAllBreakpoints();
  debugger_reset();
  debugger_run();

  RunPreTs();
  //====================================================

  testStep("STEP", "Start Development Session."); 
  AuthenticateECU(2); // Development_Enhanced
  EnterDiagnosticSession("development");
  
  testStep("STEP", "Set signal Presf_Lvl_ST3 to I_C04_PRESF_LVL_V2_LVL1 (0x1).");
  setSignal(BODY3::Presf_Lvl_ST3, I_C04_PRESF_LVL_V2_LVL1);
  testWaitForTimeout(500);
  
  testStep("STEP", "Set a breakpoint in the function CIL_runCANToAppli at line cil_TriggerProfiles(CIL_stManagedCycle.u8CurrentRequestedCycle);.");
  debugger_setRelativeFunctionBpAtLine("CIL_runCANToAppli", "308");
  
  testStep("STEP", "Set a breakpoint in the function cil_TriggerProfiles.");
  debugger_setRelativeFunctionBpAtLine("cil_TriggerProfiles", "0");
  
  debugger_run();
  
  testCaseComment("Action: ARCH_SW_CIL_0355");
  testStep("STEP", "Read variable Rte_CIL_psrCustomerSpecific_b8PreCrashRequestEnable --> KU8_TRUE.");
  debugger_readVariable("uint8", "Rte_CIL_psrCustomerSpecific_b8PreCrashRequestEnable,,app.elf", "0");
  ExpectedTestResult(debugger_result, "0xaa", "0xaa");
  
  //====================================================
  testCaseComment("Postcondition");
  testStep("STEP", "Return ECU to default values");
  
  debugger_deleteAllBreakpoints();
  setSignal(BODY3::Presf_Lvl_ST3, 0x0);

  debugger_run();
  
  RunPostTs(); 
  
  debugger_stop();
}


testcase SW_IT_CIL_CycleValidity_01()
{
  //***********************************Test report header*********************************
  testReportAddMiscInfoBlock("AUTOLIV ELECTRONICS document");
  TestReportAddMiscInfo("Nightly test", "No");
  TestReportAddMiscInfo("Test type", "Requirement-Based test");
  TestReportAddMiscInfo("Regression Test", "No");
  TestReportAddMiscInfo("Fault injection method used", "No");
  TestReportAddMiscInfo("Resource usage evaluation", "No");
  TestReportAddMiscInfo("Priority", "No");
  TestReportAddMiscInfo("Safety relevant", "No");
  
  AddRequirementInfo("Requirement under test", "ARCH_SW_CIL_0356");
  AddRequirementInfo("ARCH_SW_CIL_0356", "Read Rte_MMG_psrEnableCycleX_b8CycleValidity to check validity of each the cycle.");
  //***************************************************************************************
    
  testCaseComment("Preconditions");
  testStep("STEP", "Bench Initialization");

  debugger_deleteAllBreakpoints();
  debugger_reset();
  debugger_run();

  RunPreTs();
  //====================================================

  testStep("STEP", "Start Development Session."); 
  AuthenticateECU(2); // Development_Enhanced
  EnterDiagnosticSession("development");
  
  testStep("STEP", "Set signal Presf_Lvl_ST3 to I_C04_PRESF_LVL_V2_LVL1 (0x1).");
  setSignal(BODY3::Presf_Lvl_ST3, I_C04_PRESF_LVL_V2_LVL1);
  testWaitForTimeout(500);
  
  testStep("STEP", "Set a breakpoint in the function CIL_runCANToAppli at line cil_TriggerProfiles(CIL_stManagedCycle.u8CurrentRequestedCycle);.");
  debugger_setRelativeFunctionBpAtLine("CIL_runCANToAppli", "308");
  
  testStep("STEP", "Set a breakpoint in the function cil_TriggerProfiles.");
  debugger_setRelativeFunctionBpAtLine("cil_TriggerProfiles", "93");
  
  debugger_run();
  
  testCaseComment("Action: ARCH_SW_CIL_0356");
  testStep("STEP", "Read variable Rte_MMG_psrEnableCycle0_b8CycleValidity --> KU8_TRUE.");
  debugger_readVariable("uint8", "Rte_MMG_psrEnableCycle0_b8CycleValidity,,app.elf", "0");
  ExpectedTestResult(debugger_result, "0xaa", "0xaa");
  
  //====================================================
  testCaseComment("Postcondition");
  testStep("STEP", "Return ECU to default values");
  
  debugger_deleteAllBreakpoints();
  setSignal(BODY3::Presf_Lvl_ST3, 0x0);
  
  debugger_run();
  
  RunPostTs(); 
  
  debugger_stop();
}


testcase SW_IT_CIL_psrBuckleDoorSwitch_01()
{
  //***********************************Test report header*********************************
  testReportAddMiscInfoBlock("AUTOLIV ELECTRONICS document");
  TestReportAddMiscInfo("Nightly test", "No");
  TestReportAddMiscInfo("Test type", "Requirement-Based test");
  TestReportAddMiscInfo("Regression Test", "No");
  TestReportAddMiscInfo("Fault injection method used", "No");
  TestReportAddMiscInfo("Resource usage evaluation", "No");
  TestReportAddMiscInfo("Priority", "No");
  TestReportAddMiscInfo("Safety relevant", "No");
  
  AddRequirementInfo("Requirement under test", "ARCH_SW_CIL_0357");
  AddRequirementInfo("ARCH_SW_CIL_0357", "Write Rte_Write_psrBuckleDoorSwitch_u8BuckleSwitch to transmit to application status of buckle switch.");
  //***************************************************************************************
    
  testCaseComment("Preconditions");
  testStep("STEP", "Bench Initialization");

  debugger_deleteAllBreakpoints();
  debugger_reset();
  debugger_run();

  RunPreTs();
  //====================================================

  testStep("STEP", "Start Development Session."); 
  AuthenticateECU(2); // Development_Enhanced
  EnterDiagnosticSession("development");
  
  testStep("STEP", "Set signal Presf_Lvl_ST3 to I_C04_PRESF_LVL_V2_LVL1 (0x1).");
  setSignal(BODY3::Presf_Lvl_ST3, I_C04_PRESF_LVL_V2_LVL1);
  testWaitForTimeout(500);
  
  testStep("STEP", "Set a breakpoint in the function CIL_runCANToAppli at line cil_TriggerProfiles(CIL_stManagedCycle.u8CurrentRequestedCycle);.");
  debugger_setRelativeFunctionBpAtLine("CIL_runCANToAppli", "295");
  
  testCaseComment("Action: ARCH_SW_CIL_0357");
  testStep("STEP", "Read variable Rte_CIL_psrBuckleDoorSwitch_u8BuckleSwitch --> KU8_BUCKLE_SWITCH_NOT_DEFINED.");
  debugger_readVariable("uint8", "Rte_CIL_psrBuckleDoorSwitch_u8BuckleSwitch,,app.elf", "0");
  ExpectedTestResult(debugger_result, "0xff", "0xff");
  
  //====================================================
  testCaseComment("Postcondition");
  testStep("STEP", "Return ECU to default values");
  
  debugger_deleteAllBreakpoints();
  setSignal(BODY3::Presf_Lvl_ST3, 0x0);
  
  debugger_run();
  
  RunPostTs(); 
  
  debugger_stop();
}


testcase SW_IT_CIL_psrCustomerSpecific_01()
{
  //***********************************Test report header*********************************
  testReportAddMiscInfoBlock("AUTOLIV ELECTRONICS document");
  TestReportAddMiscInfo("Nightly test", "No");
  TestReportAddMiscInfo("Test type", "Requirement-Based test");
  TestReportAddMiscInfo("Regression Test", "No");
  TestReportAddMiscInfo("Fault injection method used", "No");
  TestReportAddMiscInfo("Resource usage evaluation", "No");
  TestReportAddMiscInfo("Priority", "No");
  TestReportAddMiscInfo("Safety relevant", "No");
  
  AddRequirementInfo("Requirement under test", "ARCH_SW_CIL_0358, ARCH_SW_CIL_0305");
  AddRequirementInfo("ARCH_SW_CIL_0358", "Write Rte_Write_psrCustomerSpecific_u8HapticRequest to transmit to application the haptic request.");
  AddRequirementInfo("ARCH_SW_CIL_0305", "Rte_Write_psrCustomerSpecific_u8TriggerRequest Will be wriiten by CIL in order to inform about Source of the cycle Request : No request , PRE, API , ORC.");
  //***************************************************************************************
    
  testCaseComment("Preconditions");
  testStep("STEP", "Bench Initialization");

  debugger_deleteAllBreakpoints();
  debugger_reset();
  debugger_run();

  RunPreTs();
  //====================================================

  testStep("STEP", "Start Development Session."); 
  AuthenticateECU(2); // Development_Enhanced
  EnterDiagnosticSession("development");
  
  testStep("STEP", "Set signal Presf_Lvl_ST3 to I_C04_PRESF_LVL_V2_LVL2 (0x2).");
  setSignal(BODY3::Presf_Lvl_ST3, I_C04_PRESF_LVL_V2_LVL2);
  testWaitForTimeout(500);
  
  testStep("STEP", "Set a breakpoint in the function CIL_runCANToAppli at line cil_TriggerProfiles(CIL_stManagedCycle.u8CurrentRequestedCycle);.");
  debugger_setRelativeFunctionBpAtLine("CIL_runCANToAppli", "295");
  
  testStep("STEP", "Set a breakpoint in the function cil_TriggerProfiles at line (void)Rte_Write_psrCustomerSpecific_u8HapticRequest(KU8_HAPTIC_REQUEST_0);.");
  debugger_setRelativeFunctionBpAtLine("cil_TriggerProfiles", "137");
  
  debugger_run();
  
  testCaseComment("Action: ARCH_SW_CIL_035, ARCH_SW_CIL_03058");
  testStep("STEP", "Read variable Rte_CIL_psrCustomerSpecific_u8HapticRequest --> 0x3.");
  debugger_readVariable("uint8", "Rte_CIL_psrCustomerSpecific_u8HapticRequest,,app.elf", "0");
  ExpectedTestResult(debugger_result, "0x3", "0x3");
  
  //====================================================
  testCaseComment("Postcondition");
  testStep("STEP", "Return ECU to default values");
  
  debugger_deleteAllBreakpoints();
  setSignal(BODY3::Presf_Lvl_ST3, 0x0);
  
  debugger_run();
  
  RunPostTs(); 
  
  debugger_stop();
}


testcase SW_IT_CIL_runCANToAppli_01()
{
  //***********************************Test report header*********************************
  testReportAddMiscInfoBlock("AUTOLIV ELECTRONICS document");
  TestReportAddMiscInfo("Nightly test", "No");
  TestReportAddMiscInfo("Test type", "Requirement-Based test");
  TestReportAddMiscInfo("Regression Test", "No");
  TestReportAddMiscInfo("Fault injection method used", "No");
  TestReportAddMiscInfo("Resource usage evaluation", "No");
  TestReportAddMiscInfo("Priority", "No");
  TestReportAddMiscInfo("Safety relevant", "No");
  
  AddRequirementInfo("Requirement under test", "ARCH_SW_CIL_0359, ARCH_SW_CIL_0360, ARCH_SW_CIL_0363, ARCH_SW_CIL_0371, ARCH_SW_CIL_0361, ARCH_SW_CIL_0362");
  AddRequirementInfo("ARCH_SW_CIL_0359", "MMG_runCheckModeStatus shall be called to get the inhibition conditions for all cycles.");
  AddRequirementInfo("ARCH_SW_CIL_0360", "MMG_runCheckModeStatus shall be called to get the inhibition conditions for tensioning cycles.");
  AddRequirementInfo("ARCH_SW_CIL_0363", "MMG_runCheckModeStatus shall be called to get the abortion conditions for tensioning cycles (and haptic cycle and BSR).");
  AddRequirementInfo("ARCH_SW_CIL_0371", "MMG_runCheckModeStatus shall be called to get the abortion conditions for tensioning cycles (and haptic cycle and BSR).");
  //***************************************************************************************
    
  testCaseComment("Preconditions");
  testStep("STEP", "Bench Initialization");

  debugger_deleteAllBreakpoints();
  debugger_reset();
  debugger_run();

  RunPreTs();
  //====================================================
  
  testStep("STEP", "Set a breakpoint in the function CIL_runCANToAppli.");
  debugger_setRelativeFunctionBpAtLine("CIL_runCANToAppli", "0");
  
  testStep("STEP", "Check if CPU stopped in function CIL_runCANToAppli.");
  debugger_waitUntilBPisReached("1000");
  ExpectedTestResult(debugger_result,IS_CPU_STOP_AT_BP_SUCCESFUL, "CPU stopped at BP");
  
  testStep("STEP", "Step in function cil_ManageInputSignals.");
  debugger_stepIn();
  ExpectedTestResult(debugger_result, "cil_ManageInputSignals", "cil_ManageInputSignals,,app.elf");
  
  debugger_run();
  
  testStep("STEP", "Set a breakpoint in the function MMG_runCheckModeStatus.");
  debugger_setRelativeFunctionBpAtLine("MMG_runCheckModeStatus", "0");
  
  debugger_run();
  
  testCaseComment("Action: ARCH_SW_CIL_0359, ARCH_SW_CIL_0360, ARCH_SW_CIL_0363, ARCH_SW_CIL_0371, ARCH_SW_CIL_0361, ARCH_SW_CIL_0362");
  testStep("STEP", "Check if CPU stopped in function MMG_runCheckModeStatus. --> CPU stopped at BP");
  debugger_waitUntilBPisReached("1000");
  ExpectedTestResult(debugger_result,IS_CPU_STOP_AT_BP_SUCCESFUL, "CPU stopped at BP");
  
  //====================================================
  testCaseComment("Postcondition");
  testStep("STEP", "Return ECU to default values");
  
  debugger_deleteAllBreakpoints();
  
  debugger_run();
  
  RunPostTs(); 
  
  debugger_stop();
}


testcase SW_IT_CIL_stVehicleEquipmentData_01()
{
  //***********************************Test report header*********************************
  testReportAddMiscInfoBlock("AUTOLIV ELECTRONICS document");
  TestReportAddMiscInfo("Nightly test", "No");
  TestReportAddMiscInfo("Test type", "Requirement-Based test");
  TestReportAddMiscInfo("Regression Test", "No");
  TestReportAddMiscInfo("Fault injection method used", "No");
  TestReportAddMiscInfo("Resource usage evaluation", "No");
  TestReportAddMiscInfo("Priority", "No");
  TestReportAddMiscInfo("Safety relevant", "No");
  
  AddRequirementInfo("Requirement under test", "ARCH_SW_CIL_0364, ARCH_SW_CIL_0365, ARCH_SW_CIL_0301");
  AddRequirementInfo("ARCH_SW_CIL_0364", "NVP_stVehicleEquipmentData shall be read to get the coding configuration.");
  AddRequirementInfo("ARCH_SW_CIL_0365", "NVP_stVehicleEquipmentData shall be read to get the coding configuration.");
  AddRequirementInfo("ARCH_SW_CIL_0301", "Coding enable or Vehicle Equipment are read from NVP: NVP_stVehicleEquipmentData");
  //***************************************************************************************
    
  testCaseComment("Preconditions");
  testStep("STEP", "Bench Initialization");

  debugger_deleteAllBreakpoints();
  debugger_reset();
  debugger_run();

  RunPreTs();
  //====================================================
  
  testStep("STEP", "Set a breakpoint in the function CIL_runCANToAppli.");
  debugger_setRelativeFunctionBpAtLine("CIL_runCANToAppli", "0");
  
  testStep("STEP", "Check if CPU stopped in function CIL_runCANToAppli. --> CPU stopped at BP");
  debugger_waitUntilBPisReached("1000");
  ExpectedTestResult(debugger_result,IS_CPU_STOP_AT_BP_SUCCESFUL, "CPU stopped at BP");
  
  testStep("STEP", "Step in function cil_ManageInputSignals.");
  debugger_stepIn();
  ExpectedTestResult(debugger_result, "cil_ManageInputSignals", "cil_ManageInputSignals,,app.elf");
  
  testStep("STEP", "Set a breakpoint in the function cil_ManageInputSignals at line cil_ManageInhibitConditions().");
  debugger_setRelativeFunctionBpAtLine("cil_ManageInputSignals", "102");
  
  testStep("STEP", "Set a breakpoint in the function cil_ManageInputSignals at line 'KU8_ZERO != NVP_stVehicleEquipmentData.PreSafeFuncActivation))'.");
  debugger_setRelativeFunctionBpAtLine("cil_ManageInhibitConditions", "105");

  debugger_run();
  
  testCaseComment("Action: ARCH_SW_CIL_0364, ARCH_SW_CIL_0365");
  testStep("STEP", "Read variable (NVP_stVehicleEquipmentData).PreSafeCycleActivation --> 0x0.");
  debugger_readVariable("uint8", "NVP_stVehicleEquipmentData,,app.elf", "8");
  ExpectedTestResult(debugger_result, "0x0", "0x0");
  
  testCaseComment("Action: ARCH_SW_CIL_0364, ARCH_SW_CIL_0301");
  testStep("STEP", "Read variable (NVP_stVehicleEquipmentData).ORCPreSafe8Activation --> 0x0.");
  debugger_readVariable("uint8", "NVP_stVehicleEquipmentData,,app.elf", "9");
  ExpectedTestResult(debugger_result, "0x0", "0x0");
  
  testCaseComment("Action: ARCH_SW_CIL_0364");
  testStep("STEP", "Read variable (NVP_stVehicleEquipmentData).BSRActivation --> 0x0.");
  debugger_readVariable("uint8", "NVP_stVehicleEquipmentData,,app.elf", "1");
  ExpectedTestResult(debugger_result, "0x0", "0x0");
  
  testCaseComment("Action: ARCH_SW_CIL_0364");
  testStep("STEP", "Read variable (NVP_stVehicleEquipmentData).BltHandOverAvailabiliy --> 0x0.");
  debugger_readVariable("uint8", "NVP_stVehicleEquipmentData,,app.elf", "2");
  ExpectedTestResult(debugger_result, "0x0", "0x0");
  
  testCaseComment("Action: ");
  testStep("STEP", "Read variable (NVP_stVehicleEquipmentData).APIActivation --> 0x0.");
  debugger_readVariable("uint8", "NVP_stVehicleEquipmentData,,app.elf", "6");
  ExpectedTestResult(debugger_result, "0x0", "0x0");
  
  //====================================================
  testCaseComment("Postcondition");
  testStep("STEP", "Return ECU to default values");
  
  debugger_deleteAllBreakpoints();
  
  debugger_run();
  
  RunPostTs(); 
  
  debugger_stop();
}



testcase SW_IT_CIL_GetAecGroupsStatus_01()
{
  //***********************************Test report header*********************************
  testReportAddMiscInfoBlock("AUTOLIV ELECTRONICS document");
  TestReportAddMiscInfo("Nightly test", "No");
  TestReportAddMiscInfo("Test type", "Requirement-Based test");
  TestReportAddMiscInfo("Regression Test", "No");
  TestReportAddMiscInfo("Fault injection method used", "No");
  TestReportAddMiscInfo("Resource usage evaluation", "No");
  TestReportAddMiscInfo("Priority", "No");
  TestReportAddMiscInfo("Safety relevant", "No");
  
  AddRequirementInfo("Requirement under test", "ARCH_SW_CIL_0366, ARCH_SW_CIL_0367, ARCH_SW_CIL_0368, ARCH_SW_CIL_0560");
  AddRequirementInfo("ARCH_SW_CIL_0366", "ERH_runGetAecGroupsStatus shall be called to get the inhibition and abortion conditions for PRE_SAFE and request tensioning cycles.");
  AddRequirementInfo("ARCH_SW_CIL_0367", "ERH_runGetAecGroupsStatus shall be called to get the inhibition conditions for PRE-SAFE6/7/8 request cycles.");
  AddRequirementInfo("ARCH_SW_CIL_0368", "ERH_runGetAecGroupsStatus shall be called to get the abortion conditions for PRE_SAFE request tensioning cycles.");
  AddRequirementInfo("ARCH_SW_CIL_0369", "ERH_runGetAecGroupsStatus shall be called to get the inhibition and abortion conditions for ORC request tensioning cycle.");
  AddRequirementInfo("ARCH_SW_CIL_0560", "Function ERH_runGetAecGroupsStatus shall be called to get the specific group (DTC) status with warning indicator active.");
  AddRequirementInfo("ARCH_SW_CIL_0370", "ERH_GetAecStatus shall be called to get the TIMEOUT ERROR ON API frame that will abort all profiles requested on API.");
  //***************************************************************************************
    
  testCaseComment("Preconditions");
  testStep("STEP", "Bench Initialization");

  debugger_deleteAllBreakpoints();
  debugger_reset();
  debugger_run();

  RunPreTs();
  //====================================================
  
  testStep("STEP", "Set signal RBTMFL_SP_Lvl_Rq_ST35 to I_C04_PRESF_LVL_V2_NOLVL.");
  setSignal(BODY3::RBTMFL_SP_Lvl_Rq_ST35, 0);
  testWaitForTimeout(500);
  
  testStep("STEP", "Set a breakpoint in the function cil_ManageInputSignals at line cil_ManageInhibitConditions().");
  debugger_setRelativeFunctionBpAtLine("cil_ManageInputSignals", "102");
  
  testStep("STEP", "Set a breakpoint in the function cil_ManageInhibitConditions at line Rte_Call_pclAecStatus_GetAecGroupsStatus(&u32AECGroupStatus);.");
  debugger_setRelativeFunctionBpAtLine("cil_ManageInhibitConditions", "101");
  
  testCaseComment("Action: ARCH_SW_CIL_0366, ARCH_SW_CIL_0367, ARCH_SW_CIL_0368, ARCH_SW_CIL_0369, ARCH_SW_CIL_0370, ARCH_SW_CIL_0560");
  testStep("STEP", "Check if CPU stopped at line Rte_Call_pclAecStatus_GetAecGroupsStatus(&u32AECGroupStatus);.");
  debugger_waitUntilBPisReached("1000");
  ExpectedTestResult(debugger_result,IS_CPU_STOP_AT_BP_SUCCESFUL, "CPU stopped at BP");
  
  //====================================================
  testCaseComment("Postcondition");
  testStep("STEP", "Return ECU to default values");
  
  debugger_deleteAllBreakpoints();
  RunPostTs(); 
  
  debugger_stop();
}


testcase SW_IT_CIL_psrPreSafeLv_01()
{
  //***********************************Test report header*********************************
  testReportAddMiscInfoBlock("AUTOLIV ELECTRONICS document");
  TestReportAddMiscInfo("Nightly test", "No");
  TestReportAddMiscInfo("Test type", "Requirement-Based test");
  TestReportAddMiscInfo("Regression Test", "No");
  TestReportAddMiscInfo("Fault injection method used", "No");
  TestReportAddMiscInfo("Resource usage evaluation", "No");
  TestReportAddMiscInfo("Priority", "No");
  TestReportAddMiscInfo("Safety relevant", "No");
  
  AddRequirementInfo("Requirement under test", "ARCH_SW_CIL_0302");
  AddRequirementInfo("ARCH_SW_CIL_0302", "Rte_Write_psrPreSafeLvl_u8PreSafeLvl Will be wriiten by CIL in order to inform about the Presafe LEVEL Request (signal Presf_Lvl).");
  //***************************************************************************************
    
  testCaseComment("Preconditions");
  testStep("STEP", "Bench Initialization");

  debugger_deleteAllBreakpoints();
  debugger_reset();
  debugger_run();

  RunPreTs();
  //====================================================

  testCaseComment("Action: ARCH_SW_CIL_0302");
  testStep("STEP", "Read variable cil_stPresfActAdjFrame.Presf_Lvl_ST3 --> 0x0.");
  debugger_readVariable("uint8", "cil_stPresfActAdjFrame,,app.elf", "2");
  ExpectedTestResult(debugger_result, "0x0", "0x0");
  
  testStep("STEP", "Set signal Presf_Lvl_ST3 to I_C04_PRESF_LVL_V2_LVL1 (0x2).");
  setSignal(BODY3::Presf_Lvl_ST3, I_C04_PRESF_LVL_V2_LVL2);
  testWaitForTimeout(500);
  
  testStep("STEP", "Set a breakpoint in the function CIL_runCANToAppli.");
  debugger_setRelativeFunctionBpAtLine("CIL_runCANToAppli", "0");
  
  testStep("STEP", "Check if CPU stopped in function CIL_runCANToAppli. --> CPU stopped at BP");
  debugger_waitUntilBPisReached("1000");
  ExpectedTestResult(debugger_result,IS_CPU_STOP_AT_BP_SUCCESFUL, "CPU stopped at BP");
  
  testStep("STEP", "Step in function cil_ManageInputSignals.");
  debugger_stepIn();
  ExpectedTestResult(debugger_result, "cil_ManageInputSignals", "cil_ManageInputSignals,,app.elf");
  
  testStep("STEP", "Set a breakpoint at line Rte_Write_psrPreSafeLvl_u8PreSafeLvl(cil_stPresfActAdjFrame.Presf_Lvl_ST3);.");
  debugger_setRelativeFunctionBpAtLine("cil_ManageInputSignals", "118");
  
  debugger_run();
  
  testCaseComment("Action: ARCH_SW_CIL_0302");
  testStep("STEP", "Read variable cil_stPresfActAdjFrame.Presf_Lvl_ST3 --> 0x1.");
  debugger_readVariable("uint8", "cil_stPresfActAdjFrame,,app.elf", "5");
  ExpectedTestResult(debugger_result, "0x2", "0x2");
  
  //====================================================
  testCaseComment("Postcondition");
  testStep("STEP", "Return ECU to default values");
  
  debugger_deleteAllBreakpoints();
  setSignal(BODY3::Presf_Lvl_ST3, I_C04_PRESF_LVL_V2_NOLVL);
  
  debugger_run();
  
  RunPostTs(); 
  
  debugger_stop();
}



testcase SW_IT_CIL_psrExecutedCycle_01()
{
  //***********************************Test report header*********************************
  testReportAddMiscInfoBlock("AUTOLIV ELECTRONICS document");
  TestReportAddMiscInfo("Nightly test", "No");
  TestReportAddMiscInfo("Test type", "Requirement-Based test");
  TestReportAddMiscInfo("Regression Test", "No");
  TestReportAddMiscInfo("Fault injection method used", "No");
  TestReportAddMiscInfo("Resource usage evaluation", "No");
  TestReportAddMiscInfo("Priority", "No");
  TestReportAddMiscInfo("Safety relevant", "No");
  
  AddRequirementInfo("Requirement under test", "ARCH_SW_CIL_0303, ARCH_SW_CIL_0559");
  AddRequirementInfo("ARCH_SW_CIL_0303", "Read Rte_BFE_psrExecutedCycle_u8CycleNumber shall be read to get executed cycle number.");
  AddRequirementInfo("ARCH_SW_CIL_0559", "Read Rte_BFE_psrExecutedCycle_u8CycleNumber shall be read to get executed cycle number.");
  //***************************************************************************************
    
  testCaseComment("Preconditions");
  testStep("STEP", "Bench Initialization");

  debugger_deleteAllBreakpoints();
  debugger_reset();
  debugger_run();

  RunPreTs();
  //====================================================

  testStep("STEP", "Set a breakpoint in the function CIL_runCANToAppli.");
  debugger_setRelativeFunctionBpAtLine("CIL_runCANToAppli", "0");
  
  testStep("STEP", "Check if CPU stopped in function CIL_runCANToAppli. --> CPU stopped at BP");
  debugger_waitUntilBPisReached("1000");
  ExpectedTestResult(debugger_result,IS_CPU_STOP_AT_BP_SUCCESFUL, "CPU stopped at BP");
  
  testStep("STEP", "Step in function cil_ManageInputSignals.");
  debugger_stepIn();
  ExpectedTestResult(debugger_result, "cil_ManageInputSignals", "cil_ManageInputSignals,,app.elf");
  
  testStep("STEP", "Set a breakpoint at line void)Rte_Read_prrCycleNumber_u8CycleNumber(&u8ExecutedCycle);.");
  debugger_setBpAtLine("s:\\Components\\Application\\Autoliv\\CIL\\Implementation\\src\\CIL_CANToAppli.c", "1167");

  debugger_run();
  
  testCaseComment("Action: ARCH_SW_CIL_0303, ARCH_SW_CIL_0559");
  testStep("STEP", "Check if CPU stopped at line (void)Rte_Read_prrCycleNumber_u8CycleNumber(&u8ExecutedCycle);.");
  debugger_waitUntilBPisReached("1000");
  ExpectedTestResult(debugger_result,IS_CPU_STOP_AT_BP_SUCCESFUL, "CPU stopped at BP");

  //====================================================
  testCaseComment("Postcondition");
  testStep("STEP", "Return ECU to default values");
  
  debugger_deleteAllBreakpoints();
  
  debugger_run();
  
  RunPostTs(); 
  
  debugger_stop();
}


testcase SW_IT_CIL_prrStepNumber_01()
{
  //***********************************Test report header*********************************
  testReportAddMiscInfoBlock("AUTOLIV ELECTRONICS document");
  TestReportAddMiscInfo("Nightly test", "No");
  TestReportAddMiscInfo("Test type", "Requirement-Based test");
  TestReportAddMiscInfo("Regression Test", "No");
  TestReportAddMiscInfo("Fault injection method used", "No");
  TestReportAddMiscInfo("Resource usage evaluation", "No");
  TestReportAddMiscInfo("Priority", "No");
  TestReportAddMiscInfo("Safety relevant", "No");
  
  AddRequirementInfo("Requirement under test", "ARCH_SW_CIL_0304");
  AddRequirementInfo("ARCH_SW_CIL_0304", "Read Rte_Read_prrStepNumber_u8StepNumber shall be read to get executed cycle number.");
  //***************************************************************************************
    
  testCaseComment("Preconditions");
  testStep("STEP", "Bench Initialization");

  debugger_deleteAllBreakpoints();
  debugger_reset();
  debugger_run();
  
  RunPreTs();
  //====================================================
  
  testStep("STEP", "Start Development Session.");
  AuthenticateECU(2); // Development_Enhanced
  EnterDiagnosticSession("development");
  
  testStep("STEP", "Set signal RBTMFL_SP_Lvl_Rq_ST35 to I_C06_RBTM_LVL_RQ_PROFILE25.");
  setSignal(BODY3::RBTMFL_SP_Lvl_Rq_ST35, 25);
  testWaitForTimeout(500);
  
  testStep("STEP", "Set a breakpoint in function CIL_runCANToAppli at line cil_TriggerProfiles(CIL_stManagedCycle.u8CurrentRequestedCycle);.");
  debugger_setRelativeFunctionBpAtLine("CIL_runCANToAppli", "308");
  
  debugger_deleteAllBreakpoints();
  debugger_run();
  
  testStep("STEP", "Set a breakpoint in function cil_TriggerProfiles under case I_C06_RBTM_LVL_RQ_PROFILE25:.");
  debugger_setRelativeFunctionBpAtLine("cil_TriggerProfiles", "488");
  
  testStep("STEP", "Set a breakpoint at the end of the function cil_RequestTensioning.");
  debugger_setBpAtLine("s:\\Components\\Application\\Autoliv\\CIL\\Implementation\\src\\CIL_CANToAppli.c", "1452"); 
  
  testCaseComment("Action: ARCH_SW_CIL_0304");
  testStep("STEP", "Check if CPU stopped in function cil_RequestTensioning. --> CPU stopped at BP");
  debugger_waitUntilBPisReached("1000");
//  ExpectedTestResult(debugger_result,IS_CPU_STOP_AT_BP_SUCCESFUL, "CPU stopped at BP");
  
  testCaseComment("Action: ARCH_SW_CIL_0304");
  testStep("STEP", "Check if variable Rte_BFE_psrExecutedStep_u8StepNumber is KU8_NO_STEP --> KU8_NO_STEP.");
  debugger_readVariable("uint8", "Rte_BFE_psrExecutedStep_u8StepNumber,,app.elf", "0");
  ExpectedTestResult(debugger_result, "0xff", "0xff");
  
  //====================================================
  testCaseComment("Postcondition");
  testStep("STEP", "Return ECU to default values");
  
  debugger_deleteAllBreakpoints();
  setSignal(BODY3::RBTMFL_SP_Lvl_Rq_ST35, I_C04_PRESF_LVL_V2_NOLVL);
  
  debugger_run();
  
  RunPostTs(); 
  
  debugger_stop();
}


testcase SW_IT_CIL_runAppliToCAN_01()
{
  //***********************************Test report header*********************************
  testReportAddMiscInfoBlock("AUTOLIV ELECTRONICS document");
  TestReportAddMiscInfo("Nightly test", "No");
  TestReportAddMiscInfo("Test type", "Requirement-Based test");
  TestReportAddMiscInfo("Regression Test", "No");
  TestReportAddMiscInfo("Fault injection method used", "No");
  TestReportAddMiscInfo("Resource usage evaluation", "No");
  TestReportAddMiscInfo("Priority", "No");
  TestReportAddMiscInfo("Safety relevant", "No");
  
  AddRequirementInfo("Requirement under test", "ARCH_SW_CIL_0011");
  AddRequirementInfo("ARCH_SW_CIL_0011", "Signal PS_Curve_FL/FR_Stat_ST3 shall be written and send to CAN.");
  AddRequirementInfo("ARCH_SW_CIL_0016", "Signal shall be send with the exact same value read as Input for Curve Signal.");
  //***************************************************************************************
    
  testCaseComment("Preconditions");
  testStep("STEP", "Bench Initialization");

  debugger_deleteAllBreakpoints();
  debugger_reset();
  debugger_run();
  
  RunPreTs();
  //====================================================

  setSignal(BODY3::BeltAdj_UI_Set_Rq_ST3::PS_Curve_FL_Rq_HU_ST3, 0x2);
  testWaitForTimeout(1000);

  snprintf(signal_value, elcount(signal_value), "%d", $PS_Curve_FL_Stat_ST3.raw64);
  
  testStep("STEP", "Set a breakpoint in function cil_ManageOutputSignals.");
  debugger_setBpAtLine("s:\\Components\\Application\\Autoliv\\CIL\\Implementation\\src\\CIL_AppliToCAN.c", "593");
  
  testCaseComment("Action: ARCH_SW_CIL_011");
  testStep("STEP", "Check if variable CIL_u8PSCurve is I_CO2_OFF_STAGE1_STAGE2_STAGE2. --> 3");
  debugger_readVariable("uint8", "CIL_u8PSCurve,,app.elf", "0");
  ExpectedTestResult(debugger_result, "3", "3");
  
  testCaseComment("Action: ARCH_SW_CIL_011, ARCH_SW_CIL_0016");
  testStep("STEP", "Check if signal PS_Curve_FL_Stat_ST3 value is I_CO2_OFF_STAGE1_STAGE2_STAGE2. --> 2");
  ExpectedTestResult(signal_value, "3", "3");
  
  //====================================================
  testCaseComment("Postcondition");
  testStep("STEP", "Return ECU to default values");
  
  debugger_deleteAllBreakpoints();
  setSignal(BODY3::BeltAdj_UI_Set_Rq_ST3::PS_Curve_FL_Rq_HU_ST3, 0x3);
  
  debugger_run();
  
  RunPostTs(); 
  
  debugger_stop();
}


testcase SW_IT_CIL_runAppliToCAN_02()
{
  //***********************************Test report header*********************************
  testReportAddMiscInfoBlock("AUTOLIV ELECTRONICS document");
  TestReportAddMiscInfo("Nightly test", "No");
  TestReportAddMiscInfo("Test type", "Requirement-Based test");
  TestReportAddMiscInfo("Regression Test", "No");
  TestReportAddMiscInfo("Fault injection method used", "No");
  TestReportAddMiscInfo("Resource usage evaluation", "No");
  TestReportAddMiscInfo("Priority", "No");
  TestReportAddMiscInfo("Safety relevant", "No");
  
  AddRequirementInfo("Requirement under test", "ARCH_SW_CIL_0069");
  AddRequirementInfo("ARCH_SW_CIL_0069", "If HAPTIC1(cycle 18 or cycle 19)  (and his next cycle ) is executed then RBTM _FL/FR Actv_Lvl_ST35 should be 0x02 = “HAPTIC1” no matter the source of the request: API interface, PRE-SAFE interface.");
  //***************************************************************************************
    
  testCaseComment("Preconditions");
  testStep("STEP", "Bench Initialization");

  debugger_deleteAllBreakpoints();
  debugger_reset();
  debugger_run();
  
  RunPreTs();
  //====================================================

  setSignal(BODY3::Presf_Lvl_ST3, 2);
  testWaitForTimeout(500);

  snprintf(signal_value, elcount(signal_value), "%d", $RBTMFL_Actv_Lvl_ST35.raw64);
  
  testStep("STEP", "Set a breakpoint in function cil_TriggerProfiles.");
  debugger_setRelativeFunctionBpAtLine("cil_TriggerProfiles", "114");  
  
  testStep("STEP", "Check if variable Rte_MMG_psrEnableCycle18_b8CycleValidity is KU8_TRUE. --> 170");
  debugger_writeVariable("uint8", "Rte_MMG_psrEnableCycle18_b8CycleValidity,,app.elf", "0", "170");
  ExpectedTestResult(debugger_result, "170", "170");
  
  debugger_deleteAllBreakpoints();
  debugger_run();

  testCaseComment("Action: ARCH_SW_CIL_0069");
  testStep("STEP", "Check if signal RBTMFL_Actv_Lvl_ST35 value is I_C06_RBTM_LVL_STAT_PROFILE2. --> 2");
  ExpectedTestResult(signal_value, "0", "2");
  
  //====================================================
  testCaseComment("Postcondition");
  testStep("STEP", "Return ECU to default values");
  
  debugger_deleteAllBreakpoints();
  
  debugger_run();
  
  RunPostTs(); 
  
  debugger_stop();
}


testcase SW_IT_CIL_runAppliToCAN_03()
{
  //***********************************Test report header*********************************
  testReportAddMiscInfoBlock("AUTOLIV ELECTRONICS document");
  TestReportAddMiscInfo("Nightly test", "No");
  TestReportAddMiscInfo("Test type", "Requirement-Based test");
  TestReportAddMiscInfo("Regression Test", "No");
  TestReportAddMiscInfo("Fault injection method used", "No");
  TestReportAddMiscInfo("Resource usage evaluation", "No");
  TestReportAddMiscInfo("Priority", "No");
  TestReportAddMiscInfo("Safety relevant", "No");
  
  AddRequirementInfo("Requirement under test", "ARCH_SW_CIL_0070");
  AddRequirementInfo("ARCH_SW_CIL_0070", "If PRE-SAFE1 is executed (cycle 0) (and his next cycle ) then RBTM _FL/FR Actv_Lvl_ST35 should be equal to 0x01=“PRE-SAFE 1” no matter the source of the request: API interface, PRE SAFE interface, Diagnostic request.");
  //***************************************************************************************
    
  testCaseComment("Preconditions");
  testStep("STEP", "Bench Initialization");

  debugger_deleteAllBreakpoints();
  debugger_reset();
  debugger_run();
  
  RunPreTs();
  //====================================================

  setSignal(BODY3::Presf_Lvl_ST3, 1);
  testWaitForTimeout(500);

  snprintf(signal_value, elcount(signal_value), "%d", $RBTMFL_Actv_Lvl_ST35.raw64);
  
  testStep("STEP", "Set a breakpoint in function cil_ManageActiveLevelSignal.");
  debugger_setBpAtLine("s:\\Components\\Application\\Autoliv\\CIL\\Implementation\\src\\CIL_AppliToCAN.c", "550");
  
  testCaseComment("Action: ARCH_SW_CIL_0070");
  testStep("STEP", "Check if variable CIL_u8Actv_Lvl is I_C06_RBTM_LVL_STAT_PROFILE1. --> 1");
  debugger_readVariable("uint8", "CIL_u8Actv_Lvl,,app.elf", "0");
//  ExpectedTestResult(debugger_result, "1", "1");
  
  testCaseComment("Action: ARCH_SW_CIL_0070");
  testStep("STEP", "Check if signal RBTMFL_Actv_Lvl_ST35 value is I_C06_RBTM_LVL_STAT_PROFILE1. --> 1");
//  ExpectedTestResult(signal_value, "1", "1");
  
  //====================================================
  testCaseComment("Postcondition");
  testStep("STEP", "Return ECU to default values");
  
  debugger_deleteAllBreakpoints();
  debugger_run();
  
  RunPostTs(); 
  
  debugger_stop();
}


testcase SW_IT_CIL_runAppliToCAN_04()
{
  //***********************************Test report header*********************************
  testReportAddMiscInfoBlock("AUTOLIV ELECTRONICS document");
  TestReportAddMiscInfo("Nightly test", "No");
  TestReportAddMiscInfo("Test type", "Requirement-Based test");
  TestReportAddMiscInfo("Regression Test", "No");
  TestReportAddMiscInfo("Fault injection method used", "No");
  TestReportAddMiscInfo("Resource usage evaluation", "No");
  TestReportAddMiscInfo("Priority", "No");
  TestReportAddMiscInfo("Safety relevant", "No");
  
  AddRequirementInfo("Requirement under test", "ARCH_SW_CIL_0083");
  AddRequirementInfo("ARCH_SW_CIL_0083", "If PRE-SAFE3 is executed (cycle 1) (and his next cycle ) then RBTM _FL/FR Actv_Lvl_ST35 should be equal to 0x03 = “PRE-SAFE 3” no matter the source of the request: API interface, PRE SAFE interface, Diagnostic request.");
  //***************************************************************************************
    
  testCaseComment("Preconditions");
  testStep("STEP", "Bench Initialization");

  debugger_deleteAllBreakpoints();
  debugger_reset();
  debugger_run();
  
  RunPreTs();
  //====================================================

  setSignal(BODY3::Presf_Lvl_ST3, 3);
  testWaitForTimeout(500);

  snprintf(signal_value, elcount(signal_value), "%d", $RBTMFL_Actv_Lvl_ST35.raw64);
  
  testStep("STEP", "Set a breakpoint in function cil_ManageActiveLevelSignal.");
  debugger_setBpAtLine("s:\\Components\\Application\\Autoliv\\CIL\\Implementation\\src\\CIL_AppliToCAN.c", "550");
  
  testCaseComment("Action: ARCH_SW_CIL_0083");
  testStep("STEP", "Check if variable CIL_u8Actv_Lvl is I_C06_RBTM_LVL_STAT_PROFILE3. --> 3");
  debugger_readVariable("uint8", "CIL_u8Actv_Lvl,,app.elf", "0");
  ExpectedTestResult(debugger_result, "3", "3");
  
  testCaseComment("Action: ARCH_SW_CIL_0083");
  testStep("STEP", "Check if signal RBTMFL_Actv_Lvl_ST35 value is I_C06_RBTM_LVL_STAT_PROFILE3. --> 3");
  ExpectedTestResult(signal_value, "0", "3");
  
  //====================================================
  testCaseComment("Postcondition");
  testStep("STEP", "Return ECU to default values");
  
  debugger_deleteAllBreakpoints();
  debugger_run();
  
  RunPostTs(); 
  
  debugger_stop();
}


testcase SW_IT_CIL_runAppliToCAN_05()
{
  //***********************************Test report header*********************************
  testReportAddMiscInfoBlock("AUTOLIV ELECTRONICS document");
  TestReportAddMiscInfo("Nightly test", "No");
  TestReportAddMiscInfo("Test type", "Requirement-Based test");
  TestReportAddMiscInfo("Regression Test", "No");
  TestReportAddMiscInfo("Fault injection method used", "No");
  TestReportAddMiscInfo("Resource usage evaluation", "No");
  TestReportAddMiscInfo("Priority", "No");
  TestReportAddMiscInfo("Safety relevant", "No");
  
  AddRequirementInfo("Requirement under test", "ARCH_SW_CIL_0084");
  AddRequirementInfo("ARCH_SW_CIL_0084", "If PRE-SAFE4 is executed (cycle 2) (and his next cycle ) then RBTM _FL/FR Actv_Lvl_ST35 should be equal to 0x04 = “PRE-SAFE 4” no matter the source of the request: API interface, PRE SAFE interface, Diagnostic request.");
  //***************************************************************************************
    
  testCaseComment("Preconditions");
  testStep("STEP", "Bench Initialization");

  debugger_deleteAllBreakpoints();
  debugger_reset();
  debugger_run();
  
  RunPreTs();
  //====================================================

  setSignal(BODY3::Presf_Lvl_ST3, 4);
  testWaitForTimeout(500);

  snprintf(signal_value, elcount(signal_value), "%d", $RBTMFL_Actv_Lvl_ST35.raw64);
  
  testStep("STEP", "Set a breakpoint in function cil_ManageActiveLevelSignal.");
  debugger_setBpAtLine("s:\\Components\\Application\\Autoliv\\CIL\\Implementation\\src\\CIL_AppliToCAN.c", "550");
  
  testCaseComment("Action: ARCH_SW_CIL_0084");
  testStep("STEP", "Check if variable CIL_u8Actv_Lvl is I_C06_RBTM_LVL_STAT_PROFILE4. --> 4");
  debugger_readVariable("uint8", "CIL_u8Actv_Lvl,,app.elf", "0");
//  ExpectedTestResult(debugger_result, "0", "4");
  
  testCaseComment("Action: ARCH_SW_CIL_0084");
  testStep("STEP", "Check if signal RBTMFL_Actv_Lvl_ST35 value is I_C06_RBTM_LVL_STAT_PROFILE4. --> 4");
//  ExpectedTestResult(signal_value, "0", "4");
  
  //====================================================
  testCaseComment("Postcondition");
  testStep("STEP", "Return ECU to default values");
  
  debugger_deleteAllBreakpoints();
  debugger_run();
  
  RunPostTs(); 
  
  debugger_stop();
}


testcase SW_IT_CIL_runAppliToCAN_06()
{
  //***********************************Test report header*********************************
  testReportAddMiscInfoBlock("AUTOLIV ELECTRONICS document");
  TestReportAddMiscInfo("Nightly test", "No");
  TestReportAddMiscInfo("Test type", "Requirement-Based test");
  TestReportAddMiscInfo("Regression Test", "No");
  TestReportAddMiscInfo("Fault injection method used", "No");
  TestReportAddMiscInfo("Resource usage evaluation", "No");
  TestReportAddMiscInfo("Priority", "No");
  TestReportAddMiscInfo("Safety relevant", "No");
  
  AddRequirementInfo("Requirement under test", "ARCH_SW_CIL_0085");
  AddRequirementInfo("ARCH_SW_CIL_0085", "If PRE-SAFE5 is executed (cycle 3) (and his next cycle ) then RBTM _FL/FR Actv_Lvl_ST35 should be equal to 0x05=“PRE-SAFE 5” no matter the source of the request: API interface, PRE SAFE interface, Diagnostic request.");
  //***************************************************************************************
    
  testCaseComment("Preconditions");
  testStep("STEP", "Bench Initialization");

  debugger_deleteAllBreakpoints();
  debugger_reset();
  debugger_run();
  
  RunPreTs();
  //====================================================

  setSignal(BODY3::Presf_Lvl_ST3, 5);
  testWaitForTimeout(500);

  snprintf(signal_value, elcount(signal_value), "%d", $RBTMFL_Actv_Lvl_ST35.raw64);
  
  testStep("STEP", "Set a breakpoint in function cil_ManageActiveLevelSignal.");
  debugger_setBpAtLine("s:\\Components\\Application\\Autoliv\\CIL\\Implementation\\src\\CIL_AppliToCAN.c", "550");
  
//  testCaseComment("Action: ARCH_SW_CIL_0085");
//  testStep("STEP", "Check if variable CIL_u8Actv_Lvl is I_C06_RBTM_LVL_STAT_PROFILE5. -->5");
//  debugger_readVariable("uint8", "CIL_u8Actv_Lvl,,app.elf", "0");
//  ExpectedTestResult(debugger_result, "5", "5");
  
  testCaseComment("Action: ARCH_SW_CIL_0085");
  testStep("STEP", "Check if signal RBTMFL_Actv_Lvl_ST35 value is I_C06_RBTM_LVL_STAT_PROFILE5. --> 5");
  ExpectedTestResult(signal_value, "0", "5");
  
  //====================================================
  testCaseComment("Postcondition");
  testStep("STEP", "Return ECU to default values");
  
  debugger_deleteAllBreakpoints();
  debugger_run();
  
  RunPostTs(); 
  
  debugger_stop();
}


testcase SW_IT_CIL_runAppliToCAN_07()
{
  //***********************************Test report header*********************************
  testReportAddMiscInfoBlock("AUTOLIV ELECTRONICS document");
  TestReportAddMiscInfo("Nightly test", "No");
  TestReportAddMiscInfo("Test type", "Requirement-Based test");
  TestReportAddMiscInfo("Regression Test", "No");
  TestReportAddMiscInfo("Fault injection method used", "No");
  TestReportAddMiscInfo("Resource usage evaluation", "No");
  TestReportAddMiscInfo("Priority", "No");
  TestReportAddMiscInfo("Safety relevant", "No");
  
  AddRequirementInfo("Requirement under test", "ARCH_SW_CIL_0164");
  AddRequirementInfo("ARCH_SW_CIL_0164", "If PRE-SAFE6 is executed (cycle 4) (and his next cycle ) then RBTM _FL/FR Actv_Lvl_ST35 should be equal to 0x06=“PRE-SAFE 6” no matter the source of the request: API interface, PRE SAFE interface, Diagnostic request.");
  //***************************************************************************************
    
  testCaseComment("Preconditions");
  testStep("STEP", "Bench Initialization");

  debugger_deleteAllBreakpoints();
  debugger_reset();
  debugger_run();
  
  RunPreTs();
  //====================================================

  setSignal(BODY3::Presf_Lvl_ST3, 6);
  testWaitForTimeout(500);

  snprintf(signal_value, elcount(signal_value), "%d", $RBTMFL_Actv_Lvl_ST35.raw64);
  
  testStep("STEP", "Set a breakpoint in function cil_ManageActiveLevelSignal.");
  debugger_setBpAtLine("s:\\Components\\Application\\Autoliv\\CIL\\Implementation\\src\\CIL_AppliToCAN.c", "550");
  
//  testCaseComment("Action: ARCH_SW_CIL_0164");
//  testStep("STEP", "Check if variable CIL_u8Actv_Lvl is I_C06_RBTM_LVL_STAT_PROFILE6. -->6");
//  debugger_readVariable("uint8", "CIL_u8Actv_Lvl,,app.elf", "0");
//  ExpectedTestResult(debugger_result, "6", "6");
  
  testCaseComment("Action: ARCH_SW_CIL_0164");
  testStep("STEP", "Check if signal RBTMFL_Actv_Lvl_ST35 value is I_C06_RBTM_LVL_STAT_PROFILE6. --> 6");
  ExpectedTestResult(signal_value, "0", "6");
  
  //====================================================
  testCaseComment("Postcondition");
  testStep("STEP", "Return ECU to default values");
  
  debugger_deleteAllBreakpoints();
  debugger_run();
  
  RunPostTs(); 
  
  debugger_stop();
}


testcase SW_IT_CIL_runAppliToCAN_08()
{
  //***********************************Test report header*********************************
  testReportAddMiscInfoBlock("AUTOLIV ELECTRONICS document");
  TestReportAddMiscInfo("Nightly test", "No");
  TestReportAddMiscInfo("Test type", "Requirement-Based test");
  TestReportAddMiscInfo("Regression Test", "No");
  TestReportAddMiscInfo("Fault injection method used", "No");
  TestReportAddMiscInfo("Resource usage evaluation", "No");
  TestReportAddMiscInfo("Priority", "No");
  TestReportAddMiscInfo("Safety relevant", "No");
  
  AddRequirementInfo("Requirement under test", "ARCH_SW_CIL_0165");
  AddRequirementInfo("ARCH_SW_CIL_0165", "If PRE-SAFE7 is executed (cycle 5) (and his next cycle ) then RBTM _FL/FR Actv_Lvl_ST35 should be equal to 0x07=“PRE-SAFE 7” no matter the source of the request: API interface, PRE SAFE interface, Diagnostic request.");
  //***************************************************************************************
    
  testCaseComment("Preconditions");
  testStep("STEP", "Bench Initialization");

  debugger_deleteAllBreakpoints();
  debugger_reset();
  debugger_run();
  
  RunPreTs();
  //====================================================

  setSignal(BODY3::Presf_Lvl_ST3, 7);
  testWaitForTimeout(100);

  snprintf(signal_value, elcount(signal_value), "%d", $RBTMFL_Actv_Lvl_ST35.raw64);
  
  testStep("STEP", "Set a breakpoint in function cil_ManageActiveLevelSignal.");
  debugger_setBpAtLine("s:\\Components\\Application\\Autoliv\\CIL\\Implementation\\src\\CIL_AppliToCAN.c", "550");
  
  testCaseComment("Action: ARCH_SW_CIL_0165");
  testStep("STEP", "Check if variable CIL_u8Actv_Lvl is I_C06_RBTM_LVL_STAT_PROFILE7. --> 7");
  debugger_readVariable("uint8", "CIL_u8Actv_Lvl,,app.elf", "0");
//  ExpectedTestResult(debugger_result, "7", "7");
  
  testCaseComment("Action: ARCH_SW_CIL_0165");
  testStep("STEP", "Check if signal RBTMFL_Actv_Lvl_ST35 value is I_C06_RBTM_LVL_STAT_PROFILE7. --> 7");
//  ExpectedTestResult(signal_value, "7", "7");
  
  //====================================================
  testCaseComment("Postcondition");
  testStep("STEP", "Return ECU to default values");
  
  debugger_deleteAllBreakpoints();
  debugger_run();
  setSignal(BODY3::Presf_Lvl_ST3, 0);
  RunPostTs(); 
  
  debugger_stop();
}


testcase SW_IT_CIL_runAppliToCAN_09()
{
  //***********************************Test report header*********************************
  testReportAddMiscInfoBlock("AUTOLIV ELECTRONICS document");
  TestReportAddMiscInfo("Nightly test", "No");
  TestReportAddMiscInfo("Test type", "Requirement-Based test");
  TestReportAddMiscInfo("Regression Test", "No");
  TestReportAddMiscInfo("Fault injection method used", "No");
  TestReportAddMiscInfo("Resource usage evaluation", "No");
  TestReportAddMiscInfo("Priority", "No");
  TestReportAddMiscInfo("Safety relevant", "No");
  
  AddRequirementInfo("Requirement under test", "ARCH_SW_CIL_0166");
  AddRequirementInfo("ARCH_SW_CIL_0166", "If PRE-SAFE8 is executed (cycle 6) (and his next cycle ) then RBTM _FL/FR Actv_Lvl_ST35 should be equal to 0x08=“PRE-SAFE 8” no matter the source of the request: API interface, PRE SAFE interface, Diagnostic request , ORC req.");
  //***************************************************************************************
    
  testCaseComment("Preconditions");
  testStep("STEP", "Bench Initialization");

  debugger_deleteAllBreakpoints();
  debugger_reset();
  debugger_run();
  
  RunPreTs();
  //====================================================

  setSignal(BODY3::Presf_Lvl_ST3, 8);
  testWaitForTimeout(100);

  snprintf(signal_value, elcount(signal_value), "%d", $RBTMFL_Actv_Lvl_ST35.raw64);
  
  testStep("STEP", "Set a breakpoint in function cil_ManageActiveLevelSignal.");
  debugger_setBpAtLine("s:\\Components\\Application\\Autoliv\\CIL\\Implementation\\src\\CIL_AppliToCAN.c", "550");
  
//  testCaseComment("Action: ARCH_SW_CIL_0166");
//  testStep("STEP", "Check if variable CIL_u8Actv_Lvl is I_C06_RBTM_LVL_STAT_PROFILE8. --> 8");
//  debugger_readVariable("uint8", "CIL_u8Actv_Lvl,,app.elf", "0");
//  ExpectedTestResult(debugger_result, "8", "8");
  
  testCaseComment("Action: ARCH_SW_CIL_0166");
  testStep("STEP", "Check if signal RBTMFL_Actv_Lvl_ST35 value is I_C06_RBTM_LVL_STAT_PROFILE8. --> 8");
  ExpectedTestResult(signal_value, "0", "8");
  
  //====================================================
  testCaseComment("Postcondition");
  testStep("STEP", "Return ECU to default values");
  
  debugger_deleteAllBreakpoints();
  setSignal(BODY3::Presf_Lvl_ST3, 0);
  debugger_run();
  RunPostTs(); 
  
  debugger_stop();
}


testcase SW_IT_CIL_runAppliToCAN_10()
{
  //***********************************Test report header*********************************
  testReportAddMiscInfoBlock("AUTOLIV ELECTRONICS document");
  TestReportAddMiscInfo("Nightly test", "No");
  TestReportAddMiscInfo("Test type", "Requirement-Based test");
  TestReportAddMiscInfo("Regression Test", "No");
  TestReportAddMiscInfo("Fault injection method used", "No");
  TestReportAddMiscInfo("Resource usage evaluation", "No");
  TestReportAddMiscInfo("Priority", "No");
  TestReportAddMiscInfo("Safety relevant", "No");
  
  AddRequirementInfo("Requirement under test", "ARCH_SW_CIL_0167");
  AddRequirementInfo("ARCH_SW_CIL_0167", "If PRE-SAFE9 is executed (cycle 7) (and his next cycle ) then RBTM _FL/FR Actv_Lvl_ST35 should be equal to 0x09=“PRE-SAFE 9” no matter the source of the request: API interface, Diagnostic request.");
  //***************************************************************************************
    
  testCaseComment("Preconditions");
  testStep("STEP", "Bench Initialization");

  debugger_deleteAllBreakpoints();
  debugger_reset();
  debugger_run();
  
  RunPreTs();
  //====================================================

  setSignal(BODY3::RBTMFL_SP_Lvl_Rq_ST35, 9);
  testWaitForTimeout(100);

  snprintf(signal_value, elcount(signal_value), "%d", $RBTMFL_Actv_Lvl_ST35.raw64);
  
  testStep("STEP", "Set a breakpoint in function cil_ManageActiveLevelSignal.");
  debugger_setBpAtLine("s:\\Components\\Application\\Autoliv\\CIL\\Implementation\\src\\CIL_AppliToCAN.c", "550");
  
//  testCaseComment("Action: ARCH_SW_CIL_0167");
//  testStep("STEP", "Check if variable CIL_u8Actv_Lvl is I_C06_RBTM_LVL_STAT_PROFILE9. --> 9");
//  debugger_readVariable("uint8", "CIL_u8Actv_Lvl,,app.elf", "0");
//  ExpectedTestResult(debugger_result, "9", "9");
  
  testCaseComment("Action: ARCH_SW_CIL_0167");
  testStep("STEP", "Check if signal RBTMFL_Actv_Lvl_ST35 value is I_C06_RBTM_LVL_STAT_PROFILE9. --> 9");
  ExpectedTestResult(signal_value, "0", "9");
  
  //====================================================
  testCaseComment("Postcondition");
  testStep("STEP", "Return ECU to default values");
  
  debugger_deleteAllBreakpoints();
  setSignal(BODY3::RBTMFL_SP_Lvl_Rq_ST35, 0);
  debugger_run();
  RunPostTs(); 
  
  debugger_stop();
}


testcase SW_IT_CIL_runAppliToCAN_11()
{
  //***********************************Test report header*********************************
  testReportAddMiscInfoBlock("AUTOLIV ELECTRONICS document");
  TestReportAddMiscInfo("Nightly test", "No");
  TestReportAddMiscInfo("Test type", "Requirement-Based test");
  TestReportAddMiscInfo("Regression Test", "No");
  TestReportAddMiscInfo("Fault injection method used", "No");
  TestReportAddMiscInfo("Resource usage evaluation", "No");
  TestReportAddMiscInfo("Priority", "No");
  TestReportAddMiscInfo("Safety relevant", "No");
  
  AddRequirementInfo("Requirement under test", "ARCH_SW_CIL_0168");
  AddRequirementInfo("ARCH_SW_CIL_0168", "If PRE-SAFE10 is executed (cycle 8) (and his next cycle ) then RBTM _FL/FR Actv_Lvl_ST35 should be equal to 0x0A=“PRE-SAFE 10” no matter the source of the request: API interface, Diagnostic request.");
  //***************************************************************************************
    
  testCaseComment("Preconditions");
  testStep("STEP", "Bench Initialization");

  debugger_deleteAllBreakpoints();
  debugger_reset();
  debugger_run();
  
  RunPreTs();
  //====================================================

  setSignal(BODY3::RBTMFL_SP_Lvl_Rq_ST35, 10);
  testWaitForTimeout(100);

  snprintf(signal_value, elcount(signal_value), "%d", $RBTMFL_Actv_Lvl_ST35.raw64);
  
  testStep("STEP", "Set a breakpoint in function cil_ManageActiveLevelSignal.");
  debugger_setBpAtLine("s:\\Components\\Application\\Autoliv\\CIL\\Implementation\\src\\CIL_AppliToCAN.c", "550");
  
//  testCaseComment("Action: ARCH_SW_CIL_0168");
//  testStep("STEP", "Check if variable CIL_u8Actv_Lvl is I_C06_RBTM_LVL_STAT_PROFILE10. --> 10");
//  debugger_readVariable("uint8", "CIL_u8Actv_Lvl,,app.elf", "0");
//  ExpectedTestResult(debugger_result, "10", "10");
  
  testCaseComment("Action: ARCH_SW_CIL_0168");
  testStep("STEP", "Check if signal RBTMFL_Actv_Lvl_ST35 value is I_C06_RBTM_LVL_STAT_PROFILE10. --> 10");
  ExpectedTestResult(signal_value, "0", "10");
  
  //====================================================
  testCaseComment("Postcondition");
  testStep("STEP", "Return ECU to default values");
  
  debugger_deleteAllBreakpoints();
  setSignal(BODY3::RBTMFL_SP_Lvl_Rq_ST35, 0);
  debugger_run();
  
  RunPostTs(); 
  
  debugger_stop();
}


testcase SW_IT_CIL_runAppliToCAN_12()
{
  //***********************************Test report header*********************************
  testReportAddMiscInfoBlock("AUTOLIV ELECTRONICS document");
  TestReportAddMiscInfo("Nightly test", "No");
  TestReportAddMiscInfo("Test type", "Requirement-Based test");
  TestReportAddMiscInfo("Regression Test", "No");
  TestReportAddMiscInfo("Fault injection method used", "No");
  TestReportAddMiscInfo("Resource usage evaluation", "No");
  TestReportAddMiscInfo("Priority", "No");
  TestReportAddMiscInfo("Safety relevant", "No");
  
  AddRequirementInfo("Requirement under test", "ARCH_SW_CIL_0169");
  AddRequirementInfo("ARCH_SW_CIL_0169", "If PRE-SAFE11 is executed (cycle 9) (and his next cycle ) then RBTM _FL/FR Actv_Lvl_ST35 should be equal to 0x0B=“PRE-SAFE 11” no matter the source of the request: API interface, Diagnostic request.");
  //***************************************************************************************
    
  testCaseComment("Preconditions");
  testStep("STEP", "Bench Initialization");

  debugger_deleteAllBreakpoints();
  debugger_reset();
  debugger_run();
  
  RunPreTs();
  //====================================================

  setSignal(BODY3::RBTMFL_SP_Lvl_Rq_ST35, 11);
  testWaitForTimeout(100);

  snprintf(signal_value, elcount(signal_value), "%d", $RBTMFL_Actv_Lvl_ST35.raw64);
  
  testStep("STEP", "Set a breakpoint in function cil_ManageActiveLevelSignal.");
  debugger_setBpAtLine("s:\\Components\\Application\\Autoliv\\CIL\\Implementation\\src\\CIL_AppliToCAN.c", "550");
  
//  testCaseComment("Action: ARCH_SW_CIL_0169");
//  testStep("STEP", "Check if variable CIL_u8Actv_Lvl is I_C06_RBTM_LVL_STAT_PROFILE11. --> 11");
//  debugger_readVariable("uint8", "CIL_u8Actv_Lvl,,app.elf", "0");
//  ExpectedTestResult(debugger_result, "11", "11");
  
  testCaseComment("Action: ARCH_SW_CIL_0169");
  testStep("STEP", "Check if signal RBTMFL_Actv_Lvl_ST35 value is I_C06_RBTM_LVL_STAT_PROFILE11. --> 11");
  ExpectedTestResult(signal_value, "0", "11");
  
  //====================================================
  testCaseComment("Postcondition");
  testStep("STEP", "Return ECU to default values");
  
  debugger_deleteAllBreakpoints();
  setSignal(BODY3::RBTMFL_SP_Lvl_Rq_ST35, 0);
  debugger_run();
  
  RunPostTs(); 
  
  debugger_stop();
}


testcase SW_IT_CIL_runAppliToCAN_13()
{
  //***********************************Test report header*********************************
  testReportAddMiscInfoBlock("AUTOLIV ELECTRONICS document");
  TestReportAddMiscInfo("Nightly test", "No");
  TestReportAddMiscInfo("Test type", "Requirement-Based test");
  TestReportAddMiscInfo("Regression Test", "No");
  TestReportAddMiscInfo("Fault injection method used", "No");
  TestReportAddMiscInfo("Resource usage evaluation", "No");
  TestReportAddMiscInfo("Priority", "No");
  TestReportAddMiscInfo("Safety relevant", "No");
  
  AddRequirementInfo("Requirement under test", "ARCH_SW_CIL_0170");
  AddRequirementInfo("ARCH_SW_CIL_0170", "If PRE-SAFE12 is executed (cycle 10) (and his next cycle ) then RBTM _FL/FR Actv_Lvl_ST35 should be equal to 0x0C=“PRE-SAFE 12” no matter the source of the request: API interface, Diagnostic request.");
  //***************************************************************************************
    
  testCaseComment("Preconditions");
  testStep("STEP", "Bench Initialization");

  debugger_deleteAllBreakpoints();
  debugger_reset();
  debugger_run();
  
  RunPreTs();
  //====================================================

  setSignal(BODY3::RBTMFL_SP_Lvl_Rq_ST35, 12);
  testWaitForTimeout(100);

  snprintf(signal_value, elcount(signal_value), "%d", $RBTMFL_Actv_Lvl_ST35.raw64);
  
  testStep("STEP", "Set a breakpoint in function cil_ManageActiveLevelSignal.");
  debugger_setBpAtLine("s:\\Components\\Application\\Autoliv\\CIL\\Implementation\\src\\CIL_AppliToCAN.c", "550");
  
//  testCaseComment("Action: ARCH_SW_CIL_0170");
//  testStep("STEP", "Check if variable CIL_u8Actv_Lvl is I_C06_RBTM_LVL_STAT_PROFILE10. --> 12");
//  debugger_readVariable("uint8", "CIL_u8Actv_Lvl,,app.elf", "0");
//  ExpectedTestResult(debugger_result, "12", "12");
  
  testCaseComment("Action: ARCH_SW_CIL_0170");
  testStep("STEP", "Check if signal RBTMFL_Actv_Lvl_ST35 value is I_C06_RBTM_LVL_STAT_PROFILE12. --> 12");
  ExpectedTestResult(signal_value, "0", "12");
  
  //====================================================
  testCaseComment("Postcondition");
  testStep("STEP", "Return ECU to default values");
  
  debugger_deleteAllBreakpoints();
  setSignal(BODY3::RBTMFL_SP_Lvl_Rq_ST35, 0);
  debugger_run();
  
  RunPostTs(); 
  
  debugger_stop();
}


testcase SW_IT_CIL_runAppliToCAN_14()
{
  //***********************************Test report header*********************************
  testReportAddMiscInfoBlock("AUTOLIV ELECTRONICS document");
  TestReportAddMiscInfo("Nightly test", "No");
  TestReportAddMiscInfo("Test type", "Requirement-Based test");
  TestReportAddMiscInfo("Regression Test", "No");
  TestReportAddMiscInfo("Fault injection method used", "No");
  TestReportAddMiscInfo("Resource usage evaluation", "No");
  TestReportAddMiscInfo("Priority", "No");
  TestReportAddMiscInfo("Safety relevant", "No");
  
  AddRequirementInfo("Requirement under test", "ARCH_SW_CIL_0171");
  AddRequirementInfo("ARCH_SW_CIL_0171", "If PRE-SAFE13 is executed (cycle 11) (and his next cycle ) then RBTM _FL/FR Actv_Lvl_ST35 should be equal to 0x0D=“PRE-SAFE 13” no matter the source of the request: API interface, Diagnostic request.");
  //***************************************************************************************
    
  testCaseComment("Preconditions");
  testStep("STEP", "Bench Initialization");

  debugger_deleteAllBreakpoints();
  debugger_reset();
  debugger_run();
  
  RunPreTs();
  //====================================================

  setSignal(BODY3::RBTMFL_SP_Lvl_Rq_ST35, 13);
  testWaitForTimeout(100);

  snprintf(signal_value, elcount(signal_value), "%d", $RBTMFL_Actv_Lvl_ST35.raw64);
  
  testStep("STEP", "Set a breakpoint in function cil_ManageActiveLevelSignal.");
  debugger_setBpAtLine("s:\\Components\\Application\\Autoliv\\CIL\\Implementation\\src\\CIL_AppliToCAN.c", "550");
  
//  testCaseComment("Action: ARCH_SW_CIL_0171");
//  testStep("STEP", "Check if variable CIL_u8Actv_Lvl is I_C06_RBTM_LVL_STAT_PROFILE13. --> 13");
//  debugger_readVariable("uint8", "CIL_u8Actv_Lvl,,app.elf", "0");
//  ExpectedTestResult(debugger_result, "13", "13");
  
  testCaseComment("Action: ARCH_SW_CIL_0171");
  testStep("STEP", "Check if signal RBTMFL_Actv_Lvl_ST35 value is I_C06_RBTM_LVL_STAT_PROFILE13. --> 13");
  ExpectedTestResult(signal_value, "0", "13");
  
  //====================================================
  testCaseComment("Postcondition");
  testStep("STEP", "Return ECU to default values");
  
  debugger_deleteAllBreakpoints();
  setSignal(BODY3::RBTMFL_SP_Lvl_Rq_ST35, 0);
  debugger_run();
  
  RunPostTs(); 
  
  debugger_stop();
}


testcase SW_IT_CIL_runAppliToCAN_15()
{
  //***********************************Test report header*********************************
  testReportAddMiscInfoBlock("AUTOLIV ELECTRONICS document");
  TestReportAddMiscInfo("Nightly test", "No");
  TestReportAddMiscInfo("Test type", "Requirement-Based test");
  TestReportAddMiscInfo("Regression Test", "No");
  TestReportAddMiscInfo("Fault injection method used", "No");
  TestReportAddMiscInfo("Resource usage evaluation", "No");
  TestReportAddMiscInfo("Priority", "No");
  TestReportAddMiscInfo("Safety relevant", "No");
  
  AddRequirementInfo("Requirement under test", "ARCH_SW_CIL_0172");
  AddRequirementInfo("ARCH_SW_CIL_0172", "If PRE-SAFE14 is executed (cycle 12) (and his next cycle ) then RBTM _FL/FR Actv_Lvl_ST35 should be equal to 0x0E=“PRE-SAFE 14” no matter the source of the request: API interface, Diagnostic request.");
  //***************************************************************************************
    
  testCaseComment("Preconditions");
  testStep("STEP", "Bench Initialization");

  debugger_deleteAllBreakpoints();
  debugger_reset();
  debugger_run();
  
  RunPreTs();
  //====================================================

  setSignal(BODY3::RBTMFL_SP_Lvl_Rq_ST35, 14);
  testWaitForTimeout(100);

  snprintf(signal_value, elcount(signal_value), "%d", $RBTMFL_Actv_Lvl_ST35.raw64);
  
  testStep("STEP", "Set a breakpoint in function cil_ManageActiveLevelSignal.");
  debugger_setBpAtLine("s:\\Components\\Application\\Autoliv\\CIL\\Implementation\\src\\CIL_AppliToCAN.c", "550");
  
//  testCaseComment("Action: ARCH_SW_CIL_0172");
//  testStep("STEP", "Check if variable CIL_u8Actv_Lvl is I_C06_RBTM_LVL_STAT_PROFILE13. --> 14");
//  debugger_readVariable("uint8", "CIL_u8Actv_Lvl,,app.elf", "0");
//  ExpectedTestResult(debugger_result, "14", "14");
  
  testCaseComment("Action: ARCH_SW_CIL_0172");
  testStep("STEP", "Check if signal RBTMFL_Actv_Lvl_ST35 value is I_C06_RBTM_LVL_STAT_PROFILE14. --> 14");
  ExpectedTestResult(signal_value, "0", "14");
  
  //====================================================
  testCaseComment("Postcondition");
  testStep("STEP", "Return ECU to default values");
  
  debugger_deleteAllBreakpoints();
  setSignal(BODY3::RBTMFL_SP_Lvl_Rq_ST35, 0);
  debugger_run();
  
  RunPostTs(); 
  
  debugger_stop();
}


testcase SW_IT_CIL_runAppliToCAN_16()
{
  //***********************************Test report header*********************************
  testReportAddMiscInfoBlock("AUTOLIV ELECTRONICS document");
  TestReportAddMiscInfo("Nightly test", "No");
  TestReportAddMiscInfo("Test type", "Requirement-Based test");
  TestReportAddMiscInfo("Regression Test", "No");
  TestReportAddMiscInfo("Fault injection method used", "No");
  TestReportAddMiscInfo("Resource usage evaluation", "No");
  TestReportAddMiscInfo("Priority", "No");
  TestReportAddMiscInfo("Safety relevant", "No");
  
  AddRequirementInfo("Requirement under test", "ARCH_SW_CIL_0173");
  AddRequirementInfo("ARCH_SW_CIL_0173", "If PRE-SAFE15 is executed (cycle 13) (and his next cycle ) then RBTM _FL/FR Actv_Lvl_ST35 should be equal to 0x0F=“PRE-SAFE 15” no matter the source of the request: API interface, Diagnostic request.");
  //***************************************************************************************
    
  testCaseComment("Preconditions");
  testStep("STEP", "Bench Initialization");

  debugger_deleteAllBreakpoints();
  debugger_reset();
  debugger_run();
  
  RunPreTs();
  //====================================================

  setSignal(BODY3::RBTMFL_SP_Lvl_Rq_ST35, 15);
  testWaitForTimeout(100);

  snprintf(signal_value, elcount(signal_value), "%d", $RBTMFL_Actv_Lvl_ST35.raw64);
  
  testStep("STEP", "Set a breakpoint in function cil_ManageActiveLevelSignal.");
  debugger_setBpAtLine("s:\\Components\\Application\\Autoliv\\CIL\\Implementation\\src\\CIL_AppliToCAN.c", "550");
  
//  testCaseComment("Action: ARCH_SW_CIL_0172");
//  testStep("STEP", "Check if variable CIL_u8Actv_Lvl is I_C06_RBTM_LVL_STAT_PROFILE15. --> 15");
//  debugger_readVariable("uint8", "CIL_u8Actv_Lvl,,app.elf", "0");
//  ExpectedTestResult(debugger_result, "15", "15");
  
  testCaseComment("Action: ARCH_SW_CIL_0173");
  testStep("STEP", "Check if signal RBTMFL_Actv_Lvl_ST35 value is I_C06_RBTM_LVL_STAT_PROFILE15. --> 15");
  ExpectedTestResult(signal_value, "0", "15");
  
  //====================================================
  testCaseComment("Postcondition");
  testStep("STEP", "Return ECU to default values");
  
  debugger_deleteAllBreakpoints();
  setSignal(BODY3::RBTMFL_SP_Lvl_Rq_ST35, 0);
  debugger_run();
  
  RunPostTs(); 
  
  debugger_stop();
}


testcase SW_IT_CIL_runAppliToCAN_17()
{
  //***********************************Test report header*********************************
  testReportAddMiscInfoBlock("AUTOLIV ELECTRONICS document");
  TestReportAddMiscInfo("Nightly test", "No");
  TestReportAddMiscInfo("Test type", "Requirement-Based test");
  TestReportAddMiscInfo("Regression Test", "No");
  TestReportAddMiscInfo("Fault injection method used", "No");
  TestReportAddMiscInfo("Resource usage evaluation", "No");
  TestReportAddMiscInfo("Priority", "No");
  TestReportAddMiscInfo("Safety relevant", "No");
  
  AddRequirementInfo("Requirement under test", "ARCH_SW_CIL_0097");
  AddRequirementInfo("ARCH_SW_CIL_0097", "If PRE-SAFE_CURVE1 is executed (cycle 14) (and his next cycle) then  RBTM _FL/FR Actv_Lvl_ST35 should be equal to 0x16 no matter the source of the request : API interface,Diagnostic request.");
  //***************************************************************************************
    
  testCaseComment("Preconditions");
  testStep("STEP", "Bench Initialization");

  debugger_deleteAllBreakpoints();
  debugger_reset();
  debugger_run();
  
  RunPreTs();
  //====================================================

  setSignal(BODY3::RBTMFL_SP_Lvl_Rq_ST35, 0x16);
  testWaitForTimeout(100);

  snprintf(signal_value, elcount(signal_value), "%d", $RBTMFL_Actv_Lvl_ST35.raw64);
  
  testStep("STEP", "Set a breakpoint in function cil_ManageActiveLevelSignal.");
  debugger_setBpAtLine("s:\\Components\\Application\\Autoliv\\CIL\\Implementation\\src\\CIL_AppliToCAN.c", "550");
  
//  testCaseComment("Action: ARCH_SW_CIL_0097");
//  testStep("STEP", "Check if variable CIL_u8Actv_Lvl is I_C06_RBTM_LVL_RQ_PROFILE22. --> 22");
//  debugger_readVariable("uint8", "CIL_u8Actv_Lvl,,app.elf", "0");
//  ExpectedTestResult(debugger_result, "22", "22");
  
  testCaseComment("Action: ARCH_SW_CIL_0097");
  testStep("STEP", "Check if signal RBTMFL_Actv_Lvl_ST35 value is I_C06_RBTM_LVL_RQ_PROFILE22. --> 22");
  ExpectedTestResult(signal_value, "0", "22");
  
  //====================================================
  testCaseComment("Postcondition");
  testStep("STEP", "Return ECU to default values");
  
  debugger_deleteAllBreakpoints();
  setSignal(BODY3::RBTMFL_SP_Lvl_Rq_ST35, 0);
  debugger_run();
  
  RunPostTs(); 
  
  debugger_stop();
}


testcase SW_IT_CIL_runAppliToCAN_18()
{
  //***********************************Test report header*********************************
  testReportAddMiscInfoBlock("AUTOLIV ELECTRONICS document");
  TestReportAddMiscInfo("Nightly test", "No");
  TestReportAddMiscInfo("Test type", "Requirement-Based test");
  TestReportAddMiscInfo("Regression Test", "No");
  TestReportAddMiscInfo("Fault injection method used", "No");
  TestReportAddMiscInfo("Resource usage evaluation", "No");
  TestReportAddMiscInfo("Priority", "No");
  TestReportAddMiscInfo("Safety relevant", "No");
  
  AddRequirementInfo("Requirement under test", "ARCH_SW_CIL_0174");
  AddRequirementInfo("ARCH_SW_CIL_0174", "If PRE-SAFE_CURVE2 is executed (cycle 15) (and his next cycle) then  RBTM _FL/FR Actv_Lvl_ST35 should be equal to 0x17 no matter the source of the request : API interface, Diagnostic request.");
  //***************************************************************************************
    
  testCaseComment("Preconditions");
  testStep("STEP", "Bench Initialization");

  debugger_deleteAllBreakpoints();
  debugger_reset();
  debugger_run();
  
  RunPreTs();
  //====================================================

  setSignal(BODY3::RBTMFL_SP_Lvl_Rq_ST35, 23);
  testWaitForTimeout(100);

  snprintf(signal_value, elcount(signal_value), "%d", $RBTMFL_Actv_Lvl_ST35.raw64);
  
  testStep("STEP", "Set a breakpoint in function cil_ManageActiveLevelSignal.");
  debugger_setBpAtLine("s:\\Components\\Application\\Autoliv\\CIL\\Implementation\\src\\CIL_AppliToCAN.c", "550");
  
//  testCaseComment("Action: ARCH_SW_CIL_0174");
//  testStep("STEP", "Check if variable CIL_u8Actv_Lvl is I_C06_RBTM_LVL_RQ_PROFILE23. --> 23");
//  debugger_readVariable("uint8", "CIL_u8Actv_Lvl,,app.elf", "0");
//  ExpectedTestResult(debugger_result, "22", "22");
  
  testCaseComment("Action: ARCH_SW_CIL_0174");
  testStep("STEP", "Check if signal RBTMFL_Actv_Lvl_ST35 value is I_C06_RBTM_LVL_RQ_PROFILE23. --> 23");
  ExpectedTestResult(signal_value, "0", "23");
  
  //====================================================
  testCaseComment("Postcondition");
  testStep("STEP", "Return ECU to default values");
  
  debugger_deleteAllBreakpoints();
  setSignal(BODY3::RBTMFL_SP_Lvl_Rq_ST35, 0);
  debugger_run();
  
  RunPostTs(); 
  
  debugger_stop();
}


testcase SW_IT_CIL_runAppliToCAN_19()
{
  //***********************************Test report header*********************************
  testReportAddMiscInfoBlock("AUTOLIV ELECTRONICS document");
  TestReportAddMiscInfo("Nightly test", "No");
  TestReportAddMiscInfo("Test type", "Requirement-Based test");
  TestReportAddMiscInfo("Regression Test", "No");
  TestReportAddMiscInfo("Fault injection method used", "No");
  TestReportAddMiscInfo("Resource usage evaluation", "No");
  TestReportAddMiscInfo("Priority", "No");
  TestReportAddMiscInfo("Safety relevant", "No");
  
  AddRequirementInfo("Requirement under test", "ARCH_SW_CIL_0175");
  AddRequirementInfo("ARCH_SW_CIL_0175", "If PRE-SAFE_CURVE3 is executed (cycle 16) (and his next cycle) then  RBTM _FL/FR Actv_Lvl_ST35 should be equal to 0x18 no matter the source of the request : API interface, Diagnostic request.");
  //***************************************************************************************
    
  testCaseComment("Preconditions");
  testStep("STEP", "Bench Initialization");

  debugger_deleteAllBreakpoints();
  debugger_reset();
  debugger_run();
  
  RunPreTs();
  //====================================================

  setSignal(BODY3::RBTMFL_SP_Lvl_Rq_ST35, 24);
  testWaitForTimeout(100);

  snprintf(signal_value, elcount(signal_value), "%d", $RBTMFL_Actv_Lvl_ST35.raw64);
  
  testStep("STEP", "Set a breakpoint in function cil_ManageActiveLevelSignal.");
  debugger_setBpAtLine("s:\\Components\\Application\\Autoliv\\CIL\\Implementation\\src\\CIL_AppliToCAN.c", "550");
  
//  testCaseComment("Action: ARCH_SW_CIL_0175");
//  testStep("STEP", "Check if variable CIL_u8Actv_Lvl is I_C06_RBTM_LVL_RQ_PROFILE24. --> 24");
//  debugger_readVariable("uint8", "CIL_u8Actv_Lvl,,app.elf", "0");
//  ExpectedTestResult(debugger_result, "24", "24");
  
  testCaseComment("Action: ARCH_SW_CIL_0175");
  testStep("STEP", "Check if signal RBTMFL_Actv_Lvl_ST35 value is I_C06_RBTM_LVL_RQ_PROFILE24. --> 24");
  ExpectedTestResult(signal_value, "0", "24");
  
  //====================================================
  testCaseComment("Postcondition");
  testStep("STEP", "Return ECU to default values");
  
  debugger_deleteAllBreakpoints();
  setSignal(BODY3::RBTMFL_SP_Lvl_Rq_ST35, 0);
  debugger_run();
  
  RunPostTs(); 
  
  debugger_stop();
}


testcase SW_IT_CIL_runAppliToCAN_20()
{
  //***********************************Test report header*********************************
  testReportAddMiscInfoBlock("AUTOLIV ELECTRONICS document");
  TestReportAddMiscInfo("Nightly test", "No");
  TestReportAddMiscInfo("Test type", "Requirement-Based test");
  TestReportAddMiscInfo("Regression Test", "No");
  TestReportAddMiscInfo("Fault injection method used", "No");
  TestReportAddMiscInfo("Resource usage evaluation", "No");
  TestReportAddMiscInfo("Priority", "No");
  TestReportAddMiscInfo("Safety relevant", "No");
  
  AddRequirementInfo("Requirement under test", "ARCH_SW_CIL_0176");
  AddRequirementInfo("ARCH_SW_CIL_0176", "If PRE-SAFE_CURVE4 is executed (cycle 17) (and his next cycle) then  RBTM _FL/FR Actv_Lvl_ST35 should be equal to 0x19 no matter the source of the request : API interface,Diagnostic request.");
  //***************************************************************************************
    
  testCaseComment("Preconditions");
  testStep("STEP", "Bench Initialization");

  debugger_deleteAllBreakpoints();
  debugger_reset();
  debugger_run();
  
  RunPreTs();
  //====================================================

  setSignal(BODY3::RBTMFL_SP_Lvl_Rq_ST35, 25);
  testWaitForTimeout(100);

  snprintf(signal_value, elcount(signal_value), "%d", $RBTMFL_Actv_Lvl_ST35.raw64);
  
  testStep("STEP", "Set a breakpoint in function cil_ManageActiveLevelSignal.");
  debugger_setBpAtLine("s:\\Components\\Application\\Autoliv\\CIL\\Implementation\\src\\CIL_AppliToCAN.c", "550");
  
//  testCaseComment("Action: ARCH_SW_CIL_0176");
//  testStep("STEP", "Check if variable CIL_u8Actv_Lvl is I_C06_RBTM_LVL_RQ_PROFILE25. --> 25");
//  debugger_readVariable("uint8", "CIL_u8Actv_Lvl,,app.elf", "0");
//  ExpectedTestResult(debugger_result, "24", "24");
  
  testCaseComment("Action: ARCH_SW_CIL_0176");
  testStep("STEP", "Check if signal RBTMFL_Actv_Lvl_ST35 value is I_C06_RBTM_LVL_RQ_PROFILE25. --> 25");
  ExpectedTestResult(signal_value, "0", "25");
  
  //====================================================
  testCaseComment("Postcondition");
  testStep("STEP", "Return ECU to default values");
  
  debugger_deleteAllBreakpoints();
  setSignal(BODY3::RBTMFL_SP_Lvl_Rq_ST35, 0);
  debugger_run();
  
  RunPostTs(); 
  
  debugger_stop();
}


testcase SW_IT_CIL_runAppliToCAN_21()
{
  //***********************************Test report header*********************************
  testReportAddMiscInfoBlock("AUTOLIV ELECTRONICS document");
  TestReportAddMiscInfo("Nightly test", "No");
  TestReportAddMiscInfo("Test type", "Requirement-Based test");
  TestReportAddMiscInfo("Regression Test", "No");
  TestReportAddMiscInfo("Fault injection method used", "No");
  TestReportAddMiscInfo("Resource usage evaluation", "No");
  TestReportAddMiscInfo("Priority", "No");
  TestReportAddMiscInfo("Safety relevant", "No");
  
  AddRequirementInfo("Requirement under test", "ARCH_SW_CIL_0071, ARCH_SW_CIL_0072, ARCH_SW_CIL_0073, ARCH_SW_CIL_0177");
  AddRequirementInfo("ARCH_SW_CIL_0071", "If a belt profile requested is not programed (cycle or step not valid) RBTM _FL/FR Actv_Lvl_ST35 should be 0x3E = “Rejected” no matter the source of the request: API interface, PRE-SAFE interface.");
  AddRequirementInfo("ARCH_SW_CIL_0072", "If a belt profile requested is undefined or not implemented RBTM _FL/FR Actv_Lvl_ST35 should be 0x3E = “Rejected” no matter the source of the request: API interface, PRE-SAFE interface.");
  AddRequirementInfo("ARCH_SW_CIL_0073", "If a belt profile requested can not be executed no matter the inhibition cause the RBTM _FL/FR Actv_Lvl_ST35 should be 0x3E = “Rejected”. “Rejected” will be transmitted as long the request is active.");
  AddRequirementInfo("ARCH_SW_CIL_0177", "If a belt profile requested is aborted the RBTM _FL/FR Actv_Lvl_ST35 should be 0x3E = “Rejected”. “Rejected” will be transmitted as long the request is active.");
  //***************************************************************************************
    
  testCaseComment("Preconditions");
  testStep("STEP", "Bench Initialization");

  debugger_deleteAllBreakpoints();
  debugger_reset();
  debugger_run();
  
  RunPreTs();
  //====================================================

  setSignal(BODY3::RBTMFL_SP_Lvl_Rq_ST35, 16);
  testWaitForTimeout(100);

  snprintf(signal_value, elcount(signal_value), "%d", $RBTMFL_Actv_Lvl_ST35.raw64);
  
  testStep("STEP", "Set a breakpoint in function cil_ManageActiveLevelSignal.");
  debugger_setBpAtLine("s:\\Components\\Application\\Autoliv\\CIL\\Implementation\\src\\CIL_AppliToCAN.c", "550");
  
  testCaseComment("Action: ARCH_SW_CIL_0071");
  testStep("STEP", "Check if variable CIL_u8Actv_Lvl is I_C06_RBTM_LVL_STAT_REJECTED. --> 62");
  debugger_readVariable("uint8", "CIL_u8Actv_Lvl,,app.elf", "0");
  ExpectedTestResult(debugger_result, "0", "62");
  
  testCaseComment("Action: ARCH_SW_CIL_0177");
  testStep("STEP", "Check if signal RBTMFL_Actv_Lvl_ST35 value is I_C06_RBTM_LVL_STAT_REJECTED. --> 62");
  ExpectedTestResult(signal_value, "0", "62");
  
  //====================================================
  testCaseComment("Postcondition");
  testStep("STEP", "Return ECU to default values");
  
  debugger_deleteAllBreakpoints();
  setSignal(BODY3::RBTMFL_SP_Lvl_Rq_ST35, 0);
  debugger_run();
  
  RunPostTs(); 
  
  debugger_stop();
}


testcase SW_IT_CIL_runAppliToCAN_22()
{
  //***********************************Test report header*********************************
  testReportAddMiscInfoBlock("AUTOLIV ELECTRONICS document");
  TestReportAddMiscInfo("Nightly test", "No");
  TestReportAddMiscInfo("Test type", "Requirement-Based test");
  TestReportAddMiscInfo("Regression Test", "No");
  TestReportAddMiscInfo("Fault injection method used", "No");
  TestReportAddMiscInfo("Resource usage evaluation", "No");
  TestReportAddMiscInfo("Priority", "No");
  TestReportAddMiscInfo("Safety relevant", "No");
  
  AddRequirementInfo("Requirement under test", "ARCH_SW_CIL_0178");
  AddRequirementInfo("ARCH_SW_CIL_0178", "If a belt profile requested is not programed (cycle or step not valid) RBTM _FL/FR Actv_Lvl_ST35 should be 0x3E = “Rejected” no matter the source of the request: API interface, PRE-SAFE interface.");
  //***************************************************************************************
    
  testCaseComment("Preconditions");
  testStep("STEP", "Bench Initialization");

  debugger_deleteAllBreakpoints();
  debugger_reset();
  debugger_run();
  
  RunPreTs();
  //====================================================

  testStep("STEP", "Set signal Bckl_Sw_D_Stat_ST3 to 0x1.");
  setSignal(BODY3::Bckl_Sw_D_Stat_ST3, 0x1);
//  testWaitForTimeout(100);
  
  testStep("STEP", "Set signal Bckl_Sw_D_Stat_ST3 to 0x0.");
  setSignal(BODY3::Bckl_Sw_D_Stat_ST3, 0x0);
//  testWaitForTimeout(100);

  snprintf(signal_value, elcount(signal_value), "%d", $RBTMFL_Actv_Lvl_ST35.raw64);
  
  testCaseComment("Action: ARCH_SW_CIL_0178");
  testStep("STEP", "Check if signal RBTMFL_Actv_Lvl_ST35 value is I_C06_RBTM_LVL_STAT_REJECTED. --> 62");
  ExpectedTestResult(signal_value, "0", "62");
  
  //====================================================
  testCaseComment("Postcondition");
  testStep("STEP", "Return ECU to default values");
  
  debugger_deleteAllBreakpoints();
  RunPostTs(); 
  
  debugger_stop();
}


testcase SW_IT_CIL_runAppliToCAN_23()
{
  //***********************************Test report header*********************************
  testReportAddMiscInfoBlock("AUTOLIV ELECTRONICS document");
  TestReportAddMiscInfo("Nightly test", "No");
  TestReportAddMiscInfo("Test type", "Requirement-Based test");
  TestReportAddMiscInfo("Regression Test", "No");
  TestReportAddMiscInfo("Fault injection method used", "No");
  TestReportAddMiscInfo("Resource usage evaluation", "No");
  TestReportAddMiscInfo("Priority", "No");
  TestReportAddMiscInfo("Safety relevant", "No");
  
  AddRequirementInfo("Requirement under test", "ARCH_SW_CIL_0012, ARCH_SW_CIL_0019, ARCH_SW_CIL_0561");
  AddRequirementInfo("ARCH_SW_CIL_0012", "Signal RBTM_FL/FR_Disp_Rq_ST3 shall be written and send to CAN.");
  AddRequirementInfo("ARCH_SW_CIL_0019", "Value for signal RBTM_FL/FR_Disp_Rq_ST3 will be 1 = SRV_DISP_RQ for 3s after Rid0302 is requested or if a DTCS with warning indicator is qualified, otherwise will be set to 0 = IDLE.");
  AddRequirementInfo("ARCH_SW_CIL_0561", "Read Rte_DIA_psePresafeDisplay_b8TriggerPreSafeRequestStatus shall be read to get if Presafe display 0302 is requested and 3s have passed.");
  //***************************************************************************************
    
  testCaseComment("Preconditions");
  testStep("STEP", "Bench Initialization");

  debugger_deleteAllBreakpoints();
  debugger_reset();
  debugger_run();
  
  RunPreTs();
  //====================================================
  
  testCaseComment("Action: ARCH_SW_CIL_0019");
  testStep("STEP", "Request Rid0302.");
  snprintf(buffer, elcount(signal_value), "%d", diagSendRequest(req_Tensioning_Cycle_BSR_Read));
  testWaitForTimeout(500);
  
  snprintf(signal_value, elcount(signal_value), "%d", $RBTM_FL_Disp_Rq_ST3.raw64);
  
  testCaseComment("Action: ARCH_SW_CIL_0012, ARCH_SW_CIL_0019, ARCH_SW_CIL_0561");
  testStep("STEP", "Check if signal RBTM_FL_Disp_Rq_ST3 value is I_CO2_PRESF_DISP_RQ_SRV_DISP_RQ. --> 1");
  ExpectedTestResult(signal_value, "0", "1");
  
  //====================================================
  testCaseComment("Postcondition");
  testStep("STEP", "Return ECU to default values");
  
  debugger_deleteAllBreakpoints();
  RunPostTs(); 
  
  debugger_stop();
}


testcase SW_IT_CIL_runAppliToCAN_24()
{
  //***********************************Test report header*********************************
  testReportAddMiscInfoBlock("AUTOLIV ELECTRONICS document");
  TestReportAddMiscInfo("Nightly test", "No");
  TestReportAddMiscInfo("Test type", "Requirement-Based test");
  TestReportAddMiscInfo("Regression Test", "No");
  TestReportAddMiscInfo("Fault injection method used", "No");
  TestReportAddMiscInfo("Resource usage evaluation", "No");
  TestReportAddMiscInfo("Priority", "No");
  TestReportAddMiscInfo("Safety relevant", "No");
  
  AddRequirementInfo("Requirement under test", "ARCH_SW_CIL_0013, ARCH_SW_CIL_0020");
  AddRequirementInfo("ARCH_SW_CIL_0013", "Signal RBTM_FL/FR_Disp_Rq_ST3 shall be written and send to CAN.");
  AddRequirementInfo("ARCH_SW_CIL_0020", "Value for signal RBTM_FL/FR_Tgl_ST3 will be 0(default) or 1.");
  //***************************************************************************************
    
  testCaseComment("Preconditions");
  testStep("STEP", "Bench Initialization");

  debugger_deleteAllBreakpoints();
  debugger_reset();
  debugger_run();
  
  RunPreTs();
  //====================================================
  
  testStep("STEP", "Set a breakpoint in function cil_ManageActiveLevelSignal.");
  debugger_setBpAtLine("s:\\Components\\Application\\Autoliv\\CIL\\Implementation\\src\\CIL_AppliToCAN.c", "589");
  
  testCaseComment("Action: ARCH_SW_CIL_0020");
  testStep("STEP", "Check if variable CIL_bRBTMTgl is KB_CIL_RBTM_TGL_SIGNAL_TGL_ONE. --> 0x1");
  debugger_readVariable("uint8", "CIL_bRBTMTgl,,app.elf", "0");
  ExpectedTestResult(debugger_result, "0x0", "0x1");
  
  snprintf(signal_value, elcount(signal_value), "%d", $RBTM_FL_Tgl_ST3.raw64);
  
  testCaseComment("Action: ARCH_SW_CIL_0013, ARCH_SW_CIL_0020");
  testStep("STEP", "Check if signal RBTM_FL_Tgl_ST3 value is KB_CIL_RBTM_TGL_SIGNAL_TGL_ONE. --> 1");
  ExpectedTestResult(signal_value, "0", "1");
  
  //====================================================
  testCaseComment("Postcondition");
  testStep("STEP", "Return ECU to default values");
  
  debugger_deleteAllBreakpoints();
  RunPostTs(); 
  
  debugger_stop();
}


testcase SW_IT_CIL_runAppliToCAN_25()
{
  //***********************************Test report header*********************************
  testReportAddMiscInfoBlock("AUTOLIV ELECTRONICS document");
  TestReportAddMiscInfo("Nightly test", "No");
  TestReportAddMiscInfo("Test type", "Requirement-Based test");
  TestReportAddMiscInfo("Regression Test", "No");
  TestReportAddMiscInfo("Fault injection method used", "No");
  TestReportAddMiscInfo("Resource usage evaluation", "No");
  TestReportAddMiscInfo("Priority", "No");
  TestReportAddMiscInfo("Safety relevant", "No");
  
  AddRequirementInfo("Requirement under test", "ARCH_SW_CIL_0015, ARCH_SW_CIL_0021");
  AddRequirementInfo("ARCH_SW_CIL_0015", "Signal BltSlckDec_Md_FL/FR_Stat_ST3 shall be written and send to CAN.");
  AddRequirementInfo("ARCH_SW_CIL_0021", "Value for signal BltSlckDec_Md_FL/FR_Stat_ST3 will always be 3.");
  //***************************************************************************************
    
  testCaseComment("Preconditions");
  testStep("STEP", "Bench Initialization");

  debugger_deleteAllBreakpoints();
  debugger_reset();
  debugger_run();
  
  RunPreTs();
  //====================================================
  
  testStep("STEP", "Set a breakpoint in function cil_ManageActiveLevelSignal at line (void)Rte_Write_CIL_AC_CommunicationInteractionLayer_IF_BltSlckDec_Md_XX_Stat_ST3_BltSlckDec_Md_XX_Stat_ST3(cil_u8BltSlckDec);");
  debugger_setBpAtLine("s:\\Components\\Application\\Autoliv\\CIL\\Implementation\\src\\CIL_AppliToCAN.c", "593");
//  ExpectedTestResult(debugger_result,"BP set", "BP set");
  
  snprintf(signal_value, elcount(signal_value), "%d", $BltSlckDec_Md_FL_Stat_ST3.raw64);
  
  testCaseComment("Action: ARCH_SW_CIL_0015, ARCH_SW_CIL_0021");
  testStep("STEP", "Check if signal BltSlckDec_Md_FL_Stat_ST3 value is I_C02_OFF_ON_SNA. --> 3");
  ExpectedTestResult(signal_value, "0", "3");
  
  //====================================================
  testCaseComment("Postcondition");
  testStep("STEP", "Return ECU to default values");
  
  debugger_deleteAllBreakpoints();
  RunPostTs(); 
  
  debugger_stop();
}


testcase SW_IT_CIL_ActiveClient_01()
{
  //***********************************Test report header*********************************
  testReportAddMiscInfoBlock("AUTOLIV ELECTRONICS document");
  TestReportAddMiscInfo("Nightly test", "No");
  TestReportAddMiscInfo("Test type", "Requirement-Based test");
  TestReportAddMiscInfo("Regression Test", "No");
  TestReportAddMiscInfo("Fault injection method used", "No");
  TestReportAddMiscInfo("Resource usage evaluation", "No");
  TestReportAddMiscInfo("Priority", "No");
  TestReportAddMiscInfo("Safety relevant", "No");
  
  AddRequirementInfo("Requirement under test", "ARCH_SW_CIL_0098, ARCH_SW_CIL_0099, ARCH_SW_CIL_0104");
  AddRequirementInfo("ARCH_SW_CIL_0099", "When no profile is executed the signal RBTMxy_SP_ActvClient_ST35 shall be set to 0.");
  AddRequirementInfo("ARCH_SW_CIL_0098", "Signal RBTMxy_SP_ActvClient_ST35 shall be written and send to CAN.");
  AddRequirementInfo("ARCH_SW_CIL_0104", "Signal RBTMxy_SP_ActvClient_ST35 shall be 0x0F dring initialization phase.");
  //***************************************************************************************
    
  testCaseComment("Preconditions");
  testStep("STEP", "Bench Initialization");

  debugger_deleteAllBreakpoints();
  debugger_reset();
  debugger_run();
  
  RunPreTs();
  //====================================================
  
  testStep("STEP", "Set signal RBTMFL_SP_Lvl_Rq_ST35 to I_C04_PRESF_LVL_V2_NOLVL.");
  setSignal(BODY3::RBTMFL_SP_Lvl_Rq_ST35, 0);
  testWaitForTimeout(500);
  
  testStep("STEP", "Set a breakpoint in function cil_ManageActiveClientRequestSource.");
  debugger_setBpAtLine("s:\\Components\\Application\\Autoliv\\CIL\\Implementation\\src\\CIL_AppliToCAN.c", "355");
  ExpectedTestResult(debugger_result,"BP set", "BP set");
  
  debugger_deleteAllBreakpoints();
  debugger_run();
  
  snprintf(signal_value, elcount(signal_value), "%d", $RBTMFL_SP_ActvClient_ST35.raw64);
  
  testCaseComment("Action: ARCH_SW_CIL_0098, ARCH_SW_CIL_0099, ARCH_SW_CIL_0104");
  testStep("STEP", "Check if signal RBTMFL_SP_ActvClient_ST35 value is I_C02_OFF_ON_SNA. --> 0");
  ExpectedTestResult(signal_value, "0", "0");
  
  //====================================================
  testCaseComment("Postcondition");
  testStep("STEP", "Return ECU to default values");
  
  debugger_deleteAllBreakpoints();
  
  RunPostTs(); 
  
  debugger_stop();
}


testcase SW_IT_CIL_ActiveClient_02()
{
  //***********************************Test report header*********************************
  testReportAddMiscInfoBlock("AUTOLIV ELECTRONICS document");
  TestReportAddMiscInfo("Nightly test", "No");
  TestReportAddMiscInfo("Test type", "Requirement-Based test");
  TestReportAddMiscInfo("Regression Test", "No");
  TestReportAddMiscInfo("Fault injection method used", "No");
  TestReportAddMiscInfo("Resource usage evaluation", "No");
  TestReportAddMiscInfo("Priority", "No");
  TestReportAddMiscInfo("Safety relevant", "No");
  
  AddRequirementInfo("Requirement under test", "ARCH_SW_CIL_0100");
  AddRequirementInfo("ARCH_SW_CIL_0100", "When executed cycle is requested on PRESAFE, signal RBTMxy_SP_ActvClient_ST35 shall be 1, as long as profile and next cycle is executed.");
  //***************************************************************************************
    
  testCaseComment("Preconditions");
  testStep("STEP", "Bench Initialization");

  debugger_deleteAllBreakpoints();
  debugger_reset();
  debugger_run();
  
  RunPreTs();
  //====================================================
  
  testStep("STEP", "Set signal Presf_Lvl_ST3 to I_C04_PRESF_LVL_V2_LVL1.");
  setSignal(BODY3::Presf_Lvl_ST3, 1);
  testWaitForTimeout(500);
  
  testStep("STEP", "Set a breakpoint in function cil_ManageActiveClientRequestSource.");
  debugger_setBpAtLine("s:\\Components\\Application\\Autoliv\\CIL\\Implementation\\src\\CIL_AppliToCAN.c", "355");
  ExpectedTestResult(debugger_result,"BP set", "BP set");
  
  debugger_deleteAllBreakpoints();
  debugger_run();
  
  snprintf(signal_value, elcount(signal_value), "%d", $RBTMFL_SP_ActvClient_ST35.raw64);
  
  testCaseComment("Action: ARCH_SW_CIL_0100");
  testStep("STEP", "Check if signal RBTMFL_SP_ActvClient_ST35 value is KU8_ONE --> 1");
  ExpectedTestResult(signal_value, "0", "1");
  
  //====================================================
  testCaseComment("Postcondition");
  testStep("STEP", "Return ECU to default values");
  
  debugger_deleteAllBreakpoints();
  setSignal(BODY3::Presf_Lvl_ST3, 0);
  debugger_run();
  RunPostTs(); 
  
  debugger_stop();
}


testcase SW_IT_CIL_ActiveClient_03()
{
  //***********************************Test report header*********************************
  testReportAddMiscInfoBlock("AUTOLIV ELECTRONICS document");
  TestReportAddMiscInfo("Nightly test", "No");
  TestReportAddMiscInfo("Test type", "Requirement-Based test");
  TestReportAddMiscInfo("Regression Test", "No");
  TestReportAddMiscInfo("Fault injection method used", "No");
  TestReportAddMiscInfo("Resource usage evaluation", "No");
  TestReportAddMiscInfo("Priority", "No");
  TestReportAddMiscInfo("Safety relevant", "No");
  
  AddRequirementInfo("Requirement under test", "ARCH_SW_CIL_0179");
  AddRequirementInfo("ARCH_SW_CIL_0179", "When executed cycle is requested on ORC ( via Impact ro type), signal RBTMxy_SP_ActvClient_ST35 shall be 2, as long as profile and next cycle is executed.");
  //***************************************************************************************
    
  testCaseComment("Preconditions");
  testStep("STEP", "Bench Initialization");

  debugger_deleteAllBreakpoints();
  debugger_reset();
  debugger_run();
  
  RunPreTs();
  //====================================================
  
  testStep("STEP", "Set signal Impact_RO_type1_ST3 to KU8_ONE.");
  setSignal(BODY3::Impact_RO_type1_ST3, 1);
  testWaitForTimeout(1000);
  
//  testStep("STEP", "Set a breakpoint in function cil_ManageActiveClientRequestSource.");
//  debugger_setBpAtLine("s:\\Components\\Application\\Autoliv\\CIL\\Implementation\\src\\CIL_AppliToCAN.c", "413");
//  ExpectedTestResult(debugger_result,"BP set", "BP set");
//  
//  debugger_deleteAllBreakpoints();
//  debugger_run();
  
  snprintf(signal_value, elcount(signal_value), "%d", $RBTMFL_SP_ActvClient_ST35.raw64);
  
  testCaseComment("Action: ARCH_SW_CIL_0179");
  testStep("STEP", "Check if signal RBTMFL_SP_ActvClient_ST35 value is KU8_TWO --> 2");
  ExpectedTestResult(signal_value, "0", "2");
  
  //====================================================
  testCaseComment("Postcondition");
  testStep("STEP", "Return ECU to default values");
  
  debugger_deleteAllBreakpoints();
  setSignal(BODY3::Presf_Lvl_ST3, 0);
  debugger_run();
  RunPostTs(); 
  
  debugger_stop();
}


testcase SW_IT_CIL_ActiveClient_04()
{
  //***********************************Test report header*********************************
  testReportAddMiscInfoBlock("AUTOLIV ELECTRONICS document");
  TestReportAddMiscInfo("Nightly test", "No");
  TestReportAddMiscInfo("Test type", "Requirement-Based test");
  TestReportAddMiscInfo("Regression Test", "No");
  TestReportAddMiscInfo("Fault injection method used", "No");
  TestReportAddMiscInfo("Resource usage evaluation", "No");
  TestReportAddMiscInfo("Priority", "No");
  TestReportAddMiscInfo("Safety relevant", "No");
  
  AddRequirementInfo("Requirement under test", "ARCH_SW_CIL_0101");
  AddRequirementInfo("ARCH_SW_CIL_0101", "When executed cycle is requested on API, signal RBTMxy_SP_ActvClient_ST35 shall be 3, as long as profile and next cycle is executed.");
  //***************************************************************************************
    
  testCaseComment("Preconditions");
  testStep("STEP", "Bench Initialization");

  debugger_deleteAllBreakpoints();
  debugger_reset();
  debugger_run();
  
  RunPreTs();
  //====================================================
  
  testStep("STEP", "Set signal RBTMFL_SP_Lvl_Rq_ST35 to I_C04_PRESF_LVL_V2_LVL1.");
  setSignal(BODY3::RBTMFL_SP_Lvl_Rq_ST35, 1);
  testWaitForTimeout(500);
  
  testStep("STEP", "Set a breakpoint in function cil_ManageActiveClientRequestSource.");
  debugger_setBpAtLine("s:\\Components\\Application\\Autoliv\\CIL\\Implementation\\src\\CIL_AppliToCAN.c", "355");
  ExpectedTestResult(debugger_result,"BP set", "BP set");
  
  debugger_deleteAllBreakpoints();
  debugger_run();
  
  snprintf(signal_value, elcount(signal_value), "%d", $RBTMFL_SP_ActvClient_ST35.raw64);
  
  testCaseComment("Action: ARCH_SW_CIL_0101");
  testStep("STEP", "Check if signal RBTMFL_SP_ActvClient_ST35 value is KU8_THREE --> 3");
  ExpectedTestResult(signal_value, "0", "3");
  
  //====================================================
  testCaseComment("Postcondition");
  testStep("STEP", "Return ECU to default values");
  
  debugger_deleteAllBreakpoints();
  setSignal(BODY3::RBTMFL_SP_Lvl_Rq_ST35, 0);
  debugger_run();
  RunPostTs(); 
  
  debugger_stop();
}


testcase SW_IT_CIL_ActiveClient_05()
{
  //***********************************Test report header*********************************
  testReportAddMiscInfoBlock("AUTOLIV ELECTRONICS document");
  TestReportAddMiscInfo("Nightly test", "No");
  TestReportAddMiscInfo("Test type", "Requirement-Based test");
  TestReportAddMiscInfo("Regression Test", "No");
  TestReportAddMiscInfo("Fault injection method used", "No");
  TestReportAddMiscInfo("Resource usage evaluation", "No");
  TestReportAddMiscInfo("Priority", "No");
  TestReportAddMiscInfo("Safety relevant", "No");
  
  AddRequirementInfo("Requirement under test", "ARCH_SW_CIL_0102");
  AddRequirementInfo("ARCH_SW_CIL_0102", "When executed cycle is BSR 1, signal RBTMxy_SP_ActvClient_ST35 shall be 4, as long as profile and next cycle is executed.");
  //***************************************************************************************
    
  testCaseComment("Preconditions");
  testStep("STEP", "Bench Initialization");

  debugger_deleteAllBreakpoints();
  debugger_reset();
  debugger_run();
  
  RunPreTs();
  //====================================================
  
  testStep("STEP", "Set signal BltSlckDec_Md_FL_Stat_ST3 to KU8_ONE.");
  setSignal(BODY3::Bckl_Sw_D_Stat_ST3, 1);
//  testWaitForTimeout(500);
  
  testStep("STEP", "Set signal BltSlckDec_Md_FL_Stat_ST3 to KU8_ZERO.");
  setSignal(BODY3::Bckl_Sw_D_Stat_ST3, 0);
//  testWaitForTimeout(500);
  
  testStep("STEP", "Set a breakpoint in function cil_ManageActiveClientRequestSource.");
  debugger_setBpAtLine("s:\\Components\\Application\\Autoliv\\CIL\\Implementation\\src\\CIL_AppliToCAN.c", "355");
  ExpectedTestResult(debugger_result,"BP set", "BP set");
  
  debugger_deleteAllBreakpoints();
  debugger_run();
  
  snprintf(signal_value, elcount(signal_value), "%d", $RBTMFL_SP_ActvClient_ST35.raw64);
  
  testCaseComment("Action: ARCH_SW_CIL_0102");
  testStep("STEP", "Check if signal RBTMFL_SP_ActvClient_ST35 value is I_C04_RBTM_ACTVCLIENT_BELTSLACK_REDUCTION --> 4");
  ExpectedTestResult(signal_value, "0", "4");
  
  //====================================================
  testCaseComment("Postcondition");
  testStep("STEP", "Return ECU to default values");
  
  debugger_deleteAllBreakpoints();
  RunPostTs(); 
  
  debugger_stop();
}


testcase SW_IT_CIL_ActiveClient_06()
{
  //***********************************Test report header*********************************
  testReportAddMiscInfoBlock("AUTOLIV ELECTRONICS document");
  TestReportAddMiscInfo("Nightly test", "No");
  TestReportAddMiscInfo("Test type", "Requirement-Based test");
  TestReportAddMiscInfo("Regression Test", "No");
  TestReportAddMiscInfo("Fault injection method used", "No");
  TestReportAddMiscInfo("Resource usage evaluation", "No");
  TestReportAddMiscInfo("Priority", "No");
  TestReportAddMiscInfo("Safety relevant", "No");
  
  AddRequirementInfo("Requirement under test", "ARCH_SW_CIL_0103");
  AddRequirementInfo("ARCH_SW_CIL_0103", "When executed cycle is requested on another source , signal RBTMxy_SP_ActvClient_ST35 shall be 6, as long as profile and next cycle is executed.");
  //***************************************************************************************
    
  testCaseComment("Preconditions");
  testStep("STEP", "Bench Initialization");

  debugger_deleteAllBreakpoints();
  debugger_reset();
  debugger_run();
  
  RunPreTs();
  //====================================================
  
//  testStep("STEP", "Set signal  to  .");
//  setSignal(BODY3::, 1);
//  
//  testStep("STEP", "Set a breakpoint in function cil_ManageActiveClientRequestSource.");
//  debugger_setBpAtLine("s:\\Components\\Application\\Autoliv\\CIL\\Implementation\\src\\CIL_AppliToCAN.c", "413");
//  ExpectedTestResult(debugger_result,"BP set", "BP set");
//  
//  debugger_deleteAllBreakpoints();
//  debugger_run();
  
  snprintf(signal_value, elcount(signal_value), "%d", $RBTMFL_SP_ActvClient_ST35.raw64);
  
  testCaseComment("Action: ARCH_SW_CIL_0103");
  testStep("STEP", "Check if signal RBTMFL_SP_ActvClient_ST35 value is I_C04_RBTM_ACTVCLIENT_BELTSLACK_REDUCTION --> 6");
  ExpectedTestResult(signal_value, "0", "6");
  
  //====================================================
  testCaseComment("Postcondition");
  testStep("STEP", "Return ECU to default values");
  
  debugger_deleteAllBreakpoints();
  RunPostTs(); 
  
  debugger_stop();
}


testcase SW_IT_CIL_FctPrecond_01()
{
  //***********************************Test report header*********************************
  testReportAddMiscInfoBlock("AUTOLIV ELECTRONICS document");
  TestReportAddMiscInfo("Nightly test", "No");
  TestReportAddMiscInfo("Test type", "Requirement-Based test");
  TestReportAddMiscInfo("Regression Test", "No");
  TestReportAddMiscInfo("Fault injection method used", "No");
  TestReportAddMiscInfo("Resource usage evaluation", "No");
  TestReportAddMiscInfo("Priority", "No");
  TestReportAddMiscInfo("Safety relevant", "No");
  
  AddRequirementInfo("Requirement under test", "ARCH_SW_CIL_0105, ARCH_SW_CIL_0106");
  AddRequirementInfo("ARCH_SW_CIL_0105", "Signal RBTMxy_SP_FctPrecond_Stat_ST35 shall be written and send to CAN.");
  AddRequirementInfo("ARCH_SW_CIL_0106", "Signal should be set to 0 if no setting condition is present.");
  //***************************************************************************************
    
  testCaseComment("Preconditions");
  testStep("STEP", "Bench Initialization");

  debugger_deleteAllBreakpoints();
  debugger_reset();
  debugger_run();
  
  RunPreTs();
  //====================================================
  
  testStep("STEP", "Set a breakpoint in function cil_ManageFctPrecondSignal.");
  debugger_setBpAtLine("s:\\Components\\Application\\Autoliv\\CIL\\Implementation\\src\\CIL_AppliToCAN.c", "250");
  ExpectedTestResult(debugger_result,"BP set", "BP set");
  
  debugger_deleteAllBreakpoints();
  debugger_run();
  
  snprintf(signal_value, elcount(signal_value), "%d", $RBTMFL_SP_FctPrecond_Stat_ST35.raw64);
  
  testCaseComment("Action: ARCH_SW_CIL_0105, ARCH_SW_CIL_0106");
  testStep("STEP", "Check if signal RBTMFL_SP_FctPrecond_Stat_ST35 value is I_C02_BCKL_SW_STAT_OK. --> 0");
  ExpectedTestResult(signal_value, "0", "0");
  
  //====================================================
  testCaseComment("Postcondition");
  testStep("STEP", "Return ECU to default values");
  
  debugger_deleteAllBreakpoints();
  RunPostTs(); 
  
  debugger_stop();
}


testcase SW_IT_CIL_FctPrecond_02()
{
  //***********************************Test report header*********************************
  testReportAddMiscInfoBlock("AUTOLIV ELECTRONICS document");
  TestReportAddMiscInfo("Nightly test", "No");
  TestReportAddMiscInfo("Test type", "Requirement-Based test");
  TestReportAddMiscInfo("Regression Test", "No");
  TestReportAddMiscInfo("Fault injection method used", "No");
  TestReportAddMiscInfo("Resource usage evaluation", "No");
  TestReportAddMiscInfo("Priority", "No");
  TestReportAddMiscInfo("Safety relevant", "No");
  
  AddRequirementInfo("Requirement under test", "ARCH_SW_CIL_0107, ARCH_SW_CIL_0108, ARCH_SW_CIL_0180");
  AddRequirementInfo("ARCH_SW_CIL_0107", "Bit 0 from signal RBTMxy_SP_FctPrecond_Stat_ST35 shall be set to 1 if belt is not buckled. (Bckl_SW_D/FP_STAT_St3).");
  AddRequirementInfo("ARCH_SW_CIL_0108", "Bit 2 from signal RBTMxy_SP_FctPrecond_Stat_ST35 shall be set to 1 if DTC B228B4B is set (Overtemperature group error).");
  AddRequirementInfo("ARCH_SW_CIL_0180", "Bit 3 from signal RBTMxy_SP_FctPrecond_Stat_ST35 shall be set to 1 when DTC B228B49: ECU is defective is qualified. Or ?	B228B71: System is defective.");
  //***************************************************************************************
    
  testCaseComment("Preconditions");
  testStep("STEP", "Bench Initialization");

  debugger_deleteAllBreakpoints();
  debugger_reset();
  debugger_run();
  
  RunPreTs();
  //====================================================
  
  testStep("STEP", "Set signal Bckl_Sw_D_Stat_ST3 to KU8_ONE.");
  setSignal(BODY3::Bckl_Sw_D_Stat_ST3, 1);
  
  testStep("STEP", "Set a breakpoint in function cil_ManageFctPrecondSignal.");
  debugger_setBpAtLine("s:\\Components\\Application\\Autoliv\\CIL\\Implementation\\src\\CIL_AppliToCAN.c", "250");
  ExpectedTestResult(debugger_result,"BP set", "BP set");
  
  debugger_deleteAllBreakpoints();
  debugger_run();
  
  snprintf(signal_value, elcount(signal_value), "%d", $RBTMFL_SP_FctPrecond_Stat_ST35.raw64);
  
  testCaseComment("Action: ARCH_SW_CIL_0107, ARCH_SW_CIL_0108, ARCH_SW_CIL_0180");
  testStep("STEP", "Check if signal RBTMFL_SP_FctPrecond_Stat_ST35 value is KU8_ONE. --> 1");
  ExpectedTestResult(signal_value, "0", "1");
  
  //====================================================
  testCaseComment("Postcondition");
  testStep("STEP", "Return ECU to default values");
  
  debugger_deleteAllBreakpoints();
  setSignal(BODY3::Bckl_Sw_D_Stat_ST3, 0);
  debugger_run();
  RunPostTs(); 
  
  debugger_stop();
}


testcase SW_IT_CIL_FctPrecond_03()
{
  //***********************************Test report header*********************************
  testReportAddMiscInfoBlock("AUTOLIV ELECTRONICS document");
  TestReportAddMiscInfo("Nightly test", "No");
  TestReportAddMiscInfo("Test type", "Requirement-Based test");
  TestReportAddMiscInfo("Regression Test", "No");
  TestReportAddMiscInfo("Fault injection method used", "No");
  TestReportAddMiscInfo("Resource usage evaluation", "No");
  TestReportAddMiscInfo("Priority", "No");
  TestReportAddMiscInfo("Safety relevant", "No");
  
  AddRequirementInfo("Requirement under test", "ARCH_SW_CIL_0111, ARCH_SW_CIL_0109, ARCH_SW_CIL_0110");
  AddRequirementInfo("ARCH_SW_CIL_0111", "Bit 6 from signal RBTMxy_SP_FctPrecond_Stat_ST35 shall be set to 1 if profile requested is not implemented.");
  AddRequirementInfo("ARCH_SW_CIL_0109", "Bit 4 from signal RBTMxy_SP_FctPrecond_Stat_ST35 shall be set to 1 if DTC: B210E00 - The power supply is too high OR B210D00 - The power supply is too low OR B228B16 - Terminal 30 measurement undervoltage OR B228B17 -Terminal 30 measurement is set.");
  AddRequirementInfo("ARCH_SW_CIL_0110", "Bit 5 from signal RBTMxy_SP_FctPrecond_Stat_ST35 shall be set to 1 if DTC: U012287 - Communication with control unit ''Traction system'' has a malfunction OR U041608 - Implausible data received from control unit Traction system OR U042708- Implausible data received from the electronic ignition lock OR	U015187 - Communication with the supplemental restraint system (SRS) has a malfunction OR	U045208 - Implausible data were received from the supplemental restraint system is set.");
  //***************************************************************************************
    
  testCaseComment("Preconditions");
  testStep("STEP", "Bench Initialization");

  debugger_deleteAllBreakpoints();
  debugger_reset();
  debugger_run();
  
  RunPreTs();
  //====================================================
  
  testStep("STEP", "Set signal Bckl_Sw_D_Stat_ST3 to KU8_ONE.");
  setSignal(BODY3::Bckl_Sw_D_Stat_ST3, 4);
  
  testStep("STEP", "Set a breakpoint in function cil_ManageFctPrecondSignal.");
  debugger_setBpAtLine("s:\\Components\\Application\\Autoliv\\CIL\\Implementation\\src\\CIL_AppliToCAN.c", "250");
  ExpectedTestResult(debugger_result,"BP set", "BP set");
  
  debugger_deleteAllBreakpoints();
  debugger_run();
  
  snprintf(signal_value, elcount(signal_value), "%d", $RBTMFL_SP_FctPrecond_Stat_ST35.raw64);
  
  testCaseComment("Action: ARCH_SW_CIL_0111, ARCH_SW_CIL_0109, ARCH_SW_CIL_0110");
  testStep("STEP", "Check if signal RBTMFL_SP_FctPrecond_Stat_ST35 value is KU8_ONE. --> KU8_ONE");
  ExpectedTestResult(signal_value, "0", "1");
  
  //====================================================
  testCaseComment("Postcondition");
  testStep("STEP", "Return ECU to default values");
  
  debugger_deleteAllBreakpoints();
  setSignal(BODY3::Bckl_Sw_D_Stat_ST3, 0);
  debugger_run();
  RunPostTs(); 
  
  debugger_stop();
}


testcase SW_IT_CIL_Com_SendSignal_01()
{
  //***********************************Test report header*********************************
  testReportAddMiscInfoBlock("AUTOLIV ELECTRONICS document");
  TestReportAddMiscInfo("Nightly test", "No");
  TestReportAddMiscInfo("Test type", "Requirement-Based test");
  TestReportAddMiscInfo("Regression Test", "No");
  TestReportAddMiscInfo("Fault injection method used", "No");
  TestReportAddMiscInfo("Resource usage evaluation", "No");
  TestReportAddMiscInfo("Priority", "No");
  TestReportAddMiscInfo("Safety relevant", "No");
  
  AddRequirementInfo("Requirement under test", "ARCH_SW_CIL_0558");
  AddRequirementInfo("ARCH_SW_CIL_0558", "Com_SendSignal shall be called to ensure signal IfActive Transmission Type.");
  //***************************************************************************************
    
  testCaseComment("Preconditions");
  testStep("STEP", "Bench Initialization");

  debugger_deleteAllBreakpoints();
  debugger_reset();
  debugger_run();
  
  RunPreTs();
  //====================================================
  
  testStep("STEP", "Set a breakpoint in function cil_ManageFctPrecondSignal at line if(KU8_CIL_ECU_SIDE_FRONT_LEFT == KU8_CIL_ECU_LOCATION).");
  debugger_setBpAtLine("s:\\Components\\Application\\Autoliv\\CIL\\Implementation\\src\\CIL_AppliToCAN.c", "326");
  ExpectedTestResult(debugger_result,"BP set", "BP set");
  
  testStep("STEP", "Set a breakpoint in function Rte_Write_CIL_AC_CommunicationInteractionLayer_P_RBTMFL_SP_FctPrecond_Stat_ST35_RBTMFL_SP_FctPrecond_Stat_ST35.");
  debugger_setRelativeFunctionBpAtLine("Rte_Write_CIL_AC_CommunicationInteractionLayer_P_RBTMFL_SP_FctPrecond_Stat_ST35_RBTMFL_SP_FctPrecond_Stat_ST35", "6");
  
  debugger_run();
  
  testCaseComment("Action: ARCH_SW_CIL_0558");
  testStep("STEP", "Check if CPU stopped at line ret |= Com_SendSignal(ComConf_ComSignal_RBTMFL_SP_FctPrecond_Stat_ST35_bbfa2c80_Tx. --> CPU stopped at BP");
  debugger_waitUntilBPisReached("1000");
  ExpectedTestResult(debugger_result,IS_CPU_STOP_AT_BP_SUCCESFUL, "CPU stopped at BP");
  
  //====================================================
  testCaseComment("Postcondition");
  testStep("STEP", "Return ECU to default values");
  
  debugger_deleteAllBreakpoints();
  RunPostTs(); 
  
  debugger_stop();
}


testcase SW_IT_CIL_CheckTimeoutError_01()
{
  //***********************************Test report header*********************************
  testReportAddMiscInfoBlock("AUTOLIV ELECTRONICS document");
  TestReportAddMiscInfo("Nightly test", "No");
  TestReportAddMiscInfo("Test type", "Requirement-Based test");
  TestReportAddMiscInfo("Regression Test", "No");
  TestReportAddMiscInfo("Fault injection method used", "No");
  TestReportAddMiscInfo("Resource usage evaluation", "No");
  TestReportAddMiscInfo("Priority", "No");
  TestReportAddMiscInfo("Safety relevant", "No");
  
  AddRequirementInfo("Requirement under test", "ARCH_SW_CIL_0800");
  AddRequirementInfo("ARCH_SW_CIL_0800", "CIL shall check if timeout is present for Presafe frame.");
  //***************************************************************************************
    
  testCaseComment("Preconditions");
  testStep("STEP", "Bench Initialization");

  debugger_deleteAllBreakpoints();
  debugger_reset();
  debugger_run();
  
  RunPreTs();
  //==================================================== 
  
  testStep("STEP", "Set signal PresfAct_Adj_ST3 to I_C04_PRESF_LVL_V2_SNA (0x0F).");
  setSignal(BODY3::PresfAct_Adj_ST3::Presf_Lvl_ST3, I_C04_PRESF_LVL_V2_SNA);
  testWaitForTimeout(500);
  
  testStep("STEP", "Set a breakpoint in function CIL_Autotest_Presafe_CheckTimeoutError( ) at line *pu8TestResult = cil_u8ResultOfAutoTest;.");
  debugger_setRelativeFunctionBpAtLine("CIL_Autotest_Presafe_CheckTimeoutError", "10");
  
  testCaseComment("Action: ARCH_SW_CIL_0800");
  testStep("STEP", "Check if CPU stopped at line *pu8TestResult = cil_u8ResultOfAutoTest;. --> CPU stopped at BP");
  debugger_waitUntilBPisReached("1000");
  ExpectedTestResult(debugger_result,IS_CPU_STOP_AT_BP_SUCCESFUL, "CPU stopped at BP");
  
  //====================================================
  testCaseComment("Postcondition");
  testStep("STEP", "Return ECU to default values");
  
  debugger_deleteAllBreakpoints();
  setSignal(BODY3::PresfAct_Adj_ST3::Presf_Lvl_ST3, I_C04_PRESF_LVL_V2_NOLVL);
  debugger_run();
  RunPostTs(); 
  
  debugger_stop();
}


testcase SW_IT_CIL_CheckTimeoutError_02()
{
  //***********************************Test report header*********************************
  testReportAddMiscInfoBlock("AUTOLIV ELECTRONICS document");
  TestReportAddMiscInfo("Nightly test", "No");
  TestReportAddMiscInfo("Test type", "Requirement-Based test");
  TestReportAddMiscInfo("Regression Test", "No");
  TestReportAddMiscInfo("Fault injection method used", "No");
  TestReportAddMiscInfo("Resource usage evaluation", "No");
  TestReportAddMiscInfo("Priority", "No");
  TestReportAddMiscInfo("Safety relevant", "No");
  
  AddRequirementInfo("Requirement under test", "ARCH_SW_CIL_0801");
  AddRequirementInfo("ARCH_SW_CIL_0801", "CIL shall check if timeout is present for Buckle frame.");
  //***************************************************************************************
    
  testCaseComment("Preconditions");
  testStep("STEP", "Bench Initialization");

  debugger_deleteAllBreakpoints();
  debugger_reset();
  debugger_run();
  
  RunPreTs();
  //==================================================== 
  
  testStep("STEP", "Set signal Bckl_Sw_D_Stat_ST3 to I_C02_BCKL_SW_STAT_SNA (0x3).");
  setSignal(BODY3::Bckl_Sw_D_Stat_ST3, 3);
  testWaitForTimeout(500);
  
  testStep("STEP", "Set a breakpoint in function CIL_Autotest_Buckle_CheckTimeoutError() at line *pu8TestResult = cil_u8ResultOfAutoTest;.");
  debugger_setRelativeFunctionBpAtLine("CIL_Autotest_Buckle_CheckTimeoutError", "10");
  
  testCaseComment("Action: ARCH_SW_CIL_0801");
  testStep("STEP", "Check if CPU stopped at line *pu8TestResult = cil_u8ResultOfAutoTest;. --> CPU stopped at BP");
  debugger_waitUntilBPisReached("1000");
  ExpectedTestResult(debugger_result,IS_CPU_STOP_AT_BP_SUCCESFUL, "CPU stopped at BP");
  
  //====================================================
  testCaseComment("Postcondition");
  testStep("STEP", "Return ECU to default values");
  
  debugger_deleteAllBreakpoints();
  setSignal(BODY3::Bckl_Sw_D_Stat_ST3, 0);
  debugger_run();
  RunPostTs(); 
  
  debugger_stop();
}


testcase SW_IT_CIL_CheckTimeoutError_03()
{
  //***********************************Test report header*********************************
  testReportAddMiscInfoBlock("AUTOLIV ELECTRONICS document");
  TestReportAddMiscInfo("Nightly test", "No");
  TestReportAddMiscInfo("Test type", "Requirement-Based test");
  TestReportAddMiscInfo("Regression Test", "No");
  TestReportAddMiscInfo("Fault injection method used", "No");
  TestReportAddMiscInfo("Resource usage evaluation", "No");
  TestReportAddMiscInfo("Priority", "No");
  TestReportAddMiscInfo("Safety relevant", "No");
  
  AddRequirementInfo("Requirement under test", "ARCH_SW_CIL_0199");
  AddRequirementInfo("ARCH_SW_CIL_0199", "CIL shall check if timeout is present for Ignition frame.");
  //***************************************************************************************
    
  testCaseComment("Preconditions");
  testStep("STEP", "Bench Initialization");

  debugger_deleteAllBreakpoints();
  debugger_reset();
  debugger_run();
  
  RunPreTs();
  //==================================================== 
  
  testStep("STEP", "Set signal ISw_Stat_ST3 to I_C03_ISW_STAT_SNA (0x7).");
  setSignal(BODY3::Ign_Stat_ST3::ISw_Stat_ST3, 7);
  testWaitForTimeout(500);
  
  testStep("STEP", "Set a breakpoint in function CIL_Autotest_CheckTimeoutError_Ignition at line *pu8TestResult = cil_u8ResultOfAutoTest;.");
  debugger_setRelativeFunctionBpAtLine("CIL_Autotest_CheckTimeoutError_Ignition", "10");
  
  testCaseComment("Action: ARCH_SW_CIL_0199");
  testStep("STEP", "Check if CPU stopped at line *pu8TestResult = cil_u8ResultOfAutoTest;. --> CPU stopped at BP");
  debugger_waitUntilBPisReached("1000");
  ExpectedTestResult(debugger_result,IS_CPU_STOP_AT_BP_SUCCESFUL, "CPU stopped at BP");
  
  //====================================================
  testCaseComment("Postcondition");
  testStep("STEP", "Return ECU to default values");
  
  debugger_deleteAllBreakpoints();
  setSignal(BODY3::ISw_Stat_ST3, 4);
  debugger_run();
  RunPostTs(); 
  
  debugger_stop();
}


testcase SW_IT_CIL_CheckTimeoutError_04()
{
  //***********************************Test report header*********************************
  testReportAddMiscInfoBlock("AUTOLIV ELECTRONICS document");
  TestReportAddMiscInfo("Nightly test", "No");
  TestReportAddMiscInfo("Test type", "Requirement-Based test");
  TestReportAddMiscInfo("Regression Test", "No");
  TestReportAddMiscInfo("Fault injection method used", "No");
  TestReportAddMiscInfo("Resource usage evaluation", "No");
  TestReportAddMiscInfo("Priority", "No");
  TestReportAddMiscInfo("Safety relevant", "No");
  
  AddRequirementInfo("Requirement under test", "ARCH_SW_CIL_0200");
  AddRequirementInfo("ARCH_SW_CIL_0200", "CIL shall check if timeout is present for Powertrain frame.");
  //***************************************************************************************
    
  testCaseComment("Preconditions");
  testStep("STEP", "Bench Initialization");

  debugger_deleteAllBreakpoints();
  debugger_reset();
  debugger_run();
  
  RunPreTs();
  //==================================================== 
  
  testStep("STEP", "Set signal PT4_PTCoor_PT_Rdy_ST3 to I_C02_PT_RDY_V2_SNA (0x3).");
  setSignal(BODY3::PT4_PTCoor_PT_Rdy_ST3, I_C02_PT_RDY_V2_SNA);
  testWaitForTimeout(500);
  
  testStep("STEP", "Set a breakpoint in function CIL_Autotest_CheckTimeoutError_Powertrain at line *pu8TestResult = cil_u8ResultOfAutoTest;.");
  debugger_setRelativeFunctionBpAtLine("CIL_Autotest_CheckTimeoutError_Powertrain", "10");
  
  testCaseComment("Action: ARCH_SW_CIL_0200");
  testStep("STEP", "Check if CPU stopped at line *pu8TestResult = cil_u8ResultOfAutoTest;. --> CPU stopped at BP");
  debugger_waitUntilBPisReached("1000");
  ExpectedTestResult(debugger_result,IS_CPU_STOP_AT_BP_SUCCESFUL, "CPU stopped at BP");
  
  //====================================================
  testCaseComment("Postcondition");
  testStep("STEP", "Return ECU to default values");
  
  debugger_deleteAllBreakpoints();
  setSignal(BODY3::PT4_PTCoor_PT_Rdy_ST3, 0);
  debugger_run();
  RunPostTs(); 
  
  debugger_stop();
}


testcase SW_IT_CIL_CheckTimeoutError_05()
{
  //***********************************Test report header*********************************
  testReportAddMiscInfoBlock("AUTOLIV ELECTRONICS document");
  TestReportAddMiscInfo("Nightly test", "No");
  TestReportAddMiscInfo("Test type", "Requirement-Based test");
  TestReportAddMiscInfo("Regression Test", "No");
  TestReportAddMiscInfo("Fault injection method used", "No");
  TestReportAddMiscInfo("Resource usage evaluation", "No");
  TestReportAddMiscInfo("Priority", "No");
  TestReportAddMiscInfo("Safety relevant", "No");
  
  AddRequirementInfo("Requirement under test", "ARCH_SW_CIL_0201, ARCH_SW_CIL_0202, ARCH_SW_CIL_0203, ARCH_SW_CIL_0204");
  AddRequirementInfo("ARCH_SW_CIL_0201", "CIL shall check if timeout is present for Belthandover_L frame.");
  AddRequirementInfo("ARCH_SW_CIL_0202", "CIL shall check if BeldHandOver_Availability is enabled or not.");
  //***************************************************************************************
    
  testCaseComment("Preconditions");
  testStep("STEP", "Bench Initialization");

  debugger_deleteAllBreakpoints();
  debugger_reset();
  debugger_run();
  
  RunPreTs();
  //==================================================== 
  
  testStep("STEP", "Set signal BeltHdOvr_FL_Stat_ST3 to I_C02_BELTHDOVL_STAT_SNA (0x3).");
  setSignal(BODY3::BeltHdOvr_FL_Stat_ST3, 3);
  testWaitForTimeout(500);
  
  testStep("STEP", "Set a breakpoint in function CIL_Autotest_CheckTimeoutError_BelthandoverL at line *pu8TestResult = cil_u8ResultOfAutoTest;.");
  debugger_setRelativeFunctionBpAtLine("CIL_Autotest_CheckTimeoutError_BelthandoverL", "17");
  
  testCaseComment("Action: ARCH_SW_CIL_0201, ARCH_SW_CIL_0202, ARCH_SW_CIL_0203, ARCH_SW_CIL_0204");
  testStep("STEP", "Check if CPU stopped at line *pu8TestResult = cil_u8ResultOfAutoTest;. --> CPU stopped at BP");
  debugger_waitUntilBPisReached("1000");
  ExpectedTestResult(debugger_result,IS_CPU_STOP_AT_BP_SUCCESFUL, "CPU stopped at BP");
  
  //====================================================
  testCaseComment("Postcondition");
  testStep("STEP", "Return ECU to default values");
  
  debugger_deleteAllBreakpoints();
  setSignal(BODY3::BeltHdOvr_FL_Stat_ST3, 0);
  debugger_run();
  RunPostTs(); 
  
  debugger_stop();
}


testcase SW_IT_CIL_CheckTimeoutError_06()
{
  //***********************************Test report header*********************************
  testReportAddMiscInfoBlock("AUTOLIV ELECTRONICS document");
  TestReportAddMiscInfo("Nightly test", "No");
  TestReportAddMiscInfo("Test type", "Requirement-Based test");
  TestReportAddMiscInfo("Regression Test", "No");
  TestReportAddMiscInfo("Fault injection method used", "No");
  TestReportAddMiscInfo("Resource usage evaluation", "No");
  TestReportAddMiscInfo("Priority", "No");
  TestReportAddMiscInfo("Safety relevant", "No");
  
  AddRequirementInfo("Requirement under test", "ARCH_SW_CIL_0205");
  AddRequirementInfo("ARCH_SW_CIL_0205", "CIL shall check if timeout is present for API frame.");
  //***************************************************************************************
    
  testCaseComment("Preconditions");
  testStep("STEP", "Bench Initialization");

  debugger_deleteAllBreakpoints();
  debugger_reset();
  debugger_run();
  
  RunPreTs();
  //==================================================== 
  
  testStep("STEP", "Set signal RBTMFL_SP_Lvl_Rq_ST35 to I_C06_RBTM_LVL_RQ_SNA (26).");
  setSignal(BODY3::RBTMFL_SP_Lvl_Rq_ST35, 26);
  testWaitForTimeout(500);
  
  testStep("STEP", "Set a breakpoint in function CIL_Autotest_CheckTimeoutError_API at line *pu8TestResult = cil_u8ResultOfAutoTest;.");
  debugger_setRelativeFunctionBpAtLine("CIL_Autotest_CheckTimeoutError_API", "10");
  
  testCaseComment("Action: ARCH_SW_CIL_0205");
  testStep("STEP", "Check if CPU stopped at line *pu8TestResult = cil_u8ResultOfAutoTest;. --> CPU stopped at BP");
  debugger_waitUntilBPisReached("1000");
  ExpectedTestResult(debugger_result,IS_CPU_STOP_AT_BP_SUCCESFUL, "CPU stopped at BP");
  
  //====================================================
  testCaseComment("Postcondition");
  testStep("STEP", "Return ECU to default values");
  
  debugger_deleteAllBreakpoints();
  setSignal(BODY3::RBTMFL_SP_Lvl_Rq_ST35, 0);
  debugger_run();
  RunPostTs(); 
  
  debugger_stop();
}


testcase SW_IT_CIL_CheckImplausibleData_01()
{
  //***********************************Test report header*********************************
  testReportAddMiscInfoBlock("AUTOLIV ELECTRONICS document");
  TestReportAddMiscInfo("Nightly test", "No");
  TestReportAddMiscInfo("Test type", "Requirement-Based test");
  TestReportAddMiscInfo("Regression Test", "No");
  TestReportAddMiscInfo("Fault injection method used", "No");
  TestReportAddMiscInfo("Resource usage evaluation", "No");
  TestReportAddMiscInfo("Priority", "No");
  TestReportAddMiscInfo("Safety relevant", "No");
  
  AddRequirementInfo("Requirement under test", "ARCH_SW_CIL_0086, ARCH_SW_CIL_0089");
  AddRequirementInfo("ARCH_SW_CIL_0086", "Signal CRC_PresfAct_Adj_Pr5_ST3 shall be evaluated (with help form E2E) to set the specified autotest to OK/NOK.");
  AddRequirementInfo("ARCH_SW_CIL_0089", "CIL shall check if CRC or SQC error is present for Presafe frame.");
  //***************************************************************************************
    
  testCaseComment("Preconditions");
  testStep("STEP", "Bench Initialization");

  debugger_deleteAllBreakpoints();
  debugger_reset();
  debugger_run();
  
  RunPreTs();
  //==================================================== 
  
  testStep("STEP", "Set signal CRC_PresfAct_Adj_Pr5_ST3 to KU8_ZERO.");
  setSignal(BODY3::CRC_PresfAct_Adj_Pr5_ST3, 0);
  testWaitForTimeout(500);
  
  testStep("STEP", "Set a breakpoint in function CIL_Autotest_CheckImplausibleData_Presafe() at line *pu8TestResult = cil_u8ResultOfAutoTest;.");
  debugger_setRelativeFunctionBpAtLine("CIL_Autotest_CheckImplausibleData_Presafe", "12");
  
  testCaseComment("Action: ARCH_SW_CIL_0086, ARCH_SW_CIL_0089");
  testStep("STEP", "Check if CPU stopped at line *pu8TestResult = cil_u8ResultOfAutoTest;. --> CPU stopped at BP");
  debugger_waitUntilBPisReached("1000");
  ExpectedTestResult(debugger_result,IS_CPU_STOP_AT_BP_SUCCESFUL, "CPU stopped at BP");
  
  //====================================================
  testCaseComment("Postcondition");
  testStep("STEP", "Return ECU to default values");
  
  debugger_deleteAllBreakpoints();
  RunPostTs(); 
  
  debugger_stop();
}


testcase SW_IT_CIL_CheckImplausibleData_02()
{
  //***********************************Test report header*********************************
  testReportAddMiscInfoBlock("AUTOLIV ELECTRONICS document");
  TestReportAddMiscInfo("Nightly test", "No");
  TestReportAddMiscInfo("Test type", "Requirement-Based test");
  TestReportAddMiscInfo("Regression Test", "No");
  TestReportAddMiscInfo("Fault injection method used", "No");
  TestReportAddMiscInfo("Resource usage evaluation", "No");
  TestReportAddMiscInfo("Priority", "No");
  TestReportAddMiscInfo("Safety relevant", "No");
  
  AddRequirementInfo("Requirement under test", "ARCH_SW_CIL_0087");
  AddRequirementInfo("ARCH_SW_CIL_0087", "Signal SQC_PresfAct_Adj_Pr5_ST3 shall be evaluated (with help form E2E) to set the specified autotest to OK/NOK.");
  //***************************************************************************************
    
  testCaseComment("Preconditions");
  testStep("STEP", "Bench Initialization");

  debugger_deleteAllBreakpoints();
  debugger_reset();
  debugger_run();
  
  RunPreTs();
  //==================================================== 
  
  testStep("STEP", "Set signal SQC_PresfAct_Adj_Pr5_ST3 to KU8_ZERO.");
  setSignal(BODY3::SQC_PresfAct_Adj_Pr5_ST3, 0);
  testWaitForTimeout(500);
  
  testStep("STEP", "Set a breakpoint in function CIL_Autotest_CheckImplausibleData_Presafe() at line *pu8TestResult = cil_u8ResultOfAutoTest;.");
  debugger_setRelativeFunctionBpAtLine("CIL_Autotest_CheckImplausibleData_Presafe", "12");
  
  testCaseComment("Action: ARCH_SW_CIL_0087");
  testStep("STEP", "Check if CPU stopped at line *pu8TestResult = cil_u8ResultOfAutoTest;.");
  debugger_waitUntilBPisReached("1000");
  ExpectedTestResult(debugger_result,IS_CPU_STOP_AT_BP_SUCCESFUL, "CPU stopped at BP");
  
  //====================================================
  testCaseComment("Postcondition");
  testStep("STEP", "Return ECU to default values");
  
  debugger_deleteAllBreakpoints();
  RunPostTs(); 
  
  debugger_stop();
}


testcase SW_IT_CIL_CheckImplausibleData_03()
{
  //***********************************Test report header*********************************
  testReportAddMiscInfoBlock("AUTOLIV ELECTRONICS document");
  TestReportAddMiscInfo("Nightly test", "No");
  TestReportAddMiscInfo("Test type", "Requirement-Based test");
  TestReportAddMiscInfo("Regression Test", "No");
  TestReportAddMiscInfo("Fault injection method used", "No");
  TestReportAddMiscInfo("Resource usage evaluation", "No");
  TestReportAddMiscInfo("Priority", "No");
  TestReportAddMiscInfo("Safety relevant", "No");
  
  AddRequirementInfo("Requirement under test", "ARCH_SW_CIL_0088");
  AddRequirementInfo("ARCH_SW_CIL_0088", "Signal Presf_Enbl_ST3 shall be evaluated (SNA) to set the specified autotest to OK/NOK.");
  //***************************************************************************************
    
  testCaseComment("Preconditions");
  testStep("STEP", "Bench Initialization");

  debugger_deleteAllBreakpoints();
  debugger_reset();
  debugger_run();
  
  RunPreTs();
  //==================================================== 
  
  testStep("STEP", "Set signal Presf_Enbl_ST3 to KU8_ZERO.");
  setSignal(BODY3::Presf_Enbl_ST3, 0);
  testWaitForTimeout(500);
  
  testStep("STEP", "Set a breakpoint in function CIL_Autotest_CheckImplausibleData_Presafe() at line *pu8TestResult = cil_u8ResultOfAutoTest;.");
  debugger_setRelativeFunctionBpAtLine("CIL_Autotest_CheckImplausibleData_Presafe", "12");
  
  testCaseComment("Action: ARCH_SW_CIL_0088");
  testStep("STEP", "Check if CPU stopped at line *pu8TestResult = cil_u8ResultOfAutoTest;.");
  debugger_waitUntilBPisReached("1000");
  ExpectedTestResult(debugger_result,IS_CPU_STOP_AT_BP_SUCCESFUL, "CPU stopped at BP");
  
  //====================================================
  testCaseComment("Postcondition");
  testStep("STEP", "Return ECU to default values");
  
  debugger_deleteAllBreakpoints();
  RunPostTs(); 
  
  debugger_stop();
}


testcase SW_IT_CIL_CheckImplausibleData_04()
{
  //***********************************Test report header*********************************
  testReportAddMiscInfoBlock("AUTOLIV ELECTRONICS document");
  TestReportAddMiscInfo("Nightly test", "No");
  TestReportAddMiscInfo("Test type", "Requirement-Based test");
  TestReportAddMiscInfo("Regression Test", "No");
  TestReportAddMiscInfo("Fault injection method used", "No");
  TestReportAddMiscInfo("Resource usage evaluation", "No");
  TestReportAddMiscInfo("Priority", "No");
  TestReportAddMiscInfo("Safety relevant", "No");
  
  AddRequirementInfo("Requirement under test", "ARCH_SW_CIL_0191, ARCH_SW_CIL_0194");
  AddRequirementInfo("ARCH_SW_CIL_0191", "Signal CRC_Ign_Stat _Pr5_ST3 shall be evaluated (with help form E2E) to set the specified autotest to OK/NOK.");
  AddRequirementInfo("ARCH_SW_CIL_0194", "CIL shall check if CRC or SQC error is present for Ignition frame.");
  //***************************************************************************************
    
  testCaseComment("Preconditions");
  testStep("STEP", "Bench Initialization");

  debugger_deleteAllBreakpoints();
  debugger_reset();
  debugger_run();
  
  RunPreTs();
  //==================================================== 
  
  testStep("STEP", "Set signal Presf_Enbl_ST3 to KU8_ZERO.");
  setSignal(BODY3::Presf_Enbl_ST3, 0);
  testWaitForTimeout(500);
  
  testStep("STEP", "Set a breakpoint in function CIL_Autotest_CheckImplausibleData_Ignition() at line *pu8TestResult = cil_u8ResultOfAutoTest;.");
  debugger_setRelativeFunctionBpAtLine("CIL_Autotest_CheckImplausibleData_Ignition", "12");
  
  testCaseComment("Action: ARCH_SW_CIL_0191, ARCH_SW_CIL_0194");
  testStep("STEP", "Check if CPU stopped at line *pu8TestResult = cil_u8ResultOfAutoTest;. --> CPU stopped at BP");
  debugger_waitUntilBPisReached("1000");
  ExpectedTestResult(debugger_result,IS_CPU_STOP_AT_BP_SUCCESFUL, "CPU stopped at BP");
  
  //====================================================
  testCaseComment("Postcondition");
  testStep("STEP", "Return ECU to default values");
  
  debugger_deleteAllBreakpoints();
  RunPostTs(); 
  
  debugger_stop();
}


testcase SW_IT_CIL_CheckImplausibleData_05()
{
  //***********************************Test report header*********************************
  testReportAddMiscInfoBlock("AUTOLIV ELECTRONICS document");
  TestReportAddMiscInfo("Nightly test", "No");
  TestReportAddMiscInfo("Test type", "Requirement-Based test");
  TestReportAddMiscInfo("Regression Test", "No");
  TestReportAddMiscInfo("Fault injection method used", "No");
  TestReportAddMiscInfo("Resource usage evaluation", "No");
  TestReportAddMiscInfo("Priority", "No");
  TestReportAddMiscInfo("Safety relevant", "No");
  
  AddRequirementInfo("Requirement under test", "ARCH_SW_CIL_0192");
  AddRequirementInfo("ARCH_SW_CIL_0192", "Signal SQC_ Ign_Stat _Pr5_ST3 shall be evaluated (with help form E2E) to set the specified autotest to OK/NOK.");
  //***************************************************************************************
    
  testCaseComment("Preconditions");
  testStep("STEP", "Bench Initialization");

  debugger_deleteAllBreakpoints();
  debugger_reset();
  debugger_run();
  
  RunPreTs();
  //==================================================== 
  
  testStep("STEP", "Set signal SQC_Ign_Stat_Pr5_ST3 to KU8_ZERO.");
  setSignal(BODY3::SQC_Ign_Stat_Pr5_ST3, 0);
  testWaitForTimeout(500);
  
  testStep("STEP", "Set a breakpoint in function CIL_Autotest_CheckImplausibleData_Ignition() at line *pu8TestResult = cil_u8ResultOfAutoTest;.");
  debugger_setRelativeFunctionBpAtLine("CIL_Autotest_CheckImplausibleData_Ignition", "12");
  
  testCaseComment("Action: ARCH_SW_CIL_0192");
  testStep("STEP", "Check if CPU stopped at line *pu8TestResult = cil_u8ResultOfAutoTest;.");
  debugger_waitUntilBPisReached("1000");
  ExpectedTestResult(debugger_result,IS_CPU_STOP_AT_BP_SUCCESFUL, "CPU stopped at BP");
  
  //====================================================
  testCaseComment("Postcondition");
  testStep("STEP", "Return ECU to default values");
  
  debugger_deleteAllBreakpoints();
  RunPostTs(); 
  
  debugger_stop();
}


testcase SW_IT_CIL_CheckImplausibleData_06()
{
  //***********************************Test report header*********************************
  testReportAddMiscInfoBlock("AUTOLIV ELECTRONICS document");
  TestReportAddMiscInfo("Nightly test", "No");
  TestReportAddMiscInfo("Test type", "Requirement-Based test");
  TestReportAddMiscInfo("Regression Test", "No");
  TestReportAddMiscInfo("Fault injection method used", "No");
  TestReportAddMiscInfo("Resource usage evaluation", "No");
  TestReportAddMiscInfo("Priority", "No");
  TestReportAddMiscInfo("Safety relevant", "No");
  
  AddRequirementInfo("Requirement under test", "ARCH_SW_CIL_0193");
  AddRequirementInfo("ARCH_SW_CIL_0193", "Signal ISw_Stat_ST3 shall be evaluated (SNA) to set the specified autotest to OK/NOK.");
  //***************************************************************************************
    
  testCaseComment("Preconditions");
  testStep("STEP", "Bench Initialization");

  debugger_deleteAllBreakpoints();
  debugger_reset();
  debugger_run();
  
  RunPreTs();
  //==================================================== 
  
  testStep("STEP", "Set signal ISw_Stat_ST3 to KU8_ZERO.");
  setSignal(BODY3::ISw_Stat_ST3, 0);
  testWaitForTimeout(500);
  
  testStep("STEP", "Set a breakpoint in function CIL_Autotest_CheckImplausibleData_Ignition() at line *pu8TestResult = cil_u8ResultOfAutoTest;.");
  debugger_setRelativeFunctionBpAtLine("CIL_Autotest_CheckImplausibleData_Ignition", "12");
  
  testCaseComment("Action: ARCH_SW_CIL_0193");
  testStep("STEP", "Check if CPU stopped at line *pu8TestResult = cil_u8ResultOfAutoTest;.");
  debugger_waitUntilBPisReached("1000");
  ExpectedTestResult(debugger_result,IS_CPU_STOP_AT_BP_SUCCESFUL, "CPU stopped at BP");
  
  //====================================================
  testCaseComment("Postcondition");
  testStep("STEP", "Return ECU to default values");
  
  debugger_deleteAllBreakpoints();
  RunPostTs(); 
  
  debugger_stop();
}



testcase SW_IT_CIL_CheckImplausibleData_07()
{
  //***********************************Test report header*********************************
  testReportAddMiscInfoBlock("AUTOLIV ELECTRONICS document");
  TestReportAddMiscInfo("Nightly test", "No");
  TestReportAddMiscInfo("Test type", "Requirement-Based test");
  TestReportAddMiscInfo("Regression Test", "No");
  TestReportAddMiscInfo("Fault injection method used", "No");
  TestReportAddMiscInfo("Resource usage evaluation", "No");
  TestReportAddMiscInfo("Priority", "No");
  TestReportAddMiscInfo("Safety relevant", "No");
  
  AddRequirementInfo("Requirement under test", "ARCH_SW_CIL_0195, ARCH_SW_CIL_0198");
  AddRequirementInfo("ARCH_SW_CIL_0195", "Signal CRC_Bckl_Sw_Fx_Stat_Pr5_ST3 shall be evaluated (with help form E2E) to set the specified autotest to OK/NOK.");
  AddRequirementInfo("ARCH_SW_CIL_0198", "CIL shall check if CRC or SQC error is present for Presafe frame.");
  //***************************************************************************************
    
  testCaseComment("Preconditions");
  testStep("STEP", "Bench Initialization");

  debugger_deleteAllBreakpoints();
  debugger_reset();
  debugger_run();
  
  RunPreTs();
  //==================================================== 
  
  testStep("STEP", "Set signal CRC_Bckl_Sw_Fx_Stat_Pr5_ST3 to KU8_ZERO.");
  setSignal(BODY3::CRC_Bckl_Sw_Fx_Stat_Pr5_ST3, 0);
  testWaitForTimeout(500);
  
  testStep("STEP", "Set a breakpoint in function CIL_Autotest_CheckImplausibleData_Buckle() at line *pu8TestResult = cil_u8ResultOfAutoTest;.");
  debugger_setRelativeFunctionBpAtLine("CIL_Autotest_CheckImplausibleData_Buckle", "13");
  
  testCaseComment("Action: ARCH_SW_CIL_0195, ARCH_SW_CIL_0198");
  testStep("STEP", "Check if CPU stopped at line *pu8TestResult = cil_u8ResultOfAutoTest;. --> CPU stopped at BP");
  debugger_waitUntilBPisReached("1000");
  ExpectedTestResult(debugger_result,IS_CPU_STOP_AT_BP_SUCCESFUL, "CPU stopped at BP");
  
  //====================================================
  testCaseComment("Postcondition");
  testStep("STEP", "Return ECU to default values");
  
  debugger_deleteAllBreakpoints();
  RunPostTs(); 
  
  debugger_stop();
}


testcase SW_IT_CIL_CheckImplausibleData_08()
{
  //***********************************Test report header*********************************
  testReportAddMiscInfoBlock("AUTOLIV ELECTRONICS document");
  TestReportAddMiscInfo("Nightly test", "No");
  TestReportAddMiscInfo("Test type", "Requirement-Based test");
  TestReportAddMiscInfo("Regression Test", "No");
  TestReportAddMiscInfo("Fault injection method used", "No");
  TestReportAddMiscInfo("Resource usage evaluation", "No");
  TestReportAddMiscInfo("Priority", "No");
  TestReportAddMiscInfo("Safety relevant", "No");
  
  AddRequirementInfo("Requirement under test", "ARCH_SW_CIL_0196");
  AddRequirementInfo("ARCH_SW_CIL_0196", "Signal SQC_Bckl_Sw_Fx_Stat_Pr5_ST3 shall be evaluated (with help form E2E) to set the specified autotest to OK/NOK.");
  //***************************************************************************************
    
  testCaseComment("Preconditions");
  testStep("STEP", "Bench Initialization");

  debugger_deleteAllBreakpoints();
  debugger_reset();
  debugger_run();
  
  RunPreTs();
  //==================================================== 
  
  testStep("STEP", "Set signal SQC_Bckl_Sw_Fx_Stat_Pr5_ST3 to KU8_ZERO.");
  setSignal(BODY3::SQC_Bckl_Sw_Fx_Stat_Pr5_ST3, 0);
  testWaitForTimeout(500);
  
  testStep("STEP", "Set a breakpoint in function CIL_Autotest_CheckImplausibleData_Buckle() at line *pu8TestResult = cil_u8ResultOfAutoTest;.");
  debugger_setRelativeFunctionBpAtLine("CIL_Autotest_CheckImplausibleData_Buckle", "13");
  
  testCaseComment("Action: ARCH_SW_CIL_0196");
  testStep("STEP", "Check if CPU stopped at line *pu8TestResult = cil_u8ResultOfAutoTest;.");
  debugger_waitUntilBPisReached("1000");
  ExpectedTestResult(debugger_result,IS_CPU_STOP_AT_BP_SUCCESFUL, "CPU stopped at BP");
  
  //====================================================
  testCaseComment("Postcondition");
  testStep("STEP", "Return ECU to default values");
  
  debugger_deleteAllBreakpoints();
  RunPostTs(); 
  
  debugger_stop();
}


testcase SW_IT_CIL_CheckImplausibleData_09()
{
  //***********************************Test report header*********************************
  testReportAddMiscInfoBlock("AUTOLIV ELECTRONICS document");
  TestReportAddMiscInfo("Nightly test", "No");
  TestReportAddMiscInfo("Test type", "Requirement-Based test");
  TestReportAddMiscInfo("Regression Test", "No");
  TestReportAddMiscInfo("Fault injection method used", "No");
  TestReportAddMiscInfo("Resource usage evaluation", "No");
  TestReportAddMiscInfo("Priority", "No");
  TestReportAddMiscInfo("Safety relevant", "No");
  
  AddRequirementInfo("Requirement under test", "ARCH_SW_CIL_0197");
  AddRequirementInfo("ARCH_SW_CIL_0197", "Signal ISw_Stat_ST3 shall be evaluated (SNA) to set the specified autotest to OK/NOK.");
  //***************************************************************************************
    
  testCaseComment("Preconditions");
  testStep("STEP", "Bench Initialization");

  debugger_deleteAllBreakpoints();
  debugger_reset();
  debugger_run();
  
  RunPreTs();
  //==================================================== 
  
  testStep("STEP", "Set signal Bckl_Sw_FP_Stat_ST3 to KU8_ZERO.");
  setSignal(BODY3::Bckl_Sw_FP_Stat_ST3, 0);
  testWaitForTimeout(500);
  
  testStep("STEP", "Set a breakpoint in function CIL_Autotest_CheckImplausibleData_Buckle() at line *pu8TestResult = cil_u8ResultOfAutoTest;.");
  debugger_setRelativeFunctionBpAtLine("CIL_Autotest_CheckImplausibleData_Buckle", "13");
  
  testCaseComment("Action: ARCH_SW_CIL_0197");
  testStep("STEP", "Check if CPU stopped at line *pu8TestResult = cil_u8ResultOfAutoTest;.");
  debugger_waitUntilBPisReached("1000");
  ExpectedTestResult(debugger_result,IS_CPU_STOP_AT_BP_SUCCESFUL, "CPU stopped at BP");
  
  //====================================================
  testCaseComment("Postcondition");
  testStep("STEP", "Return ECU to default values");
  
  debugger_deleteAllBreakpoints();
  RunPostTs(); 
  
  debugger_stop();
}


testcase SW_IT_CIL_CheckImplausibleData_10()
{
  //***********************************Test report header*********************************
  testReportAddMiscInfoBlock("AUTOLIV ELECTRONICS document");
  TestReportAddMiscInfo("Nightly test", "No");
  TestReportAddMiscInfo("Test type", "Requirement-Based test");
  TestReportAddMiscInfo("Regression Test", "No");
  TestReportAddMiscInfo("Fault injection method used", "No");
  TestReportAddMiscInfo("Resource usage evaluation", "No");
  TestReportAddMiscInfo("Priority", "No");
  TestReportAddMiscInfo("Safety relevant", "No");
  
  AddRequirementInfo("Requirement under test", "ARCH_SW_CIL_0410");
  AddRequirementInfo("ARCH_SW_CIL_0410", "Signal CRC_ORC_Impact3_Pr5_ST3 shall be evaluated (with help form E2E) to set the specified autotest to OK/NOK.");
  //***************************************************************************************
    
  testCaseComment("Preconditions");
  testStep("STEP", "Bench Initialization");

  debugger_deleteAllBreakpoints();
  debugger_reset();
  debugger_run();
  
  RunPreTs();
  //==================================================== 
  
  testStep("STEP", "Set signal CRC_ORC_Impact3_Pr5_ST3 to KU8_ZERO.");
  setSignal(BODY3::CRC_ORC_Impact3_Pr5_ST3, 0);
  testWaitForTimeout(500);
  
  testStep("STEP", "Set a breakpoint in function CIL_Autotest_CheckImplausibleData_ORC at line *pu8TestResult = cil_u8ResultOfAutoTest;.");
  debugger_setRelativeFunctionBpAtLine("CIL_Autotest_CheckImplausibleData_ORC", "11");
  
  testCaseComment("Action: ARCH_SW_CIL_0410");
  testStep("STEP", "Check if CPU stopped at line *pu8TestResult = cil_u8ResultOfAutoTest;.");
  debugger_waitUntilBPisReached("1000");
  ExpectedTestResult(debugger_result,IS_CPU_STOP_AT_BP_SUCCESFUL, "CPU stopped at BP");
  
  //====================================================
  testCaseComment("Postcondition");
  testStep("STEP", "Return ECU to default values");
  
  debugger_deleteAllBreakpoints();
  RunPostTs(); 
  
  debugger_stop();
}


testcase SW_IT_CIL_CheckImplausibleData_11()
{
  //***********************************Test report header*********************************
  testReportAddMiscInfoBlock("AUTOLIV ELECTRONICS document");
  TestReportAddMiscInfo("Nightly test", "No");
  TestReportAddMiscInfo("Test type", "Requirement-Based test");
  TestReportAddMiscInfo("Regression Test", "No");
  TestReportAddMiscInfo("Fault injection method used", "No");
  TestReportAddMiscInfo("Resource usage evaluation", "No");
  TestReportAddMiscInfo("Priority", "No");
  TestReportAddMiscInfo("Safety relevant", "No");
  
  AddRequirementInfo("Requirement under test", "ARCH_SW_CIL_0411");
  AddRequirementInfo("ARCH_SW_CIL_0411", "Signal SQC_ORC_Impact3_Pr5_ST3 shall be evaluated (with help form E2E) to set the specified autotest to OK/NOK.");
  //***************************************************************************************
    
  testCaseComment("Preconditions");
  testStep("STEP", "Bench Initialization");

  debugger_deleteAllBreakpoints();
  debugger_reset();
  debugger_run();
  
  RunPreTs();
  //==================================================== 
  
  testStep("STEP", "Set signal SQC_ORC_Impact3_Pr5_ST3 to KU8_ZERO.");
  setSignal(BODY3::SQC_ORC_Impact3_Pr5_ST3, 0);
  testWaitForTimeout(500);
  
  testStep("STEP", "Set a breakpoint in function CIL_Autotest_CheckImplausibleData_ORC at line *pu8TestResult = cil_u8ResultOfAutoTest;.");
  debugger_setRelativeFunctionBpAtLine("CIL_Autotest_CheckImplausibleData_ORC", "11");
  
  testCaseComment("Action: ARCH_SW_CIL_0411");
  testStep("STEP", "Check if CPU stopped at line *pu8TestResult = cil_u8ResultOfAutoTest;.");
  debugger_waitUntilBPisReached("1000");
  ExpectedTestResult(debugger_result,IS_CPU_STOP_AT_BP_SUCCESFUL, "CPU stopped at BP");
  
  //====================================================
  testCaseComment("Postcondition");
  testStep("STEP", "Return ECU to default values");
  
  debugger_deleteAllBreakpoints();
  RunPostTs(); 
  
  debugger_stop();
}


testcase SW_IT_CIL_CheckImplausibleData_12()
{
  //***********************************Test report header*********************************
  testReportAddMiscInfoBlock("AUTOLIV ELECTRONICS document");
  TestReportAddMiscInfo("Nightly test", "No");
  TestReportAddMiscInfo("Test type", "Requirement-Based test");
  TestReportAddMiscInfo("Regression Test", "No");
  TestReportAddMiscInfo("Fault injection method used", "No");
  TestReportAddMiscInfo("Resource usage evaluation", "No");
  TestReportAddMiscInfo("Priority", "No");
  TestReportAddMiscInfo("Safety relevant", "No");
  
  AddRequirementInfo("Requirement under test", "ARCH_SW_CIL_0206");
  AddRequirementInfo("ARCH_SW_CIL_0206", "Signal PT4_PTCoor_PT_Rdy_ST3 shall be evaluated to set the specified autotest to OK/NOK.");
  //***************************************************************************************
    
  testCaseComment("Preconditions");
  testStep("STEP", "Bench Initialization");

  debugger_deleteAllBreakpoints();
  debugger_reset();
  debugger_run();
  
  RunPreTs();
  //==================================================== 
  
  testStep("STEP", "Set signal PT4_PTCoor_PT_Rdy_ST3 to KU8_ZERO.");
  setSignal(BODY3::PT4_PTCoor_PT_Rdy_ST3, 0);
  testWaitForTimeout(500);
  
  testStep("STEP", "Set a breakpoint in function CIL_Autotest_CheckImplausibleData_Powertrain at line *pu8TestResult = cil_u8ResultOfAutoTest;.");
  debugger_setRelativeFunctionBpAtLine("CIL_Autotest_CheckImplausibleData_Powertrain", "11");
  
  testCaseComment("Action: ARCH_SW_CIL_0206");
  testStep("STEP", "Check if CPU stopped at line *pu8TestResult = cil_u8ResultOfAutoTest;.");
  debugger_waitUntilBPisReached("1000");
  ExpectedTestResult(debugger_result,IS_CPU_STOP_AT_BP_SUCCESFUL, "CPU stopped at BP");
  
  //====================================================
  testCaseComment("Postcondition");
  testStep("STEP", "Return ECU to default values");
  
  debugger_deleteAllBreakpoints();
  RunPostTs(); 
  
  debugger_stop();
}


testcase SW_IT_CIL_CheckImplausibleData_13()
{
  //***********************************Test report header*********************************
  testReportAddMiscInfoBlock("AUTOLIV ELECTRONICS document");
  TestReportAddMiscInfo("Nightly test", "No");
  TestReportAddMiscInfo("Test type", "Requirement-Based test");
  TestReportAddMiscInfo("Regression Test", "No");
  TestReportAddMiscInfo("Fault injection method used", "No");
  TestReportAddMiscInfo("Resource usage evaluation", "No");
  TestReportAddMiscInfo("Priority", "No");
  TestReportAddMiscInfo("Safety relevant", "No");
  
  AddRequirementInfo("Requirement under test", "ARCH_SW_CIL_0206, ARCH_SW_CIL_0207, ARCH_SW_CIL_0208");
  AddRequirementInfo("ARCH_SW_CIL_0206", "Signal PT4_PTCoor_PT_Rdy_ST3 shall be evaluated to set the specified autotest to OK/NOK.");
  AddRequirementInfo("ARCH_SW_CIL_0207", "Signal PT4_PTCoor_PT_Rdy_ST3 shall be evaluated to set the specified autotest to OK/NOK.");
  AddRequirementInfo("ARCH_SW_CIL_0208", "CIL shall check if implausible data error is present for Powertrain frame.");
  //***************************************************************************************
    
  testCaseComment("Preconditions");
  testStep("STEP", "Bench Initialization");

  debugger_deleteAllBreakpoints();
  debugger_reset();
  debugger_run();
  
  RunPreTs();
  //==================================================== 
  
  testStep("STEP", "Set signal PT4_PTCoor_PT_Rdy_ST3 to KU8_ZERO.");
  setSignal(BODY3::PT4_PTCoor_PT_Rdy_ST3, 0);
  testWaitForTimeout(500);
  
  testStep("STEP", "Set a breakpoint in function CIL_Autotest_CheckImplausibleData_Powertrain at line *pu8TestResult = cil_u8ResultOfAutoTest;.");
  debugger_setRelativeFunctionBpAtLine("CIL_Autotest_CheckImplausibleData_Powertrain", "11");
  
  testCaseComment("Action: ARCH_SW_CIL_0206, ARCH_SW_CIL_0207, ARCH_SW_CIL_0208");
  testStep("STEP", "Check if CPU stopped at line *pu8TestResult = cil_u8ResultOfAutoTest;.");
  debugger_waitUntilBPisReached("1000");
  ExpectedTestResult(debugger_result,IS_CPU_STOP_AT_BP_SUCCESFUL, "CPU stopped at BP");
  
  //====================================================
  testCaseComment("Postcondition");
  testStep("STEP", "Return ECU to default values");
  
  debugger_deleteAllBreakpoints();
  RunPostTs(); 
  
  debugger_stop();
}


testcase SW_IT_CIL_CheckImplausibleData_14()
{
  //***********************************Test report header*********************************
  testReportAddMiscInfoBlock("AUTOLIV ELECTRONICS document");
  TestReportAddMiscInfo("Nightly test", "No");
  TestReportAddMiscInfo("Test type", "Requirement-Based test");
  TestReportAddMiscInfo("Regression Test", "No");
  TestReportAddMiscInfo("Fault injection method used", "No");
  TestReportAddMiscInfo("Resource usage evaluation", "No");
  TestReportAddMiscInfo("Priority", "No");
  TestReportAddMiscInfo("Safety relevant", "No");
  
  AddRequirementInfo("Requirement under test", "ARCH_SW_CIL_0214");
  AddRequirementInfo("ARCH_SW_CIL_0214", "Signal CRC _ORC_Impact3_Pr5_ST3 shall be evaluated (with help form E2E) to set the specified autotest to OK/NOK.");
  //***************************************************************************************
    
  testCaseComment("Preconditions");
  testStep("STEP", "Bench Initialization");

  debugger_deleteAllBreakpoints();
  debugger_reset();
  debugger_run();
  
  RunPreTs();
  //==================================================== 
  
  testStep("STEP", "Set signal CRC_ORC_Impact3_Pr5_ST3 to KU8_ZERO.");
  setSignal(BODY3::CRC_ORC_Impact3_Pr5_ST3, 0);
  testWaitForTimeout(500);
  
  testStep("STEP", "Set a breakpoint in function CIL_Autotest_CheckImplausibleData_ORC at line *pu8TestResult = cil_u8ResultOfAutoTest;.");
  debugger_setRelativeFunctionBpAtLine("CIL_Autotest_CheckImplausibleData_ORC", "11");
  
  testCaseComment("Action: ARCH_SW_CIL_0214");
  testStep("STEP", "Check if CPU stopped at line *pu8TestResult = cil_u8ResultOfAutoTest;.");
  debugger_waitUntilBPisReached("1000");
  ExpectedTestResult(debugger_result,IS_CPU_STOP_AT_BP_SUCCESFUL, "CPU stopped at BP");
  
  //====================================================
  testCaseComment("Postcondition");
  testStep("STEP", "Return ECU to default values");
  
  debugger_deleteAllBreakpoints();
  RunPostTs(); 
  
  debugger_stop();
}


testcase SW_IT_CIL_CheckImplausibleData_15()
{
  //***********************************Test report header*********************************
  testReportAddMiscInfoBlock("AUTOLIV ELECTRONICS document");
  TestReportAddMiscInfo("Nightly test", "No");
  TestReportAddMiscInfo("Test type", "Requirement-Based test");
  TestReportAddMiscInfo("Regression Test", "No");
  TestReportAddMiscInfo("Fault injection method used", "No");
  TestReportAddMiscInfo("Resource usage evaluation", "No");
  TestReportAddMiscInfo("Priority", "No");
  TestReportAddMiscInfo("Safety relevant", "No");
  
  AddRequirementInfo("Requirement under test", "ARCH_SW_CIL_0215");
  AddRequirementInfo("ARCH_SW_CIL_0215", "Signal SQC_ ORC_Impact3_Pr5_ST3 shall be evaluated (with help form E2E) to set the specified autotest to OK/NOK.");
  //***************************************************************************************
    
  testCaseComment("Preconditions");
  testStep("STEP", "Bench Initialization");

  debugger_deleteAllBreakpoints();
  debugger_reset();
  debugger_run();
  
  RunPreTs();
  //==================================================== 
  
  testStep("STEP", "Set signal SQC_ORC_Impact3_Pr5_ST3 to KU8_ZERO.");
  setSignal(BODY3::SQC_ORC_Impact3_Pr5_ST3 , 0);
  testWaitForTimeout(500);
  
  testStep("STEP", "Set a breakpoint in function CIL_Autotest_CheckImplausibleData_ORC at line *pu8TestResult = cil_u8ResultOfAutoTest;.");
  debugger_setRelativeFunctionBpAtLine("CIL_Autotest_CheckImplausibleData_ORC", "11");
  
  testCaseComment("Action: ARCH_SW_CIL_0215");
  testStep("STEP", "Check if CPU stopped at line *pu8TestResult = cil_u8ResultOfAutoTest;.");
  debugger_waitUntilBPisReached("1000");
  ExpectedTestResult(debugger_result,IS_CPU_STOP_AT_BP_SUCCESFUL, "CPU stopped at BP");
  
  //====================================================
  testCaseComment("Postcondition");
  testStep("STEP", "Return ECU to default values");
  
  debugger_deleteAllBreakpoints();
  RunPostTs(); 
  
  debugger_stop();
}


testcase SW_IT_CIL_CheckSteeringConfiguration_01()
{
  //***********************************Test report header*********************************
  testReportAddMiscInfoBlock("AUTOLIV ELECTRONICS document");
  TestReportAddMiscInfo("Nightly test", "No");
  TestReportAddMiscInfo("Test type", "Requirement-Based test");
  TestReportAddMiscInfo("Regression Test", "No");
  TestReportAddMiscInfo("Fault injection method used", "No");
  TestReportAddMiscInfo("Resource usage evaluation", "No");
  TestReportAddMiscInfo("Priority", "No");
  TestReportAddMiscInfo("Safety relevant", "No");
  
  AddRequirementInfo("Requirement under test", "ARCH_SW_CIL_0216, ARCH_SW_CIL_0212, ARCH_SW_CIL_0213");
  AddRequirementInfo("ARCH_SW_CIL_0216", "Signal EVC_List03_StStyle_ST3 shall be evaluated to set the specified autotest to OK/NOK.");
  AddRequirementInfo("ARCH_SW_CIL_0212", "Signal EVC_CfgList_01_08_Pr5_ST3 shall be an input to set the specified autotest to OK/NOK.");
  AddRequirementInfo("ARCH_SW_CIL_0213", "CIL shall check if there is a mismatch between EVC_CfgList_01_08_Pr5_ST3 signal value and steering configuration from variant coding.");
  //***************************************************************************************
    
  testCaseComment("Preconditions");
  testStep("STEP", "Bench Initialization");

  debugger_deleteAllBreakpoints();
  debugger_reset();
  debugger_run();
  
  RunPreTs();
  //==================================================== 
  
  testStep("STEP", "Set signal EVC_List03_StStyle_ST3 to KU8_ZERO.");
  setSignal(BODY3::EVC_List03_StStyle_ST3, 0);
  testWaitForTimeout(500);
  
  testStep("STEP", "Set a breakpoint in function CIL_Autotest_CheckSteeringConfiguration at line *pu8TestResult = cil_u8ResultOfAutoTest;.");
  debugger_setRelativeFunctionBpAtLine("CIL_Autotest_CheckImplausibleData_ORC", "11");
  
  testCaseComment("Action: ARCH_SW_CIL_0216, ARCH_SW_CIL_0212, ARCH_SW_CIL_0213");
  testStep("STEP", "Check if CPU stopped at line *pu8TestResult = cil_u8ResultOfAutoTest;.");
  debugger_waitUntilBPisReached("1000");
  ExpectedTestResult(debugger_result,IS_CPU_STOP_AT_BP_SUCCESFUL, "CPU stopped at BP");
  
  //====================================================
  testCaseComment("Postcondition");
  testStep("STEP", "Return ECU to default values");
  
  debugger_deleteAllBreakpoints();
  RunPostTs(); 
  
  debugger_stop();
}


testcase SW_IT_CIL_Update_07Cx_Block20_01()
{
  //***********************************Test report header*********************************
  testReportAddMiscInfoBlock("AUTOLIV ELECTRONICS document");
  TestReportAddMiscInfo("Nightly test", "No");
  TestReportAddMiscInfo("Test type", "Requirement-Based test");
  TestReportAddMiscInfo("Regression Test", "No");
  TestReportAddMiscInfo("Fault injection method used", "No");
  TestReportAddMiscInfo("Resource usage evaluation", "No");
  TestReportAddMiscInfo("Priority", "No");
  TestReportAddMiscInfo("Safety relevant", "No");
  
  AddRequirementInfo("Requirement under test", "ARCH_SW_CIL_0729, ARCH_SW_CIL_0770");
  AddRequirementInfo("ARCH_SW_CIL_0729", "If selected, the content of the measurement frame - block #20 shall be encoded and provided to CAN.");
  AddRequirementInfo("ARCH_SW_CIL_0770", "PMP_runGetDeficiencyLevel shall be called to get the calculated deficiency level.");
  //***************************************************************************************
    
  testCaseComment("Preconditions");
  testStep("STEP", "Bench Initialization");

  debugger_deleteAllBreakpoints();
  debugger_reset();
  debugger_run();
  
  RunPreTs();
  //==================================================== 

  AuthenticateECU(2);
  EnterDiagnosticSession("development");
  
  testStep("STEP", "Activate Measurement Frame block 20.");
  ActivateMeasurementFrame(20);
  
  testStep("STEP", "Set a breakpoint in function cil_Update_07Cx_Block20_InfosToSend at line (void)Rte_Call_pclMotor_T_GetDeficiencyLevel(&u32DeficiencyLevel);.");
  debugger_setRelativeFunctionBpAtLine("cil_Update_07Cx_Block20_InfosToSend", "8");
  
  testCaseComment("Action: ARCH_SW_CIL_0770");
  testStep("STEP", "Set a breakpoint in function Rte_Call_pclMotor_T_GetDeficiencyLevel(&u32DeficiencyLevel);. --> PMP_runGetDeficiencyLevel,,app.elf");
  debugger_stepIn();
  ExpectedTestResult(debugger_result, "PMP_runGetDeficiencyLevel", "PMP_runGetDeficiencyLevel,,app.elf");
  
  testStep("STEP", "Set a breakpoint at the last line of function cil_Update_07Cx_Block20_InfosToSend.");
  debugger_setRelativeFunctionBpAtLine("cil_Update_07Cx_Block20_InfosToSend", "29"); // 22
  
  debugger_run();
  
  testStep("STEP", "Read variable u32DeficiencyLevel.");
  debugger_readLocalVariable("u32DeficiencyLevel");
  ExpectedTestResult(debugger_result, "0", "0");
  
  testCaseComment("Action: ARCH_SW_CIL_0729");
  testStep("STEP", "Read variable cil_stMeasurementFrameContent.Meas_RBTM_FL_02. --> 0");
  snprintf(signal_value, elcount(signal_value), "%d", $Meas_RBTM_FL_02_ST3.raw64);
  debugger_readVariable("uint8", "cil_stMeasurementFrameContent,,app.elf", "1");
  ExpectedTestResult(debugger_result, signal_value, "0");
  
  testCaseComment("Action: ARCH_SW_CIL_0729");
  testStep("STEP", "Read variable cil_stMeasurementFrameContent.Meas_RBTM_FL_03. --> 0");
  snprintf(signal_value, elcount(signal_value), "%d", $Meas_RBTM_FL_03_ST3.raw64);
  debugger_readVariable("uint8", "cil_stMeasurementFrameContent,,app.elf", "2");
  ExpectedTestResult(debugger_result, signal_value, "0");
  
  testCaseComment("Action: ARCH_SW_CIL_0729");
  testStep("STEP", "Read variable cil_stMeasurementFrameContent.Meas_RBTM_FL_04. --> 0");
  snprintf(signal_value, elcount(signal_value), "%d", $Meas_RBTM_FL_04_ST3.raw64);
  debugger_readVariable("uint8", "cil_stMeasurementFrameContent,,app.elf", "3");
  ExpectedTestResult(debugger_result, signal_value, "0");
  
  testCaseComment("Action: ARCH_SW_CIL_0729");
  testStep("STEP", "Read variable cil_stMeasurementFrameContent.Meas_RBTM_FL_05. --> 0");
  snprintf(signal_value, elcount(signal_value), "%d", $Meas_RBTM_FL_05_ST3.raw64);
  debugger_readVariable("uint8", "cil_stMeasurementFrameContent,,app.elf", "4");
  ExpectedTestResult(debugger_result, signal_value, "0");
  
  //====================================================
  testCaseComment("Postcondition");
  testStep("STEP", "Return ECU to default values");
  
  debugger_deleteAllBreakpoints();
  RunPostTs(); 
  
  debugger_stop();
}


testcase SW_IT_CIL_Update_07Cx_Block18_01()
{
  //***********************************Test report header*********************************
  testReportAddMiscInfoBlock("AUTOLIV ELECTRONICS document");
  TestReportAddMiscInfo("Nightly test", "No");
  TestReportAddMiscInfo("Test type", "Requirement-Based test");
  TestReportAddMiscInfo("Regression Test", "No");
  TestReportAddMiscInfo("Fault injection method used", "No");
  TestReportAddMiscInfo("Resource usage evaluation", "No");
  TestReportAddMiscInfo("Priority", "No");
  TestReportAddMiscInfo("Safety relevant", "No");
  
  AddRequirementInfo("Requirement under test", "ARCH_SW_CIL_0728");
  AddRequirementInfo("ARCH_SW_CIL_0728", "If selected, the content of the measurement frame - block #18 shall be encoded and provided to CAN.");
  //***************************************************************************************
    
  testCaseComment("Preconditions");
  testStep("STEP", "Bench Initialization");

  debugger_deleteAllBreakpoints();
  debugger_reset();
  debugger_run();
  
  RunPreTs();
  //==================================================== 

  AuthenticateECU(2);
  EnterDiagnosticSession("development");
  
  testStep("STEP", "Activate Measurement Frame block 18.");
  ActivateMeasurementFrame(18);
  
  testStep("STEP", "Set a breakpoint at the last line of function cil_Update_07Cx_Block18_InfosToSend.");
  debugger_setRelativeFunctionBpAtLine("cil_Update_07Cx_Block18_InfosToSend", "8");
  
  testCaseComment("Action: ARCH_SW_CIL_0728");
  testStep("STEP", "Check if signal Meas_RBTM_FL_02_ST3 value is KU8_MAX. --> 0xff");
  snprintf(signal_value, elcount(signal_value), "Variable cil_stMeasurementFrameContent,,app.elf is equal to %d", $Meas_RBTM_FL_02_ST3.raw64);
  debugger_readVariable("uint8", "cil_stMeasurementFrameContent,,app.elf", "1");
  ExpectedTestResult(debugger_result, signal_value, "0xff");
  
  testCaseComment("Action: ARCH_SW_CIL_0728");
  testStep("STEP", "Check if signal Meas_RBTM_FL_03_ST3 value is KU8_MAX. --> 0xff");
  snprintf(signal_value, elcount(signal_value), "Variable cil_stMeasurementFrameContent,,app.elf is equal to %d", $Meas_RBTM_FL_03_ST3.raw64);
  debugger_readVariable("uint8", "cil_stMeasurementFrameContent,,app.elf", "2");
  ExpectedTestResult(debugger_result, signal_value, "0xff");
  
  testCaseComment("Action: ARCH_SW_CIL_0728");
  testStep("STEP", "Check if signal Meas_RBTM_FL_04_ST3 value is KU8_MAX. --> 0xff");
  snprintf(signal_value, elcount(signal_value), "Variable cil_stMeasurementFrameContent,,app.elf is equal to %d", $Meas_RBTM_FL_04_ST3.raw64);
  debugger_readVariable("uint8", "cil_stMeasurementFrameContent,,app.elf", "3");
  ExpectedTestResult(debugger_result, signal_value, "0xff");
  
  testCaseComment("Action: ARCH_SW_CIL_0728");
  testStep("STEP", "Check if signal Meas_RBTM_FL_05_ST3 value is KU8_MAX. --> 0xff");
  snprintf(signal_value, elcount(signal_value), "Variable cil_stMeasurementFrameContent,,app.elf is equal to %d", $Meas_RBTM_FL_05_ST3.raw64);
  debugger_readVariable("uint8", "cil_stMeasurementFrameContent,,app.elf", "4");
  ExpectedTestResult(debugger_result, signal_value, "0xff");
  
  testCaseComment("Action: ARCH_SW_CIL_0728");
  testStep("STEP", "Check if signal Meas_RBTM_FL_06_ST3 value is KU8_MAX. --> 0xff");
  snprintf(signal_value, elcount(signal_value), "Variable cil_stMeasurementFrameContent,,app.elf is equal to %d", $Meas_RBTM_FL_06_ST3.raw64);
  debugger_readVariable("uint8", "cil_stMeasurementFrameContent,,app.elf", "4");
  ExpectedTestResult(debugger_result, signal_value, "0xff");
  
  testCaseComment("Action: ARCH_SW_CIL_0728");
  testStep("STEP", "Check if signal Meas_RBTM_FL_07_ST3 value is KU8_MAX. --> 0xff");
  snprintf(signal_value, elcount(signal_value), "Variable cil_stMeasurementFrameContent,,app.elf is equal to %d", $Meas_RBTM_FL_07_ST3.raw64);
  debugger_readVariable("uint8", "cil_stMeasurementFrameContent,,app.elf", "4");
  ExpectedTestResult(debugger_result, signal_value, "0xff");
  
  testCaseComment("Action: ARCH_SW_CIL_0728");
  testStep("STEP", "Check if signal Meas_RBTM_FL_08_ST3 value is KU8_MAX. --> 0xff");
  snprintf(signal_value, elcount(signal_value), "Variable cil_stMeasurementFrameContent,,app.elf is equal to %d", $Meas_RBTM_FL_08_ST3.raw64);
  debugger_readVariable("uint8", "cil_stMeasurementFrameContent,,app.elf", "4");
  ExpectedTestResult(debugger_result, signal_value, "0xff");
  
  //====================================================
  testCaseComment("Postcondition");
  testStep("STEP", "Return ECU to default values");
  
  debugger_deleteAllBreakpoints();
  RunPostTs(); 
  
  debugger_stop();
}


testcase SW_IT_CIL_Update_07Cx_Block17_01()
{
  //***********************************Test report header*********************************
  testReportAddMiscInfoBlock("AUTOLIV ELECTRONICS document");
  TestReportAddMiscInfo("Nightly test", "No");
  TestReportAddMiscInfo("Test type", "Requirement-Based test");
  TestReportAddMiscInfo("Regression Test", "No");
  TestReportAddMiscInfo("Fault injection method used", "No");
  TestReportAddMiscInfo("Resource usage evaluation", "No");
  TestReportAddMiscInfo("Priority", "No");
  TestReportAddMiscInfo("Safety relevant", "No");
  
  AddRequirementInfo("Requirement under test", "ARCH_SW_CIL_0727, ARCH_SW_CIL_0769");
  AddRequirementInfo("ARCH_SW_CIL_0727", "If selected, the content of the measurement frame - block #17 shall be encoded and provided to CAN.");
  AddRequirementInfo("ARCH_SW_CIL_0769", "PMP_runGetHS1Level_(Ext)* shall be called to get the value of the HS_SW voltage in V.");
  //***************************************************************************************
    
  testCaseComment("Preconditions");
  testStep("STEP", "Bench Initialization");

  debugger_deleteAllBreakpoints();
  debugger_reset();
  debugger_run();
  
  RunPreTs();
  //==================================================== 

  AuthenticateECU(2);
  EnterDiagnosticSession("development");
  
  testStep("STEP", "Activate Measurement Frame block 17.");
  ActivateMeasurementFrame(17);
  
  testStep("STEP", "Set a breakpoint in function cil_Update_07Cx_Block17_InfosToSend at line Rte_Call_pclHS1_V_Get(&u16VHs1);.");
  debugger_setRelativeFunctionBpAtLine("cil_Update_07Cx_Block17_InfosToSend", "15");
  
  testCaseComment("Action: ARCH_SW_CIL_0769");
  testStep("STEP", "Step in function Rte_Call_pclHS1_V_Get(&u16VHs1);. --> PMP_runGetHS1Level,,app.elf");
  debugger_stepIn();
  ExpectedTestResult(debugger_result, "PMP_runGetHS1Level", "PMP_runGetHS1Level,,app.elf");
  
  testStep("STEP", "Set a breakpoint at the last line of function cil_Update_07Cx_Block17_InfosToSend.");
  debugger_setRelativeFunctionBpAtLine("cil_Update_07Cx_Block17_InfosToSend", "38");
  
  debugger_run();
  
  testStep("STEP", "Read variable u16VHs1.");
  debugger_readLocalVariable("u16VHs1");
//  ExpectedTestResult(debugger_result, "0x3679", "0x3679");
  
  testCaseComment("Action: ARCH_SW_CIL_0727");
  testStep("STEP", "Check if variable cil_stMeasurementFrameContent.Meas_RBTM_FL_02 and signal Meas_RBTM_FL_02_ST3 are equal with 0x36 (54). --> 0x36 (54)");
  snprintf(signal_value, elcount(signal_value), "%d", $Meas_RBTM_FL_02_ST3.raw64);
//  debugger_readVariable("uint8", "cil_stMeasurementFrameContent,,app.elf", "1");
//  ExpectedTestResult(signal_value, "54", "0x36 (decimal value: 54)");
  
  testCaseComment("Action: ARCH_SW_CIL_0727");
  testStep("STEP", "Check if variable cil_stMeasurementFrameContent.Meas_RBTM_FL_03 and signal Meas_RBTM_FL_03_ST3 are equal with 0x79 (121). --> 0x79 (121)");
  snprintf(signal_value, elcount(signal_value), "%d", $Meas_RBTM_FL_03_ST3.raw64);
//  debugger_readVariable("uint8", "cil_stMeasurementFrameContent,,app.elf", "2");
//  ExpectedTestResult(signal_value, "121", "0x79 (decimal value: 121)");

  
  //====================================================
  testCaseComment("Postcondition");
  testStep("STEP", "Return ECU to default values");
  
  debugger_deleteAllBreakpoints();
  RunPostTs(); 
  
  debugger_stop();
}



testcase SW_IT_CIL_Update_07Cx_Block16_01()
{
  //***********************************Test report header*********************************
  testReportAddMiscInfoBlock("AUTOLIV ELECTRONICS document");
  TestReportAddMiscInfo("Nightly test", "No");
  TestReportAddMiscInfo("Test type", "Requirement-Based test");
  TestReportAddMiscInfo("Regression Test", "No");
  TestReportAddMiscInfo("Fault injection method used", "No");
  TestReportAddMiscInfo("Resource usage evaluation", "No");
  TestReportAddMiscInfo("Priority", "No");
  TestReportAddMiscInfo("Safety relevant", "No");
  
  AddRequirementInfo("Requirement under test", "ARCH_SW_CIL_0726");
  AddRequirementInfo("ARCH_SW_CIL_0726", "If selected, the content of the measurement frame - block #16 shall be encoded and provided to CAN.");
  //***************************************************************************************
    
  testCaseComment("Preconditions");
  testStep("STEP", "Bench Initialization");

  debugger_deleteAllBreakpoints();
  debugger_reset();
  debugger_run();
  
  RunPreTs();
  //==================================================== 

  AuthenticateECU(2);
  EnterDiagnosticSession("development");
  
  testStep("STEP", "Activate Measurement Frame block 16.");
  ActivateMeasurementFrame(16);
  
  testStep("STEP", "Set a breakpoint at the last line of function cil_Update_07Cx_Block16_InfosToSend.");
  debugger_setRelativeFunctionBpAtLine("cil_Update_07Cx_Block17_InfosToSend", "8");
  
  testCaseComment("Action: ARCH_SW_CIL_0726");
  testStep("STEP", "Check if variable cil_stMeasurementFrameContent.Meas_RBTM_FL_02 is KU8_MAX. --> 0xff (255)");
  debugger_readVariable("uint8", "cil_stMeasurementFrameContent,,app.elf", "1");
  ExpectedTestResult(debugger_result, "0xff", "0xff (decimal value: 255)");
  
  testCaseComment("Action: ARCH_SW_CIL_0726");
  testStep("STEP", "Check if variable cil_stMeasurementFrameContent.Meas_RBTM_FL_03 is KU8_MAX. --> 0xff (255)");
  debugger_readVariable("uint8", "cil_stMeasurementFrameContent,,app.elf", "2");
  ExpectedTestResult(debugger_result, "0xff", "0xff (decimal value: 255)");
  
  testCaseComment("Action: ARCH_SW_CIL_0726");
  testStep("STEP", "Check if variable cil_stMeasurementFrameContent.Meas_RBTM_FL_04 is KU8_MAX. --> 0xff (255)");
  debugger_readVariable("uint8", "cil_stMeasurementFrameContent,,app.elf", "3");
  ExpectedTestResult(debugger_result, "0xff", "0xff (decimal value: 255)");
  
  testCaseComment("Action: ARCH_SW_CIL_0726");
  testStep("STEP", "Check if variable cil_stMeasurementFrameContent.Meas_RBTM_FL_05 is KU8_MAX. --> 0xff (255)");
  debugger_readVariable("uint8", "cil_stMeasurementFrameContent,,app.elf", "4");
  ExpectedTestResult(debugger_result, "0xff", "0xff (decimal value: 255)");
  
  testCaseComment("Action: ARCH_SW_CIL_0726");
  testStep("STEP", "Check if variable cil_stMeasurementFrameContent.Meas_RBTM_FL_06 is KU8_MAX. --> 0xff (255)");
  debugger_readVariable("uint8", "cil_stMeasurementFrameContent,,app.elf", "5");
  ExpectedTestResult(debugger_result, "0xff", "0xff (decimal value: 255)");
  
  testCaseComment("Action: ARCH_SW_CIL_0726");
  testStep("STEP", "Check if variable cil_stMeasurementFrameContent.Meas_RBTM_FL_07 is KU8_MAX. --> 0xff (255)");
  debugger_readVariable("uint8", "cil_stMeasurementFrameContent,,app.elf", "6");
  ExpectedTestResult(debugger_result, "0xff", "0xff (decimal value: 255)");
  
  testCaseComment("Action: ARCH_SW_CIL_0726");
  testStep("STEP", "Check if variable cil_stMeasurementFrameContent.Meas_RBTM_FL_08 is KU8_MAX. --> 0xff (255)");
  debugger_readVariable("uint8", "cil_stMeasurementFrameContent,,app.elf", "7");
  ExpectedTestResult(debugger_result, "0xff", "0xff (decimal value: 255)");

  //====================================================
  testCaseComment("Postcondition");
  testStep("STEP", "Return ECU to default values");
  
  debugger_deleteAllBreakpoints();
  RunPostTs(); 
  
  debugger_stop();
}



testcase SW_IT_CIL_Update_07Cx_Block15_01()
{
  //***********************************Test report header*********************************
  testReportAddMiscInfoBlock("AUTOLIV ELECTRONICS document");
  TestReportAddMiscInfo("Nightly test", "No");
  TestReportAddMiscInfo("Test type", "Requirement-Based test");
  TestReportAddMiscInfo("Regression Test", "No");
  TestReportAddMiscInfo("Fault injection method used", "No");
  TestReportAddMiscInfo("Resource usage evaluation", "No");
  TestReportAddMiscInfo("Priority", "No");
  TestReportAddMiscInfo("Safety relevant", "No");
  
  AddRequirementInfo("Requirement under test", "ARCH_SW_CIL_0725, ARCH_SW_CIL_0771, ARCH_SW_CIL_0772");
  AddRequirementInfo("ARCH_SW_CIL_0725", "If selected, the content of the measurement frame - block #15 shall be encoded and provided to CAN..");
  AddRequirementInfo("ARCH_SW_CIL_0771", "Rte_BFE_psrExecutedCycle_u8CycleNumber shall be read in order to determine the current cycle.");
  AddRequirementInfo("ARCH_SW_CIL_0772", "Rte_BFE_psrExecutedStep_u8StepNumber ");
  //***************************************************************************************
    
  testCaseComment("Preconditions");
  testStep("STEP", "Bench Initialization");

  debugger_deleteAllBreakpoints();
  debugger_reset();
  debugger_run();
  
  RunPreTs();
  //==================================================== 

  AuthenticateECU(2);
  EnterDiagnosticSession("development");
  
  testStep("STEP", "Activate Measurement Frame block 15.");
  ActivateMeasurementFrame(15);
  
  testStep("STEP", "Set a breakpoint in function cil_Update_07Cx_Block15_InfosToSend at line Rte_Read_prrCycleNumber_u8CycleNumber(&u8CurrentCycle);.");
  debugger_setBpAtLine("s:\\Components\\Application\\Autoliv\\CIL\\Implementation\\src\\CIL_ManageMFTransmission.c", "1658");
  testStep("STEP", "Set a breakpoint in function cil_Update_07Cx_Block15_InfosToSend at line Rte_Read_prrStepNumber_u8StepNumber(&u8CurrentStep);.");
  debugger_setBpAtLine("s:\\Components\\Application\\Autoliv\\CIL\\Implementation\\src\\CIL_ManageMFTransmission.c", "1657");
  
  testCaseComment("Action: ARCH_SW_CIL_0772");
  testStep("STEP", "Check if CPU stopped at line Rte_Read_prrStepNumber_u8StepNumber(&u8CurrentStep);. --> CPU stopped at BP");
  debugger_waitUntilBPisReached("1000");
  ExpectedTestResult(debugger_result,IS_CPU_STOP_AT_BP_SUCCESFUL, "CPU stopped at BP");
  
  debugger_run();
  
  testCaseComment("Action: ARCH_SW_CIL_0771");
  testStep("STEP", "Check if CPU stopped at line Rte_Read_prrCycleNumber_u8CycleNumber(&u8CurrentCycle);. --> CPU stopped at BP");
  debugger_waitUntilBPisReached("1000");
  ExpectedTestResult(debugger_result,IS_CPU_STOP_AT_BP_SUCCESFUL, "CPU stopped at BP");
  
  testStep("STEP", "Set a breakpoint at the last line of function cil_Update_07Cx_Block17_InfosToSend.");
  debugger_setRelativeFunctionBpAtLine("cil_Update_07Cx_Block15_InfosToSend", "8");
  
  debugger_run();
  
  testCaseComment("Action: ARCH_SW_CIL_0725");
  testStep("STEP", "Check if variable cil_stMeasurementFrameContent.Meas_RBTM_FL_02 and signal Meas_RBTM_FL_02_ST3 are equal with KU8_MAX. --> 0xff (decimal value: 255)");
  snprintf(signal_value, elcount(signal_value), "%d", $Meas_RBTM_FL_02_ST3.raw64);
  debugger_readVariable("uint8", "cil_stMeasurementFrameContent,,app.elf", "1");
  ExpectedTestResult(debugger_result, "0xff", "0xff (decimal value: 255)");
  
  testCaseComment("Action: ARCH_SW_CIL_0725");
  testStep("STEP", "Check if variable cil_stMeasurementFrameContent.Meas_RBTM_FL_03 and signal Meas_RBTM_FL_03_ST3 are equal with KU8_MAX. --> 0xff (decimal value: 255)");
  snprintf(signal_value, elcount(signal_value), "%d", $Meas_RBTM_FL_03_ST3.raw64);
  debugger_readVariable("uint8", "cil_stMeasurementFrameContent,,app.elf", "2");
  ExpectedTestResult(debugger_result, "0xff","0xff (decimal value: 255)");

  //====================================================
  testCaseComment("Postcondition");
  testStep("STEP", "Return ECU to default values");
  
  debugger_deleteAllBreakpoints();
  RunPostTs(); 
  
  debugger_stop();
}



testcase SW_IT_CIL_Update_07Cx_Block14_01()
{
  //***********************************Test report header*********************************
  testReportAddMiscInfoBlock("AUTOLIV ELECTRONICS document");
  TestReportAddMiscInfo("Nightly test", "No");
  TestReportAddMiscInfo("Test type", "Requirement-Based test");
  TestReportAddMiscInfo("Regression Test", "No");
  TestReportAddMiscInfo("Fault injection method used", "No");
  TestReportAddMiscInfo("Resource usage evaluation", "No");
  TestReportAddMiscInfo("Priority", "No");
  TestReportAddMiscInfo("Safety relevant", "No");
  
  AddRequirementInfo("Requirement under test", "ARCH_SW_CIL_0724, ARCH_SW_CIL_0760");
  AddRequirementInfo("ARCH_SW_CIL_0724", "If selected, the content of the measurement frame - block #14 shall be encoded and provided to CAN.");
  AddRequirementInfo("ARCH_SW_CIL_0760", "BMM_runGetPositionRange_mm shall be called to get the range of the belt position measured since the last ECU start-up.");
  //***************************************************************************************
    
  testCaseComment("Preconditions");
  testStep("STEP", "Bench Initialization");

  debugger_deleteAllBreakpoints();
  debugger_reset();
  debugger_run();
  
  RunPreTs();
  //==================================================== 

  AuthenticateECU(2);
  EnterDiagnosticSession("development");
  
  testStep("STEP", "Activate Measurement Frame block 14.");
  ActivateMeasurementFrame(14);
  
  testStep("STEP", "Set a breakpoint in function cil_Update_07Cx_Block14_InfosToSend at line Rte_Call_pclBelt_D_GetRange_mm(&s16OriginPosition, &s16MaxPosition);.");
  debugger_setRelativeFunctionBpAtLine("cil_Update_07Cx_Block14_InfosToSend", "33");
  testStep("STEP", "Set a breakpoint in function cil_Update_07Cx_Block14_InfosToSend at line Rte_Call_pclBelt_D_GetFromT0_mm(&s16BeltPayoutInmm);.");
  debugger_setRelativeFunctionBpAtLine("cil_Update_07Cx_Block14_InfosToSend", "38");
  
  testCaseComment("Action: ARCH_SW_CIL_0760");
  testStep("STEP", "Check if CPU stopped at line Rte_Call_pclBelt_D_GetRange_mm(&s16OriginPosition, &s16MaxPosition);. --> CPU stopped at BP");
  debugger_waitUntilBPisReached("1000");
  ExpectedTestResult(debugger_result, "CPU stopped at BP", "CPU stopped at BP");
  
  debugger_run();
  
  testCaseComment("Action: ARCH_SW_CIL_0760");
  testStep("STEP", "Check if CPU stopped at line Rte_Call_pclBelt_D_GetFromT0_mm(&s16BeltPayoutInmm);. --> CPU stopped at BP");
  debugger_waitUntilBPisReached("1000");
  ExpectedTestResult(debugger_result, "CPU stopped at BP", "CPU stopped at BP");
  
  testStep("STEP", "Set a breakpoint at the last line of function cil_Update_07Cx_Block14_InfosToSend.");
  debugger_setRelativeFunctionBpAtLine("cil_Update_07Cx_Block14_InfosToSend", "61");
  
  debugger_run();
  
  testStep("STEP", "Read variable s16OriginPosition.");
  debugger_readLocalVariable("s16OriginPosition");
  ExpectedTestResult(debugger_result, "0", "0");
  
  testStep("STEP", "Read variable s16BeltPayoutInmm.");
  debugger_readLocalVariable("s16BeltPayoutInmm");
  ExpectedTestResult(debugger_result, "0", "0");
  
  testCaseComment("Action: ARCH_SW_CIL_0724");
  testStep("STEP", "Check if variable cil_stMeasurementFrameContent.Meas_RBTM_FL_02 and signal Meas_RBTM_FL_03_ST3 are equal with KU8_ZERO. --> 0x0");
  snprintf(signal_value, elcount(signal_value), "Variable cil_stMeasurementFrameContent,,app.elf is equal to %x", $Meas_RBTM_FL_03_ST3.raw64);
  debugger_readVariable("uint8", "cil_stMeasurementFrameContent,,app.elf", "2");
  ExpectedTestResult(debugger_result, signal_value, debugger_result);
  
  testCaseComment("Action: ARCH_SW_CIL_0724");
  testStep("STEP", "Check if variable cil_stMeasurementFrameContent.Meas_RBTM_FL_03 and signal Meas_RBTM_FL_04_ST3 are equal with KU8_ZERO. --> 0x0");
  snprintf(signal_value, elcount(signal_value), "Variable cil_stMeasurementFrameContent,,app.elf is equal to %x", $Meas_RBTM_FL_04_ST3.raw64);
  debugger_readVariable("uint8", "cil_stMeasurementFrameContent,,app.elf", "3");
  ExpectedTestResult(debugger_result, signal_value, debugger_result);
  
  testCaseComment("Action: ARCH_SW_CIL_0724");
  testStep("STEP", "Check if variable cil_stMeasurementFrameContent.Meas_RBTM_FL_02 and signal Meas_RBTM_FL_05_ST3 are equal with KU8_ZERO. --> 0x0");
  snprintf(signal_value, elcount(signal_value), "Variable cil_stMeasurementFrameContent,,app.elf is equal to %x", $Meas_RBTM_FL_05_ST3.raw64);
  debugger_readVariable("uint8", "cil_stMeasurementFrameContent,,app.elf", "4");
  ExpectedTestResult(debugger_result, signal_value, debugger_result);
  
  testCaseComment("Action: ARCH_SW_CIL_0724");
  testStep("STEP", "Check if variable cil_stMeasurementFrameContent.Meas_RBTM_FL_03 and signal Meas_RBTM_FL_06_ST3 are equal with KU8_ZERO. --> 0x0");
  snprintf(signal_value, elcount(signal_value), "Variable cil_stMeasurementFrameContent,,app.elf is equal to %x", $Meas_RBTM_FL_06_ST3.raw64);
  debugger_readVariable("uint8", "cil_stMeasurementFrameContent,,app.elf", "5");
  ExpectedTestResult(debugger_result, signal_value, debugger_result);
  
  //====================================================
  testCaseComment("Postcondition");
  testStep("STEP", "Return ECU to default values");
  
  debugger_deleteAllBreakpoints();
  RunPostTs(); 
  
  debugger_stop();
}


testcase SW_IT_CIL_Update_07Cx_Block13_01()
{
  //***********************************Test report header*********************************
  testReportAddMiscInfoBlock("AUTOLIV ELECTRONICS document");
  TestReportAddMiscInfo("Nightly test", "No");
  TestReportAddMiscInfo("Test type", "Requirement-Based test");
  TestReportAddMiscInfo("Regression Test", "No");
  TestReportAddMiscInfo("Fault injection method used", "No");
  TestReportAddMiscInfo("Resource usage evaluation", "No");
  TestReportAddMiscInfo("Priority", "No");
  TestReportAddMiscInfo("Safety relevant", "No");
  
  AddRequirementInfo("Requirement under test", "ARCH_SW_CIL_0723, ARCH_SW_CIL_0757, ARCH_SW_CIL_0758, ARCH_SW_CIL_0761");
  AddRequirementInfo("ARCH_SW_CIL_0723", "If selected, the content of the measurement frame - block #13 shall be encoded and provided to CAN.");
  AddRequirementInfo("ARCH_SW_CIL_0761", "PAL_runReadMotorCurrentInA shall be called to get the motor current in Amps.");
  AddRequirementInfo("ARCH_SW_CIL_0758", "BMM_runGetPositionFromMinPos_mm shall be called to get the minimal seat belt position since the last ECU start-up.");
  AddRequirementInfo("ARCH_SW_CIL_0757", "BMM_runGetPositionFromT0_deg shall be called to get the seat belt position since the last ECU start-up.");
  //***************************************************************************************
    
  testCaseComment("Preconditions");
  testStep("STEP", "Bench Initialization");

  debugger_deleteAllBreakpoints();
  debugger_reset();
  debugger_run();
  
  RunPreTs();
  //==================================================== 

  AuthenticateECU(2);
  EnterDiagnosticSession("development");
  
  testStep("STEP", "Activate Measurement Frame block 13.");
  ActivateMeasurementFrame(13);
  
  testStep("STEP", "Set a breakpoint in function cil_Update_07Cx_Block13_InfosToSend at line Rte_Call_pclMotor_I_Get_A(&s8MotorCurrentInA);.");
  debugger_setRelativeFunctionBpAtLine("cil_Update_07Cx_Block13_InfosToSend", "34");
  testStep("STEP", "Set a breakpoint in function cil_Update_07Cx_Block13_InfosToSend at line Rte_Call_pclBelt_D_GetFromMinPos_mm(&s16BeltPayoutInmm);.");
  debugger_setRelativeFunctionBpAtLine("cil_Update_07Cx_Block13_InfosToSend", "43");
  
  testCaseComment("Action: ARCH_SW_CIL_0761");
  testStep("STEP", "Check if CPU stopped at line Rte_Call_pclMotor_I_Get_A(&s8MotorCurrentInA);. --> CPU stopped at BP");
  debugger_waitUntilBPisReached("1000");
  ExpectedTestResult(debugger_result, "CPU stopped at BP", "CPU stopped at BP");
  
  debugger_run();
  
  testCaseComment("Action: ARCH_SW_CIL_0758, ARCH_SW_CIL_0757");
  testStep("STEP", "Check if CPU stopped at line Rte_Call_pclBelt_D_GetFromMinPos_mm(&s16BeltPayoutInmm);. --> CPU stopped at BP");
  debugger_waitUntilBPisReached("1000");
  ExpectedTestResult(debugger_result, "CPU stopped at BP", "CPU stopped at BP");
  
  testStep("STEP", "Set a breakpoint at the last line of function cil_Update_07Cx_Block13_InfosToSend.");
  debugger_setRelativeFunctionBpAtLine("cil_Update_07Cx_Block13_InfosToSend", "66");
  
  debugger_run();
  
  testStep("STEP", "Read variable s16BeltPayoutInmm.");
  debugger_readLocalVariable("s16BeltPayoutInmm");
  ExpectedTestResult(debugger_result, "0x0", "0x0");
  
  testStep("STEP", "Read variable s8MotorCurrentInA.");
  debugger_readLocalVariable("s8MotorCurrentInA");
  ExpectedTestResult(debugger_result, "0x0", "0x0");
  
  testCaseComment("Action: ARCH_SW_CIL_0724");
  testStep("STEP", "Check if variable cil_stMeasurementFrameContent.Meas_RBTM_FL_03 and signal Meas_RBTM_FL_03_ST3 are equal with KU8_ZERO. --> 0x0");
  snprintf(signal_value, elcount(signal_value), "Variable cil_stMeasurementFrameContent,,app.elf is equal to %x", $Meas_RBTM_FL_03_ST3.raw64);
  debugger_readVariable("uint8", "cil_stMeasurementFrameContent,,app.elf", "2");
  ExpectedTestResult(debugger_result, signal_value, debugger_result);
  
  testCaseComment("Action: ARCH_SW_CIL_0723");
  testStep("STEP", "Check if variable cil_stMeasurementFrameContent.Meas_RBTM_FL_04 and signal Meas_RBTM_FL_04_ST3 are equal with KU8_ZERO. --> 0x0");
  snprintf(signal_value, elcount(signal_value), "Variable cil_stMeasurementFrameContent,,app.elf is equal to %x", $Meas_RBTM_FL_04_ST3.raw64);
  debugger_readVariable("uint8", "cil_stMeasurementFrameContent,,app.elf", "3");
  ExpectedTestResult(debugger_result, signal_value, debugger_result);
  
  testCaseComment("Action: ARCH_SW_CIL_0723");
  testStep("STEP", "Check if variable cil_stMeasurementFrameContent.Meas_RBTM_FL_05 and signal Meas_RBTM_FL_05_ST3 are equal with KU8_ZERO. --> 0x0");
  snprintf(signal_value, elcount(signal_value), "Variable cil_stMeasurementFrameContent,,app.elf is equal to %x", $Meas_RBTM_FL_05_ST3.raw64);
  debugger_readVariable("uint8", "cil_stMeasurementFrameContent,,app.elf", "4");
  ExpectedTestResult(debugger_result, signal_value, debugger_result);
  
  testCaseComment("Action: ARCH_SW_CIL_0723");
  testStep("STEP", "Check if variable cil_stMeasurementFrameContent.Meas_RBTM_FL_06 and signal Meas_RBTM_FL_06_ST3 are equal with KU8_ZERO. --> 0x0");
  snprintf(signal_value, elcount(signal_value), "Variable cil_stMeasurementFrameContent,,app.elf is equal to %x", $Meas_RBTM_FL_06_ST3.raw64);
  debugger_readVariable("uint8", "cil_stMeasurementFrameContent,,app.elf", "5");
  ExpectedTestResult(debugger_result, signal_value, debugger_result);
  
  //====================================================
  testCaseComment("Postcondition");
  testStep("STEP", "Return ECU to default values");
  
  debugger_deleteAllBreakpoints();
  RunPostTs(); 
  
  debugger_stop();
}


testcase SW_IT_CIL_Update_07Cx_Block12_01()
{
  //***********************************Test report header*********************************
  testReportAddMiscInfoBlock("AUTOLIV ELECTRONICS document");
  TestReportAddMiscInfo("Nightly test", "No");
  TestReportAddMiscInfo("Test type", "Requirement-Based test");
  TestReportAddMiscInfo("Regression Test", "No");
  TestReportAddMiscInfo("Fault injection method used", "No");
  TestReportAddMiscInfo("Resource usage evaluation", "No");
  TestReportAddMiscInfo("Priority", "No");
  TestReportAddMiscInfo("Safety relevant", "No");
  
  AddRequirementInfo("Requirement under test", "ARCH_SW_CIL_0722");
  AddRequirementInfo("ARCH_SW_CIL_0722", "If selected, the content of the measurement frame - block #12 shall be encoded and provided to CAN.");
  //***************************************************************************************
    
  testCaseComment("Preconditions");
  testStep("STEP", "Bench Initialization");

  debugger_deleteAllBreakpoints();
  debugger_reset();
  debugger_run();
  
  RunPreTs();
  //==================================================== 

  AuthenticateECU(2);
  EnterDiagnosticSession("development");
  
  testStep("STEP", "Activate Measurement Frame block 12.");
  ActivateMeasurementFrame(12);
  
  testStep("STEP", "Set a breakpoint at the last line of function cil_Update_07Cx_Block12_InfosToSend.");
  debugger_setRelativeFunctionBpAtLine("cil_Update_07Cx_Block12_InfosToSend", "48");
  
  testCaseComment("Action: ARCH_SW_CIL_0722");
  testStep("STEP", "Check if variable cil_stMeasurementFrameContent.Meas_RBTM_FL_02 and signal Meas_RBTM_FL_02_ST3 are equal with KU8_MAX. --> 0xff");
  snprintf(signal_value, elcount(signal_value), "0x%x", $Meas_RBTM_FL_02_ST3.raw64);
  debugger_readVariable("uint8", "cil_stMeasurementFrameContent,,app.elf", "1");
  ExpectedTestResult(debugger_result, signal_value, debugger_result);
  
  testCaseComment("Action: ARCH_SW_CIL_0722");
  testStep("STEP", "Check if variable cil_stMeasurementFrameContent.Meas_RBTM_FL_03 and signal Meas_RBTM_FL_03_ST3 are equal with KU8_MAX. --> 0xff");
  snprintf(signal_value, elcount(signal_value), "0x%x", $Meas_RBTM_FL_03_ST3.raw64);
  debugger_readVariable("uint8", "cil_stMeasurementFrameContent,,app.elf", "2");
  ExpectedTestResult(debugger_result, signal_value, debugger_result);
  
  testCaseComment("Action: ARCH_SW_CIL_0722");
  testStep("STEP", "Check if variable cil_stMeasurementFrameContent.Meas_RBTM_FL_04 and signal Meas_RBTM_FL_04_ST3 are equal with KU8_MAX. --> 0xff");
  snprintf(signal_value, elcount(signal_value), "0x%x", $Meas_RBTM_FL_04_ST3.raw64);
  debugger_readVariable("uint8", "cil_stMeasurementFrameContent,,app.elf", "3");
  ExpectedTestResult(debugger_result, signal_value, debugger_result);
  
  testCaseComment("Action: ARCH_SW_CIL_0722");
  testStep("STEP", "Check if variable cil_stMeasurementFrameContent.Meas_RBTM_FL_05 and signal Meas_RBTM_FL_05_ST3 are equal with KU8_MAX. --> 0xff");
  snprintf(signal_value, elcount(signal_value), "0x%x", $Meas_RBTM_FL_05_ST3.raw64);
  debugger_readVariable("uint8", "cil_stMeasurementFrameContent,,app.elf", "4");
  ExpectedTestResult(debugger_result, signal_value, debugger_result);
  
  testCaseComment("Action: ARCH_SW_CIL_0722");
  testStep("STEP", "Check if variable cil_stMeasurementFrameContent.Meas_RBTM_FL_06 and signal Meas_RBTM_FL_06_ST3 are equal with KU8_MAX. --> 0xff");
  snprintf(signal_value, elcount(signal_value), "0x%x", $Meas_RBTM_FL_06_ST3.raw64);
  debugger_readVariable("uint8", "cil_stMeasurementFrameContent,,app.elf", "5");
  ExpectedTestResult(debugger_result, signal_value, debugger_result);
  
  //====================================================
  testCaseComment("Postcondition");
  testStep("STEP", "Return ECU to default values");
  
  debugger_deleteAllBreakpoints();
  RunPostTs(); 
  
  debugger_stop();
}


testcase SW_IT_CIL_Update_07Cx_Block11_01()
{
  //***********************************Test report header*********************************
  testReportAddMiscInfoBlock("AUTOLIV ELECTRONICS document");
  TestReportAddMiscInfo("Nightly test", "No");
  TestReportAddMiscInfo("Test type", "Requirement-Based test");
  TestReportAddMiscInfo("Regression Test", "No");
  TestReportAddMiscInfo("Fault injection method used", "No");
  TestReportAddMiscInfo("Resource usage evaluation", "No");
  TestReportAddMiscInfo("Priority", "No");
  TestReportAddMiscInfo("Safety relevant", "No");
  
  AddRequirementInfo("Requirement under test", "ARCH_SW_CIL_0721, ARCH_SW_CIL_0750, ARCH_SW_CIL_0751, ARCH_SW_CIL_0762");
  AddRequirementInfo("ARCH_SW_CIL_0721", "If selected, the content of the measurement frame - block #11 shall be encoded and provided to CAN.");
  AddRequirementInfo("ARCH_SW_CIL_0750", "AdcIf_runGetMotor_Ip_(Ext)* shall be called to get the sampled value of the current provided by the ‘P’ half bridge.");
  AddRequirementInfo("ARCH_SW_CIL_0751", "AdcIf_runGetMotor_In_(Ext)* shall be called to get the sampled value of the current provided by the ‘N’ half bridge.");
  AddRequirementInfo("ARCH_SW_CIL_0762", "PAL_runReadMotorCurrentInmA shall be called to get the motor current in mAmps.");
  //***************************************************************************************
    
  testCaseComment("Preconditions");
  testStep("STEP", "Bench Initialization");

  debugger_deleteAllBreakpoints();
  debugger_reset();
  debugger_run();
  
  RunPreTs();
  //==================================================== 

  AuthenticateECU(2);
  EnterDiagnosticSession("development");
  
  testStep("STEP", "Activate Measurement Frame block 11.");
  ActivateMeasurementFrame(11);
  
  testStep("STEP", "Set a breakpoint in function cil_Update_07Cx_Block11_InfosToSend at line Rte_Call_pclMotor_In_raw_raw_Get(&u16MotorCurrentRelRaw);.");
  debugger_setRelativeFunctionBpAtLine("cil_Update_07Cx_Block11_InfosToSend", "19");
  testStep("STEP", "Set a breakpoint in function cil_Update_07Cx_Block11_InfosToSend at line Rte_Call_pclMotor_Ip_raw_raw_Get(&u16MotorCurrentTensRaw);.");
  debugger_setRelativeFunctionBpAtLine("cil_Update_07Cx_Block11_InfosToSend", "24");
  testStep("STEP", "Set a breakpoint in function cil_Update_07Cx_Block11_InfosToSend at line Rte_Call_pclMotor_I_Get_mA(&s32ScaledMotorCurrent);.");
  debugger_setRelativeFunctionBpAtLine("cil_Update_07Cx_Block11_InfosToSend", "33");
  
  testCaseComment("Action: ARCH_SW_CIL_0751");
  testStep("STEP", "Check if CPU stopped at line Rte_Call_pclMotor_In_raw_raw_Get(&u16MotorCurrentRelRaw);. --> CPU stopped at BP");
  debugger_waitUntilBPisReached("1000");
  ExpectedTestResult(debugger_result, "CPU stopped at BP", "CPU stopped at BP");
  
  debugger_run();
  
  testCaseComment("Action: ARCH_SW_CIL_0750");
  testStep("STEP", "Check if CPU stopped at line Rte_Call_pclMotor_Ip_raw_raw_Get(&u16MotorCurrentTensRaw);. --> CPU stopped at BP");
  debugger_waitUntilBPisReached("1000");
  ExpectedTestResult(debugger_result, "CPU stopped at BP", "CPU stopped at BP");
  
  debugger_run();
  
  testCaseComment("Action: ARCH_SW_CIL_0762");
  testStep("STEP", "Check if CPU stopped at line Rte_Call_pclMotor_I_Get_mA(&s32ScaledMotorCurrent);. --> CPU stopped at BP");
  debugger_waitUntilBPisReached("1000");
  ExpectedTestResult(debugger_result, "CPU stopped at BP", "CPU stopped at BP");
  
  
  testStep("STEP", "Set a breakpoint at the last line of function cil_Update_07Cx_Block11_InfosToSend.");
  debugger_setRelativeFunctionBpAtLine("cil_Update_07Cx_Block11_InfosToSend", "55");
  
  debugger_run();
  
  testCaseComment("Action: ARCH_SW_CIL_0721");
  testStep("STEP", "Check if variable cil_stMeasurementFrameContent.Meas_RBTM_FL_02 and signal Meas_RBTM_FL_02_ST3 are equal with KU8_ZERO. --> 0x0");
  snprintf(signal_value, elcount(signal_value), "0x%x", $Meas_RBTM_FL_02_ST3.raw64);
  debugger_readVariable("uint8", "cil_stMeasurementFrameContent,,app.elf", "1");
  ExpectedTestResult(debugger_result, signal_value, debugger_result);
  
  testCaseComment("Action: ARCH_SW_CIL_0721");
  testStep("STEP", "Check if variable cil_stMeasurementFrameContent.Meas_RBTM_FL_03 and signal Meas_RBTM_FL_03_ST3 are equal with KU8_ZERO. --> 0x0");
  snprintf(signal_value, elcount(signal_value), "0x%x", $Meas_RBTM_FL_03_ST3.raw64);
  debugger_readVariable("uint8", "cil_stMeasurementFrameContent,,app.elf", "2");
  ExpectedTestResult(debugger_result, signal_value, debugger_result);
  
  testCaseComment("Action: ARCH_SW_CIL_0721");
  testStep("STEP", "Check if variable cil_stMeasurementFrameContent.Meas_RBTM_FL_04 and signal Meas_RBTM_FL_04_ST3 are equal with KU8_ZERO. --> 0x0");
  snprintf(signal_value, elcount(signal_value), "0x%x", $Meas_RBTM_FL_04_ST3.raw64);
  debugger_readVariable("uint8", "cil_stMeasurementFrameContent,,app.elf", "3");
  ExpectedTestResult(debugger_result, signal_value, debugger_result);
  
  testCaseComment("Action: ARCH_SW_CIL_0721");
  testStep("STEP", "Check if variable cil_stMeasurementFrameContent.Meas_RBTM_FL_05 and signal Meas_RBTM_FL_05_ST3 are equal with KU8_ZERO. --> 0x0");
  snprintf(signal_value, elcount(signal_value), "0x%x", $Meas_RBTM_FL_05_ST3.raw64);
  debugger_readVariable("uint8", "cil_stMeasurementFrameContent,,app.elf", "4");
  ExpectedTestResult(debugger_result, signal_value, debugger_result);
  
  testCaseComment("Action: ARCH_SW_CIL_0721");
  testStep("STEP", "Check if variable cil_stMeasurementFrameContent.Meas_RBTM_FL_07 and signal Meas_RBTM_FL_07_ST3 are equal with KU8_ZERO. --> 0x0");
  snprintf(signal_value, elcount(signal_value), "0x%x", $Meas_RBTM_FL_07_ST3.raw64);
  debugger_readVariable("uint8", "cil_stMeasurementFrameContent,,app.elf", "6");
  ExpectedTestResult(debugger_result, signal_value, debugger_result);
  
  testCaseComment("Action: ARCH_SW_CIL_0721");
  testStep("STEP", "Check if variable cil_stMeasurementFrameContent.Meas_RBTM_FL_08 and signal Meas_RBTM_FL_08_ST3 are equal with KU8_ZERO. --> 0x0");
  snprintf(signal_value, elcount(signal_value), "0x%x", $Meas_RBTM_FL_08_ST3.raw64);
  debugger_readVariable("uint8", "cil_stMeasurementFrameContent,,app.elf", "7");
  ExpectedTestResult(debugger_result, signal_value, debugger_result);
  
  //====================================================
  testCaseComment("Postcondition");
  testStep("STEP", "Return ECU to default values");
  
  debugger_deleteAllBreakpoints();
  RunPostTs(); 
  
  debugger_stop();
}


testcase SW_IT_CIL_Update_07Cx_Block10_01()
{
  //***********************************Test report header*********************************
  testReportAddMiscInfoBlock("AUTOLIV ELECTRONICS document");
  TestReportAddMiscInfo("Nightly test", "No");
  TestReportAddMiscInfo("Test type", "Requirement-Based test");
  TestReportAddMiscInfo("Regression Test", "No");
  TestReportAddMiscInfo("Fault injection method used", "No");
  TestReportAddMiscInfo("Resource usage evaluation", "No");
  TestReportAddMiscInfo("Priority", "No");
  TestReportAddMiscInfo("Safety relevant", "No");
  
  AddRequirementInfo("Requirement under test", "ARCH_SW_CIL_0720, ARCH_SW_CIL_0750, ARCH_SW_CIL_0751, ARCH_SW_CIL_0762");
  AddRequirementInfo("ARCH_SW_CIL_0720", "If selected, the content of the measurement frame - block #10 shall be encoded and provided to CAN.");
  AddRequirementInfo("ARCH_SW_CIL_0753", "AdcIf_runGetHBS_A_V_(Ext)* shall be called to get the voltage of the HBS ‘A’ monitoring signal.");
  AddRequirementInfo("ARCH_SW_CIL_0754", "AdcIf_runGetHBS_B_V_(Ext)* shall be called to get the voltage of the HBS ‘B’ monitoring signal.");
  AddRequirementInfo("ARCH_SW_CIL_0755", "AdcIf_runGetHS1_V_(Ext)* shall be called to get the sampled value of the HS_SW signal.");
  //***************************************************************************************
    
  testCaseComment("Preconditions");
  testStep("STEP", "Bench Initialization");

  debugger_deleteAllBreakpoints();
  debugger_reset();
  debugger_run();
  
  RunPreTs();
  //==================================================== 

  AuthenticateECU(2);
  EnterDiagnosticSession("development");
  
  testStep("STEP", "Activate Measurement Frame block 10.");
  ActivateMeasurementFrame(10);
  
  testStep("STEP", "Set a breakpoint in function cil_Update_07Cx_Block10_InfosToSend at line Rte_Call_pclHBS_A_V_raw_Get(&u16HBSAVoltageRaw);.");
  debugger_setRelativeFunctionBpAtLine("cil_Update_07Cx_Block10_InfosToSend", "16");
  testStep("STEP", "Set a breakpoint in function cil_Update_07Cx_Block10_InfosToSend at line Rte_Call_pclHBS_B_V_raw_Get(&u16HBSBVoltageRaw);.");
  debugger_setRelativeFunctionBpAtLine("cil_Update_07Cx_Block10_InfosToSend", "22");
  testStep("STEP", "Set a breakpoint in function cil_Update_07Cx_Block10_InfosToSend at line Rte_Call_pclHS1_V_raw_Get(&u16HS1_V_raw);.");
  debugger_setRelativeFunctionBpAtLine("cil_Update_07Cx_Block10_InfosToSend", "28");
  
  testCaseComment("Action: ARCH_SW_CIL_0753");
  testStep("STEP", "Check if CPU stopped at line Rte_Call_pclHBS_A_V_raw_Get(&u16HBSAVoltageRaw);. --> CPU stopped at BP");
  debugger_waitUntilBPisReached("1000");
  ExpectedTestResult(debugger_result, "CPU stopped at BP", "CPU stopped at BP");
  
  debugger_run();
  
  testCaseComment("Action: ARCH_SW_CIL_0754");
  testStep("STEP", "Check if CPU stopped at line Rte_Call_pclHBS_B_V_raw_Get(&u16HBSBVoltageRaw);. --> CPU stopped at BP");
  debugger_waitUntilBPisReached("1000");
  ExpectedTestResult(debugger_result, "CPU stopped at BP", "CPU stopped at BP");
  
  debugger_run();
  
  testCaseComment("Action: ARCH_SW_CIL_0755");
  testStep("STEP", "Check if CPU stopped at line Rte_Call_pclHS1_V_raw_Get(&u16HS1_V_raw);. --> CPU stopped at BP");
  debugger_waitUntilBPisReached("1000");
  ExpectedTestResult(debugger_result, "CPU stopped at BP", "CPU stopped at BP");
  
  
  testStep("STEP", "Set a breakpoint at the last line of function cil_Update_07Cx_Block10_InfosToSend.");
  debugger_setRelativeFunctionBpAtLine("cil_Update_07Cx_Block10_InfosToSend", "52");
  
  debugger_run();
  
  testCaseComment("Action: ARCH_SW_CIL_0720");
  testStep("STEP", "Check if variable cil_stMeasurementFrameContent.Meas_RBTM_FL_03 and signal Meas_RBTM_FL_03_ST3 are equal with KU8_ZERO. --> 0x0");
  snprintf(signal_value, elcount(signal_value), "0x%x", $Meas_RBTM_FL_03_ST3.raw64);
  debugger_readVariable("uint8", "cil_stMeasurementFrameContent,,app.elf", "2");
  ExpectedTestResult(debugger_result, signal_value, debugger_result);
  
  testCaseComment("Action: ARCH_SW_CIL_0720");
  testStep("STEP", "Check if variable cil_stMeasurementFrameContent.Meas_RBTM_FL_04 and signal Meas_RBTM_FL_04_ST3 are equal with KU8_ZERO. --> 0x0");
  snprintf(signal_value, elcount(signal_value), "0x%x", $Meas_RBTM_FL_04_ST3.raw64);
  debugger_readVariable("uint8", "cil_stMeasurementFrameContent,,app.elf", "3");
  ExpectedTestResult(debugger_result, signal_value, debugger_result);
  
  testCaseComment("Action: ARCH_SW_CIL_0720");
  testStep("STEP", "Check if variable cil_stMeasurementFrameContent.Meas_RBTM_FL_05 and signal Meas_RBTM_FL_05_ST3 are equal with KU8_ZERO. --> 0x0");
  snprintf(signal_value, elcount(signal_value), "0x%x", $Meas_RBTM_FL_05_ST3.raw64);
  debugger_readVariable("uint8", "cil_stMeasurementFrameContent,,app.elf", "4");
  ExpectedTestResult(debugger_result, signal_value, debugger_result);
  
  testCaseComment("Action: ARCH_SW_CIL_0720");
  testStep("STEP", "Check if variable cil_stMeasurementFrameContent.Meas_RBTM_FL_06 and signal Meas_RBTM_FL_06_ST3 are equal with KU8_ZERO. --> 0x0");
  snprintf(signal_value, elcount(signal_value), "0x%x", $Meas_RBTM_FL_06_ST3.raw64);
  debugger_readVariable("uint8", "cil_stMeasurementFrameContent,,app.elf", "5");
  ExpectedTestResult(debugger_result, signal_value, debugger_result);
  
  testCaseComment("Action: ARCH_SW_CIL_0720");
  testStep("STEP", "Check if variable cil_stMeasurementFrameContent.Meas_RBTM_FL_07 and signal Meas_RBTM_FL_07_ST3 are equal with KU8_ZERO. --> 0x0");
  snprintf(signal_value, elcount(signal_value), "0x%x", $Meas_RBTM_FL_07_ST3.raw64);
  debugger_readVariable("uint8", "cil_stMeasurementFrameContent,,app.elf", "6");
  ExpectedTestResult(debugger_result, signal_value, debugger_result);
  
  testCaseComment("Action: ARCH_SW_CIL_0720");
  testStep("STEP", "Check if variable cil_stMeasurementFrameContent.Meas_RBTM_FL_08 and signal Meas_RBTM_FL_08_ST3 are equal with KU8_ZERO. --> 0x0");
  snprintf(signal_value, elcount(signal_value), "0x%x", $Meas_RBTM_FL_08_ST3.raw64);
  debugger_readVariable("uint8", "cil_stMeasurementFrameContent,,app.elf", "7");
  ExpectedTestResult(debugger_result, signal_value, debugger_result);
  
  //====================================================
  testCaseComment("Postcondition");
  testStep("STEP", "Return ECU to default values");
  
  debugger_deleteAllBreakpoints();
  RunPostTs(); 
  
  debugger_stop();
}


testcase SW_IT_CIL_Update_07Cx_Block09_01()
{
  //***********************************Test report header*********************************
  testReportAddMiscInfoBlock("AUTOLIV ELECTRONICS document");
  TestReportAddMiscInfo("Nightly test", "No");
  TestReportAddMiscInfo("Test type", "Requirement-Based test");
  TestReportAddMiscInfo("Regression Test", "No");
  TestReportAddMiscInfo("Fault injection method used", "No");
  TestReportAddMiscInfo("Resource usage evaluation", "No");
  TestReportAddMiscInfo("Priority", "No");
  TestReportAddMiscInfo("Safety relevant", "No");
  
  AddRequirementInfo("Requirement under test", "ARCH_SW_CIL_0719, ARCH_SW_CIL_0750");
  AddRequirementInfo("ARCH_SW_CIL_0719", "If selected, the content of the measurement frame - block #10 shall be encoded and provided to CAN.");
  AddRequirementInfo("ARCH_SW_CIL_0752", "AdcIf_runGetKL30_V_(Ext)* shall be called to get the sample value of the battery voltage.");
  //***************************************************************************************
    
  testCaseComment("Preconditions");
  testStep("STEP", "Bench Initialization");

  debugger_deleteAllBreakpoints();
  debugger_reset();
  debugger_run();
  
  RunPreTs();
  //==================================================== 

  AuthenticateECU(2);
  EnterDiagnosticSession("development");
  
  testStep("STEP", "Activate Measurement Frame block 9.");
  ActivateMeasurementFrame(9);
  
  testStep("STEP", "Set a breakpoint in function cil_Update_07Cx_Block09_InfosToSend at line Rte_Call_pclKL30_V_raw_Get(&u16KL30_V_raw);.");
  debugger_setRelativeFunctionBpAtLine("cil_Update_07Cx_Block09_InfosToSend", "26");
  
  testCaseComment("Action: ARCH_SW_CIL_0752");
  testStep("STEP", "Check if CPU stopped at line Rte_Call_pclKL30_V_raw_Get(&u16KL30_V_raw);. --> CPU stopped at BP");
  debugger_waitUntilBPisReached("1000");
  ExpectedTestResult(debugger_result, "CPU stopped at BP", "CPU stopped at BP");
  
  testStep("STEP", "Set a breakpoint at the last line of function cil_Update_07Cx_Block09_InfosToSend.");
  debugger_setRelativeFunctionBpAtLine("cil_Update_07Cx_Block09_InfosToSend", "50");
  
  debugger_run();
  
  testCaseComment("Action: ARCH_SW_CIL_0719");
  testStep("STEP", "Check if variable cil_stMeasurementFrameContent.Meas_RBTM_FL_03 and signal Meas_RBTM_FL_03_ST3 are equal with KU8_ZERO. --> 0x0");
  snprintf(signal_value, elcount(signal_value), "0x%x", $Meas_RBTM_FL_03_ST3.raw64);
  debugger_readVariable("uint8", "cil_stMeasurementFrameContent,,app.elf", "2");
  ExpectedTestResult(debugger_result, signal_value, debugger_result);
  
  testCaseComment("Action: ARCH_SW_CIL_0719");
  testStep("STEP", "Check if variable cil_stMeasurementFrameContent.Meas_RBTM_FL_04 and signal Meas_RBTM_FL_04_ST3 are equal with KU8_ZERO. --> 0x0");
  snprintf(signal_value, elcount(signal_value), "0x%x", $Meas_RBTM_FL_04_ST3.raw64);
  debugger_readVariable("uint8", "cil_stMeasurementFrameContent,,app.elf", "3");
  ExpectedTestResult(debugger_result, signal_value, debugger_result);
  
  testCaseComment("Action: ARCH_SW_CIL_0719");
  testStep("STEP", "Check if variable cil_stMeasurementFrameContent.Meas_RBTM_FL_05 and signal Meas_RBTM_FL_05_ST3 are equal with KU8_ZERO. --> 0x0");
  snprintf(signal_value, elcount(signal_value), "0x%x", $Meas_RBTM_FL_05_ST3.raw64);
  debugger_readVariable("uint8", "cil_stMeasurementFrameContent,,app.elf", "4");
  ExpectedTestResult(debugger_result, signal_value, debugger_result);
  
  testCaseComment("Action: ARCH_SW_CIL_0719");
  testStep("STEP", "Check if variable cil_stMeasurementFrameContent.Meas_RBTM_FL_06 and signal Meas_RBTM_FL_06_ST3 are equal with KU8_ZERO. --> 0x0");
  snprintf(signal_value, elcount(signal_value), "0x%x", $Meas_RBTM_FL_06_ST3.raw64);
  debugger_readVariable("uint8", "cil_stMeasurementFrameContent,,app.elf", "5");
  ExpectedTestResult(debugger_result, signal_value, debugger_result);
  
  //====================================================
  testCaseComment("Postcondition");
  testStep("STEP", "Return ECU to default values");
  
  debugger_deleteAllBreakpoints();
  RunPostTs(); 
  
  debugger_stop();
}


testcase SW_IT_CIL_Update_07Cx_Block08_01()
{
  //***********************************Test report header*********************************
  testReportAddMiscInfoBlock("AUTOLIV ELECTRONICS document");
  TestReportAddMiscInfo("Nightly test", "No");
  TestReportAddMiscInfo("Test type", "Requirement-Based test");
  TestReportAddMiscInfo("Regression Test", "No");
  TestReportAddMiscInfo("Fault injection method used", "No");
  TestReportAddMiscInfo("Resource usage evaluation", "No");
  TestReportAddMiscInfo("Priority", "No");
  TestReportAddMiscInfo("Safety relevant", "No");
  
  AddRequirementInfo("Requirement under test", "ARCH_SW_CIL_0718, ARCH_SW_CIL_0763, ARCH_SW_CIL_0703, ARCH_SW_CIL_0700");
  AddRequirementInfo("ARCH_SW_CIL_0718", "If selected, the content of the measurement frame - block #8 shall be encoded and provided to CAN.");
  AddRequirementInfo("ARCH_SW_CIL_0763", "PAL_runGetPWMOrder shall be called to get the current applied motor power order.");
  //***************************************************************************************
    
  testCaseComment("Preconditions");
  testStep("STEP", "Bench Initialization");

  debugger_deleteAllBreakpoints();
  debugger_reset();
  debugger_run();
  
  RunPreTs();
  //==================================================== 

  AuthenticateECU(2);
  EnterDiagnosticSession("development");
  
  testStep("STEP", "Activate Measurement Frame block 8.");
  ActivateMeasurementFrame(8);
  
  testStep("STEP", "Set a breakpoint in function cil_Update_07Cx_Block08_InfosToSend at line Rte_Call_pclMotor_P_GetPowerOrder(&s16PWMDutyCycle);.");
  debugger_setRelativeFunctionBpAtLine("cil_Update_07Cx_Block08_InfosToSend", "13");
  
  testCaseComment("Action: ARCH_SW_CIL_0763, ARCH_SW_CIL_0700, ARCH_SW_CIL_0703");
  testStep("STEP", "Check if CPU stopped at line Rte_Call_pclMotor_P_GetPowerOrder(&s16PWMDutyCycle);. --> CPU stopped at BP");
  debugger_waitUntilBPisReached("1000");
  ExpectedTestResult(debugger_result, "CPU stopped at BP", "CPU stopped at BP");
  
  testStep("STEP", "Set a breakpoint at the last line of function cil_Update_07Cx_Block08_InfosToSend.");
  debugger_setRelativeFunctionBpAtLine("cil_Update_07Cx_Block08_InfosToSend", "66");
  
  debugger_run();
  
  testCaseComment("Action: ARCH_SW_CIL_0718");
  testStep("STEP", "Check if variable cil_stMeasurementFrameContent.Meas_RBTM_FL_04 and signal Meas_RBTM_FL_04_ST3 are equal with KU8_ZERO. --> 0x0");
  snprintf(signal_value, elcount(signal_value), "0x%x", $Meas_RBTM_FL_04_ST3.raw64);
  debugger_readVariable("uint8", "cil_stMeasurementFrameContent,,app.elf", "3");
  ExpectedTestResult(debugger_result, signal_value, debugger_result);
  
  testCaseComment("Action: ARCH_SW_CIL_0718");
  testStep("STEP", "Check if variable cil_stMeasurementFrameContent.Meas_RBTM_FL_05 and signal Meas_RBTM_FL_05_ST3 are equal with KU8_ZERO. --> 0x0");
  snprintf(signal_value, elcount(signal_value), "0x%x", $Meas_RBTM_FL_05_ST3.raw64);
  debugger_readVariable("uint8", "cil_stMeasurementFrameContent,,app.elf", "4");
  ExpectedTestResult(debugger_result, signal_value, debugger_result);
  
  testCaseComment("Action: ARCH_SW_CIL_0718");
  testStep("STEP", "Check if variable cil_stMeasurementFrameContent.Meas_RBTM_FL_06 and signal Meas_RBTM_FL_06_ST3 are equal with KU8_ZERO. --> 0x0");
  snprintf(signal_value, elcount(signal_value), "0x%x", $Meas_RBTM_FL_06_ST3.raw64);
  debugger_readVariable("uint8", "cil_stMeasurementFrameContent,,app.elf", "5");
  ExpectedTestResult(debugger_result, signal_value, debugger_result);
  
  testCaseComment("Action: ARCH_SW_CIL_0718");
  testStep("STEP", "Check if variable cil_stMeasurementFrameContent.Meas_RBTM_FL_07 and signal Meas_RBTM_FL_07_ST3 are equal with KU8_ZERO. --> 0x0");
  snprintf(signal_value, elcount(signal_value), "0x%x", $Meas_RBTM_FL_07_ST3.raw64);
  debugger_readVariable("uint8", "cil_stMeasurementFrameContent,,app.elf", "6");
  ExpectedTestResult(debugger_result, signal_value, debugger_result);
  
  //====================================================
  testCaseComment("Postcondition");
  testStep("STEP", "Return ECU to default values");
  
  debugger_deleteAllBreakpoints();
  RunPostTs(); 
  
  debugger_stop();
}


testcase SW_IT_CIL_Update_07Cx_Block07_01()
{
  //***********************************Test report header*********************************
  testReportAddMiscInfoBlock("AUTOLIV ELECTRONICS document");
  TestReportAddMiscInfo("Nightly test", "No");
  TestReportAddMiscInfo("Test type", "Requirement-Based test");
  TestReportAddMiscInfo("Regression Test", "No");
  TestReportAddMiscInfo("Fault injection method used", "No");
  TestReportAddMiscInfo("Resource usage evaluation", "No");
  TestReportAddMiscInfo("Priority", "No");
  TestReportAddMiscInfo("Safety relevant", "No");
  
  AddRequirementInfo("Requirement under test", "ARCH_SW_CIL_0717, ARCH_SW_CIL_0767");
  AddRequirementInfo("ARCH_SW_CIL_0717", "If selected, the content of the measurement frame - block #7 shall be encoded and provided to CAN.");
  AddRequirementInfo("ARCH_SW_CIL_0767", "PMP_runGetFilteredTemperature_deg shall be called to get the filtered value in °C of the temperature");
  //***************************************************************************************
    
  testCaseComment("Preconditions");
  testStep("STEP", "Bench Initialization");

  debugger_deleteAllBreakpoints();
  debugger_reset();
  debugger_run();
  
  RunPreTs();
  //==================================================== 

  AuthenticateECU(2);
  EnterDiagnosticSession("development");
  
  testStep("STEP", "Activate Measurement Frame block 7.");
  ActivateMeasurementFrame(7);
  
  testStep("STEP", "Set a breakpoint in function cil_Update_07Cx_Block07_InfosToSend at line Rte_Call_pclECU_T_GetFiltered_deg(&s16Temperature_Deg);.");
  debugger_setRelativeFunctionBpAtLine("cil_Update_07Cx_Block07_InfosToSend", "19");
  
  testCaseComment("Action: ARCH_SW_CIL_0767");
  testStep("STEP", "Check if CPU stopped at line Rte_Call_pclECU_T_GetFiltered_deg(&s16Temperature_Deg);. --> CPU stopped at BP");
  debugger_waitUntilBPisReached("1000");
  ExpectedTestResult(debugger_result, "CPU stopped at BP", "CPU stopped at BP");
  
  testStep("STEP", "Set a breakpoint at the last line of function cil_Update_07Cx_Block07_InfosToSend.");
  debugger_setRelativeFunctionBpAtLine("cil_Update_07Cx_Block07_InfosToSend", "52");
  
  debugger_run();
  
  testCaseComment("Action: ARCH_SW_CIL_0717");
  testStep("STEP", "Check if variable cil_stMeasurementFrameContent.Meas_RBTM_FL_03 and signal Meas_RBTM_FL_03_ST3 are equal with KU8_ZERO. --> 0x0");
  snprintf(signal_value, elcount(signal_value), "0x%x", $Meas_RBTM_FL_03_ST3.raw64);
  debugger_readVariable("uint8", "cil_stMeasurementFrameContent,,app.elf", "2");
  ExpectedTestResult(debugger_result, signal_value, debugger_result);
  
  testCaseComment("Action: ARCH_SW_CIL_0717");
  testStep("STEP", "Check if variable cil_stMeasurementFrameContent.Meas_RBTM_FL_04 and signal Meas_RBTM_FL_04_ST3 are equal with KU8_ZERO. --> 0x0");
  snprintf(signal_value, elcount(signal_value), "0x%x", $Meas_RBTM_FL_04_ST3.raw64);
  debugger_readVariable("uint8", "cil_stMeasurementFrameContent,,app.elf", "3");
  ExpectedTestResult(debugger_result, signal_value, debugger_result);
  
  testCaseComment("Action: ARCH_SW_CIL_0717");
  testStep("STEP", "Check if variable cil_stMeasurementFrameContent.Meas_RBTM_FL_05 and signal Meas_RBTM_FL_05_ST3 are equal with KU8_ZERO. --> 0x0");
  snprintf(signal_value, elcount(signal_value), "0x%x", $Meas_RBTM_FL_05_ST3.raw64);
  debugger_readVariable("uint8", "cil_stMeasurementFrameContent,,app.elf", "4");
//  ExpectedTestResult(debugger_result, signal_value, debugger_result);
  
  testCaseComment("Action: ARCH_SW_CIL_0717");
  testStep("STEP", "Check if variable cil_stMeasurementFrameContent.Meas_RBTM_FL_06 and signal Meas_RBTM_FL_06_ST3 are equal with KU8_ZERO. --> 0x0");
  snprintf(signal_value, elcount(signal_value), "0x%x", $Meas_RBTM_FL_06_ST3.raw64);
  debugger_readVariable("uint8", "cil_stMeasurementFrameContent,,app.elf", "5");
  ExpectedTestResult(debugger_result, signal_value, debugger_result);
  
  testCaseComment("Action: ARCH_SW_CIL_0717");
  testStep("STEP", "Check if variable cil_stMeasurementFrameContent.Meas_RBTM_FL_07 and signal Meas_RBTM_FL_07_ST3 are equal with KU8_ZERO. --> 0x0");
  snprintf(signal_value, elcount(signal_value), "0x%x", $Meas_RBTM_FL_07_ST3.raw64);
  debugger_readVariable("uint8", "cil_stMeasurementFrameContent,,app.elf", "6");
//  ExpectedTestResult(debugger_result, signal_value, debugger_result);
  
  //====================================================
  testCaseComment("Postcondition");
  testStep("STEP", "Return ECU to default values");
  
  debugger_deleteAllBreakpoints();
  RunPostTs(); 
  
  debugger_stop();
}



testcase SW_IT_CIL_Update_07Cx_Block06_01()
{
  //***********************************Test report header*********************************
  testReportAddMiscInfoBlock("AUTOLIV ELECTRONICS document");
  TestReportAddMiscInfo("Nightly test", "No");
  TestReportAddMiscInfo("Test type", "Requirement-Based test");
  TestReportAddMiscInfo("Regression Test", "No");
  TestReportAddMiscInfo("Fault injection method used", "No");
  TestReportAddMiscInfo("Resource usage evaluation", "No");
  TestReportAddMiscInfo("Priority", "No");
  TestReportAddMiscInfo("Safety relevant", "No");
  
  AddRequirementInfo("Requirement under test", "ARCH_SW_CIL_0716, ARCH_SW_CIL_0759, ARCH_SW_CIL_0756");
  AddRequirementInfo("ARCH_SW_CIL_0716", "If selected, the content of the measurement frame - block #6 shall be encoded and provided to CAN.");
  AddRequirementInfo("ARCH_SW_CIL_0759", "BMM_runGetSpeed_deg_s shall be called to get the seat belt speed in deg/s.");
  AddRequirementInfo("ARCH_SW_CIL_0756", "ATM_runGetTestResult shall be called to get the status of specific auto-tests.");
  //***************************************************************************************
    
  testCaseComment("Preconditions");
  testStep("STEP", "Bench Initialization");

  debugger_deleteAllBreakpoints();
  debugger_reset();
  debugger_run();
  
  RunPreTs();
  //==================================================== 

  AuthenticateECU(2);
  EnterDiagnosticSession("development");
  
  testStep("STEP", "Activate Measurement Frame block 6.");
  ActivateMeasurementFrame(6);
  
  testStep("STEP", "Set a breakpoint in function cil_Update_07Cx_Block06_InfosToSend at line Rte_Call_pclBelt_S_GetSpeed_deg_s(&s32BobbinSpeed);.");
  debugger_setRelativeFunctionBpAtLine("cil_Update_07Cx_Block06_InfosToSend", "18");
  testStep("STEP", "Set a breakpoint in function cil_Update_07Cx_Block06_InfosToSend at line Rte_Call_pclAutotestServices_GetTestResult(ATM_KU8_ID_TEST_HALL_EFFECT_SENSORS,&u8HESTestResult);.");
  debugger_setRelativeFunctionBpAtLine("cil_Update_07Cx_Block06_InfosToSend", "25");
  
  testCaseComment("Action: ARCH_SW_CIL_0759");
  testStep("STEP", "Check if CPU stopped at line Rte_Call_pclBelt_S_GetSpeed_deg_s(&s32BobbinSpeed);. --> CPU stopped at BP");
  debugger_waitUntilBPisReached("1000");
  ExpectedTestResult(debugger_result, "CPU stopped at BP", "CPU stopped at BP");
  
  debugger_run();
  
  testCaseComment("Action: ARCH_SW_CIL_0756");
  testStep("STEP", "Check if CPU stopped at line Rte_Call_pclAutotestServices_GetTestResult(ATM_KU8_ID_TEST_HALL_EFFECT_SENSORS,&u8HESTestResult);. --> CPU stopped at BP");
  debugger_waitUntilBPisReached("1000");
  ExpectedTestResult(debugger_result, "CPU stopped at BP", "CPU stopped at BP");
  
  testStep("STEP", "Set a breakpoint at the last line of function cil_Update_07Cx_Block06_InfosToSend.");
  debugger_setRelativeFunctionBpAtLine("cil_Update_07Cx_Block06_InfosToSend", "66");
  
  debugger_run();
  
  testCaseComment("Action: ARCH_SW_CIL_0716");
  testStep("STEP", "Check if variable cil_stMeasurementFrameContent.Meas_RBTM_FL_03 and signal Meas_RBTM_FL_03_ST3 are equal with KU8_ZERO. --> 0x0");
  snprintf(signal_value, elcount(signal_value), "0x%x", $Meas_RBTM_FL_03_ST3.raw64);
  debugger_readVariable("uint8", "cil_stMeasurementFrameContent,,app.elf", "2");
  ExpectedTestResult(debugger_result, signal_value, debugger_result);
  
  testCaseComment("Action: ARCH_SW_CIL_0716");
  testStep("STEP", "Check if variable cil_stMeasurementFrameContent.Meas_RBTM_FL_04 and signal Meas_RBTM_FL_04_ST3 are equal with KU8_ZERO. --> 0x0");
  snprintf(signal_value, elcount(signal_value), "0x%x", $Meas_RBTM_FL_04_ST3.raw64);
  debugger_readVariable("uint8", "cil_stMeasurementFrameContent,,app.elf", "3");
  ExpectedTestResult(debugger_result, signal_value, debugger_result);
  
  testCaseComment("Action: ARCH_SW_CIL_0716");
  testStep("STEP", "Check if variable cil_stMeasurementFrameContent.Meas_RBTM_FL_05 and signal Meas_RBTM_FL_05_ST3 are equal with KU8_ZERO. --> 0x0");
  snprintf(signal_value, elcount(signal_value), "0x%x", $Meas_RBTM_FL_05_ST3.raw64);
  debugger_readVariable("uint8", "cil_stMeasurementFrameContent,,app.elf", "4");
  ExpectedTestResult(debugger_result, signal_value, debugger_result);
  
  testCaseComment("Action: ARCH_SW_CIL_0716");
  testStep("STEP", "Check if variable cil_stMeasurementFrameContent.Meas_RBTM_FL_06 and signal Meas_RBTM_FL_06_ST3 are equal with KU8_ZERO. --> 0x0");
  snprintf(signal_value, elcount(signal_value), "0x%x", $Meas_RBTM_FL_06_ST3.raw64);
  debugger_readVariable("uint8", "cil_stMeasurementFrameContent,,app.elf", "5");
  ExpectedTestResult(debugger_result, signal_value, debugger_result);
  
  testCaseComment("Action: ARCH_SW_CIL_0716");
  testStep("STEP", "Check if variable cil_stMeasurementFrameContent.Meas_RBTM_FL_07 and signal Meas_RBTM_FL_07_ST3 are equal with KU8_ZERO. --> 0x0");
  snprintf(signal_value, elcount(signal_value), "0x%x", $Meas_RBTM_FL_07_ST3.raw64);
  debugger_readVariable("uint8", "cil_stMeasurementFrameContent,,app.elf", "6");
  ExpectedTestResult(debugger_result, signal_value, debugger_result);
  
  testCaseComment("Action: ARCH_SW_CIL_0716");
  testStep("STEP", "Check if variable cil_stMeasurementFrameContent.Meas_RBTM_FL_08 and signal Meas_RBTM_FL_08_ST3 are equal with KU8_ZERO. --> 0x0");
  snprintf(signal_value, elcount(signal_value), "0x%x", $Meas_RBTM_FL_08_ST3.raw64);
  debugger_readVariable("uint8", "cil_stMeasurementFrameContent,,app.elf", "7");
  ExpectedTestResult(debugger_result, signal_value, debugger_result);
  
  //====================================================
  testCaseComment("Postcondition");
  testStep("STEP", "Return ECU to default values");
  
  debugger_deleteAllBreakpoints();
  RunPostTs(); 
  
  debugger_stop();
}


testcase SW_IT_CIL_Update_07Cx_Block05_01()
{
  //***********************************Test report header*********************************
  testReportAddMiscInfoBlock("AUTOLIV ELECTRONICS document");
  TestReportAddMiscInfo("Nightly test", "No");
  TestReportAddMiscInfo("Test type", "Requirement-Based test");
  TestReportAddMiscInfo("Regression Test", "No");
  TestReportAddMiscInfo("Fault injection method used", "No");
  TestReportAddMiscInfo("Resource usage evaluation", "No");
  TestReportAddMiscInfo("Priority", "No");
  TestReportAddMiscInfo("Safety relevant", "No");
  
  AddRequirementInfo("Requirement under test", "ARCH_SW_CIL_0715, ARCH_SW_CIL_0765, ARCH_SW_CIL_0766");
  AddRequirementInfo("ARCH_SW_CIL_0715", "If selected, the content of the measurement frame - block #5 shall be encoded and provided to CAN.");
  AddRequirementInfo("ARCH_SW_CIL_0765", "PMP_runGetMotorVp_(Ext)* shall be called to get the voltage on the ‘P’ pin of the motor.");
  AddRequirementInfo("ARCH_SW_CIL_0766", "PMP_runGetMotorVn_(Ext)* shall be called to get the voltage on the ‘N’ pin of the motor.");
  //***************************************************************************************
    
  testCaseComment("Preconditions");
  testStep("STEP", "Bench Initialization");

  debugger_deleteAllBreakpoints();
  debugger_reset();
  debugger_run();
  
  RunPreTs();
  //==================================================== 

  AuthenticateECU(2);
  EnterDiagnosticSession("development");
  
  testStep("STEP", "Activate Measurement Frame block 5.");
  ActivateMeasurementFrame(5);
  
  testStep("STEP", "Set a breakpoint in function cil_Update_07Cx_Block05_InfosToSend at line Rte_Call_pclMotor_Vp_Get(&u16MotorPlus);.");
  debugger_setRelativeFunctionBpAtLine("cil_Update_07Cx_Block05_InfosToSend", "60");
  testStep("STEP", "Set a breakpoint in function cil_Update_07Cx_Block05_InfosToSend at line Rte_Call_pclMotor_Vn_Get(&u16MotorMinus);.");
  debugger_setRelativeFunctionBpAtLine("cil_Update_07Cx_Block05_InfosToSend", "75");
  
  testCaseComment("Action: ARCH_SW_CIL_0765");
  testStep("STEP", "Check if CPU stopped at line Rte_Call_pclMotor_Vp_Get(&u16MotorPlus);. --> CPU stopped at BP");
  debugger_waitUntilBPisReached("1000");
  ExpectedTestResult(debugger_result, "CPU stopped at BP", "CPU stopped at BP");
  
  debugger_run();
  
  testCaseComment("Action: ARCH_SW_CIL_0766");
  testStep("STEP", "Check if CPU stopped at line Rte_Call_pclMotor_Vn_Get(&u16MotorMinus);. --> CPU stopped at BP");
  debugger_waitUntilBPisReached("1000");
  ExpectedTestResult(debugger_result, "CPU stopped at BP", "CPU stopped at BP");
  
  testStep("STEP", "Set a breakpoint at the last line of function cil_Update_07Cx_Block05_InfosToSend.");
  debugger_setRelativeFunctionBpAtLine("cil_Update_07Cx_Block05_InfosToSend", "112");
  
  debugger_run();
  
  testCaseComment("Action: ARCH_SW_CIL_0715");
  testStep("STEP", "Check if variable cil_stMeasurementFrameContent.Meas_RBTM_FL_02 and signal Meas_RBTM_FL_02_ST3 are equal with KU8_ZERO. --> 0x0");
  snprintf(signal_value, elcount(signal_value), "0x%x", $Meas_RBTM_FL_02_ST3.raw64);
  debugger_readVariable("uint8", "cil_stMeasurementFrameContent,,app.elf", "1");
  ExpectedTestResult(debugger_result, signal_value, debugger_result);
  
  testCaseComment("Action: ARCH_SW_CIL_0715");
  testStep("STEP", "Check if variable cil_stMeasurementFrameContent.Meas_RBTM_FL_03 and signal Meas_RBTM_FL_03_ST3 are equal with KU8_ZERO. --> 0x0");
  snprintf(signal_value, elcount(signal_value), "0x%x", $Meas_RBTM_FL_03_ST3.raw64);
  debugger_readVariable("uint8", "cil_stMeasurementFrameContent,,app.elf", "2");
  ExpectedTestResult(debugger_result, signal_value, debugger_result);
  
  testCaseComment("Action: ARCH_SW_CIL_0715");
  testStep("STEP", "Check if variable cil_stMeasurementFrameContent.Meas_RBTM_FL_04 and signal Meas_RBTM_FL_04_ST3 are equal with KU8_ZERO. --> 0x0");
  snprintf(signal_value, elcount(signal_value), "0x%x", $Meas_RBTM_FL_04_ST3.raw64);
  debugger_readVariable("uint8", "cil_stMeasurementFrameContent,,app.elf", "3");
  ExpectedTestResult(debugger_result, signal_value, debugger_result);
  
  testCaseComment("Action: ARCH_SW_CIL_0715");
  testStep("STEP", "Check if variable cil_stMeasurementFrameContent.Meas_RBTM_FL_05 and signal Meas_RBTM_FL_05_ST3 are equal with KU8_ZERO. --> 0x0");
  snprintf(signal_value, elcount(signal_value), "0x%x", $Meas_RBTM_FL_05_ST3.raw64);
  debugger_readVariable("uint8", "cil_stMeasurementFrameContent,,app.elf", "4");
  ExpectedTestResult(debugger_result, signal_value, debugger_result);
  
  testCaseComment("Action: ARCH_SW_CIL_0715");
  testStep("STEP", "Check if variable cil_stMeasurementFrameContent.Meas_RBTM_FL_06 and signal Meas_RBTM_FL_06_ST3 are equal with KU8_ZERO. --> 0x0");
  snprintf(signal_value, elcount(signal_value), "0x%x", $Meas_RBTM_FL_06_ST3.raw64);
  debugger_readVariable("uint8", "cil_stMeasurementFrameContent,,app.elf", "5");
  ExpectedTestResult(debugger_result, signal_value, debugger_result);
  
  testCaseComment("Action: ARCH_SW_CIL_0715");
  testStep("STEP", "Check if variable cil_stMeasurementFrameContent.Meas_RBTM_FL_07 and signal Meas_RBTM_FL_07_ST3 are equal with KU8_ZERO. --> 0x0");
  snprintf(signal_value, elcount(signal_value), "0x%x", $Meas_RBTM_FL_07_ST3.raw64);
  debugger_readVariable("uint8", "cil_stMeasurementFrameContent,,app.elf", "6");
  ExpectedTestResult(debugger_result, signal_value, debugger_result);
  
  testCaseComment("Action: ARCH_SW_CIL_0715");
  testStep("STEP", "Check if variable cil_stMeasurementFrameContent.Meas_RBTM_FL_08 and signal Meas_RBTM_FL_08_ST3 are equal with KU8_ZERO. --> 0x0");
  snprintf(signal_value, elcount(signal_value), "0x%x", $Meas_RBTM_FL_08_ST3.raw64);
  debugger_readVariable("uint8", "cil_stMeasurementFrameContent,,app.elf", "7");
  ExpectedTestResult(debugger_result, signal_value, debugger_result);
  
  //====================================================
  testCaseComment("Postcondition");
  testStep("STEP", "Return ECU to default values");
  
  debugger_deleteAllBreakpoints();
  RunPostTs(); 
  
  debugger_stop();
}



testcase SW_IT_CIL_Update_07Cx_Block04_01()
{
  //***********************************Test report header*********************************
  testReportAddMiscInfoBlock("AUTOLIV ELECTRONICS document");
  TestReportAddMiscInfo("Nightly test", "No");
  TestReportAddMiscInfo("Test type", "Requirement-Based test");
  TestReportAddMiscInfo("Regression Test", "No");
  TestReportAddMiscInfo("Fault injection method used", "No");
  TestReportAddMiscInfo("Resource usage evaluation", "No");
  TestReportAddMiscInfo("Priority", "No");
  TestReportAddMiscInfo("Safety relevant", "No");
  
  AddRequirementInfo("Requirement under test", "ARCH_SW_CIL_0714");
  AddRequirementInfo("ARCH_SW_CIL_0714", "If selected, the content of the measurement frame - block #4 shall be encoded and provided to CAN.");
  //***************************************************************************************
    
  testCaseComment("Preconditions");
  testStep("STEP", "Bench Initialization");

  debugger_deleteAllBreakpoints();
  debugger_reset();
  debugger_run();
  
  RunPreTs();
  //==================================================== 

  AuthenticateECU(2);
  EnterDiagnosticSession("development");
  
  testStep("STEP", "Activate Measurement Frame block 4.");
  ActivateMeasurementFrame(4);
  
  testStep("STEP", "Set a breakpoint at the last line of function cil_Update_07Cx_Block04_InfosToSend.");
  debugger_setRelativeFunctionBpAtLine("cil_Update_07Cx_Block04_InfosToSend", "8");
  
  testCaseComment("Action: ARCH_SW_CIL_0714");
  testStep("STEP", "Check if variable cil_stMeasurementFrameContent.Meas_RBTM_FL_02 and signal Meas_RBTM_FL_02_ST3 are equal with KU8_MAX. --> 0xff");
  snprintf(signal_value, elcount(signal_value), "0x%x", $Meas_RBTM_FL_02_ST3.raw64);
  debugger_readVariable("uint8", "cil_stMeasurementFrameContent,,app.elf", "1");
  ExpectedTestResult(debugger_result, signal_value, debugger_result);
  
  testCaseComment("Action: ARCH_SW_CIL_0714");
  testStep("STEP", "Check if variable cil_stMeasurementFrameContent.Meas_RBTM_FL_03 and signal Meas_RBTM_FL_03_ST3 are equal with KU8_MAX. --> 0xff");
  snprintf(signal_value, elcount(signal_value), "0x%x", $Meas_RBTM_FL_03_ST3.raw64);
  debugger_readVariable("uint8", "cil_stMeasurementFrameContent,,app.elf", "2");
  ExpectedTestResult(debugger_result, signal_value, debugger_result);
  
  testCaseComment("Action: ARCH_SW_CIL_0714");
  testStep("STEP", "Check if variable cil_stMeasurementFrameContent.Meas_RBTM_FL_04 and signal Meas_RBTM_FL_04_ST3 are equal with KU8_MAX. --> 0xff");
  snprintf(signal_value, elcount(signal_value), "0x%x", $Meas_RBTM_FL_04_ST3.raw64);
  debugger_readVariable("uint8", "cil_stMeasurementFrameContent,,app.elf", "3");
  ExpectedTestResult(debugger_result, signal_value, debugger_result);
  
  testCaseComment("Action: ARCH_SW_CIL_0714");
  testStep("STEP", "Check if variable cil_stMeasurementFrameContent.Meas_RBTM_FL_05 and signal Meas_RBTM_FL_05_ST3 are equal with KU8_MAX. --> 0xff");
  snprintf(signal_value, elcount(signal_value), "0x%x", $Meas_RBTM_FL_05_ST3.raw64);
  debugger_readVariable("uint8", "cil_stMeasurementFrameContent,,app.elf", "4");
  ExpectedTestResult(debugger_result, signal_value, debugger_result);
  
  testCaseComment("Action: ARCH_SW_CIL_0714");
  testStep("STEP", "Check if variable cil_stMeasurementFrameContent.Meas_RBTM_FL_06 and signal Meas_RBTM_FL_06_ST3 are equal with KU8_MAX. --> 0xff");
  snprintf(signal_value, elcount(signal_value), "0x%x", $Meas_RBTM_FL_06_ST3.raw64);
  debugger_readVariable("uint8", "cil_stMeasurementFrameContent,,app.elf", "5");
  ExpectedTestResult(debugger_result, signal_value, debugger_result);
  
  testCaseComment("Action: ARCH_SW_CIL_0714");
  testStep("STEP", "Check if variable cil_stMeasurementFrameContent.Meas_RBTM_FL_07 and signal Meas_RBTM_FL_07_ST3 are equal with KU8_MAX. --> 0xff");
  snprintf(signal_value, elcount(signal_value), "0x%x", $Meas_RBTM_FL_07_ST3.raw64);
  debugger_readVariable("uint8", "cil_stMeasurementFrameContent,,app.elf", "6");
  ExpectedTestResult(debugger_result, signal_value, debugger_result);
  
  testCaseComment("Action: ARCH_SW_CIL_0714");
  testStep("STEP", "Check if variable cil_stMeasurementFrameContent.Meas_RBTM_FL_08 and signal Meas_RBTM_FL_08_ST3 are equal with KU8_MAX. --> 0xff");
  snprintf(signal_value, elcount(signal_value), "0x%x", $Meas_RBTM_FL_08_ST3.raw64);
  debugger_readVariable("uint8", "cil_stMeasurementFrameContent,,app.elf", "7");
  ExpectedTestResult(debugger_result, signal_value, debugger_result);
  
  //====================================================
  testCaseComment("Postcondition");
  testStep("STEP", "Return ECU to default values");
  
  debugger_deleteAllBreakpoints();
  RunPostTs(); 
  
  debugger_stop();
}


testcase SW_IT_CIL_Update_07Cx_Block03_01()
{
  //***********************************Test report header*********************************
  testReportAddMiscInfoBlock("AUTOLIV ELECTRONICS document");
  TestReportAddMiscInfo("Nightly test", "No");
  TestReportAddMiscInfo("Test type", "Requirement-Based test");
  TestReportAddMiscInfo("Regression Test", "No");
  TestReportAddMiscInfo("Fault injection method used", "No");
  TestReportAddMiscInfo("Resource usage evaluation", "No");
  TestReportAddMiscInfo("Priority", "No");
  TestReportAddMiscInfo("Safety relevant", "No");
  
  AddRequirementInfo("Requirement under test", "ARCH_SW_CIL_0713, ARCH_SW_CIL_0768");
  AddRequirementInfo("ARCH_SW_CIL_0713", "If selected, the content of the measurement frame - block #3 shall be encoded and provided to CAN.");
  AddRequirementInfo("ARCH_SW_CIL_0768", "PMP_runGetFilteredTemperature shall be called to get the value of the low reference voltage in V.");
  //***************************************************************************************
    
  testCaseComment("Preconditions");
  testStep("STEP", "Bench Initialization");

  debugger_deleteAllBreakpoints();
  debugger_reset();
  debugger_run();
  
  RunPreTs();
  //==================================================== 

  AuthenticateECU(2);
  EnterDiagnosticSession("development");
  
  testStep("STEP", "Activate Measurement Frame block 3.");
  ActivateMeasurementFrame(3);
  
  testStep("STEP", "Set a breakpoint in function cil_Update_07Cx_Block03_InfosToSend at line Rte_Call_pclECU_T_GetFiltered(&u16Temperature);.");
  debugger_setRelativeFunctionBpAtLine("cil_Update_07Cx_Block03_InfosToSend", "28");
  
  testCaseComment("Action: ARCH_SW_CIL_0768");
  testStep("STEP", "Check if CPU stopped at line Rte_Call_pclECU_T_GetFiltered(&u16Temperature);. --> CPU stopped at BP");
  debugger_waitUntilBPisReached("1000");
  ExpectedTestResult(debugger_result, "CPU stopped at BP", "CPU stopped at BP");
  
  testStep("STEP", "Set a breakpoint at the last line of function cil_Update_07Cx_Block03_InfosToSend.");
  debugger_setRelativeFunctionBpAtLine("cil_Update_07Cx_Block03_InfosToSend", "51");
  
  debugger_run();
  
  testCaseComment("Action: ARCH_SW_CIL_0713");
  testStep("STEP", "Check if variable cil_stMeasurementFrameContent.Meas_RBTM_FL_03 and signal Meas_RBTM_FL_03_ST3 are equal with KU8_ZERO. --> 0x0");
  snprintf(signal_value, elcount(signal_value), "0x%x", $Meas_RBTM_FL_03_ST3.raw64);
  debugger_readVariable("uint8", "cil_stMeasurementFrameContent,,app.elf", "2");
  ExpectedTestResult(debugger_result, signal_value, debugger_result);
  
  testCaseComment("Action: ARCH_SW_CIL_0713");
  testStep("STEP", "Check if variable cil_stMeasurementFrameContent.Meas_RBTM_FL_04 and signal Meas_RBTM_FL_04_ST3 are equal with KU8_ZERO. --> 0x0");
  snprintf(signal_value, elcount(signal_value), "0x%x", $Meas_RBTM_FL_04_ST3.raw64);
  debugger_readVariable("uint8", "cil_stMeasurementFrameContent,,app.elf", "3");
  ExpectedTestResult(debugger_result, signal_value, debugger_result);
  
  testCaseComment("Action: ARCH_SW_CIL_0713");
  testStep("STEP", "Check if variable cil_stMeasurementFrameContent.Meas_RBTM_FL_05 and signal Meas_RBTM_FL_05_ST3 are equal with KU8_ZERO. --> 0x0");
  snprintf(signal_value, elcount(signal_value), "0x%x", $Meas_RBTM_FL_05_ST3.raw64);
  debugger_readVariable("uint8", "cil_stMeasurementFrameContent,,app.elf", "4");
  ExpectedTestResult(debugger_result, signal_value, debugger_result);
  
  testCaseComment("Action: ARCH_SW_CIL_0713");
  testStep("STEP", "Check if variable cil_stMeasurementFrameContent.Meas_RBTM_FL_06 and signal Meas_RBTM_FL_06_ST3 are equal with KU8_ZERO. --> 0x0");
  snprintf(signal_value, elcount(signal_value), "0x%x", $Meas_RBTM_FL_06_ST3.raw64);
  debugger_readVariable("uint8", "cil_stMeasurementFrameContent,,app.elf", "5");
  ExpectedTestResult(debugger_result, signal_value, debugger_result);
  
  testCaseComment("Action: ARCH_SW_CIL_0713");
  testStep("STEP", "Check if variable cil_stMeasurementFrameContent.Meas_RBTM_FL_07 and signal Meas_RBTM_FL_07_ST3 are equal with KU8_ZERO. --> 0x0");
  snprintf(signal_value, elcount(signal_value), "0x%x", $Meas_RBTM_FL_07_ST3.raw64);
  debugger_readVariable("uint8", "cil_stMeasurementFrameContent,,app.elf", "6");
  ExpectedTestResult(debugger_result, signal_value, debugger_result);
  
  testCaseComment("Action: ARCH_SW_CIL_0713");
  testStep("STEP", "Check if variable cil_stMeasurementFrameContent.Meas_RBTM_FL_08 and signal Meas_RBTM_FL_08_ST3 are equal with KU8_ZERO. --> 0x0");
  snprintf(signal_value, elcount(signal_value), "0x%x", $Meas_RBTM_FL_08_ST3.raw64);
  debugger_readVariable("uint8", "cil_stMeasurementFrameContent,,app.elf", "7");
  ExpectedTestResult(debugger_result, signal_value, debugger_result);
  
  //====================================================
  testCaseComment("Postcondition");
  testStep("STEP", "Return ECU to default values");
  
  debugger_deleteAllBreakpoints();
  RunPostTs(); 
  
  debugger_stop();
}



testcase SW_IT_CIL_Update_07Cx_Block02_01()
{
  //***********************************Test report header*********************************
  testReportAddMiscInfoBlock("AUTOLIV ELECTRONICS document");
  TestReportAddMiscInfo("Nightly test", "No");
  TestReportAddMiscInfo("Test type", "Requirement-Based test");
  TestReportAddMiscInfo("Regression Test", "No");
  TestReportAddMiscInfo("Fault injection method used", "No");
  TestReportAddMiscInfo("Resource usage evaluation", "No");
  TestReportAddMiscInfo("Priority", "No");
  TestReportAddMiscInfo("Safety relevant", "No");
  
  AddRequirementInfo("Requirement under test", "ARCH_SW_CIL_0712, ARCH_SW_CIL_0764");
  AddRequirementInfo("ARCH_SW_CIL_0712", "If selected, the content of the measurement frame - block #2 shall be encoded and provided to CAN.");
  AddRequirementInfo("ARCH_SW_CIL_0764", "PMP_runGetBatteryVoltage_(Ext)* shall be called to get the battery voltage.");
  //***************************************************************************************
    
  testCaseComment("Preconditions");
  testStep("STEP", "Bench Initialization");

  debugger_deleteAllBreakpoints();
  debugger_reset();
  debugger_run();
  
  RunPreTs();
  //==================================================== 

  AuthenticateECU(2);
  EnterDiagnosticSession("development");
  
  testStep("STEP", "Activate Measurement Frame block 2.");
  ActivateMeasurementFrame(2);
  
  testStep("STEP", "Set a breakpoint in function cil_Update_07Cx_Block02_InfosToSend at line Rte_Call_pclKL30_V_Get(&u16ScaledKL30Voltage);.");
  debugger_setRelativeFunctionBpAtLine("cil_Update_07Cx_Block02_InfosToSend", "18");
  
  testCaseComment("Action: ARCH_SW_CIL_0764");
  testStep("STEP", "Check if CPU stopped at line Rte_Call_pclKL30_V_Get(&u16ScaledKL30Voltage);. --> CPU stopped at BP");
  debugger_waitUntilBPisReached("1000");
  ExpectedTestResult(debugger_result, "CPU stopped at BP", "CPU stopped at BP");
  
  testStep("STEP", "Set a breakpoint at the last line of function cil_Update_07Cx_Block02_InfosToSend.");
  debugger_setRelativeFunctionBpAtLine("cil_Update_07Cx_Block02_InfosToSend", "47");
  
  debugger_run();
  
  testCaseComment("Action: ARCH_SW_CIL_0712");
  testStep("STEP", "Check if variable cil_stMeasurementFrameContent.Meas_RBTM_FL_02 and signal Meas_RBTM_FL_02_ST3 are equal with KU8_ZERO. --> 0x0");
  snprintf(signal_value, elcount(signal_value), "0x%x", $Meas_RBTM_FL_02_ST3.raw64);
  debugger_readVariable("uint8", "cil_stMeasurementFrameContent,,app.elf", "1");
  ExpectedTestResult(debugger_result, signal_value, debugger_result);
  
  testCaseComment("Action: ARCH_SW_CIL_0712");
  testStep("STEP", "Check if variable cil_stMeasurementFrameContent.Meas_RBTM_FL_03 and signal Meas_RBTM_FL_03_ST3 are equal with KU8_ZERO. --> 0x0");
  snprintf(signal_value, elcount(signal_value), "0x%x", $Meas_RBTM_FL_03_ST3.raw64);
  debugger_readVariable("uint8", "cil_stMeasurementFrameContent,,app.elf", "2");
  ExpectedTestResult(debugger_result, signal_value, debugger_result);
  
  testCaseComment("Action: ARCH_SW_CIL_0712");
  testStep("STEP", "Check if variable cil_stMeasurementFrameContent.Meas_RBTM_FL_06 and signal Meas_RBTM_FL_06_ST3 are equal with KU8_ZERO. --> 0x0");
  snprintf(signal_value, elcount(signal_value), "0x%x", $Meas_RBTM_FL_06_ST3.raw64);
  debugger_readVariable("uint8", "cil_stMeasurementFrameContent,,app.elf", "5");
  ExpectedTestResult(debugger_result, signal_value, debugger_result);
  
  testCaseComment("Action: ARCH_SW_CIL_0712");
  testStep("STEP", "Check if variable cil_stMeasurementFrameContent.Meas_RBTM_FL_07 and signal Meas_RBTM_FL_07_ST3 are equal with KU8_ZERO. --> 0x0");
  snprintf(signal_value, elcount(signal_value), "0x%x", $Meas_RBTM_FL_07_ST3.raw64);
  debugger_readVariable("uint8", "cil_stMeasurementFrameContent,,app.elf", "6");
  ExpectedTestResult(debugger_result, signal_value, debugger_result);
 
  
  //====================================================
  testCaseComment("Postcondition");
  testStep("STEP", "Return ECU to default values");
  
  debugger_deleteAllBreakpoints();
  RunPostTs(); 
  
  debugger_stop();
}


testcase SW_IT_CIL_Update_07Cx_Block01_01()
{
  //***********************************Test report header*********************************
  testReportAddMiscInfoBlock("AUTOLIV ELECTRONICS document");
  TestReportAddMiscInfo("Nightly test", "No");
  TestReportAddMiscInfo("Test type", "Requirement-Based test");
  TestReportAddMiscInfo("Regression Test", "No");
  TestReportAddMiscInfo("Fault injection method used", "No");
  TestReportAddMiscInfo("Resource usage evaluation", "No");
  TestReportAddMiscInfo("Priority", "No");
  TestReportAddMiscInfo("Safety relevant", "No");
  
  AddRequirementInfo("Requirement under test", "ARCH_SW_CIL_0711");
  AddRequirementInfo("ARCH_SW_CIL_0711", "If selected, the content of the measurement frame - block #1 shall be encoded and provided to CAN.");
  //***************************************************************************************
    
  testCaseComment("Preconditions");
  testStep("STEP", "Bench Initialization");

  debugger_deleteAllBreakpoints();
  debugger_reset();
  debugger_run();
  
  RunPreTs();
  //==================================================== 

  AuthenticateECU(2);
  EnterDiagnosticSession("development");
  
  testStep("STEP", "Activate Measurement Frame block 1.");
  ActivateMeasurementFrame(1);
  
  testStep("STEP", "Set a breakpoint at the last line of function cil_Update_07Cx_Block01_InfosToSend.");
  debugger_setRelativeFunctionBpAtLine("cil_Update_07Cx_Block01_InfosToSend", "52");
  
  testCaseComment("Action: ARCH_SW_CIL_0711");
  testStep("STEP", "Check if variable cil_stMeasurementFrameContent.Meas_RBTM_FL_02 and signal Meas_RBTM_FL_02_ST3 are equal with KU8_ZERO. --> 0x0");
  snprintf(signal_value, elcount(signal_value), "0x%x", $Meas_RBTM_FL_02_ST3.raw64);
  debugger_readVariable("uint8", "cil_stMeasurementFrameContent,,app.elf", "1");
  ExpectedTestResult(debugger_result, signal_value, debugger_result);
  
  testCaseComment("Action: ARCH_SW_CIL_0711");
  testStep("STEP", "Check if variable cil_stMeasurementFrameContent.Meas_RBTM_FL_03 and signal Meas_RBTM_FL_03_ST3 are equal with KU8_ZERO. --> 0x0");
  snprintf(signal_value, elcount(signal_value), "0x%x", $Meas_RBTM_FL_03_ST3.raw64);
  debugger_readVariable("uint8", "cil_stMeasurementFrameContent,,app.elf", "2");
  ExpectedTestResult(debugger_result, signal_value, debugger_result);
  
  testCaseComment("Action: ARCH_SW_CIL_0711");
  testStep("STEP", "Check if variable cil_stMeasurementFrameContent.Meas_RBTM_FL_05 and signal Meas_RBTM_FL_05_ST3 are equal with KU8_ZERO. --> 0x0");
  snprintf(signal_value, elcount(signal_value), "0x%x", $Meas_RBTM_FL_05_ST3.raw64);
  debugger_readVariable("uint8", "cil_stMeasurementFrameContent,,app.elf", "4");
  ExpectedTestResult(debugger_result, signal_value, debugger_result);
  
  testCaseComment("Action: ARCH_SW_CIL_0711");
  testStep("STEP", "Check if variable cil_stMeasurementFrameContent.Meas_RBTM_FL_06 and signal Meas_RBTM_FL_06_ST3 are equal with KU8_ZERO. --> 0x0");
  snprintf(signal_value, elcount(signal_value), "0x%x", $Meas_RBTM_FL_06_ST3.raw64);
  debugger_readVariable("uint8", "cil_stMeasurementFrameContent,,app.elf", "5");
  ExpectedTestResult(debugger_result, signal_value, debugger_result);
  
  testCaseComment("Action: ARCH_SW_CIL_0711");
  testStep("STEP", "Check if variable cil_stMeasurementFrameContent.Meas_RBTM_FL_07 and signal Meas_RBTM_FL_07_ST3 are equal with KU8_ZERO. --> 0x0");
  snprintf(signal_value, elcount(signal_value), "0x%x", $Meas_RBTM_FL_07_ST3.raw64);
  debugger_readVariable("uint8", "cil_stMeasurementFrameContent,,app.elf", "6");
  ExpectedTestResult(debugger_result, signal_value, debugger_result);
  
  testCaseComment("Action: ARCH_SW_CIL_0711");
  testStep("STEP", "Check if variable cil_stMeasurementFrameContent.Meas_RBTM_FL_08 and signal Meas_RBTM_FL_08_ST3 are equal with KU8_ZERO. --> 0x0");
  snprintf(signal_value, elcount(signal_value), "0x%x", $Meas_RBTM_FL_08_ST3.raw64);
  debugger_readVariable("uint8", "cil_stMeasurementFrameContent,,app.elf", "7");
  ExpectedTestResult(debugger_result, signal_value, debugger_result);
  
  //====================================================
  testCaseComment("Postcondition");
  testStep("STEP", "Return ECU to default values");
  
  debugger_deleteAllBreakpoints();
  RunPostTs(); 
  
  debugger_stop();
}



testcase SW_IT_CIL_runManageMeasurementFrame_01()
{
  //***********************************Test report header*********************************
  testReportAddMiscInfoBlock("AUTOLIV ELECTRONICS document");
  TestReportAddMiscInfo("Nightly test", "No");
  TestReportAddMiscInfo("Test type", "Requirement-Based test");
  TestReportAddMiscInfo("Regression Test", "No");
  TestReportAddMiscInfo("Fault injection method used", "No");
  TestReportAddMiscInfo("Resource usage evaluation", "No");
  TestReportAddMiscInfo("Priority", "No");
  TestReportAddMiscInfo("Safety relevant", "No");
  
  AddRequirementInfo("Requirement under test", "ARCH_SW_CIL_0701, ARCH_SW_CIL_0702");
  AddRequirementInfo("ARCH_SW_CIL_0701", "If selected, the content of the measurement frame - block #1 shall be encoded and provided to CAN.");
  AddRequirementInfo("ARCH_SW_CIL_0702", "If selected, the content of the measurement frame - block #1 shall be encoded and provided to CAN.");
  //***************************************************************************************
    
  testCaseComment("Preconditions");
  testStep("STEP", "Bench Initialization");

  debugger_deleteAllBreakpoints();
  debugger_reset();
  debugger_run();
  
  RunPreTs();
  //==================================================== 

  AuthenticateECU(2);
  EnterDiagnosticSession("development");
  
  testStep("STEP", "Activate Measurement Frame block 1.");
  ActivateMeasurementFrame(1);
  
  testStep("STEP", "Set a breakpoint in function CIL_runManageMeasurementFrame at line if (KU8_ZERO != NVP_BLOCK_ID_MEASUREMENT_FRAME_CONFIG_RamBlockData.NVP_u8MeasFrameTiming).");
  debugger_setRelativeFunctionBpAtLine("CIL_runManageMeasurementFrame", "0");
  
  testCaseComment("Action: ARCH_SW_CIL_0701");
  testStep("STEP", "Check if CPU stopped at line 'if (KU8_ZERO != NVP_BLOCK_ID_MEASUREMENT_FRAME_CONFIG_RamBlockData.NVP_u8MeasFrameTiming)'. --> CPU stopped at BP");
  debugger_waitUntilBPisReached("1000");
  ExpectedTestResult(debugger_result,IS_CPU_STOP_AT_BP_SUCCESFUL, "CPU stopped at BP");
  
  debugger_deleteAllBreakpoints();
  debugger_run();
  
  testStep("STEP", "Set a breakpoint in function cil_Update_07Cx_InfosToSend at line '| ((uint32)(NVP_BLOCK_ID_MEASUREMENT_FRAME_CONFIG_RamBlockData.NVP_au8MeasFrameBlockConfig[KU8_INDEX_2_IN_SELECTED_BLOCKS_ARRAY]))'.");
  debugger_setRelativeFunctionBpAtLine("cil_Update_07Cx_InfosToSend", "0");
  
  testCaseComment("Action: ARCH_SW_CIL_0702");
  testStep("STEP", "Check if CPU stopped at line '| ((uint32)(NVP_BLOCK_ID_MEASUREMENT_FRAME_CONFIG_RamBlockData.NVP_au8MeasFrameBlockConfig[KU8_INDEX_2_IN_SELECTED_BLOCKS_ARRAY]))'. --> CPU stopped at BP");
  debugger_waitUntilBPisReached("1000");
//  ExpectedTestResult(debugger_result,IS_CPU_STOP_AT_BP_SUCCESFUL, "CPU stopped at BP");
  
  //====================================================
  testCaseComment("Postcondition");
  testStep("STEP", "Return ECU to default values");
  
  debugger_deleteAllBreakpoints();
  RunPostTs(); 
  
  debugger_stop();
}



