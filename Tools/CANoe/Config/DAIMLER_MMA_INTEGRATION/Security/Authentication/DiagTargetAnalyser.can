/*@!Encoding:1252*/
includes
{
  
  #include "LocalAuth_Utilities.cin"
}



void MainTest ()
{
  tc_ReadDiagQualifier();
}

testcase tc_ReadDiagQualifier()
{
  sysSetVariableString( "LocalAuthentication","AuthenticatedTargets", "-");
  ReadDiagQualifier();
}

