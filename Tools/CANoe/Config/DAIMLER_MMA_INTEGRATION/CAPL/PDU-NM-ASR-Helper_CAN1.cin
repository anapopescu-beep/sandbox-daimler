variables
{
  /* NM-IL Include for PDU IL with AUTOSAR NM
   *
   * This include file establishes the coupling between NM --> IL.
   *
   * The simulation node needs to load the components AsrPDUIL.dll and AsrNM33.dll.
   *
   * Call NMCAN1_OnInit() in "on preStart()" of the main program!
   * Call NMCAN1_OnStart() in "on start()" of the main program!
   *
   * Version 6.5, (c) 2016 Vector Informatik GmbH, Department for Networks and Distributed Systems
   */

  const dword cNMCAN1_NMIndDebug      = 0x0001;
  const dword cNMCAN1_NMInitDebug     = 0x0002;
  const dword cNMCAN1_ILControlDebug  = 0x0010;
  
  const double cNMCAN1_NS2S = 1000000000.0;

  // Internally used variables and timers:
  dword   gNMCAN1_BusContext = 0;
  long    gNMCAN1_CurrentNMState = cCAN1_ASR_NM_STATE_UNDEFINED;
  long    gNMCAN1_CurrentNMInternalRequest = 0;
  
}

/*****************************************************************************
 * Include Initialization
 *****************************************************************************/

void NMCAN1_OnInit ()
{
  // This function must be called from the main program in "on preStart()"!

  //Nm_SetVerbosity(3);
  
  
  gNMCAN1_BusContext = GetBusNameContext(gCAN1BusName);

  if (strncmp("%NODE_NAME%", "_BC_F", 50) == 0)
  {
    gNMPCAN1_DebugFlags |= cNMCAN1_NMIndDebug;
    gNMPCAN1_DebugFlags |= cNMCAN1_NMInitDebug;
    gNMPCAN1_DebugFlags |= cNMPCAN1_NMControlDebug;
    gNMPCAN1_DebugFlags |= cNMCAN1_ILControlDebug;
  }

  SetBusContext(gNMCAN1_BusContext);
  Nm_ConfigureILNotifications( 0, 1 ); // regardless of NM callbacks inform IL
}

void NMCAN1_OnStart ()
{
  // This function must be called from the main program in "on start()"!
  
  if (gNMPCAN1_DebugFlags & cNMCAN1_NMInitDebug)
  {
    write("+++++++++ %NODE_NAME%: CAN NM on start()");
  }
}

/*****************************************************************************
 * NM Control
 * These functions can be called from the main program or react on
 * panel controls in order to manipulate the NM status of the controlled node.
 *****************************************************************************/

void NMCAN1_Enable (int enable)
{
  /* void NMCAN1_Enable (int enable);
   *
   *  Function enables/disables the Network Management DLL.
   */
  int wasEnabled = -1;

  //if (enable == wasEnabled) return;

  if (gNMPCAN1_DebugFlags & cNMPCAN1_NMControlDebug)
  {
    write("[%.6f %NODE_NAME%] NMCAN1_Enable(%d) called ...", TimeNowNS()/cNMCAN1_NS2S, enable);
  }

  SetBusContext(gNMCAN1_BusContext);
  if (enable == 1)
  {
    Nm_CtrlSimulationOn();
  }
  else
  {
    Nm_CtrlSimulationOff();
  }

  wasEnabled = enable;
}

void NMCAN1_SetApplActivity (int activity)
{
  /* void NMCAN1_SetApplActivity (int activity);
   *
   *  Function sets the application activity at the Interaction Layer.
   */
  int wasActivity = -1;

  //if (activity == wasActivity) return;

  if (gNMPCAN1_DebugFlags & cNMPCAN1_NMControlDebug)
  {
    write("[%.6f %NODE_NAME%] NMCAN1_SetApplActivity(%d) called ...", TimeNowNS()/cNMCAN1_NS2S, activity);
  }

  SetBusContext(gNMCAN1_BusContext);
  if (activity > 0)
  {
    Nm_SetApplicationActivity(1);
  }
  else
  {
    Nm_SetApplicationActivity(0);
  }

  wasActivity = activity;
}

NMCAN1_ReleaseBus()
{
  if (gNMPCAN1_DebugFlags & cNMPCAN1_NMControlDebug)
  {
    write("[%.6f %NODE_NAME%]: Nm_NetworkRelease()", TimeNowNS()/cNMCAN1_NS2S);
  }
  SetBusContext(gNMCAN1_BusContext);
  Nm_NetworkRelease();
}

NMCAN1_RequestBus ()
{
  if (gNMPCAN1_DebugFlags & cNMPCAN1_NMControlDebug)
  {
    write("[%.6f %NODE_NAME%]: Nm_NetworkRequest()", TimeNowNS()/cNMCAN1_NS2S);
  }
  SetBusContext(gNMCAN1_BusContext);
  Nm_NetworkRequest();
}

NMCAN1_PassiveBusStart ()
{
  if (gNMPCAN1_DebugFlags & cNMPCAN1_NMControlDebug)
  {
    write("[%.6f %NODE_NAME%]: Nm_PassiveStartUp()", TimeNowNS()/cNMCAN1_NS2S);
  }
  SetBusContext(gNMCAN1_BusContext);
  Nm_PassiveStartUp();
}

NMCAN1_PowerOnStart()
{
  //NMCAN1_PassiveBusStart();
}

on sysvar sysvar::NM_CAN1::StateControl::NmPduTxEnable
{
  SetBusContext(gNMCAN1_BusContext);
  if(@this == 1)
    Nm_DisablePassiveMode(); // NM PDU is transmitted after wake up, and in normal operation and repeat message state
  else 
    Nm_EnablePassiveMode(); // NM PDU is never transmitted
}

/*****************************************************************************
 * NM Indications
 * They are called from the NM simulation in order to control the IL.
 *****************************************************************************/

void NMCAN1_IndNetworkStart()
{
  if (gNMPCAN1_DebugFlags & cNMCAN1_NMIndDebug)
  {
    write("[%.6f %NODE_NAME%]: Nm_NetworkStartInd()", TimeNowNS()/cNMCAN1_NS2S);
  }
  NMCAN1_PassiveBusStart();
}

void NMCAN1_IndNetworkMode()
{
  if (gNMPCAN1_DebugFlags & cNMCAN1_NMIndDebug)
  {
    write("[%.6f %NODE_NAME%]: Nm_NetworkModeInd()", TimeNowNS()/cNMCAN1_NS2S);
  }
}

void NMCAN1_IndNetworkTimeout()
{
  if (gNMPCAN1_DebugFlags & cNMCAN1_NMIndDebug)
  {
    write("[%.6f %NODE_NAME%]: Nm_NetworkTimeoutInd()", TimeNowNS()/cNMCAN1_NS2S);
  }
}

void NMCAN1_IndPrepareBusSleepMode()
{
  if (gNMPCAN1_DebugFlags & cNMCAN1_NMIndDebug)
  {
    write("[%.6f %NODE_NAME%]: NmPrepareBusSleepModeInd()", TimeNowNS()/cNMCAN1_NS2S);
  }
}

void NMCAN1_IndBusSleepMode()
{
  if (gNMPCAN1_DebugFlags & cNMCAN1_NMIndDebug)
  {
    write("[%.6f %NODE_NAME%]: Nm_BusSleepModeInd()", TimeNowNS()/cNMCAN1_NS2S);
  }
}

void NMCAN1_IndStateChangeNotification( long previousState, long currentState) 
{
  long mode;
  if ((previousState == cCAN1_ASR_NM_STATE_UNDEFINED || previousState == cCAN1_ASR_NM_STATE_BUS_SLEEP) && (currentState != cCAN1_ASR_NM_STATE_BUS_SLEEP))
  { 
    @sysvar::NM_CAN1::StateControl::ActiveNodes += 1;
  }
  if ((previousState != cCAN1_ASR_NM_STATE_UNDEFINED) && (currentState == cCAN1_ASR_NM_STATE_BUS_SLEEP))
  { 
    @sysvar::NM_CAN1::StateControl::ActiveNodes -= 1;
  }

  gNMCAN1_CurrentNMState = currentState;

  if ((currentState <= cCAN1_ASR_NM_STATE_BUS_SLEEP) || (currentState > cCAN1_ASR_NM_STATE_SYNCHRONIZE))
  {
    mode = cCAN1_NM_NODE_MODE_Sleep_Mode;
  }
  else
  {
    if (currentState == cCAN1_ASR_NM_STATE_SYNCHRONIZE)
    {
      mode = cCAN1_NM_NODE_MODE_Synchronize_Mode;
    }
    else
    {
      mode = cCAN1_NM_NODE_MODE_Network_Mode;
    }
  }

  if (gNMPCAN1_DebugFlags & cNMCAN1_NMIndDebug)
  {
    write("[%.6f %NODE_NAME%]: NM currentState = %d, mode = %d", TimeNowNS()/cNMCAN1_NS2S, currentState, mode);
  }
}

/*****************************************************************************
 * EOF
 *****************************************************************************/
