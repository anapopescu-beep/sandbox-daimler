/*@!Encoding:1252*/
includes
{
  
}

variables
{
//  byte bDefaultCalibration[40] = {0x00, 0x32, 0x00, 0x89, 0x01, 0x36, 0x03, 0xFF, 0x03, 0xFF, 0x00, 0x33, 0x00, 0x7B, 0x01, 0x08, 0x02, 0x8A, 0x03, 0xFF, 0x00, 0x00, 0x04, 0x56, 0x08, 0x18, 0x1C, 0x01, 0x1C, 0x01, 0x00, 0x00, 0x03, 0x47, 0x07, 0xAC, 0x14, 0x4E, 0x20, 0x98};
  
  char cLogPathAndName[500] ="c:\\\\Temp\\\\DAI_MMA_LOGS\\\\";
  char cFullLogPath[1000];
  char cLogName[500];

  //PC identification
  char cTesterName[4] = "AGR";
  char sPCId[20] = "ART-OF-WD3149";
  
  char cCAN_CaseId[11] = "RBE-COM-25";
  char cPowerBoardPartNumber[13] = "-";
  
  //DUT
  char cDUT[50] = "Sample_1";
  char cHWVersion[50] = "22/04.00";
  
  //Power supply 
  char cPowerSupply1Id[12] = "RBE-PWR-030";
    
  //Mockup 
  char cMOTHER_BOARD[50] = "-"; 
  char cPOWER_BOARD[50] = "-"; 
  char cSBC_BOARD[50] = "-"; 
  char cMCU[50] = "-";
  
  //Multimeter 
  char sMultimeterAddress[100] = "USB0::0x164E::0x0DAD::TW00041293::INSTR"; 
  
  //Scope  
  char sScopeAddress[100] = "USB::0x0699::0x0456::C013833::INSTR";
  
  //Signal generator 
  char sSignalGeneratorAddress[100] = "USB::0x0699::0x034A::C020918::INSTR";  
  
  //EIB 
  int iEIBport = 9;
  
  //HESS
  int iHESSport = 4;
  int iBaudrateHESS = 9600;   
  int iParityHESS = 0;	
  int iStopbitHESS = 1;
	int iByteSizeHESS = 8;
}


