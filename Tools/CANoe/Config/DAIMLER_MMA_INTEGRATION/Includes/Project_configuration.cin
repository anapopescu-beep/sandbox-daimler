/*@!Encoding:1252*/
includes
{
  #include "CyclesParameters_configuration.cin"
  #include "Core_Functions_Configuration.cin"
  #include "Core_Functions.cin"
  #include "Project_functions.cin"
  #include "RAMAddress_configuration.cin"
  #include "Testbench_configuration.cin"
  #include "Profile_configuration.cin"
  #include "PowerSupplyControl.cin"
  #include "DTC_configuration.cin"
  #include "Diag_functions.cin"
  #include "HW_Modules\FIB\FIB_Control.cin"
//  #include "HW_Modules\DMM\DMMControl.cin"
  //#include "HW_Modules\OSC\OSCILLOSCOPE_Control.cin"
}

variables
{
  char _sSwVersion[15] = "0x16 0x16 0x00"; // Defines software version.
//  char _sSwReleaseName[4] ="P30";
}