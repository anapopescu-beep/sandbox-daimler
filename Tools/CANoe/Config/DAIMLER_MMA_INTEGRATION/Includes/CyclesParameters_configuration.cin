/*@!Encoding:1252*/
includes
{
  
}

variables
{
  // DEFAULT CYCLE CONFIGURATION VALUES.
  byte bDefaultCycleValues[384] = { // Updated for R2.0
        0x46, 0x19, 0x00, 0x1A, 0x00, 0x01, 0x02, 0xFF, 0xFF, 0xFF, 0xFF, 0xFF, // NVP_BLOCK_ID_CYCLE_0  - PreSafe 1 Low Force  (LVL1)
        0x46, 0x19, 0x00, 0x1A, 0x03, 0x01, 0x02, 0xFF, 0xFF, 0xFF, 0xFF, 0xFF, // NVP_BLOCK_ID_CYCLE_1  - PreSafe 2 Low Force  (LVL3)
        0x46, 0x19, 0x00, 0x1A, 0x04, 0x05, 0x01, 0x02, 0xFF, 0xFF, 0xFF, 0xFF, // NVP_BLOCK_ID_CYCLE_2  - PreSafe 3 Low Force  (LVL4)
        0x46, 0x19, 0x00, 0x1A, 0x06, 0x07, 0x01, 0x02, 0xFF, 0xFF, 0xFF, 0xFF, // NVP_BLOCK_ID_CYCLE_3  - PreSafe 4 High Force (LVL5)
        0xFF, 0xFF, 0xFF, 0xFF, 0xFF, 0xFF, 0xFF, 0xFF, 0xFF, 0xFF, 0xFF, 0xFF, // NVP_BLOCK_ID_CYCLE_4
        0xFF, 0xFF, 0xFF, 0xFF, 0xFF, 0xFF, 0xFF, 0xFF, 0xFF, 0xFF, 0xFF, 0xFF, // NVP_BLOCK_ID_CYCLE_5
        0xFF, 0xFF, 0xFF, 0xFF, 0xFF, 0xFF, 0xFF, 0xFF, 0xFF, 0xFF, 0xFF, 0xFF, // NVP_BLOCK_ID_CYCLE_6
        0xFF, 0xFF, 0xFF, 0xFF, 0xFF, 0xFF, 0xFF, 0xFF, 0xFF, 0xFF, 0xFF, 0xFF, // NVP_BLOCK_ID_CYCLE_7
        0xFF, 0xFF, 0xFF, 0xFF, 0xFF, 0xFF, 0xFF, 0xFF, 0xFF, 0xFF, 0xFF, 0xFF, // NVP_BLOCK_ID_CYCLE_8
        0xFF, 0xFF, 0xFF, 0xFF, 0xFF, 0xFF, 0xFF, 0xFF, 0xFF, 0xFF, 0xFF, 0xFF, // NVP_BLOCK_ID_CYCLE_9
        0xFF, 0xFF, 0xFF, 0xFF, 0xFF, 0xFF, 0xFF, 0xFF, 0xFF, 0xFF, 0xFF, 0xFF, // NVP_BLOCK_ID_CYCLE_10
        0xFF, 0xFF, 0xFF, 0xFF, 0xFF, 0xFF, 0xFF, 0xFF, 0xFF, 0xFF, 0xFF, 0xFF, // NVP_BLOCK_ID_CYCLE_11
        0xFF, 0xFF, 0xFF, 0xFF, 0xFF, 0xFF, 0xFF, 0xFF, 0xFF, 0xFF, 0xFF, 0xFF, // NVP_BLOCK_ID_CYCLE_12
        0xFF, 0xFF, 0xFF, 0xFF, 0xFF, 0xFF, 0xFF, 0xFF, 0xFF, 0xFF, 0xFF, 0xFF, // NVP_BLOCK_ID_CYCLE_13
        0xFF, 0xFF, 0xFF, 0xFF, 0xFF, 0xFF, 0xFF, 0xFF, 0xFF, 0xFF, 0xFF, 0xFF, // NVP_BLOCK_ID_CYCLE_14
        0xFF, 0xFF, 0xFF, 0xFF, 0xFF, 0xFF, 0xFF, 0xFF, 0xFF, 0xFF, 0xFF, 0xFF, // NVP_BLOCK_ID_CYCLE_15
        0xFF, 0xFF, 0xFF, 0xFF, 0xFF, 0xFF, 0xFF, 0xFF, 0xFF, 0xFF, 0xFF, 0xFF, // NVP_BLOCK_ID_CYCLE_16
        0xFF, 0xFF, 0xFF, 0xFF, 0xFF, 0xFF, 0xFF, 0xFF, 0xFF, 0xFF, 0xFF, 0xFF, // NVP_BLOCK_ID_CYCLE_17
        0x28, 0x21, 0x00, 0x1A, 0x14, 0x15, 0x16, 0x17, 0x18, 0x19, 0x1A, 0xFF, // NVP_BLOCK_ID_CYCLE_18 - BSR 0
        0xFF, 0xFF, 0xFF, 0xFF, 0xFF, 0xFF, 0xFF, 0xFF, 0xFF, 0xFF, 0xFF, 0xFF, // NVP_BLOCK_ID_CYCLE_19
        0xFF, 0xFF, 0xFF, 0xFF, 0xFF, 0xFF, 0xFF, 0xFF, 0xFF, 0xFF, 0xFF, 0xFF, // NVP_BLOCK_ID_CYCLE_20
        0x29, 0x20, 0x00, 0xFF, 0x0A, 0x0B, 0xFF, 0xFF, 0xFF, 0xFF, 0xFF, 0xFF, // NVP_BLOCK_ID_CYCLE_21 - Haptic Warning 1-1(tensioning level 1)
        0x46, 0x19, 0x00, 0x1A, 0x0C, 0x0D, 0xFF, 0xFF, 0xFF, 0xFF, 0xFF, 0xFF, // NVP_BLOCK_ID_CYCLE_22 - Haptic Warning 1-2(tensioning level 2)
        0xFF, 0xFF, 0xFF, 0xFF, 0xFF, 0xFF, 0xFF, 0xFF, 0xFF, 0xFF, 0xFF, 0xFF, // NVP_BLOCK_ID_CYCLE_23 - Haptic Warning 2-1
        0xFF, 0xFF, 0xFF, 0xFF, 0xFF, 0xFF, 0xFF, 0xFF, 0xFF, 0xFF, 0xFF, 0xFF, // NVP_BLOCK_ID_CYCLE_24 - Haptic Warning 2-2
        0x29, 0x20, 0x00, 0xFF, 0x0F, 0x10, 0x11, 0xFF, 0xFF, 0xFF, 0xFF, 0xFF, // NVP_BLOCK_ID_CYCLE_25 - Start-Up
        0x29, 0x20, 0x00, 0xFF, 0x0F, 0x10, 0x11, 0xFF, 0xFF, 0xFF, 0xFF, 0xFF, // NVP_BLOCK_ID_CYCLE_26 - Hard Release
        0x29, 0x20, 0x00, 0xFF, 0x0F, 0x10, 0x11, 0xFF, 0xFF, 0xFF, 0xFF, 0xFF, // NVP_BLOCK_ID_CYCLE_27 - Smooth Release
        0x29, 0x20, 0x00, 0xFF, 0x0F, 0x10, 0x11, 0xFF, 0xFF, 0xFF, 0xFF, 0xFF, // NVP_BLOCK_ID_CYCLE_28 - Backup Release
        0xFF, 0xFF, 0xFF, 0xFF, 0xFF, 0xFF, 0xFF, 0xFF, 0xFF, 0xFF, 0xFF, 0xFF, // NVP_BLOCK_ID_CYCLE_29 - AEE
        0xFF, 0xFF, 0xFF, 0xFF, 0xFF, 0xFF, 0xFF, 0xFF, 0xFF, 0xFF, 0xFF, 0xFF, // NVP_BLOCK_ID_CYCLE_30 - AEE
        0xFF, 0xFF, 0xFF, 0xFF, 0xFF, 0xFF, 0xFF, 0xFF, 0xFF, 0xFF, 0xFF, 0xFF};// NVP_BLOCK_ID_CYCLE_31
  
  // DEFAULT STEPS LIBRARY.
  byte bDefaultStepsLibrary[960] = { // Updated for R2.0
        0x00, 0xC8, 0x38, 0x84, 0xF0, 0x00, 0xFF, 0xFF, // Step_0
        0x0D, 0xAC, 0x1A, 0x09, 0x00, 0x00, 0xFF, 0xFF, // Step_1
        0x00, 0x0A, 0x00, 0x84, 0x00, 0x00, 0xFF, 0xFF, // Step_2
        0x00, 0x28, 0x38, 0x84, 0xF4, 0x00, 0xFF, 0xFF, // Step_3
        0x00, 0x0A, 0x2C, 0x84, 0xF0, 0x00, 0xFF, 0xFF, // Step_4
        0x00, 0x28, 0x20, 0x01, 0x00, 0x00, 0xFF, 0xFF, // Step_5
        0x00, 0x02, 0x38, 0x84, 0xF4, 0x00, 0xFF, 0xFF, // Step_6
        0x00, 0x28, 0x30, 0x01, 0x00, 0x00, 0xFF, 0xFF, // Step_7
        0xFF, 0xFF, 0xFF, 0xFF, 0xFF, 0xFF, 0xFF, 0xFF, // Step_8
        0xFF, 0xFF, 0xFF, 0xFF, 0xFF, 0xFF, 0xFF, 0xFF, // Step_9
        0x00, 0x14, 0x0E, 0x84, 0x00, 0x00, 0xFF, 0xFF, // Step_10 - HWA 0-0 s1
        0x01, 0xF4, 0x0E, 0x14, 0x60, 0x20, 0xFF, 0xFF, // Step_11 - HWA0-0 s2
        0x00, 0x02, 0x14, 0x04, 0x00, 0x00, 0xFF, 0xFF, // Step_12 - HWA0-1 s1
        0x00, 0x04, 0x04, 0x04, 0x00, 0x00, 0xFF, 0xFF, // Step_13 - HWA0-1 s2
        0xFF, 0xFF, 0xFF, 0xFF, 0xFF, 0xFF, 0xFF, 0xFF, // Step_14
        0x00, 0x0A, 0xF5, 0x84, 0x00, 0x10, 0xFF, 0xFF, // Step_15
        0x00, 0x32, 0xF5, 0x04, 0x00, 0x10, 0xFF, 0xFF, // Step_16
        0x00, 0x0A, 0x00, 0x80, 0x00, 0x00, 0xFF, 0xFF, // Step_17
        0xFF, 0xFF, 0xFF, 0xFF, 0xFF, 0xFF, 0xFF, 0xFF, // Step_18
        0xFF, 0xFF, 0xFF, 0xFF, 0xFF, 0xFF, 0xFF, 0xFF, // Step_19
        0x00, 0x02, 0x03, 0x04, 0x00, 0x00, 0xFF, 0xFF, // Step_20 - BSR
        0x00, 0x46, 0x0C, 0x84, 0x38, 0x10, 0xFF, 0xFF, // Step_21
        0x00, 0x82, 0x0C, 0x84, 0x38, 0x10, 0xFF, 0xFF, // Step_22
        0x01, 0xF4, 0x08, 0x81, 0x18, 0x10, 0xFF, 0xFF, // Step_23
        0x03, 0xE8, 0x0C, 0x14, 0x38, 0x00, 0xFF, 0xFF, // Step_24
        0x00, 0x64, 0x0E, 0x84, 0x64, 0x10, 0xFF, 0xFF, // Step_25
        0x00, 0x0A, 0x00, 0x84, 0x00, 0x00, 0xFF, 0xFF, // Step_26
        0xFF, 0xFF, 0xFF, 0xFF, 0xFF, 0xFF, 0xFF, 0xFF, // Step_27
        0xFF, 0xFF, 0xFF, 0xFF, 0xFF, 0xFF, 0xFF, 0xFF, // Step_28
        0xFF, 0xFF, 0xFF, 0xFF, 0xFF, 0xFF, 0xFF, 0xFF, // Step_29
        0xFF, 0xFF, 0xFF, 0xFF, 0xFF, 0xFF, 0xFF, 0xFF, // Step_30
        0xFF, 0xFF, 0xFF, 0xFF, 0xFF, 0xFF, 0xFF, 0xFF, // Step_31
        0xFF, 0xFF, 0xFF, 0xFF, 0xFF, 0xFF, 0xFF, 0xFF, // Step_32
        0xFF, 0xFF, 0xFF, 0xFF, 0xFF, 0xFF, 0xFF, 0xFF, // Step_33
        0xFF, 0xFF, 0xFF, 0xFF, 0xFF, 0xFF, 0xFF, 0xFF, // Step_34
        0xFF, 0xFF, 0xFF, 0xFF, 0xFF, 0xFF, 0xFF, 0xFF, // Step_35
        0xFF, 0xFF, 0xFF, 0xFF, 0xFF, 0xFF, 0xFF, 0xFF, // Step_36
        0xFF, 0xFF, 0xFF, 0xFF, 0xFF, 0xFF, 0xFF, 0xFF, // Step_37
        0xFF, 0xFF, 0xFF, 0xFF, 0xFF, 0xFF, 0xFF, 0xFF, // Step_38
        0xFF, 0xFF, 0xFF, 0xFF, 0xFF, 0xFF, 0xFF, 0xFF, // Step_39
        0xFF, 0xFF, 0xFF, 0xFF, 0xFF, 0xFF, 0xFF, 0xFF, // Step_40
        0xFF, 0xFF, 0xFF, 0xFF, 0xFF, 0xFF, 0xFF, 0xFF, // Step_41
        0xFF, 0xFF, 0xFF, 0xFF, 0xFF, 0xFF, 0xFF, 0xFF, // Step_42
        0xFF, 0xFF, 0xFF, 0xFF, 0xFF, 0xFF, 0xFF, 0xFF, // Step_43
        0xFF, 0xFF, 0xFF, 0xFF, 0xFF, 0xFF, 0xFF, 0xFF, // Step_44
        0xFF, 0xFF, 0xFF, 0xFF, 0xFF, 0xFF, 0xFF, 0xFF, // Step_45
        0xFF, 0xFF, 0xFF, 0xFF, 0xFF, 0xFF, 0xFF, 0xFF, // Step_46
        0xFF, 0xFF, 0xFF, 0xFF, 0xFF, 0xFF, 0xFF, 0xFF, // Step_47
        0xFF, 0xFF, 0xFF, 0xFF, 0xFF, 0xFF, 0xFF, 0xFF, // Step_48
        0xFF, 0xFF, 0xFF, 0xFF, 0xFF, 0xFF, 0xFF, 0xFF, // Step_49
        0xFF, 0xFF, 0xFF, 0xFF, 0xFF, 0xFF, 0xFF, 0xFF, // Step_50
        0xFF, 0xFF, 0xFF, 0xFF, 0xFF, 0xFF, 0xFF, 0xFF, // Step_51
        0xFF, 0xFF, 0xFF, 0xFF, 0xFF, 0xFF, 0xFF, 0xFF, // Step_52
        0xFF, 0xFF, 0xFF, 0xFF, 0xFF, 0xFF, 0xFF, 0xFF, // Step_53
        0xFF, 0xFF, 0xFF, 0xFF, 0xFF, 0xFF, 0xFF, 0xFF, // Step_54
        0xFF, 0xFF, 0xFF, 0xFF, 0xFF, 0xFF, 0xFF, 0xFF, // Step_55
        0xFF, 0xFF, 0xFF, 0xFF, 0xFF, 0xFF, 0xFF, 0xFF, // Step_56
        0xFF, 0xFF, 0xFF, 0xFF, 0xFF, 0xFF, 0xFF, 0xFF, // Step_57
        0xFF, 0xFF, 0xFF, 0xFF, 0xFF, 0xFF, 0xFF, 0xFF, // Step_58
        0xFF, 0xFF, 0xFF, 0xFF, 0xFF, 0xFF, 0xFF, 0xFF, // Step_59
        0xFF, 0xFF, 0xFF, 0xFF, 0xFF, 0xFF, 0xFF, 0xFF, // Step_60
        0xFF, 0xFF, 0xFF, 0xFF, 0xFF, 0xFF, 0xFF, 0xFF, // Step_61
        0xFF, 0xFF, 0xFF, 0xFF, 0xFF, 0xFF, 0xFF, 0xFF, // Step_62
        0xFF, 0xFF, 0xFF, 0xFF, 0xFF, 0xFF, 0xFF, 0xFF, // Step_63
        0xFF, 0xFF, 0xFF, 0xFF, 0xFF, 0xFF, 0xFF, 0xFF, // Step_64
        0xFF, 0xFF, 0xFF, 0xFF, 0xFF, 0xFF, 0xFF, 0xFF, // Step_65
        0xFF, 0xFF, 0xFF, 0xFF, 0xFF, 0xFF, 0xFF, 0xFF, // Step_66
        0xFF, 0xFF, 0xFF, 0xFF, 0xFF, 0xFF, 0xFF, 0xFF, // Step_67
        0xFF, 0xFF, 0xFF, 0xFF, 0xFF, 0xFF, 0xFF, 0xFF, // Step_68
        0xFF, 0xFF, 0xFF, 0xFF, 0xFF, 0xFF, 0xFF, 0xFF, // Step_69
        0xFF, 0xFF, 0xFF, 0xFF, 0xFF, 0xFF, 0xFF, 0xFF, // Step_70
        0xFF, 0xFF, 0xFF, 0xFF, 0xFF, 0xFF, 0xFF, 0xFF, // Step_71
        0xFF, 0xFF, 0xFF, 0xFF, 0xFF, 0xFF, 0xFF, 0xFF, // Step_72
        0xFF, 0xFF, 0xFF, 0xFF, 0xFF, 0xFF, 0xFF, 0xFF, // Step_73
        0xFF, 0xFF, 0xFF, 0xFF, 0xFF, 0xFF, 0xFF, 0xFF, // Step_74
        0xFF, 0xFF, 0xFF, 0xFF, 0xFF, 0xFF, 0xFF, 0xFF, // Step_75
        0xFF, 0xFF, 0xFF, 0xFF, 0xFF, 0xFF, 0xFF, 0xFF, // Step_76
        0xFF, 0xFF, 0xFF, 0xFF, 0xFF, 0xFF, 0xFF, 0xFF, // Step_77
        0xFF, 0xFF, 0xFF, 0xFF, 0xFF, 0xFF, 0xFF, 0xFF, // Step_78
        0xFF, 0xFF, 0xFF, 0xFF, 0xFF, 0xFF, 0xFF, 0xFF, // Step_79
        0xFF, 0xFF, 0xFF, 0xFF, 0xFF, 0xFF, 0xFF, 0xFF, // Step_80
        0xFF, 0xFF, 0xFF, 0xFF, 0xFF, 0xFF, 0xFF, 0xFF, // Step_81
        0xFF, 0xFF, 0xFF, 0xFF, 0xFF, 0xFF, 0xFF, 0xFF, // Step_82
        0xFF, 0xFF, 0xFF, 0xFF, 0xFF, 0xFF, 0xFF, 0xFF, // Step_83
        0xFF, 0xFF, 0xFF, 0xFF, 0xFF, 0xFF, 0xFF, 0xFF, // Step_84
        0xFF, 0xFF, 0xFF, 0xFF, 0xFF, 0xFF, 0xFF, 0xFF, // Step_85
        0xFF, 0xFF, 0xFF, 0xFF, 0xFF, 0xFF, 0xFF, 0xFF, // Step_86
        0xFF, 0xFF, 0xFF, 0xFF, 0xFF, 0xFF, 0xFF, 0xFF, // Step_87
        0xFF, 0xFF, 0xFF, 0xFF, 0xFF, 0xFF, 0xFF, 0xFF, // Step_88
        0xFF, 0xFF, 0xFF, 0xFF, 0xFF, 0xFF, 0xFF, 0xFF, // Step_89
        0xFF, 0xFF, 0xFF, 0xFF, 0xFF, 0xFF, 0xFF, 0xFF, // Step_90
        0xFF, 0xFF, 0xFF, 0xFF, 0xFF, 0xFF, 0xFF, 0xFF, // Step_91
        0xFF, 0xFF, 0xFF, 0xFF, 0xFF, 0xFF, 0xFF, 0xFF, // Step_92
        0xFF, 0xFF, 0xFF, 0xFF, 0xFF, 0xFF, 0xFF, 0xFF, // Step_93
        0xFF, 0xFF, 0xFF, 0xFF, 0xFF, 0xFF, 0xFF, 0xFF, // Step_94
        0xFF, 0xFF, 0xFF, 0xFF, 0xFF, 0xFF, 0xFF, 0xFF, // Step_95
        0xFF, 0xFF, 0xFF, 0xFF, 0xFF, 0xFF, 0xFF, 0xFF, // Step_96
        0xFF, 0xFF, 0xFF, 0xFF, 0xFF, 0xFF, 0xFF, 0xFF, // Step_97
        0xFF, 0xFF, 0xFF, 0xFF, 0xFF, 0xFF, 0xFF, 0xFF, // Step_98
        0xFF, 0xFF, 0xFF, 0xFF, 0xFF, 0xFF, 0xFF, 0xFF, // Step_99
        0xFF, 0xFF, 0xFF, 0xFF, 0xFF, 0xFF, 0xFF, 0xFF, // Step_100
        0xFF, 0xFF, 0xFF, 0xFF, 0xFF, 0xFF, 0xFF, 0xFF, // Step_101
        0xFF, 0xFF, 0xFF, 0xFF, 0xFF, 0xFF, 0xFF, 0xFF, // Step_102
        0xFF, 0xFF, 0xFF, 0xFF, 0xFF, 0xFF, 0xFF, 0xFF, // Step_103
        0xFF, 0xFF, 0xFF, 0xFF, 0xFF, 0xFF, 0xFF, 0xFF, // Step_104
        0xFF, 0xFF, 0xFF, 0xFF, 0xFF, 0xFF, 0xFF, 0xFF, // Step_105
        0xFF, 0xFF, 0xFF, 0xFF, 0xFF, 0xFF, 0xFF, 0xFF, // Step_106
        0xFF, 0xFF, 0xFF, 0xFF, 0xFF, 0xFF, 0xFF, 0xFF, // Step_107
        0xFF, 0xFF, 0xFF, 0xFF, 0xFF, 0xFF, 0xFF, 0xFF, // Step_108
        0xFF, 0xFF, 0xFF, 0xFF, 0xFF, 0xFF, 0xFF, 0xFF, // Step_109
        0xFF, 0xFF, 0xFF, 0xFF, 0xFF, 0xFF, 0xFF, 0xFF, // Step_110
        0xFF, 0xFF, 0xFF, 0xFF, 0xFF, 0xFF, 0xFF, 0xFF, // Step_111
        0xFF, 0xFF, 0xFF, 0xFF, 0xFF, 0xFF, 0xFF, 0xFF, // Step_112
        0xFF, 0xFF, 0xFF, 0xFF, 0xFF, 0xFF, 0xFF, 0xFF, // Step_113
        0xFF, 0xFF, 0xFF, 0xFF, 0xFF, 0xFF, 0xFF, 0xFF, // Step_114
        0xFF, 0xFF, 0xFF, 0xFF, 0xFF, 0xFF, 0xFF, 0xFF, // Step_115
        0xFF, 0xFF, 0xFF, 0xFF, 0xFF, 0xFF, 0xFF, 0xFF, // Step_116
        0xFF, 0xFF, 0xFF, 0xFF, 0xFF, 0xFF, 0xFF, 0xFF, // Step_117
        0xFF, 0xFF, 0xFF, 0xFF, 0xFF, 0xFF, 0xFF, 0xFF, // Step_118
        0xFF, 0xFF, 0xFF, 0xFF, 0xFF, 0xFF, 0xFF, 0xFF};// Step_119
}

