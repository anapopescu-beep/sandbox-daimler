/*@!Encoding:1252*/
includes
{
  
}

variables
{
  byte bDefaultCalibration[40] = {0x00, 0x32, 0x00, 0x89, 0x01, 0x36, 0x03, 0xFF, 0x03, 0xFF, 0x00, 0x33, 0x00, 0x7B, 0x01, 0x08, 0x02, 0x8A, 0x03, 0xFF, 0x00, 0x00, 0x04, 0x56, 0x08, 0x18, 0x1C, 0x01, 0x1C, 0x01, 0x00, 0x00, 0x03, 0x47, 0x07, 0xAC, 0x14, 0x4E, 0x20, 0x98};
  
  char cLogPathAndName[200] ="c:\\\\MKS\\\\SWVR_PP_CI_Activities\\\\CANOE_Test_PLT\\\\View_Test\\\\Tests\\\\Tests_Verification_Qualification\\\\Automatic_Tests\\\\CANOE_PTL_Config\\\\Logs\\\\";
  char cFullLogPath[600];
  char cLogName[300];

  //PC identification
  char cTesterName[4] = "CGA";
  char sPCId[20] = "ART-OF-WD3172";
  
  char cCAN_CaseId[11] = "RBE-COM-08";
  char cPowerBoardPartNumber[13] = "AEEC15_0085R";
  
  //DUT
  char cDUT[50] = "AUDI TR6 PPMI";
  
  //Power supply 
  char cPowerSupply1Id[11] = "RBE-PWR-19";
    
  //Mockup 
  char cMOTHER_BOARD[50] = "AEEC17_0026R"; 
  char cPOWER_BOARD[50] = "19M210"; 
  char cSBC_BOARD[50] = "19M254"; 
  char cMCU[50] = "19M085";
  
  //Multimeter 
  char sMultimeterAddress[100] = "USB0::0x164E::0x0DAD::TW00041293::INSTR"; 
  
  //Scope  
  char sScopeAddress[100] = "USB::0x0699::0x0456::C013833::INSTR";
  
  //Signal generator 
  char sSignalGeneratorAddress[100] = "USB::0x0699::0x034A::C020918::INSTR";  
  
  //EIB 
  int iEIBport = 9;
  
  //HESS
  int iHESSport = 4;
  int iBaudrateHESS = 9600;   
  int iParityHESS = 0;	
  int iStopbitHESS = 1;
	int iByteSizeHESS = 8;
}


