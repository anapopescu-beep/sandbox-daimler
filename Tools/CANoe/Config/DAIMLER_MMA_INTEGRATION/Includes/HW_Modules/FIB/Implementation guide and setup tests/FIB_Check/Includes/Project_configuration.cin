/*@!Encoding:1252*/
includes
{
  #include "Project_functions.cin"
  #include "Testbench_configuration.cin"
  #include "PowerSupplyControl.cin"
  #include "FIB_Control.cin"
}

variables
{
  char _sSwVersion[13] = "ER01473H.P30"; // Defines software version.
  char _sSwReleaseName[4] ="P30";
}
