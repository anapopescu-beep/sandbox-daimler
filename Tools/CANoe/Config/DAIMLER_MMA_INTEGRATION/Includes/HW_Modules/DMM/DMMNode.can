/*@!Encoding:1252*/
includes
{
  
}

variables
{

}

on sysvar_update sysvar::DigitalMultimeter::sysGetDCVButton
{
If (@this == 1)
{
@sysvar::DigitalMultimeter::sysDMMTrigger=1;

}
}

on sysvar_update sysvar::DigitalMultimeter::sysGetDCIButton
{
If (@this == 1)
{
@sysvar::DigitalMultimeter::sysDMMTrigger=1;

}
}

on sysvar_update sysvar::DigitalMultimeter::sysGetACVButton
{
If (@this == 1)
{
@sysvar::DigitalMultimeter::sysDMMTrigger=1;

}
}

on sysvar_update sysvar::DigitalMultimeter::sysGetACIButton
{
If (@this == 1)
{
@sysvar::DigitalMultimeter::sysDMMTrigger=1;

}
}

on sysvar_update sysvar::DigitalMultimeter::sysGetTempButton
{
If (@this == 1)
{
@sysvar::DigitalMultimeter::sysDMMTrigger=1;

}
}

on sysvar_update sysvar::DigitalMultimeter::sysGet10TempButton
{
If (@this == 1)
{
@sysvar::DigitalMultimeter::sysDMMTrigger=1;

}
}