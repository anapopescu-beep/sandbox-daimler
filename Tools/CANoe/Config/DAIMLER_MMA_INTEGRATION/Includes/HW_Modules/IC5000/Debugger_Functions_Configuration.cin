/*@!Encoding:1252*/
variables
{
 char RUN_SUCCESSFUL [256] =            "RUN";
 char STOP_SUCCESSFUL [256] =           "STOP";
 char RESET_SUCCESSFUL [256] =          "RESET";
 char STEP_IN_SUCCESSFUL[256] =         "STEP IN";
 char STEP_OVER_SUCCESSFUL[256] =       "STEP OVER";
 char RUN_UNTIL_RETURN_SUCCESSFUL[256] ="runUntilReturn executed";
 char BP_SET_SUCCESSFUL[256] =        "BP set";
 char DELETE_ALL_BP_SUCCESSFUL [256]=   "Deleted all";
 char RUN_UNTIL_FUNCTION_SUCCESFUL[256]="Current location:";
 char W8_UNTIL_BP_SUCCESSFUL [256]=     "BP was reached";
 char IS_CPU_STOP_AT_BP_SUCCESFUL[256]= "CPU stopped";
}