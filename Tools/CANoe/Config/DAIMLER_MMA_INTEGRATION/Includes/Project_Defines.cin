/*@!Encoding:1252*/
variables
{
const CYCLE_0 = 0;
const CYCLE_1 = 1;
const CYCLE_2 = 2;
const CYCLE_3 = 3;
const CYCLE_14 = 14;
const CYCLE_18 = 18;
const CYCLE_26 = 26;
const NO_CYCLE = 255;
}