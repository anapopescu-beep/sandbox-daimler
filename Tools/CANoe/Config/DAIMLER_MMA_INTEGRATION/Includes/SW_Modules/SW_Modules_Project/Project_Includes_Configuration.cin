/*@!Encoding:1252*/
includes
{
  // <<< CORE Software Modules >>>
  #include "..\SW_Modules_Core\Core_Functions.cin"
  
  
  // <<< CORE Hardware Modules >>>
  #include "..\..\HW_Modules\PSM\PowerSupplyControl.cin"
//  #include "..\..\HW_Modules\OSC\OSCILLOSCOPE_Control.cin"
  #include "..\..\HW_Modules\FIB\FIB_Control.cin"
//  #include "..\..\HW_Modules\EIB\EIB_Control.cin"
//  #include "..\..\HW_Modules\DMM\DMMControl.cin"
//  #include "..\..\HW_Modules\TMP\ThermalChamberControl.cin"
  #include "..\..\HW_Modules\IC5000\Debugger_Functions.cin"
  
  // <<< Project specific modules >>>
  #include "Core_Functions_Configuration.cin"
  #include "Project_Functions.cin"
  #include "Project_RAMAddress_configuration.cin"
  #include "Project_DTC_Configuration.cin"
  #include "PPMI_Functions_Configuration.cin"
  #include "..\SW_Modules_PPMI\PPMI_Functions.cin"
  #include "..\SW_Modules_PPMI\PPMI_Profile_Configuration.cin"
  #include "..\SW_Modules_PPMI\PPMI_CyclesParameters_Configuration.cin"
}

variables
{

}