/*@!Encoding:1252*/
includes
{
  
}

variables
{

  const NOLVL              = 0x00;
  const PRE_SAFE_1         = 0x01; // Low Force  (LVL1).
  const HAPTIC_WARNING1    = 0x02; // Low Force  (LVL2).
  const HAPTIC_WARNING1_P1 = 0x55; // Phase 1 of Haptic Warning 0.
  const PRE_SAFE_3         = 0x03; // Low Force  (LVL3).
  const PRE_SAFE_4         = 0x04; // Low Force  (LVL4).
  const PRE_SAFE_5         = 0x05; // High Force (LVL5).
  const PRE_SAFE_6         = 0x06; // High Force (LVL6). // 0x04
  const PRE_SAFE_7         = 0x07; // High Force (LVL7). // 0x05
  const PRE_SAFE_8         = 0x08; 
  const PRE_SAFE_9         = 0x09; 
  const PRE_SAFE_10         = 0x10; 
  const PRE_SAFE_11         = 0x11;  
  const PRE_SAFE_12         = 0x12; 
  const PRE_SAFE_13         = 0x13;  
  const PRE_SAFE_14         = 0x14;  
  const PRE_SAFE_15         = 0x15; 
  
  const HAPTIC_WARNING2    = 0x16;
  const HAPTIC_WARNING3    = 0x17;
  const HAPTIC_WARNING4    = 0x18;
  
  const BSR_1              = 0x19;
  const BSR_2              = 0x20;
  const BSR_3              = 0x21;
  
  const PRE_SAFE_CURVE_1   = 0x22;
  const PRE_SAFE_CURVE_2   = 0x23;
  const PRE_SAFE_CURVE_3   = 0x24;
  const PRE_SAFE_CURVE_4   = 0x25;
  
  const RESERVED           = 0x44; // Reserved value. // 0x09
  const ANG_PROCESS        = 0x45; // ANG // 0x13
  const AEE_PROCESS        = 0x46; // AEE // 0x14
  
  const SOFT_RELEASE    = 0x1D;
  const HARD_RELEASE    = 0x1E;
  const BACKUP_RELEASE  = 0x1F;
  const START_UP        = 0x26;
  
  const REJECTED        = 0x3E;
  const INIT            = 0x3F;
  
  
  
  /*
  const NOLVL              = 0x00;
  const PRE_SAFE_1         = 0x01; // Low Force  (LVL1).
  const HAPTIC_WARNING1    = 0x02; // Low Force  (LVL2).
  const HAPTIC_WARNING1_P1 = 0x13; // Phase 1 of Haptic Warning 0.
  const PRE_SAFE_2         = 0x03; // Low Force  (LVL3).
  const PRE_SAFE_3         = 0x04; // Low Force  (LVL4).
  const PRE_SAFE_4         = 0x05; // High Force (LVL5).
  const PRE_SAFE_5         = 0x40; // High Force (LVL6). // 0x04
  const PRE_SAFE_6         = 0x41; // High Force (LVL7). // 0x05
  const PRE_SAFE_7         = 0x42; // High Force (LVL8). // 0x06
  const PRE_SAFE_8         = 0x43; // High Force (LVL9). // 0x07
  
  const PRE_SAFE_22        = 0x16; 
  
  const RESERVED           = 0x44; // Reserved value. // 0x09
  const ANG_PROCESS        = 0x45; // ANG // 0x13
  const AEE_PROCESS        = 0x46; // AEE // 0x14
  
  const BSR_1           = 0x1A;
  
  const SOFT_RELEASE    = 0x1D;
  const HARD_RELEASE    = 0x1E;
  const BACKUP_RELEASE  = 0x1F;
  const START_UP        = 0x20;
  
  const REJECTED        = 0x3E;
  const INIT            = 0x3F;

  */
  
  const Low     = 0x00;
  const High    = 0x01;
  const Comfort = 0x02;
  const Max     = 0x03;
  const RequestCounter = 0x04;
  
  struct Cycle_Characteristics {
    byte SF_ID;
    byte MF_ID;
    byte Launch_ID;
    byte DiagLaunch_ID;
    char Launch_Name[50];
    char DiagLaunch_Name[50];
    char SF_Name[50];
    char MF_Name[50];
  } CYCLE[double,31];
  
//*********************************************************************************************
}
//void InitCycleParameters()
//{
//  CYCLE[NOLVL]        .MF_ID            = 0xFF;
//  CYCLE[NOLVL]        .SF_ID            = 0x00;
//  CYCLE[NOLVL]        .Launch_ID        = 0x00;
//  CYCLE[NOLVL]        .DiagLaunch_ID    = 0x15;
//  strncpy(CYCLE[NOLVL].Launch_Name        , "OFF"      , 50);
//  strncpy(CYCLE[NOLVL].DiagLaunch_Name    , "NoCycle"  , 50);
//  strncpy(CYCLE[NOLVL].SF_Name            , "OFF"      , 50);
//  strncpy(CYCLE[NOLVL].MF_Name            , "NOLVL"    , 50);
//  
//  CYCLE[PRE_SAFE_1]        .MF_ID            = 0x00;
//  CYCLE[PRE_SAFE_1]        .SF_ID            = 0x01;
//  CYCLE[PRE_SAFE_1]        .Launch_ID        = 0x01;
//  CYCLE[PRE_SAFE_1]        .DiagLaunch_ID    = 0x00;
//  strncpy(CYCLE[PRE_SAFE_1].Launch_Name        , "PRE-SAFE 1"   , 50);
//  strncpy(CYCLE[PRE_SAFE_1].DiagLaunch_Name    , "PreCrash 0"   , 50);
//  strncpy(CYCLE[PRE_SAFE_1].SF_Name            , "STAGE1"       , 50);
//  strncpy(CYCLE[PRE_SAFE_1].MF_Name            , "LVL1"         , 50);
//  
//  CYCLE[HAPTIC_WARNING1]        .MF_ID            = 0x12;
//  CYCLE[HAPTIC_WARNING1]        .SF_ID            = 0x02;
//  CYCLE[HAPTIC_WARNING1]        .Launch_ID        = 0x02;
//  CYCLE[HAPTIC_WARNING1]        .DiagLaunch_ID    = 0x12;
//  strncpy(CYCLE[HAPTIC_WARNING1].Launch_Name        , "HAPTIC WARNING 0 PHASE 0", 50);
//  strncpy(CYCLE[HAPTIC_WARNING1].DiagLaunch_Name    , "Haptic Warning Phase 1"  , 50);
//  strncpy(CYCLE[HAPTIC_WARNING1].SF_Name            , "HAPTIC WARNING 0 PHASE 0", 50);
//  strncpy(CYCLE[HAPTIC_WARNING1].MF_Name            , "LVL2"                    , 50);
//  
//  CYCLE[HAPTIC_WARNING1_P1]        .MF_ID            = 0x13;
//  CYCLE[HAPTIC_WARNING1_P1]        .SF_ID            = 0x02;
//  CYCLE[HAPTIC_WARNING1_P1]        .Launch_ID        = 0x02;
//  CYCLE[HAPTIC_WARNING1_P1]        .DiagLaunch_ID    = 0x13;
//  strncpy(CYCLE[HAPTIC_WARNING1_P1].Launch_Name        , "HAPTIC WARNING 0 PHASE 1", 50);
//  strncpy(CYCLE[HAPTIC_WARNING1_P1].DiagLaunch_Name    , "Haptic Warning Phase 2"  , 50);
//  strncpy(CYCLE[HAPTIC_WARNING1_P1].SF_Name            , "HAPTIC WARNING 0 PHASE 1", 50);
//  strncpy(CYCLE[HAPTIC_WARNING1_P1].MF_Name            , "LVL2"                    , 50);
//  
//  CYCLE[PRE_SAFE_2]        .MF_ID            = 0x01;
//  CYCLE[PRE_SAFE_2]        .SF_ID            = 0x03;
//  CYCLE[PRE_SAFE_2]        .Launch_ID        = 0x03;
//  CYCLE[PRE_SAFE_2]        .DiagLaunch_ID    = 0x01;
//  strncpy(CYCLE[PRE_SAFE_2].Launch_Name        , "PRE-SAFE 2"  , 50);
//  strncpy(CYCLE[PRE_SAFE_2].DiagLaunch_Name    , "PreCrash 1"  , 50);
//  strncpy(CYCLE[PRE_SAFE_2].SF_Name            , "STAGE2"      , 50);
//  strncpy(CYCLE[PRE_SAFE_2].MF_Name            , "LVL3"        , 50);
//  
//  CYCLE[PRE_SAFE_3]        .MF_ID            = 0x02;
//  CYCLE[PRE_SAFE_3]        .SF_ID            = 0x04;
//  CYCLE[PRE_SAFE_3]        .Launch_ID        = 0x04;
//  CYCLE[PRE_SAFE_3]        .DiagLaunch_ID    = 0x02;
//  strncpy(CYCLE[PRE_SAFE_3].Launch_Name        , "PRE-SAFE 3"  , 50);
//  strncpy(CYCLE[PRE_SAFE_3].DiagLaunch_Name    , "PreCrash 2"  , 50);
//  strncpy(CYCLE[PRE_SAFE_3].SF_Name            , "STAGE3"      , 50);
//  strncpy(CYCLE[PRE_SAFE_3].MF_Name            , "LVL4"        , 50);
//  
//  CYCLE[PRE_SAFE_4]        .MF_ID            = 0x03;
//  CYCLE[PRE_SAFE_4]        .SF_ID            = 0x05;
//  CYCLE[PRE_SAFE_4]        .Launch_ID        = 0x05;
//  CYCLE[PRE_SAFE_4]        .DiagLaunch_ID    = 0x03;
//  strncpy(CYCLE[PRE_SAFE_4].Launch_Name        , "PRE-SAFE 4", 50);
//  strncpy(CYCLE[PRE_SAFE_4].DiagLaunch_Name    , "PreCrash 3"  , 50);
//  strncpy(CYCLE[PRE_SAFE_4].SF_Name            , "STAGE4"    , 50);
//  strncpy(CYCLE[PRE_SAFE_4].MF_Name            , "LVL5"      , 50);
//  
//  CYCLE[PRE_SAFE_5]        .MF_ID            = 0x04;
////CYCLE[PRE_SAFE_5]        .SF_ID            = 0x06;
//  CYCLE[PRE_SAFE_5]        .Launch_ID        = 0x06;
//  CYCLE[PRE_SAFE_5]        .DiagLaunch_ID    = 0x04;
//  strncpy(CYCLE[PRE_SAFE_5].Launch_Name        , "PRE-SAFE 5"  , 50);
//  strncpy(CYCLE[PRE_SAFE_5].DiagLaunch_Name    , "PreCrash 4"  , 50);
//  strncpy(CYCLE[PRE_SAFE_5].SF_Name            , "STAGE5"      , 50);
//  strncpy(CYCLE[PRE_SAFE_5].MF_Name            , "LVL6"        , 50);
//  
//  CYCLE[PRE_SAFE_6]        .MF_ID            = 0x05;
////CYCLE[PRE_SAFE_6]        .SF_ID            = 0x07;
//  CYCLE[PRE_SAFE_6]        .Launch_ID        = 0x07;
//  CYCLE[PRE_SAFE_6]        .DiagLaunch_ID    = 0x05;
//  strncpy(CYCLE[PRE_SAFE_6].Launch_Name        , "PRE-SAFE 6"  , 50);
//  strncpy(CYCLE[PRE_SAFE_6].DiagLaunch_Name    , "PreCrash 5"  , 50);
//  strncpy(CYCLE[PRE_SAFE_6].SF_Name            , "STAGE6"      , 50);
//  strncpy(CYCLE[PRE_SAFE_6].MF_Name            , "LVL7"        , 50);
//  
//  CYCLE[PRE_SAFE_7]        .MF_ID            = 0x06;
////CYCLE[PRE_SAFE_7]        .SF_ID            = 0x08;
//  CYCLE[PRE_SAFE_7]        .Launch_ID        = 0x08;
//  CYCLE[PRE_SAFE_7]        .DiagLaunch_ID    = 0x06;
//  strncpy(CYCLE[PRE_SAFE_7].Launch_Name        , "PRE-SAFE 7"  , 50);
//  strncpy(CYCLE[PRE_SAFE_7].DiagLaunch_Name    , "PreCrash 6"  , 50);
//  strncpy(CYCLE[PRE_SAFE_7].SF_Name            , "STAGE7"      , 50);
//  strncpy(CYCLE[PRE_SAFE_7].MF_Name            , "LVL8"        , 50);
//  
//  CYCLE[PRE_SAFE_8]        .MF_ID            = 0x07;
////CYCLE[PRE_SAFE_8]        .SF_ID            = 0x09;
//  CYCLE[PRE_SAFE_8]        .Launch_ID        = 0x09;
//  CYCLE[PRE_SAFE_8]        .DiagLaunch_ID    = 0x07;
//  strncpy(CYCLE[PRE_SAFE_8].Launch_Name        , "PRE-SAFE 8"  , 50);
//  strncpy(CYCLE[PRE_SAFE_8].DiagLaunch_Name    , "PreCrash 7"  , 50);
//  strncpy(CYCLE[PRE_SAFE_8].SF_Name            , "STAGE8"      , 50);
//  strncpy(CYCLE[PRE_SAFE_8].MF_Name            , "LVL9"        , 50);
//
//  CYCLE[PRE_SAFE_22]        .MF_ID            = 0x0E;
//  CYCLE[PRE_SAFE_22]        .SF_ID            = 0x16;
//  CYCLE[PRE_SAFE_22]        .Launch_ID        = 0x16;
////  CYCLE[PRE_SAFE_22]        .DiagLaunch_ID    = 0x07;
//  strncpy(CYCLE[PRE_SAFE_22].Launch_Name        , "PRE-SAFE Curve 1"  , 50);
//  strncpy(CYCLE[PRE_SAFE_22].DiagLaunch_Name    , "PreCrash 14"  , 50);
//  strncpy(CYCLE[PRE_SAFE_22].SF_Name            , "STAGE12"      , 50);
//  strncpy(CYCLE[PRE_SAFE_22].MF_Name            , "LVL14"        , 50);
//  
//  CYCLE[BSR_1]             .MF_ID            = 0x1A;
//  CYCLE[BSR_1]             .SF_ID            = 0x13;
////CYCLE[BSR_1]             .Launch_ID        = ; // Unbuckle - Buckle
//  CYCLE[BSR_1]             .DiagLaunch_ID    = 0x1A;
//  strncpy(CYCLE[BSR_1].Launch_Name        , "BSR 1" , 50);
//  strncpy(CYCLE[BSR_1].DiagLaunch_Name    , "BSR"   , 50);
//  strncpy(CYCLE[BSR_1].SF_Name            , "BSR 1" , 50);
//  strncpy(CYCLE[BSR_1].MF_Name            , "BSR 1" , 50);
//  
//  CYCLE[RESERVED]        .MF_ID            = 0x09;
////CYCLE[RESERVED]        .SF_ID            = ;
////CYCLE[RESERVED]        .Launch_ID        = ;
//  CYCLE[RESERVED]        .DiagLaunch_ID    = 0x09;
//  strncpy(CYCLE[RESERVED].Launch_Name        , "RESERVED" , 50);
//  strncpy(CYCLE[RESERVED].DiagLaunch_Name    , "Reserved" , 50);
//  strncpy(CYCLE[RESERVED].SF_Name            , "RESERVED" , 50);
//  strncpy(CYCLE[RESERVED].MF_Name            , "RESERVED" , 50);
//  
//  CYCLE[START_UP]        .MF_ID            = 0x20;
//  CYCLE[START_UP]        .SF_ID            = 0x3F;
////CYCLE[START_UP]        .Launch_ID        = 0x20;
//  CYCLE[START_UP]        .DiagLaunch_ID    = 0x20;
//  strncpy(CYCLE[START_UP].Launch_Name        , "START-UP", 50);
//  strncpy(CYCLE[START_UP].DiagLaunch_Name    , "Start-up" , 50);
//  strncpy(CYCLE[START_UP].SF_Name            , "START-UP", 50);
//  strncpy(CYCLE[START_UP].MF_Name            , "START-UP", 50);
//  
//  CYCLE[SOFT_RELEASE]        .MF_ID            = 0x1D;
////CYCLE[SOFT_RELEASE]        .SF_ID            = 0x1D;
////CYCLE[SOFT_RELEASE]        .Launch_ID        = 0x1D;
//  CYCLE[SOFT_RELEASE]        .DiagLaunch_ID    = 0x1D;
//  strncpy(CYCLE[SOFT_RELEASE].Launch_Name     , "SMOOTH-RELEASE" , 50);
//  strncpy(CYCLE[SOFT_RELEASE].DiagLaunch_Name , "Smooth Release ", 50);
//  strncpy(CYCLE[SOFT_RELEASE].SF_Name         , "SMOOTH-RELEASE" , 50);
//  strncpy(CYCLE[SOFT_RELEASE].MF_Name         , "SMOOTH-RELEASE" , 50);
//  
//  CYCLE[HARD_RELEASE]        .MF_ID            = 0x1E;
////CYCLE[HARD_RELEASE]        .SF_ID            = 0x1E;
////CYCLE[HARD_RELEASE]        .Launch_ID        = 0x1E;
//  CYCLE[HARD_RELEASE]        .DiagLaunch_ID    = 0x1E;
//  strncpy(CYCLE[HARD_RELEASE].Launch_Name     , "HARD_RELEASE", 50);
//  strncpy(CYCLE[HARD_RELEASE].DiagLaunch_Name , "Hard Release", 50);
//  strncpy(CYCLE[HARD_RELEASE].SF_Name         , "HARD_RELEASE", 50);
//  strncpy(CYCLE[HARD_RELEASE].MF_Name         , "HARD_RELEASE", 50);
//  
//  CYCLE[BACKUP_RELEASE]        .MF_ID            = 0x1F;
////CYCLE[BACKUP_RELEASE]        .SF_ID            = 0x1F;
////CYCLE[BACKUP_RELEASE]        .Launch_ID        = 0x1F;
//  CYCLE[BACKUP_RELEASE]        .DiagLaunch_ID    = 0x1F;
//  strncpy(CYCLE[BACKUP_RELEASE].Launch_Name     , "BACKUP_RELEASE", 50);
//  strncpy(CYCLE[BACKUP_RELEASE].DiagLaunch_Name , "Backup Release", 50);
//  strncpy(CYCLE[BACKUP_RELEASE].SF_Name         , "BACKUP_RELEASE", 50);
//  strncpy(CYCLE[BACKUP_RELEASE].MF_Name         , "BACKUP_RELEASE", 50);
//  
//  CYCLE[ANG_PROCESS]        .MF_ID            = 0x21;
////CYCLE[ANG_PROCESS]        .SF_ID            = 0x1F;
////CYCLE[ANG_PROCESS]        .Launch_ID        = 0x1F;
//  CYCLE[ANG_PROCESS]        .DiagLaunch_ID    = 0x21;
//  strncpy(CYCLE[ANG_PROCESS].Launch_Name     , "ANG_PROCESS", 50);
//  strncpy(CYCLE[ANG_PROCESS].DiagLaunch_Name , "ANG Process", 50);
//  strncpy(CYCLE[ANG_PROCESS].SF_Name         , "ANG_PROCESS", 50);
//  strncpy(CYCLE[ANG_PROCESS].MF_Name         , "ANG_PROCESS", 50);
//  
//  CYCLE[AEE_PROCESS]        .MF_ID            = 0x22;
////CYCLE[AEE_PROCESS]        .SF_ID            = 0x1F;
////CYCLE[AEE_PROCESS]        .Launch_ID        = 0x1F;
//  CYCLE[AEE_PROCESS]        .DiagLaunch_ID    = 0x22;
//  strncpy(CYCLE[AEE_PROCESS].Launch_Name     , "AEE_PROCESS", 50);
//  strncpy(CYCLE[AEE_PROCESS].DiagLaunch_Name , "AEE Process", 50);
//  strncpy(CYCLE[AEE_PROCESS].SF_Name         , "AEE_PROCESS", 50);
//  strncpy(CYCLE[AEE_PROCESS].MF_Name         , "AEE_PROCESS", 50);
//  
////CYCLE[REJECTED]        .MF_ID            = 0x3E;
//  CYCLE[REJECTED]        .SF_ID            = 0x3E;
////CYCLE[REJECTED]        .Launch_ID        = 0x3E;
////CYCLE[REJECTED]        .DiagLaunch_ID    = ;
//  strncpy(CYCLE[REJECTED].Launch_Name    , "REJECTED", 50);
//  strncpy(CYCLE[REJECTED].DiagLaunch_Name, "Rejected", 50);
//  strncpy(CYCLE[REJECTED].SF_Name        , "REJECTED", 50);
//  strncpy(CYCLE[REJECTED].MF_Name        , "REJECTED", 50);
//  
////CYCLE[INIT]        .MF_ID            = 0x3F;
//  CYCLE[INIT]        .SF_ID            = 0x3F;
////CYCLE[INIT]        .Launch_ID        = 0x3F;
////CYCLE[INIT]        .DiagLaunch_ID    = ;
//  strncpy(CYCLE[INIT].Launch_Name    , "INIT", 50);
//  strncpy(CYCLE[INIT].DiagLaunch_Name, "Init", 50);
//  strncpy(CYCLE[INIT].SF_Name        , "INIT", 50);
//  strncpy(CYCLE[INIT].MF_Name        , "INIT", 50);
//}

void InitCycleParameters()
{
  CYCLE[NOLVL]        .MF_ID            = 0xFF;
  CYCLE[NOLVL]        .SF_ID            = 0x00;
  CYCLE[NOLVL]        .Launch_ID        = 0x00;
  CYCLE[NOLVL]        .DiagLaunch_ID    = 0x15;
  strncpy(CYCLE[NOLVL].Launch_Name        , "OFF"      , 50);
  strncpy(CYCLE[NOLVL].DiagLaunch_Name    , "NoCycle"  , 50);
  strncpy(CYCLE[NOLVL].SF_Name            , "OFF"      , 50);
  strncpy(CYCLE[NOLVL].MF_Name            , "NOLVL"    , 50);
  
  CYCLE[PRE_SAFE_1]        .MF_ID            = 0x00;
  CYCLE[PRE_SAFE_1]        .SF_ID            = 0x01;
  CYCLE[PRE_SAFE_1]        .Launch_ID        = 0x01;
  CYCLE[PRE_SAFE_1]        .DiagLaunch_ID    = 0x00;
  strncpy(CYCLE[PRE_SAFE_1].Launch_Name        , "PRE_SAFE_1"   , 50);
  strncpy(CYCLE[PRE_SAFE_1].DiagLaunch_Name    , "Pre-Safe Level 1"   , 50);
  strncpy(CYCLE[PRE_SAFE_1].SF_Name            , "PRE_SAFE_1"       , 50);
  strncpy(CYCLE[PRE_SAFE_1].MF_Name            , "PRE_SAFE_1"         , 50);
  
  CYCLE[HAPTIC_WARNING1]        .MF_ID            = 0x12;
  CYCLE[HAPTIC_WARNING1]        .SF_ID            = 0x02;
  CYCLE[HAPTIC_WARNING1]        .Launch_ID        = 0x02;
  CYCLE[HAPTIC_WARNING1]        .DiagLaunch_ID    = 0x12;
  strncpy(CYCLE[HAPTIC_WARNING1].Launch_Name        , "HAPTIC WARNING 0 PHASE 0", 50);
  strncpy(CYCLE[HAPTIC_WARNING1].DiagLaunch_Name    , "Haptic Warning Phase 1"  , 50);
  strncpy(CYCLE[HAPTIC_WARNING1].SF_Name            , "HAPTIC WARNING 0 PHASE 0", 50);
  strncpy(CYCLE[HAPTIC_WARNING1].MF_Name            , "LVL2"                    , 50);
  
  CYCLE[HAPTIC_WARNING1_P1]        .MF_ID            = 0x13;
  CYCLE[HAPTIC_WARNING1_P1]        .SF_ID            = 0x02;
  CYCLE[HAPTIC_WARNING1_P1]        .Launch_ID        = 0x02;
  CYCLE[HAPTIC_WARNING1_P1]        .DiagLaunch_ID    = 0x13;
  strncpy(CYCLE[HAPTIC_WARNING1_P1].Launch_Name        , "HAPTIC WARNING 0 PHASE 1", 50);
  strncpy(CYCLE[HAPTIC_WARNING1_P1].DiagLaunch_Name    , "Haptic Warning Phase 2"  , 50);
  strncpy(CYCLE[HAPTIC_WARNING1_P1].SF_Name            , "HAPTIC WARNING 0 PHASE 1", 50);
  strncpy(CYCLE[HAPTIC_WARNING1_P1].MF_Name            , "LVL2"                    , 50);
  
  CYCLE[PRE_SAFE_3]        .MF_ID            = 0x01;
  CYCLE[PRE_SAFE_3]        .SF_ID            = 0x03;
  CYCLE[PRE_SAFE_3]        .Launch_ID        = 0x03;
  CYCLE[PRE_SAFE_3]        .DiagLaunch_ID    = 0x01;
  strncpy(CYCLE[PRE_SAFE_3].Launch_Name        , "PRE_SAFE_3"  , 50);
  strncpy(CYCLE[PRE_SAFE_3].DiagLaunch_Name    , "Pre-Safe Level 2"  , 50);
  strncpy(CYCLE[PRE_SAFE_3].SF_Name            , "PRE_SAFE_3"      , 50);
  strncpy(CYCLE[PRE_SAFE_3].MF_Name            , "PRE_SAFE_3"        , 50);
  
  CYCLE[PRE_SAFE_4]        .MF_ID            = 0x02;
  CYCLE[PRE_SAFE_4]        .SF_ID            = 0x04;
  CYCLE[PRE_SAFE_4]        .Launch_ID        = 0x04;
  CYCLE[PRE_SAFE_4]        .DiagLaunch_ID    = 0x02;
  strncpy(CYCLE[PRE_SAFE_4].Launch_Name        , "PRE_SAFE_4"  , 50);
  strncpy(CYCLE[PRE_SAFE_4].DiagLaunch_Name    , "Pre-Safe Level 3"  , 50);
  strncpy(CYCLE[PRE_SAFE_4].SF_Name            , "PRE_SAFE_4"      , 50);
  strncpy(CYCLE[PRE_SAFE_4].MF_Name            , "PRE_SAFE_4"        , 50);
  
  CYCLE[PRE_SAFE_5]        .MF_ID            = 0x03;
  CYCLE[PRE_SAFE_5]        .SF_ID            = 0x05;
  CYCLE[PRE_SAFE_5]        .Launch_ID        = 0x05;
  CYCLE[PRE_SAFE_5]        .DiagLaunch_ID    = 0x03;
  strncpy(CYCLE[PRE_SAFE_5].Launch_Name        , "PRE_SAFE_5", 50);
  strncpy(CYCLE[PRE_SAFE_5].DiagLaunch_Name    , "Pre-Safe Level 4"  , 50);
  strncpy(CYCLE[PRE_SAFE_5].SF_Name            , "PRE_SAFE_5"    , 50);
  strncpy(CYCLE[PRE_SAFE_5].MF_Name            , "PRE_SAFE_5"      , 50);
  
  CYCLE[PRE_SAFE_6]        .MF_ID            = 0x04;
  CYCLE[PRE_SAFE_6]        .SF_ID            = 0x06;
  CYCLE[PRE_SAFE_6]        .Launch_ID        = 0x06;
  CYCLE[PRE_SAFE_6]        .DiagLaunch_ID    = 0x04;
  strncpy(CYCLE[PRE_SAFE_6].Launch_Name        , "PRE_SAFE_6"  , 50);
  strncpy(CYCLE[PRE_SAFE_6].DiagLaunch_Name    , "Pre-Safe Level 5"  , 50);
  strncpy(CYCLE[PRE_SAFE_6].SF_Name            , "PRE_SAFE_6"      , 50);
  strncpy(CYCLE[PRE_SAFE_6].MF_Name            , "PRE_SAFE_6"        , 50);
  
  CYCLE[PRE_SAFE_7]        .MF_ID            = 0x05;
  CYCLE[PRE_SAFE_7]        .SF_ID            = 0x07;
  CYCLE[PRE_SAFE_7]        .Launch_ID        = 0x07;
  CYCLE[PRE_SAFE_7]        .DiagLaunch_ID    = 0x05;
  strncpy(CYCLE[PRE_SAFE_7].Launch_Name        , "PRE_SAFE_7"  , 50);
  strncpy(CYCLE[PRE_SAFE_7].DiagLaunch_Name    , "Pre-Safe Level 6"  , 50);
  strncpy(CYCLE[PRE_SAFE_7].SF_Name            , "PRE_SAFE_7"      , 50);
  strncpy(CYCLE[PRE_SAFE_7].MF_Name            , "PRE_SAFE_7"        , 50);
  
  CYCLE[PRE_SAFE_8]        .MF_ID            = 0x06;
  CYCLE[PRE_SAFE_8]        .SF_ID            = 0x08;
  CYCLE[PRE_SAFE_8]        .Launch_ID        = 0x08;
  CYCLE[PRE_SAFE_8]        .DiagLaunch_ID    = 0x06;
  strncpy(CYCLE[PRE_SAFE_8].Launch_Name        , "PRE_SAFE_8"  , 50);
  strncpy(CYCLE[PRE_SAFE_8].DiagLaunch_Name    , "Pre-Safe Level 7"  , 50);
  strncpy(CYCLE[PRE_SAFE_8].SF_Name            , "PRE_SAFE_8"      , 50);
  strncpy(CYCLE[PRE_SAFE_8].MF_Name            , "PRE_SAFE_8"        , 50);
  
  CYCLE[PRE_SAFE_9]        .MF_ID            = 0x07;
  CYCLE[PRE_SAFE_9]        .SF_ID            = 0x09;
  CYCLE[PRE_SAFE_9]        .Launch_ID        = 0x09;
  CYCLE[PRE_SAFE_9]        .DiagLaunch_ID    = 0x07;
  strncpy(CYCLE[PRE_SAFE_9].Launch_Name        , "PRE_SAFE_9"  , 50);
  strncpy(CYCLE[PRE_SAFE_9].DiagLaunch_Name    , "Pre-Safe Level 8"  , 50);
  strncpy(CYCLE[PRE_SAFE_9].SF_Name            , "PRE_SAFE_9"      , 50);
  strncpy(CYCLE[PRE_SAFE_9].MF_Name            , "PRE_SAFE_9"        , 50);
  
  CYCLE[PRE_SAFE_10]        .MF_ID            = 0x08;
  CYCLE[PRE_SAFE_10]        .SF_ID            = 0x0A;
  CYCLE[PRE_SAFE_10]        .Launch_ID        = 0x0A;
  CYCLE[PRE_SAFE_10]        .DiagLaunch_ID    = 0x08;
  strncpy(CYCLE[PRE_SAFE_10].Launch_Name        , "PRE_SAFE_10"  , 50);
  strncpy(CYCLE[PRE_SAFE_10].DiagLaunch_Name    , "Pre-Safe Level 9"  , 50);
  strncpy(CYCLE[PRE_SAFE_10].SF_Name            , "PRE_SAFE_10"      , 50);
  strncpy(CYCLE[PRE_SAFE_10].MF_Name            , "PRE_SAFE_10"        , 50);
  
  CYCLE[PRE_SAFE_11]        .MF_ID            = 0x09;
  CYCLE[PRE_SAFE_11]        .SF_ID            = 0x0B;
  CYCLE[PRE_SAFE_11]        .Launch_ID        = 0x0B;
  CYCLE[PRE_SAFE_11]        .DiagLaunch_ID    = 0x09;
  strncpy(CYCLE[PRE_SAFE_11].Launch_Name        , "PRE_SAFE_11"  , 50);
  strncpy(CYCLE[PRE_SAFE_11].DiagLaunch_Name    , "Pre-Safe Level 10"  , 50);
  strncpy(CYCLE[PRE_SAFE_11].SF_Name            , "PRE_SAFE_11"      , 50);
  strncpy(CYCLE[PRE_SAFE_11].MF_Name            , "PRE_SAFE_11"        , 50);
  
  CYCLE[PRE_SAFE_12]        .MF_ID            = 0x0A;
  CYCLE[PRE_SAFE_12]        .SF_ID            = 0x0C;
  CYCLE[PRE_SAFE_12]        .Launch_ID        = 0x0C;
  CYCLE[PRE_SAFE_12]        .DiagLaunch_ID    = 0x0A;
  strncpy(CYCLE[PRE_SAFE_12].Launch_Name        , "PRE_SAFE_12"  , 50);
  strncpy(CYCLE[PRE_SAFE_12].DiagLaunch_Name    , "Pre-Safe Level 11"  , 50);
  strncpy(CYCLE[PRE_SAFE_12].SF_Name            , "PRE_SAFE_12"      , 50);
  strncpy(CYCLE[PRE_SAFE_12].MF_Name            , "PRE_SAFE_12"        , 50);
  
  CYCLE[PRE_SAFE_13]        .MF_ID            = 0x0B;
  CYCLE[PRE_SAFE_13]        .SF_ID            = 0x0D;
  CYCLE[PRE_SAFE_13]        .Launch_ID        = 0x0D;
  CYCLE[PRE_SAFE_13]        .DiagLaunch_ID    = 0x0B;
  strncpy(CYCLE[PRE_SAFE_13].Launch_Name        , "PRE_SAFE_13"  , 50);
  strncpy(CYCLE[PRE_SAFE_13].DiagLaunch_Name    , "Pre-Safe Level 12"  , 50);
  strncpy(CYCLE[PRE_SAFE_13].SF_Name            , "PRE_SAFE_13"      , 50);
  strncpy(CYCLE[PRE_SAFE_13].MF_Name            , "PRE_SAFE_13"        , 50);
  
  CYCLE[PRE_SAFE_14]        .MF_ID            = 0x0C;
  CYCLE[PRE_SAFE_14]        .SF_ID            = 0x0E;
  CYCLE[PRE_SAFE_14]        .Launch_ID        = 0x0E;
  CYCLE[PRE_SAFE_14]        .DiagLaunch_ID    = 0x0C;
  strncpy(CYCLE[PRE_SAFE_14].Launch_Name        , "PRE_SAFE_14"  , 50);
  strncpy(CYCLE[PRE_SAFE_14].DiagLaunch_Name    , "Pre-Safe Level 13"  , 50);
  strncpy(CYCLE[PRE_SAFE_14].SF_Name            , "PRE_SAFE_14"      , 50);
  strncpy(CYCLE[PRE_SAFE_14].MF_Name            , "PRE_SAFE_14"        , 50);

  CYCLE[PRE_SAFE_15]        .MF_ID            = 0x0D;
  CYCLE[PRE_SAFE_15]        .SF_ID            = 0x0F;
  CYCLE[PRE_SAFE_15]        .Launch_ID        = 0x0F;
  CYCLE[PRE_SAFE_15]        .DiagLaunch_ID    = 0x0D;
  strncpy(CYCLE[PRE_SAFE_15].Launch_Name        , "PRE_SAFE_15"  , 50);
  strncpy(CYCLE[PRE_SAFE_15].DiagLaunch_Name    , "Pre-Safe Level 14"  , 50);
  strncpy(CYCLE[PRE_SAFE_15].SF_Name            , "PRE_SAFE_15"      , 50);
  strncpy(CYCLE[PRE_SAFE_15].MF_Name            , "PRE_SAFE_15"        , 50);
  
  CYCLE[PRE_SAFE_CURVE_1]        .MF_ID            = 0x0E;
  CYCLE[PRE_SAFE_CURVE_1]        .SF_ID            = 0x16;
  CYCLE[PRE_SAFE_CURVE_1]        .Launch_ID        = 0x16;
//  CYCLE[PRE_SAFE_Curve_1]        .DiagLaunch_ID    = 0x07;
  strncpy(CYCLE[PRE_SAFE_CURVE_1].Launch_Name        , "PRE_SAFE_Curve_1"  , 50);
//  strncpy(CYCLE[PRE_SAFE_Curve_1].DiagLaunch_Name    , "PreCrash 14"  , 50);
  strncpy(CYCLE[PRE_SAFE_CURVE_1].SF_Name            , "PRE_SAFE_Curve_1"      , 50);
  strncpy(CYCLE[PRE_SAFE_CURVE_1].MF_Name            , "PRE_SAFE_Curve_1"        , 50);
  
  CYCLE[PRE_SAFE_CURVE_2]        .MF_ID            = 0x0F;
  CYCLE[PRE_SAFE_CURVE_2]        .SF_ID            = 0x17;
  CYCLE[PRE_SAFE_CURVE_2]        .Launch_ID        = 0x17;
//  CYCLE[PRE_SAFE_CURVE_2]        .DiagLaunch_ID    = 0x07;
  strncpy(CYCLE[PRE_SAFE_CURVE_2].Launch_Name        , "PRE_SAFE_Curve_2"  , 50);
//  strncpy(CYCLE[PRE_SAFE_CURVE_2].DiagLaunch_Name    , "PreCrash 14"  , 50);
  strncpy(CYCLE[PRE_SAFE_CURVE_2].SF_Name            , "PRE_SAFE_Curve_2"      , 50);
  strncpy(CYCLE[PRE_SAFE_CURVE_2].MF_Name            , "PRE_SAFE_Curve_2"        , 50);
  
  CYCLE[PRE_SAFE_CURVE_3]        .MF_ID            = 0x10;
  CYCLE[PRE_SAFE_CURVE_3]        .SF_ID            = 0x18;
  CYCLE[PRE_SAFE_CURVE_3]        .Launch_ID        = 0x18;
//  CYCLE[PRE_SAFE_CURVE_3]        .DiagLaunch_ID    = 0x07;
  strncpy(CYCLE[PRE_SAFE_CURVE_3].Launch_Name        , "PRE_SAFE_Curve_3"  , 50);
//  strncpy(CYCLE[PRE_SAFE_CURVE_3].DiagLaunch_Name    , "PreCrash 14"  , 50);
  strncpy(CYCLE[PRE_SAFE_CURVE_3].SF_Name            , "PRE_SAFE_Curve_3"      , 50);
  strncpy(CYCLE[PRE_SAFE_CURVE_3].MF_Name            , "PRE_SAFE_Curve_3"        , 50);
  
  CYCLE[PRE_SAFE_CURVE_4]        .MF_ID            = 0x11;
  CYCLE[PRE_SAFE_CURVE_4]        .SF_ID            = 0x19;
  CYCLE[PRE_SAFE_CURVE_4]        .Launch_ID        = 0x19;
//  CYCLE[PRE_SAFE_CURVE_4]        .DiagLaunch_ID    = 0x07;
  strncpy(CYCLE[PRE_SAFE_CURVE_4].Launch_Name        , "PRE_SAFE_Curve_4"  , 50);
//  strncpy(CYCLE[PRE_SAFE_CURVE_4].DiagLaunch_Name    , "PreCrash 14"  , 50);
  strncpy(CYCLE[PRE_SAFE_CURVE_4].SF_Name            , "PRE_SAFE_Curve_4"      , 50);
  strncpy(CYCLE[PRE_SAFE_CURVE_4].MF_Name            , "PRE_SAFE_Curve_4"        , 50);
  
  CYCLE[BSR_1]             .MF_ID            = 0x1A;
  CYCLE[BSR_1]             .SF_ID            = 0x13;
//CYCLE[BSR_1]             .Launch_ID        = ; // Unbuckle - Buckle
  CYCLE[BSR_1]             .DiagLaunch_ID    = 0x1A;
  strncpy(CYCLE[BSR_1].Launch_Name        , "BSR 1" , 50);
  strncpy(CYCLE[BSR_1].DiagLaunch_Name    , "BSR"   , 50);
  strncpy(CYCLE[BSR_1].SF_Name            , "BSR 1" , 50);
  strncpy(CYCLE[BSR_1].MF_Name            , "BSR 1" , 50);
  
  CYCLE[RESERVED]        .MF_ID            = 0x09;
//CYCLE[RESERVED]        .SF_ID            = ;
//CYCLE[RESERVED]        .Launch_ID        = ;
  CYCLE[RESERVED]        .DiagLaunch_ID    = 0x09;
  strncpy(CYCLE[RESERVED].Launch_Name        , "RESERVED" , 50);
  strncpy(CYCLE[RESERVED].DiagLaunch_Name    , "Reserved" , 50);
  strncpy(CYCLE[RESERVED].SF_Name            , "RESERVED" , 50);
  strncpy(CYCLE[RESERVED].MF_Name            , "RESERVED" , 50);
  
  CYCLE[START_UP]        .MF_ID            = 0x20;
  CYCLE[START_UP]        .SF_ID            = 0x3F;
//CYCLE[START_UP]        .Launch_ID        = 0x20;
  CYCLE[START_UP]        .DiagLaunch_ID    = 0x20;
  strncpy(CYCLE[START_UP].Launch_Name        , "START-UP", 50);
  strncpy(CYCLE[START_UP].DiagLaunch_Name    , "Start-up" , 50);
  strncpy(CYCLE[START_UP].SF_Name            , "START-UP", 50);
  strncpy(CYCLE[START_UP].MF_Name            , "START-UP", 50);
  
  CYCLE[SOFT_RELEASE]        .MF_ID            = 0x1D;
//CYCLE[SOFT_RELEASE]        .SF_ID            = 0x1D;
//CYCLE[SOFT_RELEASE]        .Launch_ID        = 0x1D;
  CYCLE[SOFT_RELEASE]        .DiagLaunch_ID    = 0x1D;
  strncpy(CYCLE[SOFT_RELEASE].Launch_Name     , "SMOOTH-RELEASE" , 50);
  strncpy(CYCLE[SOFT_RELEASE].DiagLaunch_Name , "Smooth Release ", 50);
  strncpy(CYCLE[SOFT_RELEASE].SF_Name         , "SMOOTH-RELEASE" , 50);
  strncpy(CYCLE[SOFT_RELEASE].MF_Name         , "SMOOTH-RELEASE" , 50);
  
  CYCLE[HARD_RELEASE]        .MF_ID            = 0x1E;
//CYCLE[HARD_RELEASE]        .SF_ID            = 0x1E;
//CYCLE[HARD_RELEASE]        .Launch_ID        = 0x1E;
  CYCLE[HARD_RELEASE]        .DiagLaunch_ID    = 0x1E;
  strncpy(CYCLE[HARD_RELEASE].Launch_Name     , "HARD_RELEASE", 50);
  strncpy(CYCLE[HARD_RELEASE].DiagLaunch_Name , "Hard Release", 50);
  strncpy(CYCLE[HARD_RELEASE].SF_Name         , "HARD_RELEASE", 50);
  strncpy(CYCLE[HARD_RELEASE].MF_Name         , "HARD_RELEASE", 50);
  
  CYCLE[BACKUP_RELEASE]        .MF_ID            = 0x1F;
//CYCLE[BACKUP_RELEASE]        .SF_ID            = 0x1F;
//CYCLE[BACKUP_RELEASE]        .Launch_ID        = 0x1F;
  CYCLE[BACKUP_RELEASE]        .DiagLaunch_ID    = 0x1F;
  strncpy(CYCLE[BACKUP_RELEASE].Launch_Name     , "BACKUP_RELEASE", 50);
  strncpy(CYCLE[BACKUP_RELEASE].DiagLaunch_Name , "Backup Release", 50);
  strncpy(CYCLE[BACKUP_RELEASE].SF_Name         , "BACKUP_RELEASE", 50);
  strncpy(CYCLE[BACKUP_RELEASE].MF_Name         , "BACKUP_RELEASE", 50);
  
  CYCLE[ANG_PROCESS]        .MF_ID            = 0x21;
//CYCLE[ANG_PROCESS]        .SF_ID            = 0x1F;
//CYCLE[ANG_PROCESS]        .Launch_ID        = 0x1F;
  CYCLE[ANG_PROCESS]        .DiagLaunch_ID    = 0x21;
  strncpy(CYCLE[ANG_PROCESS].Launch_Name     , "ANG_PROCESS", 50);
  strncpy(CYCLE[ANG_PROCESS].DiagLaunch_Name , "ANG Process", 50);
  strncpy(CYCLE[ANG_PROCESS].SF_Name         , "ANG_PROCESS", 50);
  strncpy(CYCLE[ANG_PROCESS].MF_Name         , "ANG_PROCESS", 50);
  
  CYCLE[AEE_PROCESS]        .MF_ID            = 0x22;
//CYCLE[AEE_PROCESS]        .SF_ID            = 0x1F;
//CYCLE[AEE_PROCESS]        .Launch_ID        = 0x1F;
  CYCLE[AEE_PROCESS]        .DiagLaunch_ID    = 0x22;
  strncpy(CYCLE[AEE_PROCESS].Launch_Name     , "AEE_PROCESS", 50);
  strncpy(CYCLE[AEE_PROCESS].DiagLaunch_Name , "AEE Process", 50);
  strncpy(CYCLE[AEE_PROCESS].SF_Name         , "AEE_PROCESS", 50);
  strncpy(CYCLE[AEE_PROCESS].MF_Name         , "AEE_PROCESS", 50);
  
//CYCLE[REJECTED]        .MF_ID            = 0x3E;
  CYCLE[REJECTED]        .SF_ID            = 0x3E;
//CYCLE[REJECTED]        .Launch_ID        = 0x3E;
//CYCLE[REJECTED]        .DiagLaunch_ID    = ;
  strncpy(CYCLE[REJECTED].Launch_Name    , "REJECTED", 50);
  strncpy(CYCLE[REJECTED].DiagLaunch_Name, "Rejected", 50);
  strncpy(CYCLE[REJECTED].SF_Name        , "REJECTED", 50);
  strncpy(CYCLE[REJECTED].MF_Name        , "REJECTED", 50);
  
//CYCLE[INIT]        .MF_ID            = 0x3F;
  CYCLE[INIT]        .SF_ID            = 0x3F;
//CYCLE[INIT]        .Launch_ID        = 0x3F;
//CYCLE[INIT]        .DiagLaunch_ID    = ;
  strncpy(CYCLE[INIT].Launch_Name    , "INIT", 50);
  strncpy(CYCLE[INIT].DiagLaunch_Name, "Init", 50);
  strncpy(CYCLE[INIT].SF_Name        , "INIT", 50);
  strncpy(CYCLE[INIT].MF_Name        , "INIT", 50);
}
