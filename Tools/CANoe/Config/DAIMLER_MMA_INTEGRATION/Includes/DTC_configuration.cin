/*@!Encoding:1252*/
includes
{
  
}

variables
{
// DTC status definition
 byte _bTestedNotPresent = 0x00;             
//const _sAbsentFailed="0x00"                     //0x14     //Autotest has failded at least 1 but not qualified
//
 byte _bQualified = 0x29;
//const _sQualifiedConfirmed="0x2F";                         //0x27 --> SoftReset/SlepWakeUp -->0x2F

 byte _bDeskilledFailed = 0x28;                 
//const _sDeskilledFailedConfirmed="0x2E";                   //0x2F -->Diskill error -->0x2E
//
//const _sQualifingInProgress="0x00";             //0x1C 
//const _sReQualifingInProgress="0x26";           //0x1E
//const _sReQualifingInProgressConfirmed="0x2E";  //0x1E
//
//const _sDeskillingInProgress="0x2E";            //0x1F 
//const _sDeskillingInProgressConfirmed="0x2E";   //0x1F 
//
//// const _sDeskilledNotFailed="0x24";              //0x06     //0x26 --> SoftReset/SlepWakeUp -->0x24 
//const _sDeskilledNotFailed="0x20";                       //(0x24 or 0x20 depending of pending) 
//const _sDeskilledNotFailedConfirmed="0x20";                //0x2E --> SoftReset/SlepWakeUp -->0x2C 
//
//
//const _sNotCompletedSinceLastReset="0x40";      //(not ever qualified since last reset)
//const _sNotCompletedSinceLastClear="0x50";      //(not ever qualified since last clear ; after clear bi6=1)
//const _sNotCompletedSinceLastResetAndLastClear="0x50";  //(not ever qualified since last clear and last reset)
//
//const _sNotCompletedSincePowerOffOn="0x40";     // 0x00 (no matter if clear is performed or NOT)
//
//const _sEverQualified="0x60";                   //0x02
//const _sEverQualifiedStartup="0x00";            //0x03
//const _sNotEverQualified="0x00";                // 0x00
//const _sNotFailedDeskilledInProgress="0x00"     //"0x0F";
  
  // Defines different thresholds for the project.
  const _fBAT_NOMINAL_VALUE = 12.5; // battery nominal value
  
/////////////////////////////////////////////////////////////////////////////////////////////////////////////////////////////////////////////////////////////////////		
   // DTC identifier for: Motor_Current, HW_Self_Protection, SW_Self_Protection
  dword _dDTC_GENERAL_FAILURE = 0xA00020;
  
  // Thresholds for MOTOR_CURRENT autotest. ******************
//const _iERR_MOTOR_CURRENT_Periodicity      = 10;
  const NVP_u8MotorCurrentHighThrs           = 25000;  // (mA)
  const NVP_u32MotorCurrentHighMaxDuration   = 1200;   // (ms)
  const NVP_u16MotorCurrentHighResetTime     = 300;    // (ms)
 	const NVP_u8MotorCurrentMediumThrs         = 10000;  // (mA)
  const NVP_u32MotorCurrentMediumMaxDuration = 120000; // (ms)
  const NVP_u16MotorCurrentMediumResetTime   = 1000;   // (ms) 
  const NVP_u16MotorCurrentResetTime         = 60000;  // (ms)
  //**********************************************************
  
  //// Thresholds for HW_SELF_PROTECTION autotest. ************
	const _iQualif_HW_SELF_PROTECTION      = 1000;  // (ms) (NO REQUIREMENT FOR THIS VALUE -TBD)
	const _iDeskill_HW_SELF_PROTECTION     = 60000; // (ms) (NO REQUIREMENT FOR THIS VALUE -TBD)
 	const NVP_u16HWSelfProtecCurrentThrs   = 4000;  // (mA)
  
//const NVP_u16HWSelfProtecMaturateTime      = 1000;  // (ms)
//const NVP_u16HWSelfProtecDematurateTime    = 60000; // (ms)
//const _iERR_HW_SELF_PROTECTION_Periodicity = 10;    // (ms)
//const _iERR_HW_SELF_PROTECTION_Delay       = 0;     // (ms)
  
  //// Thresholds for SW_SELF_PROTECTION autotest. **********
  // TBD
  
/////////////////////////////////////////////////////////////////////////////////////////////////////////////////////////////////////////////////////////////////////	
  // Battery Power DTC - KL30: Undervoltage, Overvoltage
  dword _dDTC_POWER_SUPPLY = 0xA00010;
  
	// Thresholds for Overvoltage Power autotest. *************
//const _iERR_BAT_PWR_OVER_VOLTAGE_Periodicity = 10;   // (ms)
//const _iERR_BAT_PWR_OVER_VOLTAGE_Delay       = 0;    // (ms) 
  const _iQualif_BAT_PWR_OVER_VOLTAGE          = 400;  // (ms) (NO REQUIREMENT FOR THIS VALUE -TBD)
  const _iDeskill_BAT_PWR_OVER_VOLTAGE         = 900;  // (ms) (NO REQUIREMENT FOR THIS VALUE -TBD)
	const NVP_u16OverKL30QualificationThrs       = 16;   // (V)
	const NVP_u16OverKL30DeskillingThrs          = 15.5; // (V)
  
	// Thresholds for Undervoltage Power autotest. *****************************
	const _iQualif_BAT_PWR_UNDER_VOLTAGE          = 400;  // (ms) (NO REQUIREMENT FOR THIS VALUE -TBD)
	const _iDeskill_BAT_PWR_UNDER_VOLTAGE         = 900;  // (ms) (NO REQUIREMENT FOR THIS VALUE -TBD)
//const _iERR_BAT_PWR_UNDER_VOLTAGE_Periodicity = 10;   // (ms)
//const _iERR_BAT_PWR_UNDER_VOLTAGE_Delay       = 5000; // (ms)
	const NVP_u16UnderKL30QualificationThrs       = 9;    // (V)
  const NVP_u16UnderKL30DeskillingThrs          = 9.5;  // (V)
//const NVP_u16UnderKL30QualificationThrs_uC    = 0;    // (mV) Scaled for FIB.

  // Thresholds for Undervoltage during tensioning autotest. ************
	const _iQualif_BAT_PWR_UNDER_VOLTAGE_TENSIONING          = 200; // (ms) (NO REQUIREMENT FOR THIS VALUE -TBD)
	const _iDeskill_BAT_PWR_UNDER_VOLTAGE_TENSIONING         = 700; // (ms) (NO REQUIREMENT FOR THIS VALUE -TBD)
//const _iERR_BAT_PWR_UNDER_VOLTAGE_TENSIONING_Periodicity = 10;  // (ms)
//const _iERR_BAT_PWR_UNDER_VOLTAGE_TENSIONING_Delay       = 0;   // (ms)
	const NVP_u16UnderKL30DuringTensQualificationThrs        = 7.5; // (V) (TBD)
	const NVP_u16UnderKL30DuringTensDeskillingThrs           = 8;   // (V) (TBD)
  
  // Thresholds for Overvoltage during tensioning autotest. ************
	const _iQualif_BAT_PWR_OVER_VOLTAGE_TENSIONING          = 200;  // (ms) (NO REQUIREMENT FOR THIS VALUE -TBD)
	const _iDeskill_BAT_PWR_OVER_VOLTAGE_TENSIONING         = 700;  // (ms) (NO REQUIREMENT FOR THIS VALUE -TBD)
//const _iERR_BAT_PWR_OVER_VOLTAGE_TENSIONING_Periodicity = 10;   // (ms)
//const _iERR_BAT_PWR_OVER_VOLTAGE_TENSIONING_Delay       = 0;    // (ms)
	const NVP_u16OverKL30DuringTensQualificationThrs        = 18;   // (V) (TBD)
	const NVP_u16OverKL30DuringTensDeskillingThrs           = 17.5; // (V) (TBD)

  // Thresholds for Battery Logic Overvoltage Logic autotest. **************************************************************************
	const _iQualif_BAT_LOG_OVER_VOLTAGE        = 400;                                                  // (ms) Qualification time. (NO REQUIREMENT FOR THIS VALUE -TBD)
	const _iDeskill_BAT_LOG_OVER_VOLTAGE       = 900;                                                  // (ms) Deskill time. (NO REQUIREMENT FOR THIS VALUE -TBD)
//const _iERR_BAT_LOG_OVER_VOLTAGE_Periodicity   = 10;                                                   // (ms)
//const _iERR_BAT_LOG_OVER_VOLTAGE_Delay         = 0;                                                    // (ms)
	const NVP_u16OverKL30bgQualificationThrs       = 16;                                                   // (V) Qualification threshold.
	const NVP_u16OverKL30bgDeskillingThrs          = 15.5;                                                 // (V) Deskill threshold.
	const  _fBAT_LOG_OVER_THRESHOLD_HIGH_uC        = (NVP_u16OverKL30bgQualificationThrs * 5 / 33) * 1000; // (mV) Scaled for FIB.
	const  _fBAT_LOG_OVER_Deskilling_Threshold_uC  = (NVP_u16OverKL30bgDeskillingThrs*5 / 33) * 1000;      // (mV) Scaled for FIB.
  
  // Thresholds for Battery Logic Undervoltage Logic autotest. *****************************************************************************************
	const _iQualif_BAT_LOG_UNDER_VOLTAGE           = 400;                                                   // (ms) Qualification time. (NO REQUIREMENT FOR THIS VALUE -TBD)
	const _iDeskill_BAT_LOG_UNDER_VOLTAGE          = 900;                                                   // (ms) Deskill time. (NO REQUIREMENT FOR THIS VALUE -TBD)
//const _iERR_BAT_LOG_UNDER_VOLTAGE_Periodicity  = 10;                                                    // (ms)
//const _iERR_BAT_LOG_UNDER_VOLTAGE_Delay        = 5000;                                                  // (ms) Delay execution after motor activation.
	const  NVP_u16UnderKL30bgQualificationThrs     = 9;                                                     // (V) Qualification threshold.
	const  NVP_u16UnderKL30bgDeskillingThrs        = 9.5;                                                   // (V) Deskill threshold.
	const  _fBAT_LOG_UNDER_THRESHOLD_LOW_uC        = (NVP_u16UnderKL30bgQualificationThrs * 5 / 33) * 1000; // (mV) Scaled for FIB.
 	const  _fBAT_LOG_UNDER_Deskilling_Threshold_uC = (NVP_u16UnderKL30bgDeskillingThrs*5 / 33) * 1000;      // (mV) Scaled for FIB.
/////////////////////////////////////////////////////////////////////////////////////////////////////////////////////////////////////////////////////////////////////		
}

