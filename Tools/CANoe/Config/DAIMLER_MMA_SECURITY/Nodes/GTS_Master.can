/*@!Encoding:1252*/
includes
{
  #include "GT.cin"
}

variables
{ 
  //Global Time constants
  const byte GT_MASTER = 1;
  const byte GT_DOMAIN = 0;
  const byte GT_SGW = 1;
  const byte GT_SYNC_CRC = 1;
  const byte GT_FUP_CRC = 1;
  const long GT_CAN_ID = 0x79;
  const byte GT_VERBOSE = 1;
  
  //Data IDs array
  byte GT_SYNC_DATA_ID_LIST[16] = {225, 102, 230, 107, 235, 112, 240, 117, 245, 122, 250, 127, 4, 132, 9, 137};
  byte GT_FUP_DATA_ID_LIST[16]  = {143, 78, 13, 199, 134, 69, 4, 190, 125, 60, 246, 181, 116, 51, 237, 172};
}

on start
{
  GT_MASTER_START();
}