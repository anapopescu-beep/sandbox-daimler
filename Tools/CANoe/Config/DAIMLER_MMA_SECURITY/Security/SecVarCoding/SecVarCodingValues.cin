/*@!Encoding:1252*/
variables
{
        /*
  Up to 350 * 4096 Bytes can be coded in one sequence -> 1433600 Bytes 
  */
  const dword cMaxBufferSize = 1433600; // max buffer size to evaluate var coding write requests
}

