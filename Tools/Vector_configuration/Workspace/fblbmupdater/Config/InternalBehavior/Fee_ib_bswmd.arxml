AUTOSAR XML (schema 00046)
package /AURIX2G/EcucDefs/Fee_ib_bswmd/BswModuleDescriptions
  bsw module description Fee: provided-entrys=Fee_MainFunction
    bsw internal behavior FeeBehavior
      bsw schedulable entity Fee_MainFunction: implemented-entry=Fee_MainFunction
      bsw timing event Fee_MainFunctionTimingEvent0: starts-on-event=Fee_MainFunction, period=0.01
  bsw module entry Fee_MainFunction: call-type=SCHEDULED, execution-context=TASK
