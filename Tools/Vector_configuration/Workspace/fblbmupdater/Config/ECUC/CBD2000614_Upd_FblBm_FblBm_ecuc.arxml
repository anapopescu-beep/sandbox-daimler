AUTOSAR XML (schema 00046)
package /ActiveEcuC
  module config FblBm: implementation-config-variant=VARIANT-PRE-COMPILE, module-description=FblBm_Impl
    FblBmGeneral:
      FblBmFailsafeUpdater = true
      FblBmIncludeHardwareConfiguration = false
      FblBmInitializeKeys = false
      FblBmSecureBoot = false
      FblBmStandaloneMode = false
      FblBmInitializeMacOfBootloader = false
      FblBmIncludeOemConfiguration = false
      FblBmHeaderAddress = 2684568320
      FblBmExecutionInstance = FlashBootloaderUpdater
