AUTOSAR XML (schema 00046)
package /ActiveEcuC
  module config Dcm: implementation-config-variant=VARIANT-POST-BUILD-SELECTABLE, module-description=Dcm_Impl
    DcmConfigSet
      DcmGeneral:
        DcmRespondAllRequest = true
        DcmVersionInfoApi = false
        DcmBaudrateSwitch = false
        DcmKeySlotMode = false
        DcmNwStatusRxBufferSize = 0
        DcmQueuedRequest = false
        DcmDevErrorDetect = false
        DcmTaskTime = 10
        DcmCanHardwareLoopTimeout = 100
        DcmTaskCycle = 5
      DcmDsp
        DcmDspSession
          DcmDspSessionRow: DcmDspSessionLevel=0, DcmDspSessionP2ServerMax=20, DcmDspSessionP2StarServerMax=2000
      DcmDsl
        DcmDslBuffer: DcmDslBufferSize=8
        DcmDslDiagResp: DcmDslDiagRespMaxNumOfDeclinedRequests=3, DcmDslDiagRespOnSecondDeclinedRequest=false
        DcmDslProtocol
          DcmDslProtocolRow_29812fbf (DcmDslProtocolRow): DcmDslProtocolID=DCM_UDS_ON_CAN
            6 x DcmDslConnection:
              DIAG_RBTM_FL_03_ExtCAN_RQ_BODY3_ST3_DIAG_RBTM_FL_03_ExtCAN_RS_BODY3_ST3_2f852a42: variation-point=post-build-variant-condition{matching-criterion=Side, value=0}
                DIAG_RBTM_FL_03_ExtCAN_RQ_BODY3_ST3_DIAG_RBTM_FL_03_ExtCAN_RS_BODY3_ST3_2f852a42 (DcmDslMainConnection): DcmDslProtocolRxTesterSourceAddr=3833, DcmDslPayloadLimit=4095
                  SDU_DIAG_RBTM_FL_03_ExtCAN_RQ_BODY3_ST3_ec0e6e12_Rx_2873db84 (DcmDslProtocolRx):
                    DcmDslProtocolRxAddrType = DCM_PHYSICAL_TYPE
                    DcmDslProtocolRxPduId = 1
                    DcmDslProtocolRxComMChannelRef = RBTM_FL_BODY3_8uqv9blm85ehm0msat385m76v_03d5f5f6
                    DcmDslProtocolRxPduRef = SDU_DIAG_RBTM_FL_03_ExtCAN_RQ_BODY3_ST3_ec0e6e12_Rx
                  SDU_DIAG_RBTM_FL_03_ExtCAN_RS_BODY3_ST3_b462d7d3_Tx_70f6d2b0 (DcmDslProtocolTx): DcmDslTxConfirmationPduId=0, DcmDslProtocolTxPduRef=SDU_DIAG_RBTM_FL_03_ExtCAN_RS_BODY3_ST3_b462d7d3_Tx
                  SDU_DIAG_GLOBAL_ExtCAN_RQ_BODY3_ST3_18e7f235_Rx_2b322367 (DcmDslProtocolRx):
                    DcmDslProtocolRxAddrType = DCM_FUNCTIONAL_TYPE
                    DcmDslProtocolRxPduId = 0
                    DcmDslProtocolRxComMChannelRef = RBTM_FL_BODY3_8uqv9blm85ehm0msat385m76v_03d5f5f6
                    DcmDslProtocolRxPduRef = SDU_DIAG_GLOBAL_ExtCAN_RQ_BODY3_ST3_18e7f235_Rx
              DIAG_RBTM_FL_03_ExtEth_RQ_BODY3_ST3_DIAG_RBTM_FL_03_ExtEth_RS_BODY3_ST3_816f6eb3: variation-point=post-build-variant-condition{matching-criterion=Side, value=0}
                DIAG_RBTM_FL_03_ExtEth_RQ_BODY3_ST3_DIAG_RBTM_FL_03_ExtEth_RS_BODY3_ST3_816f6eb3 (DcmDslMainConnection): DcmDslProtocolRxTesterSourceAddr=3832, DcmDslPayloadLimit=4095
                  SDU_DIAG_GLOBAL_ExtEth_RQ_BODY3_ST3_81f0b7e5_Rx_d414628a (DcmDslProtocolRx):
                    DcmDslProtocolRxAddrType = DCM_FUNCTIONAL_TYPE
                    DcmDslProtocolRxPduId = 2
                    DcmDslProtocolRxComMChannelRef = RBTM_FL_BODY3_8uqv9blm85ehm0msat385m76v_03d5f5f6
                    DcmDslProtocolRxPduRef = SDU_DIAG_GLOBAL_ExtEth_RQ_BODY3_ST3_81f0b7e5_Rx
                  SDU_DIAG_RBTM_FL_03_ExtEth_RQ_BODY3_ST3_75192bc2_Rx_5a27dd11 (DcmDslProtocolRx):
                    DcmDslProtocolRxAddrType = DCM_PHYSICAL_TYPE
                    DcmDslProtocolRxPduId = 3
                    DcmDslProtocolRxComMChannelRef = RBTM_FL_BODY3_8uqv9blm85ehm0msat385m76v_03d5f5f6
                    DcmDslProtocolRxPduRef = SDU_DIAG_RBTM_FL_03_ExtEth_RQ_BODY3_ST3_75192bc2_Rx
                  SDU_DIAG_RBTM_FL_03_ExtEth_RS_BODY3_ST3_2d759203_Tx_2b590afc (DcmDslProtocolTx): DcmDslTxConfirmationPduId=1, DcmDslProtocolTxPduRef=SDU_DIAG_RBTM_FL_03_ExtEth_RS_BODY3_ST3_2d759203_Tx
              DIAG_RBTM_FL_03_IntEth_RQ_BODY3_ST3_DIAG_RBTM_FL_03_IntEth_RS_BODY3_ST3_1d9ca21c: variation-point=post-build-variant-condition{matching-criterion=Side, value=0}
                DIAG_RBTM_FL_03_IntEth_RQ_BODY3_ST3_DIAG_RBTM_FL_03_IntEth_RS_BODY3_ST3_1d9ca21c (DcmDslMainConnection): DcmDslProtocolRxTesterSourceAddr=3853, DcmDslPayloadLimit=4095
                  SDU_DIAG_GLOBAL_IntEth_RQ_BODY3_ST3_41e6471f_Rx_c0cc433b (DcmDslProtocolRx):
                    DcmDslProtocolRxAddrType = DCM_FUNCTIONAL_TYPE
                    DcmDslProtocolRxPduId = 4
                    DcmDslProtocolRxComMChannelRef = RBTM_FL_BODY3_8uqv9blm85ehm0msat385m76v_03d5f5f6
                    DcmDslProtocolRxPduRef = SDU_DIAG_GLOBAL_IntEth_RQ_BODY3_ST3_41e6471f_Rx
                  SDU_DIAG_RBTM_FL_03_IntEth_RQ_BODY3_ST3_b50fdb38_Rx_6a163982 (DcmDslProtocolRx):
                    DcmDslProtocolRxAddrType = DCM_PHYSICAL_TYPE
                    DcmDslProtocolRxPduId = 5
                    DcmDslProtocolRxComMChannelRef = RBTM_FL_BODY3_8uqv9blm85ehm0msat385m76v_03d5f5f6
                    DcmDslProtocolRxPduRef = SDU_DIAG_RBTM_FL_03_IntEth_RQ_BODY3_ST3_b50fdb38_Rx
                  SDU_DIAG_RBTM_FL_03_IntEth_RS_BODY3_ST3_ed6362f9_Tx_3060e687 (DcmDslProtocolTx): DcmDslTxConfirmationPduId=2, DcmDslProtocolTxPduRef=SDU_DIAG_RBTM_FL_03_IntEth_RS_BODY3_ST3_ed6362f9_Tx
              DIAG_RBTM_FR_03_ExtEth_RQ_BODY3_ST3_DIAG_RBTM_FR_03_ExtEth_RS_BODY3_ST3_b444e987: variation-point=post-build-variant-condition{matching-criterion=Side, value=1}
                DIAG_RBTM_FR_03_ExtEth_RQ_BODY3_ST3_DIAG_RBTM_FR_03_ExtEth_RS_BODY3_ST3_b444e987 (DcmDslMainConnection): DcmDslProtocolRxTesterSourceAddr=3832, DcmDslPayloadLimit=4095
                  SDU_DIAG_RBTM_FR_03_ExtEth_RQ_BODY3_ST3_68423a11_Rx_510ebea9 (DcmDslProtocolRx):
                    DcmDslProtocolRxAddrType = DCM_PHYSICAL_TYPE
                    DcmDslProtocolRxPduId = 9
                    DcmDslProtocolRxComMChannelRef = RBTM_FR_BODY3_4xwwtd59665s787n6ctawh7k8_23a94727
                    DcmDslProtocolRxPduRef = SDU_DIAG_RBTM_FR_03_ExtEth_RQ_BODY3_ST3_68423a11_Rx
                  SDU_DIAG_RBTM_FR_03_ExtEth_RS_BODY3_ST3_302e83d0_Tx_afb57ffd (DcmDslProtocolTx): DcmDslTxConfirmationPduId=4, DcmDslProtocolTxPduRef=SDU_DIAG_RBTM_FR_03_ExtEth_RS_BODY3_ST3_302e83d0_Tx
                  SDU_DIAG_GLOBAL_ExtEth_RQ_BODY3_ST3_81f0b7e5_Rx_d414628a (DcmDslProtocolRx):
                    DcmDslProtocolRxAddrType = DCM_FUNCTIONAL_TYPE
                    DcmDslProtocolRxPduId = 8
                    DcmDslProtocolRxComMChannelRef = RBTM_FR_BODY3_4xwwtd59665s787n6ctawh7k8_23a94727
                    DcmDslProtocolRxPduRef = SDU_DIAG_GLOBAL_ExtEth_RQ_BODY3_ST3_81f0b7e5_Rx
              DIAG_RBTM_FR_03_ExtCAN_RQ_BODY3_ST3_DIAG_RBTM_FR_03_ExtCAN_RS_BODY3_ST3_1aaead76: variation-point=post-build-variant-condition{matching-criterion=Side, value=1}
                DIAG_RBTM_FR_03_ExtCAN_RQ_BODY3_ST3_DIAG_RBTM_FR_03_ExtCAN_RS_BODY3_ST3_1aaead76 (DcmDslMainConnection): DcmDslProtocolRxTesterSourceAddr=3833, DcmDslPayloadLimit=4095
                  SDU_DIAG_RBTM_FR_03_ExtCAN_RQ_BODY3_ST3_f1557fc1_Rx_3b6533a8 (DcmDslProtocolRx):
                    DcmDslProtocolRxAddrType = DCM_PHYSICAL_TYPE
                    DcmDslProtocolRxPduId = 7
                    DcmDslProtocolRxComMChannelRef = RBTM_FR_BODY3_4xwwtd59665s787n6ctawh7k8_23a94727
                    DcmDslProtocolRxPduRef = SDU_DIAG_RBTM_FR_03_ExtCAN_RQ_BODY3_ST3_f1557fc1_Rx
                  SDU_DIAG_RBTM_FR_03_ExtCAN_RS_BODY3_ST3_a939c600_Tx_82eb6958 (DcmDslProtocolTx): DcmDslTxConfirmationPduId=3, DcmDslProtocolTxPduRef=SDU_DIAG_RBTM_FR_03_ExtCAN_RS_BODY3_ST3_a939c600_Tx
                  SDU_DIAG_GLOBAL_ExtCAN_RQ_BODY3_ST3_18e7f235_Rx_2b322367 (DcmDslProtocolRx):
                    DcmDslProtocolRxAddrType = DCM_FUNCTIONAL_TYPE
                    DcmDslProtocolRxPduId = 6
                    DcmDslProtocolRxComMChannelRef = RBTM_FR_BODY3_4xwwtd59665s787n6ctawh7k8_23a94727
                    DcmDslProtocolRxPduRef = SDU_DIAG_GLOBAL_ExtCAN_RQ_BODY3_ST3_18e7f235_Rx
              DIAG_RBTM_FR_03_IntEth_RQ_BODY3_ST3_DIAG_RBTM_FR_03_IntEth_RS_BODY3_ST3_28b72528: variation-point=post-build-variant-condition{matching-criterion=Side, value=1}
                DIAG_RBTM_FR_03_IntEth_RQ_BODY3_ST3_DIAG_RBTM_FR_03_IntEth_RS_BODY3_ST3_28b72528 (DcmDslMainConnection): DcmDslProtocolRxTesterSourceAddr=3853, DcmDslPayloadLimit=4095
                  SDU_DIAG_GLOBAL_IntEth_RQ_BODY3_ST3_41e6471f_Rx_c0cc433b (DcmDslProtocolRx):
                    DcmDslProtocolRxAddrType = DCM_FUNCTIONAL_TYPE
                    DcmDslProtocolRxPduId = 10
                    DcmDslProtocolRxComMChannelRef = RBTM_FR_BODY3_4xwwtd59665s787n6ctawh7k8_23a94727
                    DcmDslProtocolRxPduRef = SDU_DIAG_GLOBAL_IntEth_RQ_BODY3_ST3_41e6471f_Rx
                  SDU_DIAG_RBTM_FR_03_IntEth_RQ_BODY3_ST3_a854caeb_Rx_536fd8c4 (DcmDslProtocolRx):
                    DcmDslProtocolRxAddrType = DCM_PHYSICAL_TYPE
                    DcmDslProtocolRxPduId = 11
                    DcmDslProtocolRxComMChannelRef = RBTM_FR_BODY3_4xwwtd59665s787n6ctawh7k8_23a94727
                    DcmDslProtocolRxPduRef = SDU_DIAG_RBTM_FR_03_IntEth_RQ_BODY3_ST3_a854caeb_Rx
                  SDU_DIAG_RBTM_FR_03_IntEth_RS_BODY3_ST3_f038732a_Tx_f8a04d74 (DcmDslProtocolTx): DcmDslTxConfirmationPduId=5, DcmDslProtocolTxPduRef=SDU_DIAG_RBTM_FR_03_IntEth_RS_BODY3_ST3_f038732a_Tx
      DcmGeneration:
        DcmInterfacesForDeactivatedData = false
        DcmReduceConstantData2Define = false
        DcmReduceNumericalDataByOffsetThreshold = 2
        DcmReferringKeysInComments = false
        DcmShortSymbols = false
