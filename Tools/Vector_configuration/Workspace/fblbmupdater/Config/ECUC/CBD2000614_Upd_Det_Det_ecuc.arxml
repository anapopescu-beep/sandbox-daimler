AUTOSAR XML (schema 00046)
package /ActiveEcuC
  module config Det: implementation-config-variant=VARIANT-PRE-COMPILE, module-description=Det_Impl
    DetGeneral:
      DetVersionInfoApi = false
      DetReportRuntimeErrorCallout = ApplFbl_DetEntryHandler
      DetReportTransientFaultCallout = ApplFbl_DetEntryHandler
      DetEnableDet = true
      DetExtDebugSupport = false
      DetGlobalFilterSize = 0
      DetBreakFilterSize = 0
      DetLogBufferSize = 0
      DetReportErrorRecursionLimit = 0
      DetReportRuntimeErrorRecursionLimit = 0
      DetReportTransientFaultRecursionLimit = 0
      DetDltFilterSize = 0
    DetNotification:
      DetErrorHook = ApplFbl_DetEntryHandler
      DetReportRuntimeErrorCallout = ApplFbl_DetEntryHandler
      DetReportTransientFaultCallout = ApplFbl_DetEntryHandler
