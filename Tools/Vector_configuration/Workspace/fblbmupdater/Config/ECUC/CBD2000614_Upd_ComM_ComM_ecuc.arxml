AUTOSAR XML (schema 00046)
package /ActiveEcuC
  module config ComM: implementation-config-variant=VARIANT-POST-BUILD-SELECTABLE, module-description=ComM_Impl
    ComMGeneral:
      ComMPncGatewayEnabled = false
      ComMPncIdCounting = COMM_PNC_ID_COUNT_FROM_NM_MESSAGE
      ComMPncPrepareSleepTimer = 1.3
      ComMPncSupport = false
      ComMVersionInfoApi = false
      ComMDevErrorDetect = true
      ComMEcuGroupClassification = 3
      ComMModeLimitationEnabled = false
      ComMSynchronousWakeUp = true
      ComMTMinFullComModeDuration = 5
      ComMWakeupInhibitionEnabled = false
      ComMSafeBswChecks = false
      ComM0PncVectorAvoidance = false
      ComMUserConfigurationFile = $(DpaProjectFolder)\config\user_config_comm.cfg
      ComMGeneration: ComMOutOfBoundsWriteSanitizer=false, ComMOutOfBoundsReadSanitizer=false
    ComMConfigSet: ComMPncEnabled=true
      RBTM_FL_BODY3_8uqv9blm85ehm0msat385m76v_03d5f5f6 (ComMChannel):
        ComMBusType = COMM_BUS_TYPE_CAN
        ComMChannelId = 0
        ComMPncGatewayType = COMM_GATEWAY_TYPE_NONE
        ComMFullCommRequestNotificationEnabled = false
        ComMMainFunctionPeriod = 0.005
        ComMNoCom = false
        ComMNoWakeup = false
        variation-point = post-build-variant-condition{matching-criterion=Side, value=0}
        ComMNetworkManagement: ComMNmVariant=NONE, ComMPncNmRequest=false
        RBTM_FL_BODY3_8uqv9blm85ehm0msat385m76v_f6dc70ca (ComMUserPerChannel): ComMUserChannel=RBTM_FL_BODY3_8uqv9blm85ehm0msat385m76v_a4eabb6e
      RBTM_FL_BODY3_8uqv9blm85ehm0msat385m76v_a4eabb6e (ComMUser): ComMUserIdentifier=0, ComMUserModeNotification=false, variation-point=post-build-variant-condition{matching-criterion=Side, value=0}
      RBTM_FR_BODY3_4xwwtd59665s787n6ctawh7k8_23a94727 (ComMChannel):
        ComMBusType = COMM_BUS_TYPE_CAN
        ComMChannelId = 1
        ComMPncGatewayType = COMM_GATEWAY_TYPE_NONE
        ComMFullCommRequestNotificationEnabled = false
        ComMMainFunctionPeriod = 0.005
        ComMNoCom = false
        ComMNoWakeup = false
        variation-point = post-build-variant-condition{matching-criterion=Side, value=1}
        ComMNetworkManagement: ComMNmVariant=NONE, ComMPncNmRequest=false
        RBTM_FR_BODY3_4xwwtd59665s787n6ctawh7k8_dbac4b95 (ComMUserPerChannel): ComMUserChannel=RBTM_FR_BODY3_4xwwtd59665s787n6ctawh7k8_1f2180a7
      RBTM_FR_BODY3_4xwwtd59665s787n6ctawh7k8_1f2180a7 (ComMUser): ComMUserIdentifier=1, ComMUserModeNotification=false, variation-point=post-build-variant-condition{matching-criterion=Side, value=1}
