AUTOSAR XML (schema 00046)
package /ActiveEcuC
  module config CanIf: implementation-config-variant=VARIANT-POST-BUILD-SELECTABLE, module-description=CanIf_Impl
    CanIfCtrlDrvCfg_7d254554 (CanIfCtrlDrvCfg): CanIfCtrlDrvTxCancellation=false, CanIfCtrlDrvInitHohConfigRef=CanIfInitHohCfg, CanIfCtrlDrvNameRef=CanGeneral
      RBTM_FL_BODY3_180ddaa4 (CanIfCtrlCfg):
        CanIfCtrlId = 0
        CanIfCtrlWakeupSupport = false
        CanIfCtrlJ1939DynAddrSupport = DISABLED
        CanIfCtrlCanCtrlRef = RBTM_FL_BODY3_180ddaa4
        variation-point = post-build-variant-condition{matching-criterion=Side, value=0}
      RBTM_FR_BODY3_2fec3d37 (CanIfCtrlCfg):
        CanIfCtrlId = 0
        CanIfCtrlWakeupSupport = false
        CanIfCtrlJ1939DynAddrSupport = DISABLED
        CanIfCtrlCanCtrlRef = RBTM_FR_BODY3_2fec3d37
        variation-point = post-build-variant-condition{matching-criterion=Side, value=1}
    CanIfDispatchCfg:
      CanIfDispatchUserCtrlBusOffName = FblCw_ControllerBusOff
      CanIfDispatchUserCtrlBusOffUL = CDD
      CanIfDispatchUserCtrlModeIndicationName = FblCw_ControllerModeIndication
      CanIfDispatchUserCtrlModeIndicationUL = CDD
    CanIfInitCfg
      CanIfInitHohCfg: CanIfInitRefCfgSet=CanConfigSet
        RBTM_FL_BODY3_8uqv9blm85ehm0msat385m76v_e046a621_Rx (CanIfHrhCfg):
          CanIfHrhSoftwareFilter = true
          CanIfHrhCanCtrlIdRef = RBTM_FL_BODY3_180ddaa4
          CanIfHrhIdSymRef = RBTM_FL_BODY3_8uqv9blm85ehm0msat385m76v_e046a621_Rx
          variation-point = post-build-variant-condition{matching-criterion=Side, value=0}
        RBTM_FL_BODY3_8uqv9blm85ehm0msat385m76v_03d5f5f6_Tx (CanIfHthCfg):
          CanIfHthCanCtrlIdRef = RBTM_FL_BODY3_180ddaa4
          CanIfHthIdSymRef = RBTM_FL_BODY3_8uqv9blm85ehm0msat385m76v_03d5f5f6_Tx
          variation-point = post-build-variant-condition{matching-criterion=Side, value=0}
        RBTM_FR_BODY3_4xwwtd59665s787n6ctawh7k8_23a94727_Tx (CanIfHthCfg):
          CanIfHthCanCtrlIdRef = RBTM_FR_BODY3_2fec3d37
          CanIfHthIdSymRef = RBTM_FR_BODY3_4xwwtd59665s787n6ctawh7k8_23a94727_Tx
          variation-point = post-build-variant-condition{matching-criterion=Side, value=1}
        RBTM_FR_BODY3_4xwwtd59665s787n6ctawh7k8_5b8d9de8_Rx (CanIfHrhCfg):
          CanIfHrhSoftwareFilter = true
          CanIfHrhCanCtrlIdRef = RBTM_FR_BODY3_2fec3d37
          CanIfHrhIdSymRef = RBTM_FR_BODY3_4xwwtd59665s787n6ctawh7k8_5b8d9de8_Rx
          variation-point = post-build-variant-condition{matching-criterion=Side, value=1}
      DIAG_RBTM_FL_03_ExtCAN_RQ_ST3_688ae269_Rx (CanIfRxPduCfg):
        CanIfRxPduCanId = 417440905
        CanIfRxPduCanIdType = EXTENDED_CAN
        CanIfRxPduDlc = 8
        CanIfRxPduUserRxIndicationName = CanTp_RxIndication
        CanIfRxPduUserRxIndicationType = PDUID_PDUINFOPTR
        CanIfRxPduUserRxIndicationUL = CAN_TP
        CanIfRxPduId = 3
        CanIfRxPduReadData = false
        CanIfRxPduReadNotifyStatus = false
        CanIfRxPduDlcCheck = true
        CanIfRxPduHrhIdRef = RBTM_FL_BODY3_8uqv9blm85ehm0msat385m76v_e046a621_Rx
        CanIfRxPduRef = DIAG_RBTM_FL_03_ExtCAN_RQ_ST3_3f957a34_Rx
        variation-point = post-build-variant-condition{matching-criterion=Side, value=0}
      DIAG_RBTM_FL_03_ExtCAN_RS_ST3_70f788c0_Tx (CanIfTxPduCfg):
        CanIfTxPduCanId = 417440897
        CanIfTxPduCanIdType = EXTENDED_CAN
        CanIfTxPduDlc = 8
        CanIfTxPduUserTxConfirmationName = CanTp_TxConfirmation
        CanIfTxPduUserTxConfirmationUL = CAN_TP
        CanIfTxPduId = 0
        CanIfTxPduReadNotifyStatus = false
        CanIfTxPduType = STATIC
        CanIfTxPduTruncation = true
        CanIfTxPduBufferRef = BODY3_bccb160f
        CanIfTxPduRef = DIAG_RBTM_FL_03_ExtCAN_RS_ST3_ba6d58fb_Tx
        variation-point = post-build-variant-condition{matching-criterion=Side, value=0}
      DIAG_RQ_GLOBAL_ExtCAN_ST3_c34d4a41_Rx (CanIfRxPduCfg):
        CanIfRxPduCanId = 418314633
        CanIfRxPduCanIdType = EXTENDED_CAN
        CanIfRxPduDlc = 8
        CanIfRxPduUserRxIndicationName = CanTp_RxIndication
        CanIfRxPduUserRxIndicationType = PDUID_PDUINFOPTR
        CanIfRxPduUserRxIndicationUL = CAN_TP
        CanIfRxPduId = 0
        CanIfRxPduReadData = false
        CanIfRxPduReadNotifyStatus = false
        CanIfRxPduDlcCheck = true
        CanIfRxPduHrhIdRef = RBTM_FL_BODY3_8uqv9blm85ehm0msat385m76v_e046a621_Rx if post-build-variant-condition{matching-criterion=Side, value=0}
        CanIfRxPduRef = DIAG_RQ_GLOBAL_ExtCAN_ST3_320b5155_Rx
        CanIfRxPduHrhIdRef = RBTM_FR_BODY3_4xwwtd59665s787n6ctawh7k8_5b8d9de8_Rx if post-build-variant-condition{matching-criterion=Side, value=1}
      BODY3_bccb160f (CanIfBufferCfg):
        CanIfBufferSize = 3 if post-build-variant-condition{matching-criterion=Side, value=1}
        CanIfBufferSize = 3 if post-build-variant-condition{matching-criterion=Side, value=0}
        CanIfTxBufferHandlingType = PRIO_BY_CANID
        CanIfTxBufferMappedTxPdus = 3 if post-build-variant-condition{matching-criterion=Side, value=0}
        CanIfTxBufferMappedTxPdus = 3 if post-build-variant-condition{matching-criterion=Side, value=1}
        CanIfTxBufferMaxPduLength = 8
        CanIfBufferHthRef = RBTM_FL_BODY3_8uqv9blm85ehm0msat385m76v_03d5f5f6_Tx if post-build-variant-condition{matching-criterion=Side, value=0}
        CanIfBufferHthRef = RBTM_FR_BODY3_4xwwtd59665s787n6ctawh7k8_23a94727_Tx if post-build-variant-condition{matching-criterion=Side, value=1}
      DIAG_RBTM_FL_03_ExtEth_RQ_ST3_89267c36_Rx (CanIfRxPduCfg):
        CanIfRxPduCanId = 417440904
        CanIfRxPduCanIdType = EXTENDED_CAN
        CanIfRxPduDlc = 8
        CanIfRxPduUserRxIndicationName = CanTp_RxIndication
        CanIfRxPduUserRxIndicationType = PDUID_PDUINFOPTR
        CanIfRxPduUserRxIndicationUL = CAN_TP
        CanIfRxPduId = 4
        CanIfRxPduReadData = false
        CanIfRxPduReadNotifyStatus = false
        CanIfRxPduDlcCheck = true
        CanIfRxPduHrhIdRef = RBTM_FL_BODY3_8uqv9blm85ehm0msat385m76v_e046a621_Rx
        CanIfRxPduRef = DIAG_RBTM_FL_03_ExtEth_RQ_ST3_8e910fe6_Rx
        variation-point = post-build-variant-condition{matching-criterion=Side, value=0}
      DIAG_RBTM_FL_03_ExtEth_RS_ST3_5af4aefa_Tx (CanIfTxPduCfg):
        CanIfTxPduCanId = 417440896
        CanIfTxPduCanIdType = EXTENDED_CAN
        CanIfTxPduDlc = 8
        CanIfTxPduUserTxConfirmationName = CanTp_TxConfirmation
        CanIfTxPduUserTxConfirmationUL = CAN_TP
        CanIfTxPduId = 1
        CanIfTxPduReadNotifyStatus = false
        CanIfTxPduType = STATIC
        CanIfTxPduTruncation = true
        CanIfTxPduBufferRef = BODY3_bccb160f
        CanIfTxPduRef = DIAG_RBTM_FL_03_ExtEth_RS_ST3_0b692d29_Tx
        variation-point = post-build-variant-condition{matching-criterion=Side, value=0}
      DIAG_RBTM_FL_03_IntEth_RQ_ST3_91813a5c_Rx (CanIfRxPduCfg):
        CanIfRxPduCanId = 417440909
        CanIfRxPduCanIdType = EXTENDED_CAN
        CanIfRxPduDlc = 8
        CanIfRxPduUserRxIndicationName = CanTp_RxIndication
        CanIfRxPduUserRxIndicationType = PDUID_PDUINFOPTR
        CanIfRxPduUserRxIndicationUL = CAN_TP
        CanIfRxPduId = 5
        CanIfRxPduReadData = false
        CanIfRxPduReadNotifyStatus = false
        CanIfRxPduDlcCheck = true
        CanIfRxPduHrhIdRef = RBTM_FL_BODY3_8uqv9blm85ehm0msat385m76v_e046a621_Rx
        CanIfRxPduRef = DIAG_RBTM_FL_03_IntEth_RQ_ST3_c3ea483d_Rx
        variation-point = post-build-variant-condition{matching-criterion=Side, value=0}
      DIAG_RBTM_FL_03_IntEth_RS_ST3_de5e5f30_Tx (CanIfTxPduCfg):
        CanIfTxPduCanId = 417440901
        CanIfTxPduCanIdType = EXTENDED_CAN
        CanIfTxPduDlc = 8
        CanIfTxPduUserTxConfirmationName = CanTp_TxConfirmation
        CanIfTxPduUserTxConfirmationUL = CAN_TP
        CanIfTxPduId = 2
        CanIfTxPduReadNotifyStatus = false
        CanIfTxPduType = STATIC
        CanIfTxPduTruncation = true
        CanIfTxPduBufferRef = BODY3_bccb160f
        CanIfTxPduRef = DIAG_RBTM_FL_03_IntEth_RS_ST3_46126af2_Tx
        variation-point = post-build-variant-condition{matching-criterion=Side, value=0}
      DIAG_RQ_GLOBAL_ExtEth_ST3_c52e42e8_Rx (CanIfRxPduCfg):
        CanIfRxPduCanId = 418314376
        CanIfRxPduCanIdType = EXTENDED_CAN
        CanIfRxPduDlc = 8
        CanIfRxPduUserRxIndicationName = CanTp_RxIndication
        CanIfRxPduUserRxIndicationType = PDUID_PDUINFOPTR
        CanIfRxPduUserRxIndicationUL = CAN_TP
        CanIfRxPduId = 1
        CanIfRxPduReadData = false
        CanIfRxPduReadNotifyStatus = false
        CanIfRxPduDlcCheck = true
        CanIfRxPduHrhIdRef = RBTM_FL_BODY3_8uqv9blm85ehm0msat385m76v_e046a621_Rx if post-build-variant-condition{matching-criterion=Side, value=0}
        CanIfRxPduRef = DIAG_RQ_GLOBAL_ExtEth_ST3_3402b191_Rx
        CanIfRxPduHrhIdRef = RBTM_FR_BODY3_4xwwtd59665s787n6ctawh7k8_5b8d9de8_Rx if post-build-variant-condition{matching-criterion=Side, value=1}
      DIAG_RQ_GLOBAL_IntEth_ST3_dc07327b_Rx (CanIfRxPduCfg):
        CanIfRxPduCanId = 418319757
        CanIfRxPduCanIdType = EXTENDED_CAN
        CanIfRxPduDlc = 8
        CanIfRxPduUserRxIndicationName = CanTp_RxIndication
        CanIfRxPduUserRxIndicationType = PDUID_PDUINFOPTR
        CanIfRxPduUserRxIndicationUL = CAN_TP
        CanIfRxPduId = 2
        CanIfRxPduReadData = false
        CanIfRxPduReadNotifyStatus = false
        CanIfRxPduDlcCheck = true
        CanIfRxPduHrhIdRef = RBTM_FL_BODY3_8uqv9blm85ehm0msat385m76v_e046a621_Rx if post-build-variant-condition{matching-criterion=Side, value=0}
        CanIfRxPduRef = DIAG_RQ_GLOBAL_IntEth_ST3_f8cf566a_Rx
        CanIfRxPduHrhIdRef = RBTM_FR_BODY3_4xwwtd59665s787n6ctawh7k8_5b8d9de8_Rx if post-build-variant-condition{matching-criterion=Side, value=1}
      DIAG_RBTM_FR_03_ExtEth_RS_ST3_25545cfe_Tx (CanIfTxPduCfg):
        CanIfTxPduCanId = 417441152
        CanIfTxPduCanIdType = EXTENDED_CAN
        CanIfTxPduDlc = 8
        CanIfTxPduUserTxConfirmationName = CanTp_TxConfirmation
        CanIfTxPduUserTxConfirmationUL = CAN_TP
        CanIfTxPduId = 1
        CanIfTxPduReadNotifyStatus = false
        CanIfTxPduType = STATIC
        CanIfTxPduTruncation = true
        CanIfTxPduBufferRef = BODY3_bccb160f
        CanIfTxPduRef = DIAG_RBTM_FR_03_ExtEth_RS_ST3_16a31970_Tx
        variation-point = post-build-variant-condition{matching-criterion=Side, value=1}
      DIAG_RBTM_FR_03_IntEth_RS_ST3_6c8422ac_Tx (CanIfTxPduCfg):
        CanIfTxPduCanId = 417441157
        CanIfTxPduCanIdType = EXTENDED_CAN
        CanIfTxPduDlc = 8
        CanIfTxPduUserTxConfirmationName = CanTp_TxConfirmation
        CanIfTxPduUserTxConfirmationUL = CAN_TP
        CanIfTxPduId = 2
        CanIfTxPduReadNotifyStatus = false
        CanIfTxPduType = STATIC
        CanIfTxPduTruncation = true
        CanIfTxPduBufferRef = BODY3_bccb160f
        CanIfTxPduRef = DIAG_RBTM_FR_03_IntEth_RS_ST3_5bd85eab_Tx
        variation-point = post-build-variant-condition{matching-criterion=Side, value=1}
      3 x CanIfRxPduCfg, all with CanIfRxPduCanIdType=EXTENDED_CAN, CanIfRxPduDlc=8, CanIfRxPduUserRxIndicationName=CanTp_RxIndication, CanIfRxPduUserRxIndicationType=PDUID_PDUINFOPTR, CanIfRxPduUserRxIndicationUL=CAN_TP, CanIfRxPduReadData=false, CanIfRxPduReadNotifyStatus=false, CanIfRxPduDlcCheck=true, CanIfRxPduHrhIdRef=RBTM_FR_BODY3_4xwwtd59665s787n6ctawh7k8_5b8d9de8_Rx, variation-point=post-build-variant-condition{matching-criterion=Side, value=1}:
        DIAG_RBTM_FR_03_IntEth_RQ_ST3_fad47561_Rx: CanIfRxPduCanId=417441165, CanIfRxPduId=5, CanIfRxPduRef=DIAG_RBTM_FR_03_IntEth_RQ_ST3_de207c64_Rx
        DIAG_RBTM_FR_03_ExtEth_RQ_ST3_0a9e12f4_Rx: CanIfRxPduCanId=417441160, CanIfRxPduId=4, CanIfRxPduRef=DIAG_RBTM_FR_03_ExtEth_RQ_ST3_935b3bbf_Rx
        DIAG_RBTM_FR_03_ExtCAN_RQ_ST3_72fbd255_Rx: CanIfRxPduCanId=417441161, CanIfRxPduId=3, CanIfRxPduRef=DIAG_RBTM_FR_03_ExtCAN_RQ_ST3_225f4e6d_Rx
      DIAG_RBTM_FR_03_ExtCAN_RS_ST3_d977ea77_Tx (CanIfTxPduCfg):
        CanIfTxPduCanId = 417441153
        CanIfTxPduCanIdType = EXTENDED_CAN
        CanIfTxPduDlc = 8
        CanIfTxPduUserTxConfirmationName = CanTp_TxConfirmation
        CanIfTxPduUserTxConfirmationUL = CAN_TP
        CanIfTxPduId = 0
        CanIfTxPduReadNotifyStatus = false
        CanIfTxPduType = STATIC
        CanIfTxPduTruncation = true
        CanIfTxPduBufferRef = BODY3_bccb160f
        CanIfTxPduRef = DIAG_RBTM_FR_03_ExtCAN_RS_ST3_a7a76ca2_Tx
        variation-point = post-build-variant-condition{matching-criterion=Side, value=1}
    CanIfPrivateCfg:
      CanIfPrivateSoftwareFilterType = LINEAR
      CanIfSupportNmOsek = false
      CanIfWakeupSupport = false
      CanIfPrivateDlcCheck = true
      CanIfSupportTTCAN = false
      CanIfTransceiverMapping = false
      CanIfTransceiverHandling = false
      CanIfSupportExtendedIds = true
      CanIfTxBufferType = BYTE_QUEUE
      CanIfStaticFdTxBufferSupport = false
      CanIfRxSearchConsiderMsgType = false
      CanIfTxBufferFifoSupport = false
      CanIfSetPduReceptionModeSupport = false
      CanIfCheckWakeupCanRetType = false
      CanIfDataChecksumRxSupport = false
      CanIfDataChecksumTxSupport = false
    CanIfPublicCfg:
      CanIfPublicPnSupport = true
      CanIfPublicCddHeaderFile = CanIf_Cdd.h
      CanIfPublicVersionInfoApi = false
      CanIfPublicCancelTransmitSupport = false
      CanIfPublicDevErrorDetect = false
      CanIfPublicHandleTypeEnum = UINT8
      CanIfPublicMultipleDrvSupport = false
      CanIfPublicNumberOfCanHwUnits = 1
      CanIfPublicReadRxPduDataApi = false
      CanIfPublicReadRxPduNotifyStatusApi = false
      CanIfPublicReadTxPduNotifyStatusApi = false
      CanIfPublicSetDynamicTxIdApi = false
      CanIfPublicTxBuffering = true
      CanIfPublicTxConfirmPollingSupport = false
      CanIfPublicWakeupCheckValidSupport = false
      CanIfPnWakeupTxPduFilterSupport = false
      CanIfPnTrcvHandlingSupport = false
      CanIfJ1939DynAddrSupport = DISABLED
      CanIfSafeBswChecks = false
      CanIfBusMirroringSupport = false
      CanIfEnableSecurityEventReporting = false
      CanIfSupportCanDrvAsr440 = false
      CanIfSetBaudrateApi = false
