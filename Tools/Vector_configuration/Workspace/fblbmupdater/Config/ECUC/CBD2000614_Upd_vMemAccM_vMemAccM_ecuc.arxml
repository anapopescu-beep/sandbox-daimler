AUTOSAR XML (schema 00046)
package /ActiveEcuC
  module config vMemAccM: implementation-config-variant=VARIANT-PRE-COMPILE, module-description=vMemAccM_Impl
    vMemAccMAddressAreaConfiguration_Partition_B (vMemAccMAddressAreaConfiguration): vMemAccMAddressAreaId=1, vMemAccMAddressAreaPriority=1, vMemAccMReadRequestLength=1024
      vMemAccMSubAddressAreaConfiguration_Bootloader (vMemAccMSubAddressAreaConfiguration):
        vMemAccMNumberOfSectors = 9
        vMemAccMVirtualStartAddress = 2684616704
        vMemAccMPhysicalStartAddress = 2690908160
        vMemAccMvMemFuncPtrTableSymbol = vMem_30_Fbl_FunctionPointerTable
        vMemAccMUseEraseBurst = false
        vMemAccMUseWriteBurst = false
        vMemAccMSectorRef = PF2_PF0_PS0_S36_S63
      vMemAccMSubAddressAreaConfiguration_Application_S1 (vMemAccMSubAddressAreaConfiguration):
        vMemAccMNumberOfSectors = 38
        vMemAccMVirtualStartAddress = 2684780544
        vMemAccMPhysicalStartAddress = 2691072000
        vMemAccMvMemFuncPtrTableSymbol = vMem_30_Fbl_FunctionPointerTable
        vMemAccMUseEraseBurst = false
        vMemAccMUseWriteBurst = false
        vMemAccMSectorRef = PF2_PF0_PS1_S64_S127
    vMemAccMAddressAreaConfiguration_Partition_A (vMemAccMAddressAreaConfiguration): vMemAccMAddressAreaId=0, vMemAccMAddressAreaPriority=0, vMemAccMReadRequestLength=1024
      4 x vMemAccMSubAddressAreaConfiguration, all with vMemAccMvMemFuncPtrTableSymbol=vMem_30_Fbl_FunctionPointerTable, vMemAccMUseEraseBurst=false, vMemAccMUseWriteBurst=false:
        vMemAccMSubAddressAreaConfiguration_Bootloader: vMemAccMNumberOfSectors=14, vMemAccMVirtualStartAddress=2684567552, vMemAccMPhysicalStartAddress=2684567552, vMemAccMSectorRef=PF0_PF2_PS0_S36_S63
        vMemAccMSubAddressAreaConfiguration_Application_S1: vMemAccMNumberOfSectors=37, vMemAccMVirtualStartAddress=2684796928, vMemAccMPhysicalStartAddress=2684796928, vMemAccMSectorRef=PF0_PF2_PS1_S64_S127
        vMemAccMSubAddressAreaConfiguration_UCB_ORIG: vMemAccMNumberOfSectors=1, vMemAccMVirtualStartAddress=2940207104, vMemAccMPhysicalStartAddress=2940207104, vMemAccMSectorRef=PF0_PF2_PS0_S36_S63_UCB_ORIG
        vMemAccMSubAddressAreaConfiguration_UCB_ORIG_COPY: vMemAccMNumberOfSectors=1, vMemAccMVirtualStartAddress=2940211200, vMemAccMPhysicalStartAddress=2940211200, vMemAccMSectorRef=PF0_PF2_PS0_S36_S63_UCB_ORIG_COPY
    vMemAccMGeneral:
      vMemAccMVersionInfoApi = false
      vMemAccMMainFunctionPeriod = 0.005
      vMemAccMMainFunctionTriggering = FixedCycleTime
      vMemAccMSafeBswChecks = false
      vMemAccMDevErrorDetect = true
      vMemAccMCompareApi = true
