AUTOSAR XML (schema 00046)
package /ActiveEcuC
  ecuc value collection ActiveEcuC: ecu-extract=SYSTEM
    ecuc-values:
      Det
      EcuC
      vSet
      vSecPrim
      FblBm
      FblHal
      Fbl
      FblBmHdr
      vBaseEnv
      McalLib
      ResourceM
      Os
      vLinkGen
      CryIf
      Crypto
      Crypto_vHsm
      Csm
      vBRS
      vMem
      vMemAccM
      Mcu
      MemMap
      Fee
      Fls
      WrapNv
      NvM_Stub
