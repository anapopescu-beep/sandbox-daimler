AUTOSAR XML (schema 00046)
package /ActiveEcuC
  module config CryIf: implementation-config-variant=VARIANT-PRE-COMPILE, module-description=CryIf_Impl
    CryIfGeneral:
      CryIfVersionInfoApi = false
      CryIfDevErrorDetect = true
      CryIfMaxNumberOfKeyElements = 10
      CryIfMaxSizeOfKeyElement = 32
      CryIfRedirection = false
      CryIfSafeBswChecks = false
    CryIfChannel_CryptoCv_Fbl_Aes (CryIfChannel): CryIfChannelId=0, CryIfDriverObjectRef=Crypto_30_LibCv_Aes
    CryIfChannel_CryptoCv_Fbl_Signature (CryIfChannel): CryIfChannelId=2, CryIfDriverObjectRef=Crypto_30_LibCv
    CryIfCryptoModule: CryIfSupportsKeyElementCopyPartial=true, CryIfCancelJobApiUsesJobType=true, CryIfCryptoModuleRef=Crypto
    4 x CryIfKey:
      CryIfKey_Fbl_Decrypt_Aes128: CryIfKeyId=11, CryIfKeyRef=CryptoKey_Fbl_Decrypt_Aes128
      CryIfKey_Fbl_HashDummy: CryIfKeyId=12, CryIfKeyRef=CryptoKey_Fbl_HashDummy
      CryIfKey_Fbl_Signature_Ed25519: CryIfKeyId=14, CryIfKeyRef=CryptoKey_Fbl_Signature_Ed25519
      CryIfKey_Fbl_Rng_Fips186: CryIfKeyId=13, CryIfKeyRef=CryptoKey_Fbl_Fips186
    CryIfChannel_CryptoCv_Fbl_Rng (CryIfChannel): CryIfChannelId=1, CryIfDriverObjectRef=Crypto_30_LibCv_Rng
    CryIfChannel_vHsm_Core (CryIfChannel): CryIfChannelId=3, CryIfDriverObjectRef=Crypto_30_vHsm_Core
    CryIfCryptoModule_Hsm (CryIfCryptoModule): CryIfSupportsKeyElementCopyPartial=true, CryIfCancelJobApiUsesJobType=true, CryIfCryptoModuleRef=Crypto_vHsm
    53 x CryIfKey:
      CryIfKey_KeyM_Cert_Root: CryIfKeyId=15, CryIfKeyRef=KeyM_Cert_Root
      CryIfKey_KeyM_ECC_Intermediate: CryIfKeyId=16, CryIfKeyRef=KeyM_ECC_Intermediate
      CryIfKey_KeyM_ECC_Root: CryIfKeyId=17, CryIfKeyRef=KeyM_ECC_Root
      CryIfKey_KeyM_SigVerifyKey_TrustModelBackend: CryIfKeyId=18, CryIfKeyRef=KeyM_SigVerifyKey_TrustModelBackend
      CryIfKey_KeyM_SigVerifyKey_TrustModelIntermediate: CryIfKeyId=21, CryIfKeyRef=KeyM_SigVerifyKey_TrustModelIntermediate
      CryIfKey_KeyM_SigVerifyKey_TrustModelRoot: CryIfKeyId=23, CryIfKeyRef=KeyM_SigVerifyKey_TrustModelRoot
      CryIfKey_SSA_SecOC_Int_MacVerify_DI_OdoSpeedometer: CryIfKeyId=29, CryIfKeyRef=SSA_SecOC_Int_MacVerify_DI_OdoSpeedometer
      CryIfKey_SSA_SecOC_Int_MacVerify_Ign_Stat: CryIfKeyId=30, CryIfKeyRef=SSA_SecOC_Int_MacVerify_Ign_Stat
      CryIfKey_SSA_SecOC_Int_MacVerify_PN14_Master_Stat1: CryIfKeyId=31, CryIfKeyRef=SSA_SecOC_Int_MacVerify_PN14_Master_Stat1
      CryIfKey_SSA_SecOC_Int_MacVerify_PT4_PTCoor4: CryIfKeyId=32, CryIfKeyRef=SSA_SecOC_Int_MacVerify_PT4_PTCoor4
      CryIfKey_SSA_SecOC_Int_MacVerify_VehSpd_8: CryIfKeyId=33, CryIfKeyRef=SSA_SecOC_Int_MacVerify_VehSpd_8
      CryIfKey_Ssa_AesRamKey: CryIfKeyId=34, CryIfKeyRef=Ssa_AesRamKey
      CryIfKey_Ssa_Authentication: CryIfKeyId=35, CryIfKeyRef=Ssa_Authentication
      CryIfKey_Ssa_BackendCert: CryIfKeyId=36, CryIfKeyRef=Ssa_BackendCert
      CryIfKey_Ssa_RandomSeed: CryIfKeyId=38, CryIfKeyRef=Ssa_RandomSeed
      CryIfKey_Ssa_RealTime: CryIfKeyId=39, CryIfKeyRef=Ssa_RealTime
      CryIfKey_Ssa_RootCert: CryIfKeyId=40, CryIfKeyRef=Ssa_RootCert
      CryIfKey_Ssa_SecurityAccessPublicKey: CryIfKeyId=41, CryIfKeyRef=Ssa_SecurityAccessPublicKey
      CryIfKey_Ssa_SharedSecretExchangeKey: CryIfKeyId=42, CryIfKeyRef=Ssa_SharedSecretExchangeKey
      CryIfKey_Ssa_SharedSecretHash: CryIfKeyId=43, CryIfKeyRef=Ssa_SharedSecretHash
      CryIfKey_Ssa_SignatureRamKey: CryIfKeyId=44, CryIfKeyRef=Ssa_SignatureRamKey
      CryIfKey_Ssa_TickCount: CryIfKeyId=45, CryIfKeyRef=Ssa_TickCount
      CryIfKey_Ssa_VIN: CryIfKeyId=49, CryIfKeyRef=Ssa_VIN
      CryIfKey_vHsm_Custom: CryIfKeyId=50, CryIfKeyRef=vHsm_Custom
      CryIfKey_vHsm_FirmwareUpdate_Signature: CryIfKeyId=51, CryIfKeyRef=vHsm_FirmwareUpdate_Signature
      CryIfKey_vHsm_Hardware: CryIfKeyId=52, CryIfKeyRef=vHsm_Hardware
      CryIfKey_vHsm_Info: CryIfKeyId=53, CryIfKeyRef=vHsm_Info
      CryIfKey_vHsm_RomKey0: CryIfKeyId=55, CryIfKeyRef=vHsm_RomKey0
      CryIfKey_SSA_SecOC_Int_MacGen_COM_C04_Pdu21_secured_2e466e5b_Tx: CryIfKeyId=26, CryIfKeyRef=SSA_SecOC_Int_MacGen_COM_C04_Pdu21_secured_2e466e5b_Tx
      CryIfKey_SSA_SecOC_Int_MacVerify_COM_C0X_Pdu21_secured_298d825c_Rx: CryIfKeyId=28, CryIfKeyRef=SSA_SecOC_Int_MacVerify_COM_C0X_Pdu21_secured_298d825c_Rx
      CryIfKey_CryIfKey_Ssa_SignatureRamKey_replacementAuthority: CryIfKeyId=2, CryIfKeyRef=CryIfKey_Ssa_SignatureRamKey_replacementAuthority
      CryIfKey_Ssa_TrustModelEcuPublicCsr_StagingKey: CryIfKeyId=46, CryIfKeyRef=Ssa_TrustModelEcuPublicCsr_StagingKey
      CryIfKey_CryIfKey_vHsm_Info: CryIfKeyId=10, CryIfKeyRef=CryIfKey_vHsm_Info
      CryIfKey_KeyM_SigVerifyKey_TrustModelIntermediatePeer: CryIfKeyId=22, CryIfKeyRef=KeyM_SigVerifyKey_TrustModelIntermediatePeer
      CryIfKey_Ssa_TrustModelEcuPublic_LiveKey: CryIfKeyId=47, CryIfKeyRef=Ssa_TrustModelEcuPublic_LiveKey
      CryIfKey_SSA_SecOC_Int_MacGen_COM_C04_Pdu20_secured_393d7a18_Tx: CryIfKeyId=25, CryIfKeyRef=SSA_SecOC_Int_MacGen_COM_C04_Pdu20_secured_393d7a18_Tx
      CryIfKey_CryIfKey_KeyMCertificate_OSSL_X509_ECDSA_P384_CA: CryIfKeyId=0, CryIfKeyRef=CryIfKey_KeyMCertificate_OSSL_X509_ECDSA_P384_CA
      CryIfKey_Ssa_PduKeysMac: CryIfKeyId=37, CryIfKeyRef=Ssa_PduKeysMac
      CryIfKey_SSA_SecOC_Int_MacVerify_COM_C0X_Pdu20_secured_3ef6961f_Rx: CryIfKeyId=27, CryIfKeyRef=SSA_SecOC_Int_MacVerify_COM_C0X_Pdu20_secured_3ef6961f_Rx
      CryIfKey_vHsm_Log: CryIfKeyId=54, CryIfKeyRef=vHsm_Log
      CryIfKey_KeyM_SigVerifyKey_TrustModelEcuPeer: CryIfKeyId=20, CryIfKeyRef=KeyM_SigVerifyKey_TrustModelEcuPeer
      CryIfKey_Ssa_TrustModelPrivateEcu_LiveKey: CryIfKeyId=48, CryIfKeyRef=Ssa_TrustModelPrivateEcu_LiveKey
      CryIfKey_CryIfKey_Ssa_TrustModelPrivateEcuUnique_StagingKey: CryIfKeyId=6, CryIfKeyRef=CryIfKey_Ssa_TrustModelPrivateEcuUnique_StagingKey
      CryIfKey_KeyM_SigVerifyKey_TrustModelBackendPeer: CryIfKeyId=19, CryIfKeyRef=KeyM_SigVerifyKey_TrustModelBackendPeer
      CryIfKey_vHsm_TRNG: CryIfKeyId=56, CryIfKeyRef=vHsm_TRNG
      CryIfKey_CryIfKey_KeyMCertificate_OSSL_X509_ECDSA_P384_IA: CryIfKeyId=1, CryIfKeyRef=CryIfKey_KeyMCertificate_OSSL_X509_ECDSA_P384_IA
      CryIfKey_SSA_SecOC_Int_MacGen_COM_C04_Pdu03_secured_044596e0_Tx: CryIfKeyId=24, CryIfKeyRef=SSA_SecOC_Int_MacGen_COM_C04_Pdu03_secured_044596e0_Tx
      CryIfKey_CryIfKey_Ssa_TrustModelBackendCert_inHSM: CryIfKeyId=3, CryIfKeyRef=CryIfKey_Ssa_TrustModelBackendCert_inHSM
      CryIfKey_CryIfKey_Ssa_TrustModel_Ecu_CsrPublicKey: CryIfKeyId=9, CryIfKeyRef=CryIfKey_Ssa_TrustModel_Ecu_CsrPublicKey
      CryIfKey_CryIfKey_Ssa_TrustModelRootCert_inHSM: CryIfKeyId=7, CryIfKeyRef=CryIfKey_Ssa_TrustModelRootCert_inHSM
      CryIfKey_CryIfKey_Ssa_TrustModel_Ecu_CsrPrivateKey: CryIfKeyId=8, CryIfKeyRef=CryIfKey_Ssa_TrustModel_Ecu_CsrPrivateKey
      CryIfKey_CryIfKey_Ssa_TrustModelEcuCert_inHSM: CryIfKeyId=4, CryIfKeyRef=CryIfKey_Ssa_TrustModelEcuCert_inHSM
      CryIfKey_CryIfKey_Ssa_TrustModelIntermediateCert_inHSM: CryIfKeyId=5, CryIfKeyRef=CryIfKey_Ssa_TrustModelIntermediateCert_inHSM
