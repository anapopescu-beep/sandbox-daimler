AUTOSAR XML (schema 00046)
package /ActiveEcuC
  module config CanSM: implementation-config-variant=VARIANT-POST-BUILD-SELECTABLE, module-description=CanSM_Impl
    CanSMConfiguration: CanSMModeRequestRepetitionMax=10, CanSMModeRequestRepetitionTime=0.1
      BODY3_bccb160f (CanSMManagerNetwork):
        CanSMBorCounterL1ToL2 = 5
        CanSMBorTimeL1 = 1
        CanSMBorTimeL2 = 3
        CanSMBorTimeTxEnsured = 5
        CanSMBorTxConfirmationPolling = false
        CanSMComMNetworkHandleRef = RBTM_FL_BODY3_8uqv9blm85ehm0msat385m76v_03d5f5f6 if post-build-variant-condition{matching-criterion=Side, value=0}
        CanSMComMNetworkHandleRef = RBTM_FR_BODY3_4xwwtd59665s787n6ctawh7k8_23a94727 if post-build-variant-condition{matching-criterion=Side, value=1}
        RBTM_FL_BODY3_001d3ccc (CanSMController): CanSMControllerId=RBTM_FL_BODY3_180ddaa4, variation-point=post-build-variant-condition{matching-criterion=Side, value=0}
        RBTM_FR_BODY3_d6bbf7e7 (CanSMController): CanSMControllerId=RBTM_FR_BODY3_2fec3d37, variation-point=post-build-variant-condition{matching-criterion=Side, value=1}
    CanSMGeneral:
      CanSMVersionInfoApi = false
      CanSMDevErrorDetect = true
      CanSMMainFunctionTimePeriod = 0.005
      CanSMBorCheckLevel = false
      CanSMSafeBswChecks = false
      CanSMSetBaudrateApi = false
      CanSMGeneration: CanSMOutOfBoundsWriteSanitizer=false, CanSMOutOfBoundsReadSanitizer=false
