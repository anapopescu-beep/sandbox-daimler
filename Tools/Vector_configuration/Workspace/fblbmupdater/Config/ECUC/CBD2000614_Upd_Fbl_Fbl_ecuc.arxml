AUTOSAR XML (schema 00046)
package /ActiveEcuC
  module config Fbl: implementation-config-variant=VARIANT-LINK-TIME, module-description=Fbl_Impl
    FblGeneral:
      FblCommonData = true
      FblDataProcessingBufferSize = 256
      FblDiagnosticBufferSize = 4095
      FblGapFilling = true
      FblInternalMemoryCopy = true
      FblMaximumNumberOfSegments = 10
      FblP2Server = 20
      FblP2StarServer = 2000
      FblProcessedVerification = false
      FblProjectState = INTEGRATION
      FblUserConfigFile = $(DpaProjectFolder)\Config\user_config.cfg
      FblVerificationSegmentation = 256
      FblWriteSegmentation = 256
      FblWatchdogService = true
      FblUnalignedDataTransfer = true
      FblResponseAfterReset = false
      FblPipelinedVerification = true
      FblOutputVerification = false
      FblPipelinedProgramming = true
      FblApplicationStateTask = false
      FblMaximumAmountOfLogicalBlocks = 2
      FblApplicationTimerTask = false
      FblAdaptiveDataTransferRcrrp = false
      FblGatewaySupport = false
      FblSleepTime = 300000
      FblStayInBoot = false
      FblSuspendDriverOperation = false
      FblVerificationFunction = false
      FblSleepMode = true
      FblUserRoutine = false
      FblS3ServerExtendedSession = 5000
      FblS3ServerProgrammingSession = 5000
      FblFlashDriverUsage = USE_FLASH_DRIVER_FROM_ROM
      FblReprogrammableLbt = false
      FblHeaderAddress = 2684650272
      FblFillCode = 170
      FblPresencePattern = true
      FblStartFunction = true
      FblUserSubfunction = false
      FblUserService = false
      FblWatchdogTriggerCycle = 1
      FblEncryptionMode = false
      FblCompressionMode = false
      FblInputVerification = true
      FblBlockStartAddress = 2684649472
      FblBlockLength = 147456
      FblHardwareSwap = false
      FblOta = false
      FblOneStepUpdater = false
      FblXcpSupport = false
    FblLogicalBlockTable
      Fbl (FblLogicalBlock):
        FblLbInputVerification = SecM_VerifySignature
        FblLbProcessedVerification = SecM_VerifySignature
        FblLbPipelinedVerification = SecM_VerifyClassDDD
        FblLbOutputVerification = SecM_VerifyClassDDD
        FblLbDisposability = MANDATORY
        FblLbStartAddress = 2684649472
        FblLbEndAddress = 2684796927
        FblLbMaxReprogAttempts = 0
        FblLbDescription = 
        FblLbBmHeaderAddress = 2684650272
        FblLbBlockIndex = 0
        FblLbBlockType = BOOT
      Updater (FblLogicalBlock):
        FblLbInputVerification = SecM_VerifySignature
        FblLbProcessedVerification = SecM_VerifySignature
        FblLbPipelinedVerification = SecM_VerifyClassDDD
        FblLbOutputVerification = SecM_VerifyClassDDD
        FblLbDisposability = MANDATORY
        FblLbStartAddress = 2684796928
        FblLbEndAddress = 2685403135
        FblLbMaxReprogAttempts = 0
        FblLbDescription = 
        FblLbBmHeaderAddress = 2684797152
        FblLbBlockIndex = 1
        FblLbBlockType = CODE
    FblFlashBlockTable
      7 x FblFlashBlock:
        FblFlashBlock_0: FblFbStartAddress=2684354560, FblFbEndAddress=2684387327, FblFbDescription=PF0 PS0: 32KB Block (HSM)
        FblFlashBlock_1: FblFbStartAddress=2684387328, FblFbEndAddress=2684567551, FblFbDescription=PF0 PS0: 32KB Block (HSM)
        FblFlashBlock_9: FblFbStartAddress=2684649472, FblFbEndAddress=2684796927, FblFbDescription=PF0 PS0: 148KB Block (FBL), FblFbMemoryDeviceRef=Flash, FblFbLogicalBlockRef=Fbl
        FblFlashBlock_8: FblFbStartAddress=2684567552, FblFbEndAddress=2684649471, FblFbDescription=PF0 PS0: 64KB Block (BM), FblFbMemoryDeviceRef=Flash
        FblFlashBlock_10: FblFbStartAddress=2684796928, FblFbEndAddress=2685403135, FblFbDescription=PF0 PS1: 458KB Block (APPL), FblFbMemoryDeviceRef=Flash, FblFbLogicalBlockRef=Updater
        FblFlashBlock_UCB_BMHD0: FblFbStartAddress=2940207104, FblFbEndAddress=2940207616, FblFbDescription=UCB BMDH0 ORIG, FblFbMemoryDeviceRef=Flash
        FblFlashBlock_UCB_BMHD0_COPY: FblFbStartAddress=2940211200, FblFbEndAddress=2940211712, FblFbDescription=UCB BMDH0 ORIG, FblFbMemoryDeviceRef=Flash
    FblMemoryDeviceTable
      Flash (FblMemoryDevice):
        FblMdSegmentSize = 32
        FblMdErasedValue = 0
        FblMdIndex = 0
        FblMdInitHook = false
        FblMdDeinitHook = false
        FblMdReadHook = true
        FblMdEraseHook = true
        FblMdWriteHook = true
        FblMdVerifyHook = true
      Protected (FblMemoryDevice):
        FblMdErasedValue = 255
        FblMdSegmentSize = 1
        FblMdIndex = 1
        FblMdInitHook = false
        FblMdDeinitHook = false
        FblMdReadHook = false
        FblMdEraseHook = false
        FblMdWriteHook = false
        FblMdVerifyHook = false
    FblDaimler:
      FblEvaluateMemoryStatusInformation = true
      FblResumableProgramming = false
      FblMinimumResumeSectionGranularity = MRSG_256
      FblFlashDownloadSpecification = DDS_R01_01_2020_01
