AUTOSAR XML (schema 00046)
package /ActiveEcuC
  module config CanTp: implementation-config-variant=VARIANT-POST-BUILD-SELECTABLE, module-description=CanTp_Impl
    CanTpGeneral:
      CanTpVersionInfoApi = false
      CanTpSupportExtendedAddressing = false
      CanTpSupportMixed11Addressing = false
      CanTpSupportStandardAddressing = true
      CanTpChangeParameterApi = true
      CanTpDevErrorDetect = false
      CanTpPaddingByte = 0
      CanTpReadParameterApi = true
      CanTpPaddingActive = true
      CanTpHavePaddingByte = false
      CanTpNumRxChannels = 0
      CanTpNumTxChannels = 0
      CanTpEnableSplitMainFunction = false
      CanTpSupportMixed29Addressing = true
      CanTpSupportNormalFixedAddressing = true
      CanTpSupportCustomAddressing = false
      CanTpOnlyNotifyInformedAppl = true
      CanTpRc = false
      CanTpTc = false
      CanTpSafeBswChecks = false
      CanTpEnableSynchronousTransmit = true
      CanTpSupportLongFirstFrames = true
      CanTpFlexibleDataRateSupport = true
    CanTpConfig: CanTpMainFunctionPeriod=0.005
      12 x CanTpChannel:
        BODY3_DIAG_GLOBAL_ExtCAN_RQ_BODY3_ST3_1b970870: CanTpChannelMode=CANTP_MODE_HALF_DUPLEX, variation-point=post-build-variant-condition{matching-criterion=Side, value=0}
          CanTpRxNSdu_e35239dd (CanTpRxNSdu):
            CanTpRxAddressingFormat = CANTP_STANDARD
            CanTpRxDl = 8
            CanTpRxPaddingActivation = CANTP_ON
            CanTpRxTaType = CANTP_FUNCTIONAL
            CanTpNbr = 0.1
            CanTpRxNSduId = 0
            CanTpRxNSduRef = SDU_DIAG_GLOBAL_ExtCAN_RQ_BODY3_ST3_1d96a036_Rx
            CanTpRxNPdu_a8dd74b8 (CanTpRxNPdu): CanTpRxNPduId=3, CanTpRxNPduRef=DIAG_RQ_GLOBAL_ExtCAN_ST3_320b5155_Rx
        BODY3_DIAG_RBTM_FL_03_ExtCAN_RQ_BODY3_ST3_DIAG_RBTM_FL_03_ExtCAN_RS_BODY3_ST3_83aa84a1: CanTpChannelMode=CANTP_MODE_FULL_DUPLEX, variation-point=post-build-variant-condition{matching-criterion=Side, value=0}
          CanTpTxNSdu_530d12e8 (CanTpTxNSdu):
            CanTpTxAddressingFormat = CANTP_STANDARD
            CanTpTxDl = 8
            CanTpTxPaddingActivation = CANTP_ON
            CanTpTxTaType = CANTP_PHYSICAL
            CanTpNas = 0.1
            CanTpNcs = 1.5
            CanTpTc = false
            CanTpTxNSduId = 0
            CanTpNbs = 0.5
            CanTpTxNSduRef = SDU_DIAG_RBTM_FL_03_ExtCAN_RS_BODY3_ST3_92b91e83_Tx
            CanTpRxFcNPdu_5cdfcb87 (CanTpRxFcNPdu): CanTpRxFcNPduId=0, CanTpRxFcNPduRef=DIAG_RBTM_FL_03_ExtCAN_RQ_ST3_3f957a34_Rx
            CanTpTxNPdu_5cdfcb87 (CanTpTxNPdu): CanTpTxNPduConfirmationPduId=0, CanTpTxNPduRef=DIAG_RBTM_FL_03_ExtCAN_RS_ST3_ba6d58fb_Tx
          CanTpRxNSdu_530d12e8 (CanTpRxNSdu):
            CanTpBs = 0
            CanTpRxAddressingFormat = CANTP_STANDARD
            CanTpRxDl = 8
            CanTpRxPaddingActivation = CANTP_ON
            CanTpRxTaType = CANTP_PHYSICAL
            CanTpSTmin = 0
            CanTpNbr = 1.5
            CanTpRxNSduId = 6
            CanTpNar = 0.1
            CanTpNcr = 0.5
            CanTpRxWftMax = 5
            CanTpRxNSduRef = SDU_DIAG_RBTM_FL_03_ExtCAN_RQ_BODY3_ST3_6d2a29a5_Rx
            CanTpRxNPdu_7e251f75 (CanTpRxNPdu): CanTpRxNPduId=0, CanTpRxNPduRef=DIAG_RBTM_FL_03_ExtCAN_RQ_ST3_3f957a34_Rx
            CanTpTxFcNPdu_7e251f75 (CanTpTxFcNPdu): CanTpTxFcNPduConfirmationPduId=0, CanTpTxFcNPduRef=DIAG_RBTM_FL_03_ExtCAN_RS_ST3_ba6d58fb_Tx
        BODY3_DIAG_GLOBAL_ExtEth_RQ_BODY3_ST3_55538ea6: CanTpChannelMode=CANTP_MODE_HALF_DUPLEX, variation-point=post-build-variant-condition{matching-criterion=Side, value=0}
          CanTpRxNSdu_4a102435 (CanTpRxNSdu):
            CanTpRxAddressingFormat = CANTP_STANDARD
            CanTpRxDl = 8
            CanTpRxPaddingActivation = CANTP_ON
            CanTpRxTaType = CANTP_FUNCTIONAL
            CanTpNbr = 0.1
            CanTpRxNSduId = 2
            CanTpBs = 32
            CanTpSTmin = 0
            CanTpRxNSduRef = SDU_DIAG_GLOBAL_ExtEth_RQ_BODY3_ST3_38ac71dd_Rx
            CanTpRxNPdu_2dd5cd3e (CanTpRxNPdu): CanTpRxNPduId=4, CanTpRxNPduRef=DIAG_RQ_GLOBAL_ExtEth_ST3_3402b191_Rx
        BODY3_DIAG_GLOBAL_IntEth_RQ_BODY3_ST3_01a72909: CanTpChannelMode=CANTP_MODE_HALF_DUPLEX, variation-point=post-build-variant-condition{matching-criterion=Side, value=0}
          CanTpRxNSdu_44714e59 (CanTpRxNSdu):
            CanTpRxAddressingFormat = CANTP_STANDARD
            CanTpRxDl = 8
            CanTpRxPaddingActivation = CANTP_ON
            CanTpRxTaType = CANTP_FUNCTIONAL
            CanTpNbr = 0.1
            CanTpRxNSduId = 4
            CanTpBs = 32
            CanTpSTmin = 0
            CanTpRxNSduRef = SDU_DIAG_GLOBAL_IntEth_RQ_BODY3_ST3_6efa2066_Rx
            CanTpRxNPdu_29880c5f (CanTpRxNPdu): CanTpRxNPduId=5, CanTpRxNPduRef=DIAG_RQ_GLOBAL_IntEth_ST3_f8cf566a_Rx
        BODY3_DIAG_RBTM_FL_03_ExtEth_RQ_BODY3_ST3_DIAG_RBTM_FL_03_ExtEth_RS_BODY3_ST3_6c739aa3: CanTpChannelMode=CANTP_MODE_FULL_DUPLEX, variation-point=post-build-variant-condition{matching-criterion=Side, value=0}
          CanTpRxNSdu_690fe637 (CanTpRxNSdu):
            CanTpBs = 0
            CanTpRxAddressingFormat = CANTP_STANDARD
            CanTpRxDl = 8
            CanTpRxPaddingActivation = CANTP_ON
            CanTpRxTaType = CANTP_PHYSICAL
            CanTpSTmin = 0
            CanTpNbr = 1.5
            CanTpRxNSduId = 7
            CanTpNar = 0.1
            CanTpNcr = 0.5
            CanTpRxWftMax = 5
            CanTpRxNSduRef = SDU_DIAG_RBTM_FL_03_ExtEth_RQ_BODY3_ST3_4810f84e_Rx
            CanTpRxNPdu_2f8b5959 (CanTpRxNPdu): CanTpRxNPduId=1, CanTpRxNPduRef=DIAG_RBTM_FL_03_ExtEth_RQ_ST3_8e910fe6_Rx
            CanTpTxFcNPdu_2f8b5959 (CanTpTxFcNPdu): CanTpTxFcNPduConfirmationPduId=1, CanTpTxFcNPduRef=DIAG_RBTM_FL_03_ExtEth_RS_ST3_0b692d29_Tx
          CanTpTxNSdu_690fe637 (CanTpTxNSdu):
            CanTpTxAddressingFormat = CANTP_STANDARD
            CanTpTxDl = 8
            CanTpTxPaddingActivation = CANTP_ON
            CanTpTxTaType = CANTP_PHYSICAL
            CanTpNas = 0.1
            CanTpNcs = 1.5
            CanTpTc = false
            CanTpTxNSduId = 1
            CanTpNbs = 0.5
            CanTpTxNSduRef = SDU_DIAG_RBTM_FL_03_ExtEth_RS_BODY3_ST3_b783cf68_Tx
            CanTpRxFcNPdu_0d718dab (CanTpRxFcNPdu): CanTpRxFcNPduId=1, CanTpRxFcNPduRef=DIAG_RBTM_FL_03_ExtEth_RQ_ST3_8e910fe6_Rx
            CanTpTxNPdu_0d718dab (CanTpTxNPdu): CanTpTxNPduConfirmationPduId=1, CanTpTxNPduRef=DIAG_RBTM_FL_03_ExtEth_RS_ST3_0b692d29_Tx
        BODY3_DIAG_RBTM_FL_03_IntEth_RQ_BODY3_ST3_DIAG_RBTM_FL_03_IntEth_RS_BODY3_ST3_794384a5: CanTpChannelMode=CANTP_MODE_FULL_DUPLEX, variation-point=post-build-variant-condition{matching-criterion=Side, value=0}
          CanTpRxNSdu_b61ae5cc (CanTpRxNSdu):
            CanTpBs = 0
            CanTpRxAddressingFormat = CANTP_STANDARD
            CanTpRxDl = 8
            CanTpRxPaddingActivation = CANTP_ON
            CanTpRxTaType = CANTP_PHYSICAL
            CanTpSTmin = 0
            CanTpNbr = 1.5
            CanTpRxNSduId = 8
            CanTpNar = 0.1
            CanTpNcr = 0.5
            CanTpRxWftMax = 5
            CanTpRxNSduRef = SDU_DIAG_RBTM_FL_03_IntEth_RQ_BODY3_ST3_1e46a9f5_Rx
            CanTpRxNPdu_afe154c1 (CanTpRxNPdu): CanTpRxNPduId=2, CanTpRxNPduRef=DIAG_RBTM_FL_03_IntEth_RQ_ST3_c3ea483d_Rx
            CanTpTxFcNPdu_afe154c1 (CanTpTxFcNPdu): CanTpTxFcNPduConfirmationPduId=2, CanTpTxFcNPduRef=DIAG_RBTM_FL_03_IntEth_RS_ST3_46126af2_Tx
          CanTpTxNSdu_b61ae5cc (CanTpTxNSdu):
            CanTpTxAddressingFormat = CANTP_STANDARD
            CanTpTxDl = 8
            CanTpTxPaddingActivation = CANTP_ON
            CanTpTxTaType = CANTP_PHYSICAL
            CanTpNas = 0.1
            CanTpNcs = 1.5
            CanTpTc = false
            CanTpTxNSduId = 2
            CanTpNbs = 0.5
            CanTpTxNSduRef = SDU_DIAG_RBTM_FL_03_IntEth_RS_BODY3_ST3_e1d59ed3_Tx
            CanTpRxFcNPdu_8d1b8033 (CanTpRxFcNPdu): CanTpRxFcNPduId=2, CanTpRxFcNPduRef=DIAG_RBTM_FL_03_IntEth_RQ_ST3_c3ea483d_Rx
            CanTpTxNPdu_8d1b8033 (CanTpTxNPdu): CanTpTxNPduConfirmationPduId=2, CanTpTxNPduRef=DIAG_RBTM_FL_03_IntEth_RS_ST3_46126af2_Tx
        BODY3_DIAG_RBTM_FR_03_ExtEth_RQ_BODY3_ST3_DIAG_RBTM_FR_03_ExtEth_RS_BODY3_ST3_008d4b08: CanTpChannelMode=CANTP_MODE_FULL_DUPLEX, variation-point=post-build-variant-condition{matching-criterion=Side, value=1}
          CanTpTxNSdu_b14888e8 (CanTpTxNSdu):
            CanTpTxAddressingFormat = CANTP_STANDARD
            CanTpTxDl = 8
            CanTpTxPaddingActivation = CANTP_ON
            CanTpTxTaType = CANTP_PHYSICAL
            CanTpNas = 0.1
            CanTpNcs = 1.5
            CanTpTc = false
            CanTpTxNSduId = 4
            CanTpNbs = 0.5
            CanTpTxNSduRef = SDU_DIAG_RBTM_FR_03_ExtEth_RS_BODY3_ST3_c5adb650_Tx
            CanTpRxFcNPdu_619ae506 (CanTpRxFcNPdu): CanTpRxFcNPduId=1, CanTpRxFcNPduRef=DIAG_RBTM_FR_03_ExtEth_RQ_ST3_935b3bbf_Rx
            CanTpTxNPdu_619ae506 (CanTpTxNPdu): CanTpTxNPduConfirmationPduId=1, CanTpTxNPduRef=DIAG_RBTM_FR_03_ExtEth_RS_ST3_16a31970_Tx
          CanTpRxNSdu_b14888e8 (CanTpRxNSdu):
            CanTpBs = 0
            CanTpRxAddressingFormat = CANTP_STANDARD
            CanTpRxDl = 8
            CanTpRxPaddingActivation = CANTP_ON
            CanTpRxTaType = CANTP_PHYSICAL
            CanTpSTmin = 0
            CanTpNbr = 1.5
            CanTpRxNSduId = 10
            CanTpNar = 0.1
            CanTpNcr = 0.5
            CanTpRxWftMax = 5
            CanTpRxNSduRef = SDU_DIAG_RBTM_FR_03_ExtEth_RQ_BODY3_ST3_3a3e8176_Rx
            CanTpRxNPdu_436031f4 (CanTpRxNPdu): CanTpRxNPduId=1, CanTpRxNPduRef=DIAG_RBTM_FR_03_ExtEth_RQ_ST3_935b3bbf_Rx
            CanTpTxFcNPdu_436031f4 (CanTpTxFcNPdu): CanTpTxFcNPduConfirmationPduId=1, CanTpTxFcNPduRef=DIAG_RBTM_FR_03_ExtEth_RS_ST3_16a31970_Tx
        BODY3_DIAG_GLOBAL_ExtCAN_RQ_BODY3_ST3_c9615aa1: CanTpChannelMode=CANTP_MODE_HALF_DUPLEX, variation-point=post-build-variant-condition{matching-criterion=Side, value=1}
          CanTpRxNSdu_64c01817 (CanTpRxNSdu):
            CanTpRxAddressingFormat = CANTP_STANDARD
            CanTpRxDl = 8
            CanTpRxPaddingActivation = CANTP_ON
            CanTpRxTaType = CANTP_FUNCTIONAL
            CanTpNbr = 0.1
            CanTpRxNSduId = 1
            CanTpRxNSduRef = SDU_DIAG_GLOBAL_ExtCAN_RQ_BODY3_ST3_1d96a036_Rx
            CanTpRxNPdu_42fcb720 (CanTpRxNPdu): CanTpRxNPduId=3, CanTpRxNPduRef=DIAG_RQ_GLOBAL_ExtCAN_ST3_320b5155_Rx
        BODY3_DIAG_GLOBAL_IntEth_RQ_BODY3_ST3_e279a650: CanTpChannelMode=CANTP_MODE_HALF_DUPLEX, variation-point=post-build-variant-condition{matching-criterion=Side, value=1}
          CanTpRxNSdu_dbf7577d (CanTpRxNSdu):
            CanTpRxAddressingFormat = CANTP_STANDARD
            CanTpRxDl = 8
            CanTpRxPaddingActivation = CANTP_ON
            CanTpRxTaType = CANTP_FUNCTIONAL
            CanTpNbr = 0.1
            CanTpRxNSduId = 5
            CanTpRxNSduRef = SDU_DIAG_GLOBAL_IntEth_RQ_BODY3_ST3_6efa2066_Rx
            CanTpRxNPdu_68607596 (CanTpRxNPdu): CanTpRxNPduId=5, CanTpRxNPduRef=DIAG_RQ_GLOBAL_IntEth_ST3_f8cf566a_Rx
        BODY3_DIAG_GLOBAL_ExtEth_RQ_BODY3_ST3_66205a56: CanTpChannelMode=CANTP_MODE_HALF_DUPLEX, variation-point=post-build-variant-condition{matching-criterion=Side, value=1}
          CanTpRxNSdu_84669b72 (CanTpRxNSdu):
            CanTpRxAddressingFormat = CANTP_STANDARD
            CanTpRxDl = 8
            CanTpRxPaddingActivation = CANTP_ON
            CanTpRxTaType = CANTP_FUNCTIONAL
            CanTpNbr = 0.1
            CanTpRxNSduId = 3
            CanTpRxNSduRef = SDU_DIAG_GLOBAL_ExtEth_RQ_BODY3_ST3_38ac71dd_Rx
            CanTpRxNPdu_4461701a (CanTpRxNPdu): CanTpRxNPduId=4, CanTpRxNPduRef=DIAG_RQ_GLOBAL_ExtEth_ST3_3402b191_Rx
        BODY3_DIAG_RBTM_FR_03_IntEth_RQ_BODY3_ST3_DIAG_RBTM_FR_03_IntEth_RS_BODY3_ST3_15bd550e: CanTpChannelMode=CANTP_MODE_FULL_DUPLEX, variation-point=post-build-variant-condition{matching-criterion=Side, value=1}
          CanTpRxNSdu_6f7c1760 (CanTpRxNSdu):
            CanTpBs = 0
            CanTpRxAddressingFormat = CANTP_STANDARD
            CanTpRxDl = 8
            CanTpRxPaddingActivation = CANTP_ON
            CanTpRxTaType = CANTP_PHYSICAL
            CanTpSTmin = 0
            CanTpNbr = 1.5
            CanTpRxNSduId = 11
            CanTpNar = 0.1
            CanTpNcr = 0.5
            CanTpRxWftMax = 5
            CanTpRxNSduRef = SDU_DIAG_RBTM_FR_03_IntEth_RQ_BODY3_ST3_6c68d0cd_Rx
            CanTpTxFcNPdu_4b1f8ee6 (CanTpTxFcNPdu): CanTpTxFcNPduConfirmationPduId=2, CanTpTxFcNPduRef=DIAG_RBTM_FR_03_IntEth_RS_ST3_5bd85eab_Tx
            CanTpRxNPdu_4b1f8ee6 (CanTpRxNPdu): CanTpRxNPduId=2, CanTpRxNPduRef=DIAG_RBTM_FR_03_IntEth_RQ_ST3_de207c64_Rx
          CanTpTxNSdu_6f7c1760 (CanTpTxNSdu):
            CanTpTxAddressingFormat = CANTP_STANDARD
            CanTpTxDl = 8
            CanTpTxPaddingActivation = CANTP_ON
            CanTpTxTaType = CANTP_PHYSICAL
            CanTpNas = 0.1
            CanTpNcs = 1.5
            CanTpTc = false
            CanTpTxNSduId = 5
            CanTpNbs = 0.5
            CanTpTxNSduRef = SDU_DIAG_RBTM_FR_03_IntEth_RS_BODY3_ST3_93fbe7eb_Tx
            CanTpRxFcNPdu_69e55a14 (CanTpRxFcNPdu): CanTpRxFcNPduId=2, CanTpRxFcNPduRef=DIAG_RBTM_FR_03_IntEth_RQ_ST3_de207c64_Rx
            CanTpTxNPdu_69e55a14 (CanTpTxNPdu): CanTpTxNPduConfirmationPduId=2, CanTpTxNPduRef=DIAG_RBTM_FR_03_IntEth_RS_ST3_5bd85eab_Tx
        BODY3_DIAG_RBTM_FR_03_ExtCAN_RQ_BODY3_ST3_DIAG_RBTM_FR_03_ExtCAN_RS_BODY3_ST3_ef54550a: CanTpChannelMode=CANTP_MODE_FULL_DUPLEX, variation-point=post-build-variant-condition{matching-criterion=Side, value=1}
          CanTpTxNSdu_036251db (CanTpTxNSdu):
            CanTpTxAddressingFormat = CANTP_STANDARD
            CanTpTxDl = 8
            CanTpTxPaddingActivation = CANTP_ON
            CanTpTxTaType = CANTP_PHYSICAL
            CanTpNas = 0.1
            CanTpNcs = 1.5
            CanTpTc = false
            CanTpTxNSduId = 3
            CanTpNbs = 0.5
            CanTpTxNSduRef = SDU_DIAG_RBTM_FR_03_ExtCAN_RS_BODY3_ST3_e09767bb_Tx
            CanTpRxFcNPdu_ebeac4b1 (CanTpRxFcNPdu): CanTpRxFcNPduId=0, CanTpRxFcNPduRef=DIAG_RBTM_FR_03_ExtCAN_RQ_ST3_225f4e6d_Rx
            CanTpTxNPdu_ebeac4b1 (CanTpTxNPdu): CanTpTxNPduConfirmationPduId=0, CanTpTxNPduRef=DIAG_RBTM_FR_03_ExtCAN_RS_ST3_a7a76ca2_Tx
          CanTpRxNSdu_036251db (CanTpRxNSdu):
            CanTpBs = 0
            CanTpRxAddressingFormat = CANTP_STANDARD
            CanTpRxDl = 8
            CanTpRxPaddingActivation = CANTP_ON
            CanTpRxTaType = CANTP_PHYSICAL
            CanTpSTmin = 0
            CanTpNbr = 1.5
            CanTpRxNSduId = 9
            CanTpNar = 0.1
            CanTpNcr = 0.5
            CanTpRxWftMax = 5
            CanTpRxNSduRef = SDU_DIAG_RBTM_FR_03_ExtCAN_RQ_BODY3_ST3_1f04509d_Rx
            CanTpTxFcNPdu_c9101043 (CanTpTxFcNPdu): CanTpTxFcNPduConfirmationPduId=0, CanTpTxFcNPduRef=DIAG_RBTM_FR_03_ExtCAN_RS_ST3_a7a76ca2_Tx
            CanTpRxNPdu_c9101043 (CanTpRxNPdu): CanTpRxNPduId=0, CanTpRxNPduRef=DIAG_RBTM_FR_03_ExtCAN_RQ_ST3_225f4e6d_Rx
