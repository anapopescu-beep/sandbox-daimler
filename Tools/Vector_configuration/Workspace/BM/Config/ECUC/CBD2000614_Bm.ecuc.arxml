AUTOSAR XML (schema 00048)
package /ActiveEcuC
  ecuc value collection ActiveEcuC
    ecuc-values:
      FblBm
      FblHal
      Det
      Fbl
      FblBmHdr
      EcuC
      vSet
      vBaseEnv
      Os
      vSecPrim
      vLinkGen
      CryIf
      Crypto
      Crypto_vHsm
      Csm
      vMemAccM
      vMem
      vBRS
      Mcu
      MemMap
      Port
      Spi
      McalLib
      Dma
      ResourceM
