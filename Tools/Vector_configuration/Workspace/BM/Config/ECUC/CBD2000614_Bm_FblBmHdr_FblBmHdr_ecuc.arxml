AUTOSAR XML (schema 00048)
package /ActiveEcuC
  module config FblBmHdr: implementation-config-variant=VARIANT-PRE-COMPILE, module-description=FblBmHdr_Impl
    FblBmHdrGeneral: FblBmHdrMaxVerificationEntries=1, FblBmHdrSbVerificationList=false
    4 x FblBmHdrTarget:
      Appl: FblBmHdrTargetId=2
      Data: FblBmHdrTargetId=3
      Fbl: FblBmHdrTargetId=0
      FblUpdater: FblBmHdrTargetId=1
