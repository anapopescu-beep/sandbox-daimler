AUTOSAR XML (schema 00048)
package /ActiveEcuC
  module config FblBm: implementation-config-variant=VARIANT-PRE-COMPILE, module-description=FblBm_Impl
    FblBmGeneral:
      FblBmFailsafeUpdater = true
      FblBmIncludeHardwareConfiguration = false
      FblBmInitializeKeys = false
      FblBmSecureBoot = false
      FblBmStandaloneMode = true
      FblBmInitializeMacOfBootloader = false
      FblBmIncludeOemConfiguration = false
      FblBmExecutionInstance = BootManager
      FblBmHeaderAddress = 2684568320
    FblBmBootOrder
      Application (FblBmBootTarget): FblBmBootOrderId=1, FblBmBootTargetRef=Appl
      Updater (FblBmBootTarget): FblBmBootOrderId=0, FblBmBootTargetRef=FblUpdater
