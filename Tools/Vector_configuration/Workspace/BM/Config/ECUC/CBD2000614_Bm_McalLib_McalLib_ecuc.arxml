AUTOSAR XML (schema 00048)
package /ActiveEcuC
  module config McalLib: implementation-config-variant=VARIANT-PRE-COMPILE, module-description=McalLib_Impl
    McalLibPublishedInformation:
      McalLibMcalAvailableCores = 1
      McalLibDsprCore0StartAddr = 1879048192
      McalLibDsprCore0EndAddr = 1879244799
      McalLibDsprCore1StartAddr = 0
      McalLibDsprCore1EndAddr = 0
      McalLibDsprCore2StartAddr = 0
      McalLibDsprCore2EndAddr = 0
      McalLibDsprCore3StartAddr = 0
      McalLibDsprCore3EndAddr = 0
      McalLibDsprCore4StartAddr = 0
      McalLibDsprCore4EndAddr = 0
      McalLibDsprCore5StartAddr = 0
      McalLibDsprCore5EndAddr = 0
      McalLibPsprCore0StartAddr = 1880096768
      McalLibPsprCore0EndAddr = 1880104959
      McalLibPsprCore1StartAddr = 0
      McalLibPsprCore1EndAddr = 0
      McalLibPsprCore2StartAddr = 0
      McalLibPsprCore2EndAddr = 0
      McalLibPsprCore3StartAddr = 0
      McalLibPsprCore3EndAddr = 0
      McalLibPsprCore4StartAddr = 0
      McalLibPsprCore4EndAddr = 0
      McalLibPsprCore5StartAddr = 0
      McalLibPsprCore5EndAddr = 0
      McalLibBackUpClockFreq = 100
    CommonPublishedInformation:
      ArMajorVersion = 4
      ArMinorVersion = 4
      ArPatchVersion = 0
      SwMajorVersion = 20
      SwMinorVersion = 0
      SwPatchVersion = 1
      ModuleId = 255
      VendorId = 17
      Release = _TRICORE_TC332
    McalLibGeneral: McalLibSafetyEnable=true
