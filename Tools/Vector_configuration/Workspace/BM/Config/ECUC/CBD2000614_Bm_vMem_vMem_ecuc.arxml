AUTOSAR XML (schema 00048)
package /ActiveEcuC
  module config vMem: implementation-config-variant=VARIANT-PRE-COMPILE, module-description=vMem_Impl
    vMemInstance: vMemInstanceId=0
      vMemSectorList
        vMemSector: vMemNumberOfSectors=359, vMemPageSize=32, vMemSectorSize=16384, vMemStartAddress=2684633088
    vMemInstanceMapping: vMemvMemInstanceRef=vMemInstance, vMemFblMemoryDeviceRef=Flash
    vMemGeneral:
      vMemInitialize = false
      vMemUseIsBlank = false
      vMemUserMainFunction = false
      vMemUserInitFunction = false
      vMemCompareAfterWrite = false
      vMemInitHandling = ALL_DRIVERS_MANDATORY
