AUTOSAR XML (schema 00048)
package /ActiveEcuC
  module config Os: implementation-config-variant=VARIANT-PRE-COMPILE
    OsAppMode
    OsOS: OsStackMonitoring=false, OsStatus=EXTENDED, OsUseGetServiceId=false, OsUseParameterAccess=false, OsUseResScheduler=true
      OsHooks: OsErrorHook=false, OsPostTaskHook=false, OsPreTaskHook=false, OsShutdownHook=false, OsStartupHook=false, OsProtectionHook=false
