AUTOSAR XML (schema 00048)
package /ActiveEcuC
  module config EcuC: implementation-config-variant=VARIANT-PRE-COMPILE, module-description=EcuC_Impl
    EcucGeneral:
      AtomicBitAccessInBitfield = false
      AtomicVariableAccess = Atomic32BitAccess
      DummyFunction = false
      DummyStatement = true
      StructAlignment = Auto
      ArrayAlignment = Align8Bit
      StructInArrayAlignment = Auto
      SizeOfEnum = Size32Bit
      SizeOfROMPointer = Size32Bit
      SizeOfRAMPointer = Size32Bit
      CPUType = CPU32Bit
      SizeOfInt = Size32Bit
      ByteOrder = LITTLE_ENDIAN
      BitOrder = LSB_to_MSB
      BitFieldDataType = INT
      DummyStatementKind = None
      ConditionalGenerating = true
      EcucBswImplementationCodeType = EcuCSourceCode
      EcuCUseStdReturnTypeForRte = false
      PostbuildLoadable: AlignmentFillPattern=255, PBROMStartAddress=0, PBRAMStartAddress=0, PBROMEndAddress=0, PBRAMEndAddress=0
      BswInitialization
        21 x InitFunction:
          Det_InitMemory: Header=Det.h, InitPhase=INIT_MEMORY, ModuleRef=Det  # /ActiveEcuC/Det PLAIN_TEXT InitMemory function description of Det in UnfilteredViewInInvariantProject (UnfilteredInvariantProjectModelView) .
          Det_Init: Header=Det.h, InitPhase=INIT_ZERO, ConfigType=Det_ConfigType, ConfigPtrName=Det_Config_Ptr, ConfigPtrClass=DET_INIT_DATA, ModuleRef=Det  # /ActiveEcuC/Det PLAIN_TEXT Init function description of Det in UnfilteredViewInInvariantProject (UnfilteredInvariantProjectModelView) .
          vBaseEnv_Init: Header=, InitPhase=NO_INIT, ModuleRef=vBaseEnv  # /ActiveEcuC/vBaseEnv PLAIN_TEXT Created vBaseEnv_Init by Extended Init XML Service
          vLinkGen_Init: Header=vLinkGen_Lcfg.h, InitPhase=NO_INIT, ModuleRef=vLinkGen  # /ActiveEcuC/vLinkGen PLAIN_TEXT Dummy initialization of the vLinkGen
          CryIf_InitMemory: Header=CryIf.h, InitPhase=INIT_MEMORY, ModuleRef=CryIf  # /ActiveEcuC/CryIf PLAIN_TEXT Initializes variables of the Crypto Interface
          CryIf_Init: Header=CryIf.h, InitPhase=INIT_TWO_IF, ModuleRef=CryIf  # /ActiveEcuC/CryIf PLAIN_TEXT Initializes the Crypto Interface
          Crypto_30_LibCv_Init: Header=Crypto_30_LibCv.h, InitPhase=INIT_TWO_DRV, ModuleRef=Crypto  # /ActiveEcuC/Crypto PLAIN_TEXT Initializes the Crypto Driver
          Crypto_30_LibCv_InitMemory: Header=Crypto_30_LibCv.h, InitPhase=INIT_MEMORY, ModuleRef=Crypto  # /ActiveEcuC/Crypto PLAIN_TEXT Initializes variables of the Crypto Driver
          Csm_InitMemory: Header=Csm.h, InitPhase=INIT_MEMORY, ModuleRef=Csm  # /ActiveEcuC/Csm PLAIN_TEXT Initializes variables of the Crypto Service Manager
          Csm_Init: Header=Csm.h, InitPhase=INIT_TWO_SYS, ModuleRef=Csm  # /ActiveEcuC/Csm PLAIN_TEXT Initializes the Crypto Service Manager
          Crypto_30_vHsm_InitMemory: Header=Crypto_30_vHsm.h, InitPhase=INIT_MEMORY, ModuleRef=Crypto_vHsm  # /ActiveEcuC/Crypto_vHsm PLAIN_TEXT Initializes variables of the Crypto Interface
          Crypto_30_vHsm_Init: Header=Crypto_30_vHsm.h, InitPhase=INIT_TWO_DRV, ModuleRef=Crypto_vHsm  # /ActiveEcuC/Crypto_vHsm PLAIN_TEXT Initializes the Crypto Driver
          vMemAccM_Init: Header=vMemAccM.h, InitPhase=INIT_TWO_DRV, ModuleRef=vMemAccM  # /ActiveEcuC/vMemAccM PLAIN_TEXT Initializes the vMemAccM.
          vMemAccM_InitMemory: Header=vMemAccM.h, InitPhase=INIT_MEMORY, ModuleRef=vMemAccM  # /ActiveEcuC/vMemAccM PLAIN_TEXT Initializes all *_INIT_* section variables within the vMemAccM.
          Brs_Init: Header=, InitPhase=NO_INIT, ModuleRef=vBRS  # /ActiveEcuC/vBRS PLAIN_TEXT Automatically generated by EcuCBswInitFctConfigurationService.
          Mcu_Init: Header=Mcu.h, InitPhase=INIT_ONE_EARLY, ConfigType=Mcu_ConfigType, ConfigPtrName=&Mcu_Config, ConfigPtrClass=AUTOMATIC, AdditionalInitCode=Mcu_InitClock(0);while (MCU_PLL_LOCKED != Mcu_GetPllStatus());Mcu_DistributePllClock();, ModuleRef=Mcu  # /Mcu/Mcu PLAIN_TEXT Created Mcu_Init by Extended Init XML Service
          Dma_Init: Header=Dma.h, InitPhase=INIT_ONE, ConfigType=Dma_ConfigType, ConfigPtrName=&Dma_Config, ConfigPtrClass=AUTOMATIC, ModuleRef=Dma  # /ActiveEcuC/Dma PLAIN_TEXT Created Dma_Init by Extended Init XML Service
          McalLib_Init: Header=McalLib.h, InitPhase=NO_INIT, ModuleRef=McalLib  # /ActiveEcuC/McalLib PLAIN_TEXT Created McalLib_Init by Extended Init XML Service
          Port_Init: Header=Port.h, InitPhase=INIT_ONE_EARLY, ConfigType=Port_ConfigType, ConfigPtrName=&Port_Config, ConfigPtrClass=AUTOMATIC, ModuleRef=Port  # /ActiveEcuC/Port PLAIN_TEXT Created Port_Init by Extended Init XML Service
          Spi_Init: Header=Spi.h, InitPhase=INIT_ONE, ConfigType=Spi_ConfigType, ConfigPtrName=&Spi_Config, ConfigPtrClass=AUTOMATIC, ModuleRef=Spi  # /ActiveEcuC/Spi PLAIN_TEXT Created Spi_Init by Extended Init XML Service
          ResourceM_Init: Header=ResourceM.h, InitPhase=NO_INIT, ModuleRef=ResourceM  # /ActiveEcuC/ResourceM PLAIN_TEXT Created ResourceM_Init by Extended Init XML Service
    EcucHardware
      EcucCoreDefinition: EcucCoreId=0
