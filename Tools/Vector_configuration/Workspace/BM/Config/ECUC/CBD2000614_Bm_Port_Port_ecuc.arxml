AUTOSAR XML (schema 00048)
package /ActiveEcuC
  module config Port: implementation-config-variant=VARIANT-POST-BUILD-LOADABLE, module-description=Port_Impl
    PortConfigSet
      11 x PortContainer:
        PortContainer_2: PortNumber=2, PortNumberOfPortPins=9
          9 x PortPin, all with PortPinControllerSelect=DISABLE, PortPinEmergencyStop=false, PortPinEnableAnalogInputOnly=PORT_PIN_ANALOG_INPUT_DISABLE, PortPinInitialMode=GPIO, PortPinInputPadLevel=PORT_INPUT_LEVEL_CMOS_AUTOMOTIVE, PortPinLevelValue=PORT_PIN_LEVEL_LOW, PortPinMode=PORT_PIN_MODE_ALL, PortPinOutputPadDriveStrength=PORT_PIN_DEFAULT_DRIVER, PortPinOutputPinDriveMode=PORT_PIN_OUT_PUSHPULL:
            Port_2_Pin_0_HB_P_EN: PortPinDirection=PORT_PIN_OUT, PortPinDirectionChangeable=false, PortPinId=32, PortPinInputPullResistor=PORT_PIN_IN_PULL_UP, PortPinModeChangeable=false, PortPinSymbolicName=PORT_2_PIN_0
            Port_2_Pin_1_DBG1: PortPinDirection=PORT_PIN_IN, PortPinDirectionChangeable=false, PortPinId=33, PortPinInputPullResistor=PORT_PIN_IN_PULL_UP, PortPinModeChangeable=false, PortPinSymbolicName=PORT_2_PIN_1
            Port_2_Pin_3: PortPinDirection=PORT_PIN_IN, PortPinDirectionChangeable=false, PortPinId=35, PortPinInputPullResistor=PORT_PIN_IN_PULL_UP, PortPinModeChangeable=false, PortPinSymbolicName=PORT_2_PIN_3
            Port_2_Pin_4_HB_P_PWM: PortPinDirection=PORT_PIN_OUT, PortPinDirectionChangeable=true, PortPinId=36, PortPinInputPullResistor=PORT_PIN_IN_NO_PULL, PortPinModeChangeable=true, PortPinSymbolicName=PORT_2_PIN_4
            Port_2_Pin_5_DBG2: PortPinDirection=PORT_PIN_IN, PortPinDirectionChangeable=false, PortPinId=37, PortPinInputPullResistor=PORT_PIN_IN_PULL_UP, PortPinModeChangeable=false, PortPinSymbolicName=PORT_2_PIN_5
            Port_2_Pin_8_HB_N_PWM: PortPinDirection=PORT_PIN_OUT, PortPinDirectionChangeable=true, PortPinId=40, PortPinInputPullResistor=PORT_PIN_IN_NO_PULL, PortPinModeChangeable=true, PortPinSymbolicName=PORT_2_PIN_8
            Port_2_Pin_2_HB_N_EN: PortPinDirection=PORT_PIN_OUT, PortPinDirectionChangeable=false, PortPinId=34, PortPinInputPullResistor=PORT_PIN_IN_PULL_UP, PortPinModeChangeable=false, PortPinSymbolicName=PORT_2_PIN_2
            Port_2_Pin_6_HES_A_PULSE: PortPinDirection=PORT_PIN_IN, PortPinDirectionChangeable=false, PortPinId=38, PortPinInputPullResistor=PORT_PIN_IN_PULL_UP, PortPinModeChangeable=true, PortPinSymbolicName=PORT_2_PIN_6
            Port_2_Pin_7_HES_B_PULSE: PortPinDirection=PORT_PIN_IN, PortPinDirectionChangeable=false, PortPinId=39, PortPinInputPullResistor=PORT_PIN_IN_PULL_UP, PortPinModeChangeable=true, PortPinSymbolicName=PORT_2_PIN_7
        PortContainer_10: PortNumber=10, PortNumberOfPortPins=2
          Port_10_Pin_5_HWCFG4 (PortPin):
            PortPinControllerSelect = DISABLE
            PortPinDirection = PORT_PIN_IN
            PortPinDirectionChangeable = false
            PortPinEmergencyStop = false
            PortPinEnableAnalogInputOnly = PORT_PIN_ANALOG_INPUT_DISABLE
            PortPinId = 165
            PortPinInitialMode = GPIO
            PortPinInputPadLevel = PORT_INPUT_LEVEL_CMOS_AUTOMOTIVE
            PortPinInputPullResistor = PORT_PIN_IN_PULL_UP
            PortPinLevelValue = PORT_PIN_LEVEL_LOW
            PortPinMode = PORT_PIN_MODE_ALL
            PortPinModeChangeable = false
            PortPinOutputPadDriveStrength = PORT_PIN_DEFAULT_DRIVER
            PortPinOutputPinDriveMode = PORT_PIN_OUT_PUSHPULL
            PortPinSymbolicName = PORT_10_PIN_5
          Port_10_Pin_6_HWCFG5 (PortPin):
            PortPinControllerSelect = DISABLE
            PortPinDirection = PORT_PIN_IN
            PortPinDirectionChangeable = false
            PortPinEmergencyStop = false
            PortPinEnableAnalogInputOnly = PORT_PIN_ANALOG_INPUT_DISABLE
            PortPinId = 166
            PortPinInitialMode = GPIO
            PortPinInputPadLevel = PORT_INPUT_LEVEL_CMOS_AUTOMOTIVE
            PortPinInputPullResistor = PORT_PIN_IN_PULL_UP
            PortPinLevelValue = PORT_PIN_LEVEL_LOW
            PortPinMode = PORT_PIN_MODE_ALL
            PortPinModeChangeable = false
            PortPinOutputPadDriveStrength = PORT_PIN_DEFAULT_DRIVER
            PortPinOutputPinDriveMode = PORT_PIN_OUT_PUSHPULL
            PortPinSymbolicName = PORT_10_PIN_6
        PortContainer_0: PortNumber=0, PortNumberOfPortPins=1
          Port_0_Pin_0_MCU_DBG3 (PortPin):
            PortPinControllerSelect = DISABLE
            PortPinDirection = PORT_PIN_IN
            PortPinDirectionChangeable = true
            PortPinEmergencyStop = false
            PortPinEnableAnalogInputOnly = PORT_PIN_ANALOG_INPUT_DISABLE
            PortPinId = 0
            PortPinInitialMode = GPIO
            PortPinInputPadLevel = PORT_INPUT_LEVEL_CMOS_AUTOMOTIVE
            PortPinInputPullResistor = PORT_PIN_IN_PULL_UP
            PortPinLevelValue = PORT_PIN_LEVEL_LOW
            PortPinMode = PORT_PIN_MODE_ALL
            PortPinModeChangeable = true
            PortPinOutputPadDriveStrength = PORT_PIN_DEFAULT_DRIVER
            PortPinOutputPinDriveMode = PORT_PIN_OUT_PUSHPULL
            PortPinSymbolicName = PORT_0_PIN_0
        PortContainer_11: PortNumber=11, PortNumberOfPortPins=7
          7 x PortPin, all with PortPinControllerSelect=DISABLE, PortPinEmergencyStop=false, PortPinEnableAnalogInputOnly=PORT_PIN_ANALOG_INPUT_DISABLE, PortPinInputPadLevel=PORT_INPUT_LEVEL_CMOS_AUTOMOTIVE, PortPinLevelValue=PORT_PIN_LEVEL_LOW, PortPinMode=PORT_PIN_MODE_ALL, PortPinOutputPadDriveStrength=PORT_PIN_DEFAULT_DRIVER, PortPinOutputPinDriveMode=PORT_PIN_OUT_PUSHPULL:
            Port_11_Pin_2: PortPinDirection=PORT_PIN_IN, PortPinDirectionChangeable=false, PortPinId=178, PortPinInitialMode=GPIO, PortPinInputPullResistor=PORT_PIN_IN_PULL_UP, PortPinModeChangeable=false, PortPinSymbolicName=PORT_11_PIN_2
            Port_11_Pin_3_SPI1_MISO: PortPinDirection=PORT_PIN_IN, PortPinDirectionChangeable=false, PortPinId=179, PortPinInitialMode=GPIO, PortPinInputPullResistor=PORT_PIN_IN_NO_PULL, PortPinModeChangeable=false, PortPinSymbolicName=PORT_11_PIN_3
            Port_11_Pin_6_SPI1_SCK: PortPinDirection=PORT_PIN_OUT, PortPinDirectionChangeable=false, PortPinId=182, PortPinInitialMode=ALT3, PortPinInputPullResistor=PORT_PIN_IN_PULL_DOWN, PortPinModeChangeable=false, PortPinSymbolicName=PORT_11_PIN_6
            Port_11_Pin_9_SPI1_MOSI: PortPinDirection=PORT_PIN_OUT, PortPinDirectionChangeable=false, PortPinId=185, PortPinInitialMode=ALT3, PortPinInputPullResistor=PORT_PIN_IN_PULL_DOWN, PortPinModeChangeable=false, PortPinSymbolicName=PORT_11_PIN_9
            Port_11_Pin_10: PortPinDirection=PORT_PIN_IN, PortPinDirectionChangeable=false, PortPinId=186, PortPinInitialMode=GPIO, PortPinInputPullResistor=PORT_PIN_IN_PULL_UP, PortPinModeChangeable=false, PortPinSymbolicName=PORT_11_PIN_10
            Port_11_Pin_11_SPI1_CS: PortPinDirection=PORT_PIN_OUT, PortPinDirectionChangeable=true, PortPinId=187, PortPinInitialMode=ALT4, PortPinInputPullResistor=PORT_PIN_IN_PULL_UP, PortPinModeChangeable=true, PortPinSymbolicName=PORT_11_PIN_11
            Port_11_Pin_12: PortPinDirection=PORT_PIN_IN, PortPinDirectionChangeable=false, PortPinId=188, PortPinInitialMode=GPIO, PortPinInputPullResistor=PORT_PIN_IN_PULL_UP, PortPinModeChangeable=false, PortPinSymbolicName=PORT_11_PIN_12
        PortContainer_14: PortNumber=14, PortNumberOfPortPins=4
          4 x PortPin, all with PortPinControllerSelect=DISABLE, PortPinDirection=PORT_PIN_IN, PortPinDirectionChangeable=false, PortPinEmergencyStop=false, PortPinEnableAnalogInputOnly=PORT_PIN_ANALOG_INPUT_DISABLE, PortPinInitialMode=GPIO, PortPinInputPadLevel=PORT_INPUT_LEVEL_CMOS_AUTOMOTIVE, PortPinInputPullResistor=PORT_PIN_IN_PULL_UP, PortPinLevelValue=PORT_PIN_LEVEL_LOW, PortPinMode=PORT_PIN_MODE_ALL, PortPinModeChangeable=false, PortPinOutputPadDriveStrength=PORT_PIN_DEFAULT_DRIVER, PortPinOutputPinDriveMode=PORT_PIN_OUT_PUSHPULL:
            Port_14_Pin_0: PortPinId=224, PortPinSymbolicName=PORT_14_PIN_0
            Port_14_Pin_1: PortPinId=225, PortPinSymbolicName=PORT_14_PIN_1
            Port_14_Pin_3: PortPinId=227, PortPinSymbolicName=PORT_14_PIN_3
            Port_14_Pin_5: PortPinId=229, PortPinSymbolicName=PORT_14_PIN_5
        PortContainer_15: PortNumber=15, PortNumberOfPortPins=4
          4 x PortPin, all with PortPinControllerSelect=DISABLE, PortPinDirectionChangeable=false, PortPinEmergencyStop=false, PortPinEnableAnalogInputOnly=PORT_PIN_ANALOG_INPUT_DISABLE, PortPinInputPadLevel=PORT_INPUT_LEVEL_CMOS_AUTOMOTIVE, PortPinInputPullResistor=PORT_PIN_IN_PULL_UP, PortPinLevelValue=PORT_PIN_LEVEL_LOW, PortPinModeChangeable=false, PortPinOutputPadDriveStrength=PORT_PIN_DEFAULT_DRIVER, PortPinOutputPinDriveMode=PORT_PIN_OUT_PUSHPULL:
            Port_15_Pin_0: PortPinDirection=PORT_PIN_IN, PortPinId=240, PortPinInitialMode=GPIO, PortPinMode=PORT_PIN_MODE_ALL, PortPinSymbolicName=PORT_15_PIN_0
            Port_15_Pin_1: PortPinDirection=PORT_PIN_IN, PortPinId=241, PortPinInitialMode=GPIO, PortPinMode=PORT_PIN_MODE_ALL, PortPinSymbolicName=PORT_15_PIN_1
            Port_15_Pin_2_CAN_TX: PortPinDirection=PORT_PIN_OUT, PortPinId=242, PortPinInitialMode=ALT5, PortPinMode=PORT_PIN_MODE_ALT5, PortPinSymbolicName=PORT_15_PIN_2
            Port_15_Pin_3_CAN_RX: PortPinDirection=PORT_PIN_IN, PortPinId=243, PortPinInitialMode=GPIO, PortPinMode=PORT_PIN_MODE_ALL, PortPinSymbolicName=PORT_15_PIN_3
        PortContainer_20: PortNumber=20, PortNumberOfPortPins=7
          7 x PortPin, all with PortPinControllerSelect=DISABLE, PortPinDirectionChangeable=false, PortPinEmergencyStop=false, PortPinEnableAnalogInputOnly=PORT_PIN_ANALOG_INPUT_DISABLE, PortPinInitialMode=GPIO, PortPinInputPadLevel=PORT_INPUT_LEVEL_CMOS_AUTOMOTIVE, PortPinInputPullResistor=PORT_PIN_IN_PULL_UP, PortPinMode=PORT_PIN_MODE_ALL, PortPinModeChangeable=false, PortPinOutputPadDriveStrength=PORT_PIN_DEFAULT_DRIVER, PortPinOutputPinDriveMode=PORT_PIN_OUT_PUSHPULL:
            Port_20_Pin_2_TESTMODE: PortPinDirection=PORT_PIN_IN, PortPinId=322, PortPinLevelValue=PORT_PIN_LEVEL_LOW, PortPinSymbolicName=PORT_20_PIN_2
            Port_20_Pin_8: PortPinDirection=PORT_PIN_IN, PortPinId=328, PortPinLevelValue=PORT_PIN_LEVEL_LOW, PortPinSymbolicName=PORT_20_PIN_8
            Port_20_Pin_11: PortPinDirection=PORT_PIN_IN, PortPinId=331, PortPinLevelValue=PORT_PIN_LEVEL_LOW, PortPinSymbolicName=PORT_20_PIN_11
            Port_20_Pin_13: PortPinDirection=PORT_PIN_IN, PortPinId=333, PortPinLevelValue=PORT_PIN_LEVEL_LOW, PortPinSymbolicName=PORT_20_PIN_13
            Port_20_Pin_14_KL30_SW_EN: PortPinDirection=PORT_PIN_OUT, PortPinId=334, PortPinLevelValue=PORT_PIN_LEVEL_LOW, PortPinSymbolicName=PORT_20_PIN_14
            Port_20_Pin_12: PortPinDirection=PORT_PIN_IN, PortPinId=332, PortPinLevelValue=PORT_PIN_LEVEL_HIGH, PortPinSymbolicName=PORT_20_PIN_12
            Port_20_Pin_9: PortPinDirection=PORT_PIN_IN, PortPinId=329, PortPinLevelValue=PORT_PIN_LEVEL_HIGH, PortPinSymbolicName=PORT_20_PIN_9
        PortContainer_21: PortNumber=21, PortNumberOfPortPins=2
          Port_21_Pin_6_TDI (PortPin):
            PortPinControllerSelect = DISABLE
            PortPinDirection = PORT_PIN_IN
            PortPinDirectionChangeable = false
            PortPinEmergencyStop = false
            PortPinEnableAnalogInputOnly = PORT_PIN_ANALOG_INPUT_DISABLE
            PortPinId = 342
            PortPinInitialMode = GPIO
            PortPinInputPadLevel = PORT_INPUT_LEVEL_CMOS_AUTOMOTIVE
            PortPinInputPullResistor = PORT_PIN_IN_PULL_UP
            PortPinLevelValue = PORT_PIN_LEVEL_LOW
            PortPinMode = PORT_PIN_MODE_ALL
            PortPinModeChangeable = false
            PortPinOutputPadDriveStrength = PORT_PIN_DEFAULT_DRIVER
            PortPinOutputPinDriveMode = PORT_PIN_OUT_PUSHPULL
            PortPinSymbolicName = PORT_21_PIN_6
          Port_21_Pin_7_TDO (PortPin):
            PortPinControllerSelect = DISABLE
            PortPinDirection = PORT_PIN_IN
            PortPinDirectionChangeable = false
            PortPinEmergencyStop = false
            PortPinEnableAnalogInputOnly = PORT_PIN_ANALOG_INPUT_DISABLE
            PortPinId = 343
            PortPinInitialMode = GPIO
            PortPinInputPadLevel = PORT_INPUT_LEVEL_CMOS_AUTOMOTIVE
            PortPinInputPullResistor = PORT_PIN_IN_PULL_UP
            PortPinLevelValue = PORT_PIN_LEVEL_LOW
            PortPinMode = PORT_PIN_MODE_ALL
            PortPinModeChangeable = false
            PortPinOutputPadDriveStrength = PORT_PIN_DEFAULT_DRIVER
            PortPinOutputPinDriveMode = PORT_PIN_OUT_PUSHPULL
            PortPinSymbolicName = PORT_21_PIN_7
        PortContainer_23: PortNumber=23, PortNumberOfPortPins=1
          Port_23_Pin_1_ECLK (PortPin):
            PortPinControllerSelect = DISABLE
            PortPinDirection = PORT_PIN_IN
            PortPinDirectionChangeable = false
            PortPinEmergencyStop = false
            PortPinEnableAnalogInputOnly = PORT_PIN_ANALOG_INPUT_DISABLE
            PortPinId = 369
            PortPinInitialMode = GPIO
            PortPinInputPadLevel = PORT_INPUT_LEVEL_CMOS_AUTOMOTIVE
            PortPinInputPullResistor = PORT_PIN_IN_PULL_UP
            PortPinLevelValue = PORT_PIN_LEVEL_LOW
            PortPinMode = PORT_PIN_MODE_ALL
            PortPinModeChangeable = false
            PortPinOutputPadDriveStrength = PORT_PIN_DEFAULT_DRIVER
            PortPinOutputPinDriveMode = PORT_PIN_OUT_PUSHPULL
            PortPinSymbolicName = PORT_23_PIN_1
        PortContainer_33: PortNumber=33, PortNumberOfPortPins=7
          7 x PortPin, all with PortPinControllerSelect=DISABLE, PortPinDirection=PORT_PIN_IN, PortPinEmergencyStop=false, PortPinEnableAnalogInputOnly=PORT_PIN_ANALOG_INPUT_DISABLE, PortPinInitialMode=GPIO, PortPinInputPadLevel=PORT_INPUT_LEVEL_CMOS_AUTOMOTIVE, PortPinLevelValue=PORT_PIN_LEVEL_LOW, PortPinMode=PORT_PIN_MODE_ALL, PortPinOutputPadDriveStrength=PORT_PIN_DEFAULT_DRIVER, PortPinOutputPinDriveMode=PORT_PIN_OUT_PUSHPULL:
            Port_33_Pin_4_DBG4: PortPinDirectionChangeable=true, PortPinId=532, PortPinInputPullResistor=PORT_PIN_IN_PULL_UP, PortPinModeChangeable=true, PortPinSymbolicName=PORT_33_PIN_4
            Port_33_Pin_5_HB_P_EN_RD: PortPinDirectionChangeable=false, PortPinId=533, PortPinInputPullResistor=PORT_PIN_IN_NO_PULL, PortPinModeChangeable=false, PortPinSymbolicName=PORT_33_PIN_5
            Port_33_Pin_6: PortPinDirectionChangeable=false, PortPinId=534, PortPinInputPullResistor=PORT_PIN_IN_PULL_UP, PortPinModeChangeable=false, PortPinSymbolicName=PORT_33_PIN_6
            Port_33_Pin_7_HB_N_EN_RD: PortPinDirectionChangeable=false, PortPinId=535, PortPinInputPullResistor=PORT_PIN_IN_NO_PULL, PortPinModeChangeable=false, PortPinSymbolicName=PORT_33_PIN_7
            Port_33_Pin_8: PortPinDirectionChangeable=false, PortPinId=536, PortPinInputPullResistor=PORT_PIN_IN_PULL_UP, PortPinModeChangeable=false, PortPinSymbolicName=PORT_33_PIN_8
            Port_33_Pin_9: PortPinDirectionChangeable=false, PortPinId=537, PortPinInputPullResistor=PORT_PIN_IN_PULL_UP, PortPinModeChangeable=false, PortPinSymbolicName=PORT_33_PIN_9
            Port_33_Pin_10: PortPinDirectionChangeable=false, PortPinId=538, PortPinInputPullResistor=PORT_PIN_IN_PULL_UP, PortPinModeChangeable=false, PortPinSymbolicName=PORT_33_PIN_10
        PortContainer_40: PortNumber=40, PortNumberOfPortPins=2
          Port_40_Pin_4 (PortPin):
            PortPinControllerSelect = DISABLE
            PortPinDirection = PORT_PIN_IN
            PortPinDirectionChangeable = false
            PortPinEmergencyStop = false
            PortPinEnableAnalogInputOnly = PORT_PIN_ANALOG_INPUT_DISABLE
            PortPinId = 644
            PortPinInitialMode = GPIO
            PortPinInputPadLevel = PORT_INPUT_LEVEL_CMOS_AUTOMOTIVE
            PortPinInputPullResistor = PORT_PIN_IN_PULL_UP
            PortPinLevelValue = PORT_PIN_LEVEL_LOW
            PortPinMode = PORT_PIN_MODE_ALL
            PortPinModeChangeable = false
            PortPinOutputPadDriveStrength = PORT_PIN_DEFAULT_DRIVER
            PortPinOutputPinDriveMode = PORT_PIN_OUT_PUSHPULL
            PortPinSymbolicName = PORT_40_PIN_4
          Port_40_Pin_5 (PortPin):
            PortPinControllerSelect = DISABLE
            PortPinDirection = PORT_PIN_IN
            PortPinDirectionChangeable = false
            PortPinEmergencyStop = false
            PortPinEnableAnalogInputOnly = PORT_PIN_ANALOG_INPUT_DISABLE
            PortPinId = 645
            PortPinInitialMode = GPIO
            PortPinInputPadLevel = PORT_INPUT_LEVEL_CMOS_AUTOMOTIVE
            PortPinInputPullResistor = PORT_PIN_IN_PULL_UP
            PortPinLevelValue = PORT_PIN_LEVEL_LOW
            PortPinMode = PORT_PIN_MODE_ALL
            PortPinModeChangeable = false
            PortPinOutputPadDriveStrength = PORT_PIN_DEFAULT_DRIVER
            PortPinOutputPinDriveMode = PORT_PIN_OUT_PUSHPULL
            PortPinSymbolicName = PORT_40_PIN_5
    PortGeneral:
      PortDevErrorDetect = false
      PortSetPinDirectionApi = true
      PortSetPinModeApi = true
      PortVersionInfoApi = false
      PortInitApiMode = PORT_MCAL_SUPERVISOR
      PortSafetyEnable = true
      PortInitCheckApi = false
    CommonPublishedInformation:
      ArMajorVersion = 4
      ArMinorVersion = 4
      ArPatchVersion = 0
      SwMajorVersion = 20
      SwMinorVersion = 0
      SwPatchVersion = 1
      ModuleId = 124
      VendorId = 17
      Release = _TRICORE_TC332
