AUTOSAR XML (schema 00048)
package /ActiveEcuC
  module config Dma: implementation-config-variant=VARIANT-POST-BUILD-LOADABLE, module-description=Dma_Impl
    DmaGeneral:
      DmaDevErrorDetect = false
      DmaMultiCoreErrorDetect = false
      DmaSafetyEnable = true
      DmaInitCheckApi = false
      DmaDeInitApi = false
      DmaChDeInitApi = false
      DmaSuspendApi = false
      DmaTriggerApi = true
      DmaDataPendingApi = false
      DmaBufferSwitchApi = false
      DmaGetVersionInfoApi = false
      DmaMaxTransactionSetPerChannel = 1
      DmaInitDeInitApiMode = DMA_MCAL_SUPERVISORMODE
      DmaRuntimeApiMode = DMA_MCAL_SUPERVISORMODE
    DmaMoveEngineConfig: DmaMESourceErrorInterrupt=true, DmaMEDestinationErrorInterrupt=true, DmaMELinkedListErrorInterrupt=true
    CommonPublishedInformation:
      VendorId = 17
      ModuleId = 255
      ArMajorVersion = 4
      ArMinorVersion = 4
      ArPatchVersion = 0
      SwMajorVersion = 20
      SwMinorVersion = 0
      SwPatchVersion = 2
      Release = _TRICORE_TC332
    DmaPatternConfig: DmaPattern0=0, DmaPattern1=0
    4 x DmaResourcePartition, all with DmaResourcePartitionBusMode=DMA_RP_SUPERVISOR_MODE, DmaPermittedBusMaster=4294967295:
      DmaResourcePartition
      DmaResourcePartition_{1..3}
    3 x DmaChannelConfig, all with DmaChannelAssignedPartition=0, DmaChannelNumTransactionSet=1, DmaTcsInterruptTransactionLoss=false, DmaChannelNotification=NULL_PTR, DmaErrorNotification=NULL_PTR, DmaChannelUser=Other:
      DmaChannelConfig_0: DmaChannelId=0
        DmaChannelTransactionSet_0 (DmaChannelTransactionSet):
          DmaTcsIndex = 0
          DmaTcsSourceAddress = NULL_PTR
          DmaTcsDestinationAddress = NULL_PTR
          DmaTcsDoubleBuffer = NULL_PTR
          DmaUserHeaderFileWithExternDeclarations = NULL
          DmaTcsMoveLength = DMA_WIDTH_8BITS
          DmaPatternMode = Pattern_Detection_Disabled
          DmaTcsTransferLength = DMA_MOVES_1
          DmaTcsTransactionLength = 0
          DmaTcsCircularBufferSourceEnable = false
          DmaTcsCircularBufferDestinationEnable = false
          DmaTcsCircularBufferSourceLength = DMA_CIRCULAR_BUFFER_LENGTH_1BYTE
          DmaTcsCircularBufferDestinationLength = DMA_CIRCULAR_BUFFER_LENGTH_1BYTE
          DmaTcsSourceAddressModificationFactor = DMA_FACTOR_1
          DmaTcsDestinationAddressModificationFactor = DMA_FACTOR_1
          DmaTcsAppendTimeStamp = false
          DmaTcsSourceAddressMovement = DMA_INCREASING
          DmaTcsDestinationAddressMovement = DMA_INCREASING
          DmaTcsShadowRegisterConfiguration = DMA_SHADOWING_DISABLED
          DmaCLLNextIndex = 0
          DmaNextTcsIndex = 1
          DmaTcsTriggerFrequency = DMA_TRANSFER_PER_TRIGGER
          DmaTcsHardwareTrigger = DMA_NO_HARDWARE_TRIGGER
          DmaTcsDaisyChaining = false
          DmaTcsInterruptSourceAddressWrap = false
          DmaTcsInterruptDestinationAddressWrap = false
          DmaTcsDataTransferInterrupt = false
          DmaTcsInterruptDataTransfer = DMA_INTERRUPT_PER_TRANSACTION
          DmaTcsInterruptDataTransferThreshold = 0
          DmaTcsSwapDataCRCByteOrder = false
          DmaTcsAutoStartEnable = false
          DmaTcsReferenceAddressCrc = 0
          DmaTcsReferenceDataCrc = 0
      DmaChannelConfig_1: DmaChannelId=1
        DmaChannelTransactionSet_0 (DmaChannelTransactionSet):
          DmaTcsIndex = 0
          DmaTcsSourceAddress = NULL_PTR
          DmaTcsDestinationAddress = NULL_PTR
          DmaTcsDoubleBuffer = NULL_PTR
          DmaUserHeaderFileWithExternDeclarations = NULL
          DmaTcsMoveLength = DMA_WIDTH_8BITS
          DmaPatternMode = Pattern_Detection_Disabled
          DmaTcsTransferLength = DMA_MOVES_1
          DmaTcsTransactionLength = 0
          DmaTcsCircularBufferSourceEnable = false
          DmaTcsCircularBufferDestinationEnable = false
          DmaTcsCircularBufferSourceLength = DMA_CIRCULAR_BUFFER_LENGTH_1BYTE
          DmaTcsCircularBufferDestinationLength = DMA_CIRCULAR_BUFFER_LENGTH_1BYTE
          DmaTcsSourceAddressModificationFactor = DMA_FACTOR_1
          DmaTcsDestinationAddressModificationFactor = DMA_FACTOR_1
          DmaTcsAppendTimeStamp = false
          DmaTcsSourceAddressMovement = DMA_INCREASING
          DmaTcsDestinationAddressMovement = DMA_INCREASING
          DmaTcsShadowRegisterConfiguration = DMA_SHADOWING_DISABLED
          DmaCLLNextIndex = 0
          DmaNextTcsIndex = 1
          DmaTcsTriggerFrequency = DMA_TRANSFER_PER_TRIGGER
          DmaTcsHardwareTrigger = DMA_NO_HARDWARE_TRIGGER
          DmaTcsDaisyChaining = false
          DmaTcsInterruptSourceAddressWrap = false
          DmaTcsInterruptDestinationAddressWrap = false
          DmaTcsDataTransferInterrupt = true
          DmaTcsInterruptDataTransfer = DMA_INTERRUPT_PER_TRANSACTION
          DmaTcsInterruptDataTransferThreshold = 0
          DmaTcsSwapDataCRCByteOrder = false
          DmaTcsAutoStartEnable = false
          DmaTcsReferenceAddressCrc = 0
          DmaTcsReferenceDataCrc = 0
      DmaChannelConfig_16: DmaChannelId=16
        DmaChannelTransactionSet_0 (DmaChannelTransactionSet):
          DmaTcsIndex = 0
          DmaTcsSourceAddress = NULL_PTR
          DmaTcsDestinationAddress = NULL_PTR
          DmaTcsDoubleBuffer = NULL_PTR
          DmaUserHeaderFileWithExternDeclarations = NULL
          DmaTcsMoveLength = DMA_WIDTH_8BITS
          DmaPatternMode = Pattern_Detection_Disabled
          DmaTcsTransferLength = DMA_MOVES_1
          DmaTcsTransactionLength = 14
          DmaTcsCircularBufferSourceEnable = false
          DmaTcsCircularBufferDestinationEnable = false
          DmaTcsCircularBufferSourceLength = DMA_CIRCULAR_BUFFER_LENGTH_1BYTE
          DmaTcsCircularBufferDestinationLength = DMA_CIRCULAR_BUFFER_LENGTH_1BYTE
          DmaTcsSourceAddressModificationFactor = DMA_FACTOR_1
          DmaTcsDestinationAddressModificationFactor = DMA_FACTOR_1
          DmaTcsAppendTimeStamp = false
          DmaTcsSourceAddressMovement = DMA_INCREASING
          DmaTcsDestinationAddressMovement = DMA_INCREASING
          DmaTcsShadowRegisterConfiguration = DMA_SHADOWING_DISABLED
          DmaCLLNextIndex = 0
          DmaNextTcsIndex = 1
          DmaTcsTriggerFrequency = DMA_TRANSFER_PER_TRIGGER
          DmaTcsHardwareTrigger = DMA_NO_HARDWARE_TRIGGER
          DmaTcsDaisyChaining = false
          DmaTcsInterruptSourceAddressWrap = false
          DmaTcsInterruptDestinationAddressWrap = false
          DmaTcsDataTransferInterrupt = false
          DmaTcsInterruptDataTransfer = DMA_INTERRUPT_PER_TRANSACTION
          DmaTcsInterruptDataTransferThreshold = 0
          DmaTcsSwapDataCRCByteOrder = false
          DmaTcsAutoStartEnable = false
          DmaTcsReferenceAddressCrc = 0
          DmaTcsReferenceDataCrc = 0
