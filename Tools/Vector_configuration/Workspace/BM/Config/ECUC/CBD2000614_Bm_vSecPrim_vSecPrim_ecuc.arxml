AUTOSAR XML (schema 00048)
package /ActiveEcuC
  module config vSecPrim: implementation-config-variant=VARIANT-PRE-COMPILE, module-description=vSecPrim_Impl
    vSecPrimSymmetricAlgorithms
      vSecPrimCipher:
        vSecPrimAes128Enabled = true
        vSecPrimAes192Enabled = false
        vSecPrimAes256Enabled = false
        vSecPrimGcmEnabled = false
        vSecPrimDesEnabled = false
        vSecPrimRC2Enabled = false
        vSecPrimTDesEnabled = false
        vSecPrimChaCha20Enabled = false
        vSecPrimAeadChaCha20Poly1305Enabled = false
        vSecPrimAesCcmEnabled = false
      vSecPrimMac:
        vSecPrimSipHashEnabled = false
        vSecPrimCmacEnabled = false
        vSecPrimHMacSHA1Enabled = false
        vSecPrimHMacRMD160Enabled = false
        vSecPrimHMacSHA2_256Enabled = false
        vSecPrimGMacEnabled = false
        vSecPrimPoly1305Enabled = false
        vSecPrimHMacSHA2_384Enabled = false
    vSecPrimAsymmetricAlgorithms
      vSecPrimSignature:
        vSecPrimECDSA_25519Enabled = true
        vSecPrimRSA_V15_SHA2_256Enabled = false
        vSecPrimRSA_V15_SHA1Enabled = false
        vSecPrimRSA_PSS_RIPEMD160Enabled = false
        vSecPrimRSA_PSS_SHA1Enabled = false
        vSecPrimRSA_PSS_SHA2_256Enabled = false
        vSecPrimRSA_V15_RIPEMD160Enabled = false
        vSecPrimECDSA_GenericEnabled = false
      vSecPrimKeyExchange: vSecPrimECDH_25519Enabled=false, vSecPrimECDH_GenericEnabled=false, vSecPrimECBD_GenericEnabled=false, vSecPrimSPAKE2pEnabled=false
      vSecPrimKeyDerivation:
        vSecPrimPKCS5Enabled = false
        vSecPrimANSI_X963Enabled = false
        vSecPrimANSI_X963_SHA256Enabled = false
        vSecPrimPKCS5HMacSHA256Enabled = false
        vSecPrimANSI_X963_SHA512Enabled = false
        vSecPrimHKDF_HMAC_SHA256Enabled = false
        vSecPrimHKDF_SHA2_256_OnestepEnabled = false
        vSecPrimHKDF_HMAC_SHA384Enabled = false
      vSecPrimCipher: vSecPrimRSA_OAEP_SHA1Enabled=false, vSecPrimRSA_OAEP_SHA2_256Enabled=false, vSecPrimRSA_V15Enabled=false
      vSecPrimKeyGeneration: vSecPrimECCEnabled=false
    vSecPrimBasicAlgorithms
      vSecPrimHash:
        vSecPrimSHA2_512Enabled = true
        vSecPrimSHA1Enabled = false
        vSecPrimRIPEMD160Enabled = false
        vSecPrimSHA2_256Enabled = false
        vSecPrimSHA3Enabled = false
        vSecPrimMD5Enabled = false
      vSecPrimRandomNumberGeneration: vSecPrimFIPS186Enabled=true, vSecPrimCtrDrbgEnabled=false, vSecPrimHashDrbgEnabled=false
    vSecPrimOptimization:
      vSecPrimAesSpeedUp = SPEED_UP_LEVEL_3
      vSecPrimSha1SpeedUp = SPEED_UP_LEVEL_1
      vSecPrimSha256SpeedUp = SPEED_UP_LEVEL_0
      vSecPrimSha512SpeedUp = SPEED_UP_LEVEL_0
      vSecPrimChaCha20SpeedUp = SPEED_UP_LEVEL_1
    vSecPrimGeneral:
      vSecPrimRSAMaxKeySize = RSA_MAX_KEY_SIZE_2048
      vSecPrimECPMaxKeySize = ECP_MAX_KEY_SIZE_256
      vSecPrimClearWorkspaceEnabled = false
      vSecPrimSupportUInt64 = true
      vSecPrimWatchdogLevel = WD_LEVEL_3
      vSecPrimSizeOfEsltLength = SIZE_UINT32
      vSecPrimCTRDRBGAES128SecurityStrength = SECURITY_STRENGTH_128
      vSecPrimDrbgReseedInterval = 4294967295
      vSecPrimSPAKE2pMaxAADSize = 16
      vSecPrimSPAKE2pPreambleOKMLength = 64
      vSecPrimUseVstdLib = false
