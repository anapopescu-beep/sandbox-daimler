AUTOSAR XML (schema 00048)
package /ActiveEcuC
  module config vMemAccM: implementation-config-variant=VARIANT-PRE-COMPILE, module-description=vMemAccM_Impl
    Active_AddressArea (vMemAccMAddressAreaConfiguration): vMemAccMAddressAreaId=0, vMemAccMAddressAreaPriority=0, vMemAccMReadRequestLength=64
      vMemAccMSubAddressAreaConfiguration:
        vMemAccMNumberOfSectors = 359
        vMemAccMVirtualStartAddress = 2684633088
        vMemAccMPhysicalStartAddress = 2684633088
        vMemAccMvMemFuncPtrTableSymbol = vMem_30_Fbl_FunctionPointerTable
        vMemAccMUseEraseBurst = false
        vMemAccMUseWriteBurst = false
        vMemAccMSectorRef = vMemSector
    vMemAccMGeneral:
      vMemAccMVersionInfoApi = false
      vMemAccMMainFunctionPeriod = 0.005
      vMemAccMMainFunctionTriggering = FixedCycleTime
      vMemAccMSafeBswChecks = false
      vMemAccMDevErrorDetect = true
      vMemAccMCompareApi = false
