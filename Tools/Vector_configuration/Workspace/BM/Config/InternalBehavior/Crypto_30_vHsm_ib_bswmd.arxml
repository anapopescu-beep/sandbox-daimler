AUTOSAR XML (schema 4-0-3)
package /MICROSAR/Crypto_30_vHsm_ib_bswmd/BswModuleDescriptions
  bsw module description Crypto: provided-entrys=Crypto_30_vHsm_MainFunction
    bsw internal behavior Crypto_30_vHsm
      4 x exclusive area:
        CRYPTO_30_VHSM_EXCLUSIVE_AREA_0  # This critical section protects workspace locking resources. Therefore the critical section enclosed with CRYPTO_30_VHSM_EXCLUSIVE_AREA_0 should never be interrupted by any other API. For more details, see DocTechRef.
        CRYPTO_30_VHSM_EXCLUSIVE_AREA_1  # This critical section ensures that a forwarded DET from the vHsm is processed only once (Flag is located in the IPC memory).Therefore the critical section enclosed with CRYPTO_30_VHSM_EXCLUSIVE_AREA_1 should ensure that the Crypto_30_vHsm_MainFuncion does not interrupt an ongoing Job Processing. Otherwise, a DET could be notified twice.
        CRYPTO_30_VHSM_EXCLUSIVE_AREA_2  # This critical section protects workspace locking resources when it can not be ensured that uint32 write access is atomic.The critical section enclosed with CRYPTO_30_VHSM_EXCLUSIVE_AREA_2 does not need to be protected against interruption by other API calls when the combination of hardware and compiler can guarantee atomic uint32 write operations.The critical section can therefore be empty in this case. If atomic uint32 write access can not be guaranteed, the critical sections enclosed with CRYPTO_30_VHSM_EXCLUSIVE_AREA_2 should ensure that they should never be interrupted by any other API
        CRYPTO_30_VHSM_EXCLUSIVE_AREA_3  # This critical section protects workspace locking resources when it can not be ensured that uint32 write access is atomic.The critical section enclosed with CRYPTO_30_VHSM_EXCLUSIVE_AREA_3 does not need to be protected against interruption by other API calls when the combination of hardware and compiler can guarantee atomic uint32 write operations.The critical section can therefore be empty in this case. If atomic uint32 write access can not be guaranteed, the critical sections enclosed with CRYPTO_30_VHSM_EXCLUSIVE_AREA_3 should ensure that they should never be interrupted by any other API. If interrupt mode of the driver is used and ISRs can not be interrupted by other interrupts, this critical section does not need to be protected.
      bsw schedulable entity Crypto_30_vHsm_MainFunction: implemented-entry=Crypto_30_vHsm_MainFunction
      bsw timing event Crypto_30_vHsm_MainFunctionTimingEvent0: starts-on-event=Crypto_30_vHsm_MainFunction, period=0.01
  bsw module entry Crypto_30_vHsm_MainFunction: call-type=SCHEDULED, execution-context=TASK
