AUTOSAR XML (schema 00046)
package /MICROSAR/CanTrcv_Tja1043
  bsw implementation CanTrcv_Impl: programming-language=C, sw-version=4.04.00, used-code-generator=DaVinci Configurator5, vendor-id=30, ar-release-version=4.00.03, vendor-api-infix=Tja1043
