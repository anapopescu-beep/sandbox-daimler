AUTOSAR XML (schema 4-3-0)
package /MICROSAR
  bsw implementation DoIP_Impl: programming-language=C, sw-version=11.03.00, used-code-generator=DaVinci Configurator, vendor-id=30, ar-release-version=4.05.00
