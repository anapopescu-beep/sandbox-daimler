AUTOSAR XML (schema 4-3-0)
package /MICROSARFBL/Dcm_ib_bswmd/BswModuleDescriptions
  bsw module description Dcm
    bsw internal behavior DcmBehavior
