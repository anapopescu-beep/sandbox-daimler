AUTOSAR XML (schema 4-3-0)
package /MICROSAR
  bsw implementation LinSM_Impl: programming-language=C, sw-version=7.00.02, used-code-generator=DaVinci Configurator, vendor-id=30, ar-release-version=4.00.03
