AUTOSAR XML (schema 4-3-0)
package /MICROSAR
  bsw implementation CanIf_Impl: programming-language=C, sw-version=6.25.00, used-code-generator=cMSR, vendor-id=30, ar-release-version=4.00.03
package /MICROSAR/CanIf_ib_bswmd/BswModuleDescriptions
  bsw module description CanIf
    bsw internal behavior CanIf_Behavior
      8 x exclusive area:
        CANIF_EXCLUSIVE_AREA_{0..7}
