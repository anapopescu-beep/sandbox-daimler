AUTOSAR XML (schema 00046)
package /AURIX2G/EcucDefs/Dma_ib_bswmd/BswModuleDescriptions
  bsw module description Dma
    bsw internal behavior DmaBehavior
      9 x exclusive area:
        ChannelInitDeinit
        ChannelFreezeResume
        ChannelHWTrigger
        ChannelStartStop
        ChannelSwitchBuffer
        ChEventStatus
        MEErrorStatus
        InterruptStatus
        ChannelConfigUpdate
