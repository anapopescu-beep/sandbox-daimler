AUTOSAR XML (schema 4-3-0)
package /MICROSAR
  bsw implementation LinIf_Impl: programming-language=C, sw-version=9.02.00, used-code-generator=DaVinci Configurator, vendor-id=30, ar-release-version=4.00.03
