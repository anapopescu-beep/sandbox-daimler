AUTOSAR XML (schema 4-3-0)
package /MICROSAR/Lin_Tricore
  bsw implementation Lin_Impl: programming-language=C, sw-version=15.01.02, used-code-generator=DaVinci Configurator, vendor-id=30, ar-release-version=4.00.03
