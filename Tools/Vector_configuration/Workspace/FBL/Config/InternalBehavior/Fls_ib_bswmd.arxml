AUTOSAR XML (schema 00046)
package /AURIX2G/EcucDefs/Fls_ib_bswmd/BswModuleDescriptions
  bsw module description Fls: provided-entrys=Fls_17_Dmu_MainFunction
    bsw internal behavior FlsBehavior
      6 x exclusive area:
        Init
        Erase
        Write
        Main
        ResumeErase
        UserContentCount
      bsw schedulable entity Fls_17_Dmu_MainFunction: implemented-entry=Fls_17_Dmu_MainFunction
      bsw timing event Fls_17_Dmu_MainFunctionTimingEvent0: starts-on-event=Fls_17_Dmu_MainFunction, period=0.01
