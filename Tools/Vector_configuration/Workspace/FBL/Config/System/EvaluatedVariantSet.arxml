AUTOSAR XML (schema 00049)
package /VariantDefinition
  evaluated variant set EvaluatedVariantSet: approval-status=APPROVED, evaluated-variant=[RBTM_FL, RBTM_FR]
package /VariantDefinition/Variant
  predefined variant RBTM_FL: post-build-variant-criterion-value-set=RBTM_FL
  predefined variant RBTM_FR: post-build-variant-criterion-value-set=RBTM_FR
package /VariantDefinition/Variant/CriterionValueSet
  post build variant criterion value set RBTM_FL: post-build-variant-criterion-value{variant-criterion=Side, value=0}
  post build variant criterion value set RBTM_FR: post-build-variant-criterion-value{variant-criterion=Side, value=1}
package /VariantDefinition/Criterion
  post build variant criterion Side: compu {0=Left, 1=Right}
