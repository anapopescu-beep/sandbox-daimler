AUTOSAR XML (schema 00046)
package /COM/VECTOR/CFG/WORKFLOW/SYSDESC/SYNC
  flat map FLATMAP
    149 x flat instance descriptor:
      P_ROE: upstream-reference=ECU_RBTM_FL_STAR_3_2020_ST3.P_ROE, ecu-extract-reference=COMPOSITIONTYPE.P_ROE
      VSS_TP_SecTickCount_Lvl2_ST3_9eubq13iosat764o0lqh5xb6r: upstream-reference=ECU_RBTM_FL_STAR_3_2020_ST3.R_VSS_TP_SecTickCount_ST3.VSS_TP_SecTickCount_ST3, ecu-extract-reference=COMPOSITIONTYPE.R_VSS_TP_SecTickCount_ST3.VSS_TP_SecTickCount_ST3
      DI_Odo_Pr5_ST3_e68xmtlkywxgxsdwekdjjhw3t: upstream-reference=ECU_RBTM_FL_STAR_3_2020_ST3.R_DI_Odo_Pr5_ST3.DI_Odo_Pr5_ST3, ecu-extract-reference=COMPOSITIONTYPE.R_DI_Odo_Pr5_ST3.DI_Odo_Pr5_ST3
      R_DI_Odo_Pr5_ST3: upstream-reference=ECU_RBTM_FL_STAR_3_2020_ST3.R_DI_Odo_Pr5_ST3, ecu-extract-reference=COMPOSITIONTYPE.R_DI_Odo_Pr5_ST3
      DidA_ExtTest_Pres_ST3: upstream-reference=ECU_RBTM_FL_STAR_3_2020_ST3.R_DidA_ExtTest_Pres_ST3.DidA_ExtTest_Pres_ST3, ecu-extract-reference=COMPOSITIONTYPE.R_DidA_ExtTest_Pres_ST3.DidA_ExtTest_Pres_ST3
      R_DidA_ExtTest_Pres_ST3: upstream-reference=ECU_RBTM_FL_STAR_3_2020_ST3.R_DidA_ExtTest_Pres_ST3, ecu-extract-reference=COMPOSITIONTYPE.R_DidA_ExtTest_Pres_ST3
      Ign_Stat_Pr5_ST3_csgs1dv6drms80o1i9p49677w: upstream-reference=ECU_RBTM_FL_STAR_3_2020_ST3.R_Ign_Stat_Pr5_ST3.Ign_Stat_Pr5_ST3, ecu-extract-reference=COMPOSITIONTYPE.R_Ign_Stat_Pr5_ST3.Ign_Stat_Pr5_ST3
      R_Ign_Stat_Pr5_ST3: upstream-reference=ECU_RBTM_FL_STAR_3_2020_ST3.R_Ign_Stat_Pr5_ST3, ecu-extract-reference=COMPOSITIONTYPE.R_Ign_Stat_Pr5_ST3
      PN14_ProdMd_Stat_ST3: upstream-reference=ECU_RBTM_FL_STAR_3_2020_ST3.R_PN14_ProdMd_Stat_ST3.PN14_ProdMd_Stat_ST3, ecu-extract-reference=COMPOSITIONTYPE.R_PN14_ProdMd_Stat_ST3.PN14_ProdMd_Stat_ST3
      R_PN14_ProdMd_Stat_ST3: upstream-reference=ECU_RBTM_FL_STAR_3_2020_ST3.R_PN14_ProdMd_Stat_ST3, ecu-extract-reference=COMPOSITIONTYPE.R_PN14_ProdMd_Stat_ST3
      PN14_SupBat_Volt_ST3: upstream-reference=ECU_RBTM_FL_STAR_3_2020_ST3.R_PN14_SupBat_Volt_ST3.PN14_SupBat_Volt_ST3, ecu-extract-reference=COMPOSITIONTYPE.R_PN14_SupBat_Volt_ST3.PN14_SupBat_Volt_ST3
      R_PN14_SupBat_Volt_ST3: upstream-reference=ECU_RBTM_FL_STAR_3_2020_ST3.R_PN14_SupBat_Volt_ST3, ecu-extract-reference=COMPOSITIONTYPE.R_PN14_SupBat_Volt_ST3
      PN14_TransMd_Stat_ST3: upstream-reference=ECU_RBTM_FL_STAR_3_2020_ST3.R_PN14_TransMd_Stat_ST3.PN14_TransMd_Stat_ST3, ecu-extract-reference=COMPOSITIONTYPE.R_PN14_TransMd_Stat_ST3.PN14_TransMd_Stat_ST3
      R_PN14_TransMd_Stat_ST3: upstream-reference=ECU_RBTM_FL_STAR_3_2020_ST3.R_PN14_TransMd_Stat_ST3, ecu-extract-reference=COMPOSITIONTYPE.R_PN14_TransMd_Stat_ST3
      PT4_PTCoor4_Pr5_ST3_af4fxb1ykieox3itqdfzs0kpb: upstream-reference=ECU_RBTM_FL_STAR_3_2020_ST3.R_PT4_PTCoor4_Pr5_ST3.PT4_PTCoor4_Pr5_ST3, ecu-extract-reference=COMPOSITIONTYPE.R_PT4_PTCoor4_Pr5_ST3.PT4_PTCoor4_Pr5_ST3
      R_PT4_PTCoor4_Pr5_ST3: upstream-reference=ECU_RBTM_FL_STAR_3_2020_ST3.R_PT4_PTCoor4_Pr5_ST3, ecu-extract-reference=COMPOSITIONTYPE.R_PT4_PTCoor4_Pr5_ST3
      VSS_TP_Auth_ST3_6j4id7sghlvlbroli4wjozjik: upstream-reference=ECU_RBTM_FL_STAR_3_2020_ST3.R_VSS_TP_Auth_ST3.VSS_TP_Auth_ST3, ecu-extract-reference=COMPOSITIONTYPE.R_VSS_TP_Auth_ST3.VSS_TP_Auth_ST3
      R_VSS_TP_Auth_ST3: upstream-reference=ECU_RBTM_FL_STAR_3_2020_ST3.R_VSS_TP_Auth_ST3, ecu-extract-reference=COMPOSITIONTYPE.R_VSS_TP_Auth_ST3
      VSS_TP_RealTmOffset_ST3_1t7vc44gftc0wv35k5kgc2in9: upstream-reference=ECU_RBTM_FL_STAR_3_2020_ST3.R_VSS_TP_RealTmOffset_ST3.VSS_TP_RealTmOffset_ST3, ecu-extract-reference=COMPOSITIONTYPE.R_VSS_TP_RealTmOffset_ST3.VSS_TP_RealTmOffset_ST3
      R_VSS_TP_RealTmOffset_ST3: upstream-reference=ECU_RBTM_FL_STAR_3_2020_ST3.R_VSS_TP_RealTmOffset_ST3, ecu-extract-reference=COMPOSITIONTYPE.R_VSS_TP_RealTmOffset_ST3
      R_VSS_TP_SecTickCount_ST3: upstream-reference=ECU_RBTM_FL_STAR_3_2020_ST3.R_VSS_TP_SecTickCount_ST3, ecu-extract-reference=COMPOSITIONTYPE.R_VSS_TP_SecTickCount_ST3
      VSS_TP_SharedSecret_ST3_8pj4t8t4rm3tw3pk5hj7vonti: upstream-reference=ECU_RBTM_FL_STAR_3_2020_ST3.R_VSS_TP_SharedSecret_ST3.VSS_TP_SharedSecret_ST3, ecu-extract-reference=COMPOSITIONTYPE.R_VSS_TP_SharedSecret_ST3.VSS_TP_SharedSecret_ST3
      R_VSS_TP_SharedSecret_ST3: upstream-reference=ECU_RBTM_FL_STAR_3_2020_ST3.R_VSS_TP_SharedSecret_ST3, ecu-extract-reference=COMPOSITIONTYPE.R_VSS_TP_SharedSecret_ST3
      VSS_TP_VIN_ST3_bz1xsv84cxzl09j028gn39p69: upstream-reference=ECU_RBTM_FL_STAR_3_2020_ST3.R_VSS_TP_VIN_ST3.VSS_TP_VIN_ST3, ecu-extract-reference=COMPOSITIONTYPE.R_VSS_TP_VIN_ST3.VSS_TP_VIN_ST3
      R_VSS_TP_VIN_ST3: upstream-reference=ECU_RBTM_FL_STAR_3_2020_ST3.R_VSS_TP_VIN_ST3, ecu-extract-reference=COMPOSITIONTYPE.R_VSS_TP_VIN_ST3
      Awake_Diag_Actv_RBTM_FL_ST3: upstream-reference=ECU_RBTM_FL_STAR_3_2020_ST3.P_Awake_Diag_Actv_RBTM_FL_ST3.Awake_Diag_Actv_RBTM_FL_ST3, ecu-extract-reference=COMPOSITIONTYPE.P_Awake_Diag_Actv_RBTM_FL_ST3.Awake_Diag_Actv_RBTM_FL_ST3, variation-point=post-build-variant-condition{matching-criterion=Side, value=0}
      P_Awake_Diag_Actv_RBTM_FL_ST3: upstream-reference=ECU_RBTM_FL_STAR_3_2020_ST3.P_Awake_Diag_Actv_RBTM_FL_ST3, ecu-extract-reference=COMPOSITIONTYPE.P_Awake_Diag_Actv_RBTM_FL_ST3
      Awake_Ignition_On_RBTM_FL_ST3: upstream-reference=ECU_RBTM_FL_STAR_3_2020_ST3.P_Awake_Ignition_On_RBTM_FL_ST3.Awake_Ignition_On_RBTM_FL_ST3, ecu-extract-reference=COMPOSITIONTYPE.P_Awake_Ignition_On_RBTM_FL_ST3.Awake_Ignition_On_RBTM_FL_ST3, variation-point=post-build-variant-condition{matching-criterion=Side, value=0}
      P_Awake_Ignition_On_RBTM_FL_ST3: upstream-reference=ECU_RBTM_FL_STAR_3_2020_ST3.P_Awake_Ignition_On_RBTM_FL_ST3, ecu-extract-reference=COMPOSITIONTYPE.P_Awake_Ignition_On_RBTM_FL_ST3
      Awake_NwStart_RBTM_FL_ST3: upstream-reference=ECU_RBTM_FL_STAR_3_2020_ST3.P_Awake_NwStart_RBTM_FL_ST3.Awake_NwStart_RBTM_FL_ST3, ecu-extract-reference=COMPOSITIONTYPE.P_Awake_NwStart_RBTM_FL_ST3.Awake_NwStart_RBTM_FL_ST3, variation-point=post-build-variant-condition{matching-criterion=Side, value=0}
      P_Awake_NwStart_RBTM_FL_ST3: upstream-reference=ECU_RBTM_FL_STAR_3_2020_ST3.P_Awake_NwStart_RBTM_FL_ST3, ecu-extract-reference=COMPOSITIONTYPE.P_Awake_NwStart_RBTM_FL_ST3
      BltSlckDec_Md_FL_Stat_ST3: upstream-reference=ECU_RBTM_FL_STAR_3_2020_ST3.P_BltSlckDec_Md_XX_Stat_ST3.BltSlckDec_Md_XX_Stat_ST3, ecu-extract-reference=COMPOSITIONTYPE.P_BltSlckDec_Md_XX_Stat_ST3.BltSlckDec_Md_XX_Stat_ST3, variation-point=post-build-variant-condition{matching-criterion=Side, value=0}
      P_BltSlckDec_Md_XX_Stat_ST3: upstream-reference=ECU_RBTM_FL_STAR_3_2020_ST3.P_BltSlckDec_Md_XX_Stat_ST3, ecu-extract-reference=COMPOSITIONTYPE.P_BltSlckDec_Md_XX_Stat_ST3
      Develop8_Rs_RBTM_FL_ST3_7jg1r8p1skn6yj1t9z2s157vt: upstream-reference=ECU_RBTM_FL_STAR_3_2020_ST3.P_Develop8_Rs_RBTM_FL_ST3.Develop8_Rs_RBTM_FL_ST3, ecu-extract-reference=COMPOSITIONTYPE.P_Develop8_Rs_RBTM_FL_ST3.Develop8_Rs_RBTM_FL_ST3, variation-point=post-build-variant-condition{matching-criterion=Side, value=0}
      P_Develop8_Rs_RBTM_FL_ST3: upstream-reference=ECU_RBTM_FL_STAR_3_2020_ST3.P_Develop8_Rs_RBTM_FL_ST3, ecu-extract-reference=COMPOSITIONTYPE.P_Develop8_Rs_RBTM_FL_ST3
      ECU_Id_RBTM_FL_ST3: upstream-reference=ECU_RBTM_FL_STAR_3_2020_ST3.P_ECU_Id_RBTM_FL_ST3.ECU_Id_RBTM_FL_ST3, ecu-extract-reference=COMPOSITIONTYPE.P_ECU_Id_RBTM_FL_ST3.ECU_Id_RBTM_FL_ST3, variation-point=post-build-variant-condition{matching-criterion=Side, value=0}
      P_ECU_Id_RBTM_FL_ST3: upstream-reference=ECU_RBTM_FL_STAR_3_2020_ST3.P_ECU_Id_RBTM_FL_ST3, ecu-extract-reference=COMPOSITIONTYPE.P_ECU_Id_RBTM_FL_ST3
      Meas8_RBTM_FL_ST3_72jyquhuktrmjm0hkqempja37: upstream-reference=ECU_RBTM_FL_STAR_3_2020_ST3.P_Meas_RBTM_FL_ST3.Meas8_RBTM_FL_ST3, ecu-extract-reference=COMPOSITIONTYPE.P_Meas_RBTM_FL_ST3.Meas8_RBTM_FL_ST3, variation-point=post-build-variant-condition{matching-criterion=Side, value=0}
      P_Meas_RBTM_FL_ST3: upstream-reference=ECU_RBTM_FL_STAR_3_2020_ST3.P_Meas_RBTM_FL_ST3, ecu-extract-reference=COMPOSITIONTYPE.P_Meas_RBTM_FL_ST3
      PS_Curve_FL_Stat_ST3: upstream-reference=ECU_RBTM_FL_STAR_3_2020_ST3.P_PS_Curve_FL_Stat_ST3.PS_Curve_FL_Stat_ST3, ecu-extract-reference=COMPOSITIONTYPE.P_PS_Curve_FL_Stat_ST3.PS_Curve_FL_Stat_ST3, variation-point=post-build-variant-condition{matching-criterion=Side, value=0}
      P_PS_Curve_FL_Stat_ST3: upstream-reference=ECU_RBTM_FL_STAR_3_2020_ST3.P_PS_Curve_FL_Stat_ST3, ecu-extract-reference=COMPOSITIONTYPE.P_PS_Curve_FL_Stat_ST3
      RBTM_FL_Disp_Rq_ST3: upstream-reference=ECU_RBTM_FL_STAR_3_2020_ST3.P_RBTM_FL_Disp_Rq_ST3.RBTM_FL_Disp_Rq_ST3, ecu-extract-reference=COMPOSITIONTYPE.P_RBTM_FL_Disp_Rq_ST3.RBTM_FL_Disp_Rq_ST3, variation-point=post-build-variant-condition{matching-criterion=Side, value=0}
      P_RBTM_FL_Disp_Rq_ST3: upstream-reference=ECU_RBTM_FL_STAR_3_2020_ST3.P_RBTM_FL_Disp_Rq_ST3, ecu-extract-reference=COMPOSITIONTYPE.P_RBTM_FL_Disp_Rq_ST3
      RBTM_FL_Tgl_ST3: upstream-reference=ECU_RBTM_FL_STAR_3_2020_ST3.P_RBTM_FL_Tgl_ST3.RBTM_FL_Tgl_ST3, ecu-extract-reference=COMPOSITIONTYPE.P_RBTM_FL_Tgl_ST3.RBTM_FL_Tgl_ST3, variation-point=post-build-variant-condition{matching-criterion=Side, value=0}
      P_RBTM_FL_Tgl_ST3: upstream-reference=ECU_RBTM_FL_STAR_3_2020_ST3.P_RBTM_FL_Tgl_ST3, ecu-extract-reference=COMPOSITIONTYPE.P_RBTM_FL_Tgl_ST3
      RevBltTns_FL_ComCyc_Actv_ST3: upstream-reference=ECU_RBTM_FL_STAR_3_2020_ST3.P_RevBltTns_FL_ComCyc_Actv_ST3.RevBltTns_FL_ComCyc_Actv_ST3, ecu-extract-reference=COMPOSITIONTYPE.P_RevBltTns_FL_ComCyc_Actv_ST3.RevBltTns_FL_ComCyc_Actv_ST3, variation-point=post-build-variant-condition{matching-criterion=Side, value=0}
      P_RevBltTns_FL_ComCyc_Actv_ST3: upstream-reference=ECU_RBTM_FL_STAR_3_2020_ST3.P_RevBltTns_FL_ComCyc_Actv_ST3, ecu-extract-reference=COMPOSITIONTYPE.P_RevBltTns_FL_ComCyc_Actv_ST3
      RevBltTns_FL_SafeCyc_Actv_ST3: upstream-reference=ECU_RBTM_FL_STAR_3_2020_ST3.P_RevBltTns_FL_SafeCyc_Actv_ST3.RevBltTns_FL_SafeCyc_Actv_ST3, ecu-extract-reference=COMPOSITIONTYPE.P_RevBltTns_FL_SafeCyc_Actv_ST3.RevBltTns_FL_SafeCyc_Actv_ST3, variation-point=post-build-variant-condition{matching-criterion=Side, value=0}
      P_RevBltTns_FL_SafeCyc_Actv_ST3: upstream-reference=ECU_RBTM_FL_STAR_3_2020_ST3.P_RevBltTns_FL_SafeCyc_Actv_ST3, ecu-extract-reference=COMPOSITIONTYPE.P_RevBltTns_FL_SafeCyc_Actv_ST3
      ROE_RBTM_FL_ST3_6e0rxnifai2txra0wamb18g4m: upstream-reference=ECU_RBTM_FL_STAR_3_2020_ST3.P_ROE.ROE_XX_ST3, ecu-extract-reference=COMPOSITIONTYPE.P_ROE.ROE_XX_ST3, variation-point=post-build-variant-condition{matching-criterion=Side, value=0}
      WakeupRsn_RBTM_FL_ST3: upstream-reference=ECU_RBTM_FL_STAR_3_2020_ST3.P_WakeupRsn_RBTM_FL_ST3.WakeupRsn_RBTM_FL_ST3, ecu-extract-reference=COMPOSITIONTYPE.P_WakeupRsn_RBTM_FL_ST3.WakeupRsn_RBTM_FL_ST3, variation-point=post-build-variant-condition{matching-criterion=Side, value=0}
      P_WakeupRsn_RBTM_FL_ST3: upstream-reference=ECU_RBTM_FL_STAR_3_2020_ST3.P_WakeupRsn_RBTM_FL_ST3, ecu-extract-reference=COMPOSITIONTYPE.P_WakeupRsn_RBTM_FL_ST3
      ADAS_Meta_ST3_40sly585w5zu8pqjwib3nr7y7: upstream-reference=ECU_RBTM_FL_STAR_3_2020_ST3.R_ADAS_Meta_ST3.ADAS_Meta_ST3, ecu-extract-reference=COMPOSITIONTYPE.R_ADAS_Meta_ST3.ADAS_Meta_ST3
      R_ADAS_Meta_ST3: upstream-reference=ECU_RBTM_FL_STAR_3_2020_ST3.R_ADAS_Meta_ST3, ecu-extract-reference=COMPOSITIONTYPE.R_ADAS_Meta_ST3
      ADAS_Posn_ST3_cre9f2x2lehhx0k4gxnl4u9sg: upstream-reference=ECU_RBTM_FL_STAR_3_2020_ST3.R_ADAS_Posn_ST3.ADAS_Posn_ST3, ecu-extract-reference=COMPOSITIONTYPE.R_ADAS_Posn_ST3.ADAS_Posn_ST3
      R_ADAS_Posn_ST3: upstream-reference=ECU_RBTM_FL_STAR_3_2020_ST3.R_ADAS_Posn_ST3, ecu-extract-reference=COMPOSITIONTYPE.R_ADAS_Posn_ST3
      ADAS_Prediction_MsgTyp_ST3: upstream-reference=ECU_RBTM_FL_STAR_3_2020_ST3.R_ADAS_Prediction_MsgTyp_ST3.ADAS_Prediction_MsgTyp_ST3, ecu-extract-reference=COMPOSITIONTYPE.R_ADAS_Prediction_MsgTyp_ST3.ADAS_Prediction_MsgTyp_ST3
      R_ADAS_Prediction_MsgTyp_ST3: upstream-reference=ECU_RBTM_FL_STAR_3_2020_ST3.R_ADAS_Prediction_MsgTyp_ST3, ecu-extract-reference=COMPOSITIONTYPE.R_ADAS_Prediction_MsgTyp_ST3
      ADAS_Profile_Short_CurvLn_ST3_96e9ejcafisp13h7moqj5malh: upstream-reference=ECU_RBTM_FL_STAR_3_2020_ST3.R_ADAS_Profile_Short_CurvLn_ST3.ADAS_Profile_Short_CurvLn_ST3, ecu-extract-reference=COMPOSITIONTYPE.R_ADAS_Profile_Short_CurvLn_ST3.ADAS_Profile_Short_CurvLn_ST3
      R_ADAS_Profile_Short_CurvLn_ST3: upstream-reference=ECU_RBTM_FL_STAR_3_2020_ST3.R_ADAS_Profile_Short_CurvLn_ST3, ecu-extract-reference=COMPOSITIONTYPE.R_ADAS_Profile_Short_CurvLn_ST3
      ADAS_ProfShort_ProfTyp_ST3: upstream-reference=ECU_RBTM_FL_STAR_3_2020_ST3.R_ADAS_ProfShort_ProfTyp_ST3.ADAS_ProfShort_ProfTyp_ST3, ecu-extract-reference=COMPOSITIONTYPE.R_ADAS_ProfShort_ProfTyp_ST3.ADAS_ProfShort_ProfTyp_ST3
      R_ADAS_ProfShort_ProfTyp_ST3: upstream-reference=ECU_RBTM_FL_STAR_3_2020_ST3.R_ADAS_ProfShort_ProfTyp_ST3, ecu-extract-reference=COMPOSITIONTYPE.R_ADAS_ProfShort_ProfTyp_ST3
      Bckl_Sw_Fx_Stat_Pr5_ST3_dihag5a55iw4h5qk539fx0kup: upstream-reference=ECU_RBTM_FL_STAR_3_2020_ST3.R_Bckl_Sw_Fx_Stat_Pr5_ST3.Bckl_Sw_Fx_Stat_Pr5_ST3, ecu-extract-reference=COMPOSITIONTYPE.R_Bckl_Sw_Fx_Stat_Pr5_ST3.Bckl_Sw_Fx_Stat_Pr5_ST3
      R_Bckl_Sw_Fx_Stat_Pr5_ST3: upstream-reference=ECU_RBTM_FL_STAR_3_2020_ST3.R_Bckl_Sw_Fx_Stat_Pr5_ST3, ecu-extract-reference=COMPOSITIONTYPE.R_Bckl_Sw_Fx_Stat_Pr5_ST3
      BeltHdOvr_FL_Stat_ST3: upstream-reference=ECU_RBTM_FL_STAR_3_2020_ST3.R_BeltHdOvr_XX_Stat_ST3.BeltHdOvr_XX_Stat_ST3, ecu-extract-reference=COMPOSITIONTYPE.R_BeltHdOvr_XX_Stat_ST3.BeltHdOvr_XX_Stat_ST3, variation-point=post-build-variant-condition{matching-criterion=Side, value=0}
      R_BeltHdOvr_XX_Stat_ST3: upstream-reference=ECU_RBTM_FL_STAR_3_2020_ST3.R_BeltHdOvr_XX_Stat_ST3, ecu-extract-reference=COMPOSITIONTYPE.R_BeltHdOvr_XX_Stat_ST3
      BltSlckDec_Md_Rq_HU_ST3: upstream-reference=ECU_RBTM_FL_STAR_3_2020_ST3.R_BltSlckDec_Md_Rq_HU_ST3.BltSlckDec_Md_Rq_HU_ST3, ecu-extract-reference=COMPOSITIONTYPE.R_BltSlckDec_Md_Rq_HU_ST3.BltSlckDec_Md_Rq_HU_ST3
      R_BltSlckDec_Md_Rq_HU_ST3: upstream-reference=ECU_RBTM_FL_STAR_3_2020_ST3.R_BltSlckDec_Md_Rq_HU_ST3, ecu-extract-reference=COMPOSITIONTYPE.R_BltSlckDec_Md_Rq_HU_ST3
      CLkS_DrRltch_Stat_Pr5_ST3_7at68qvnk0r9npofyykyfq82v: upstream-reference=ECU_RBTM_FL_STAR_3_2020_ST3.R_CLkS_DrRltch_Stat_Pr5_ST3.CLkS_DrRltch_Stat_Pr5_ST3, ecu-extract-reference=COMPOSITIONTYPE.R_CLkS_DrRltch_Stat_Pr5_ST3.CLkS_DrRltch_Stat_Pr5_ST3
      R_CLkS_DrRltch_Stat_Pr5_ST3: upstream-reference=ECU_RBTM_FL_STAR_3_2020_ST3.R_CLkS_DrRltch_Stat_Pr5_ST3, ecu-extract-reference=COMPOSITIONTYPE.R_CLkS_DrRltch_Stat_Pr5_ST3
      Develop8_Rq_RBTM_FL_ST3_48g6nu8rjjp9s4bhq1x3pz06u: upstream-reference=ECU_RBTM_FL_STAR_3_2020_ST3.R_Develop8_Rq_RBTM_FL_ST3.Develop8_Rq_RBTM_FL_ST3, ecu-extract-reference=COMPOSITIONTYPE.R_Develop8_Rq_RBTM_FL_ST3.Develop8_Rq_RBTM_FL_ST3, variation-point=post-build-variant-condition{matching-criterion=Side, value=0}
      R_Develop8_Rq_RBTM_FL_ST3: upstream-reference=ECU_RBTM_FL_STAR_3_2020_ST3.R_Develop8_Rq_RBTM_FL_ST3, ecu-extract-reference=COMPOSITIONTYPE.R_Develop8_Rq_RBTM_FL_ST3
      DPC_Md_Rq_ESP_Pr5_ST3_dcsny138uwpesz5bmssj1scqi: upstream-reference=ECU_RBTM_FL_STAR_3_2020_ST3.R_DPC_Md_Rq_ESP_Pr5_ST3.DPC_Md_Rq_ESP_Pr5_ST3, ecu-extract-reference=COMPOSITIONTYPE.R_DPC_Md_Rq_ESP_Pr5_ST3.DPC_Md_Rq_ESP_Pr5_ST3
      R_DPC_Md_Rq_ESP_Pr5_ST3: upstream-reference=ECU_RBTM_FL_STAR_3_2020_ST3.R_DPC_Md_Rq_ESP_Pr5_ST3, ecu-extract-reference=COMPOSITIONTYPE.R_DPC_Md_Rq_ESP_Pr5_ST3
      ELC_Lvr_Stat_Pr5_ST3_7b68ktfwrvsk1oyozi7cntryn: upstream-reference=ECU_RBTM_FL_STAR_3_2020_ST3.R_ELC_Lvr_Stat_Pr5_ST3.ELC_Lvr_Stat_Pr5_ST3, ecu-extract-reference=COMPOSITIONTYPE.R_ELC_Lvr_Stat_Pr5_ST3.ELC_Lvr_Stat_Pr5_ST3
      R_ELC_Lvr_Stat_Pr5_ST3: upstream-reference=ECU_RBTM_FL_STAR_3_2020_ST3.R_ELC_Lvr_Stat_Pr5_ST3, ecu-extract-reference=COMPOSITIONTYPE.R_ELC_Lvr_Stat_Pr5_ST3
      EVC_CfgList_01_08_Pr5_ST3_co3q1mwsf7pwxo2ix5jryc04x: upstream-reference=ECU_RBTM_FL_STAR_3_2020_ST3.R_EVC_CfgList_01_08_Pr5_ST3.EVC_CfgList_01_08_Pr5_ST3, ecu-extract-reference=COMPOSITIONTYPE.R_EVC_CfgList_01_08_Pr5_ST3.EVC_CfgList_01_08_Pr5_ST3
      R_EVC_CfgList_01_08_Pr5_ST3: upstream-reference=ECU_RBTM_FL_STAR_3_2020_ST3.R_EVC_CfgList_01_08_Pr5_ST3, ecu-extract-reference=COMPOSITIONTYPE.R_EVC_CfgList_01_08_Pr5_ST3
      Navi_RouteGuidance_Stat_ST3: upstream-reference=ECU_RBTM_FL_STAR_3_2020_ST3.R_Navi_RouteGuidance_Stat_ST3.Navi_RouteGuidance_Stat_ST3, ecu-extract-reference=COMPOSITIONTYPE.R_Navi_RouteGuidance_Stat_ST3.Navi_RouteGuidance_Stat_ST3
      R_Navi_RouteGuidance_Stat_ST3: upstream-reference=ECU_RBTM_FL_STAR_3_2020_ST3.R_Navi_RouteGuidance_Stat_ST3, ecu-extract-reference=COMPOSITIONTYPE.R_Navi_RouteGuidance_Stat_ST3
      ORC_Impact2_Pr5_ST3_b9l09rrslyv7vj3o92j69irnd: upstream-reference=ECU_RBTM_FL_STAR_3_2020_ST3.R_ORC_Impact2_Pr5_ST3.ORC_Impact2_Pr5_ST3, ecu-extract-reference=COMPOSITIONTYPE.R_ORC_Impact2_Pr5_ST3.ORC_Impact2_Pr5_ST3
      R_ORC_Impact2_Pr5_ST3: upstream-reference=ECU_RBTM_FL_STAR_3_2020_ST3.R_ORC_Impact2_Pr5_ST3, ecu-extract-reference=COMPOSITIONTYPE.R_ORC_Impact2_Pr5_ST3
      ORC_Impact3_Pr5_ST3_c4pqnkonfjwv3uiohsxhe9dwu: upstream-reference=ECU_RBTM_FL_STAR_3_2020_ST3.R_ORC_Impact3_Pr5_ST3.ORC_Impact3_Pr5_ST3, ecu-extract-reference=COMPOSITIONTYPE.R_ORC_Impact3_Pr5_ST3.ORC_Impact3_Pr5_ST3
      R_ORC_Impact3_Pr5_ST3: upstream-reference=ECU_RBTM_FL_STAR_3_2020_ST3.R_ORC_Impact3_Pr5_ST3, ecu-extract-reference=COMPOSITIONTYPE.R_ORC_Impact3_Pr5_ST3
      PN14_DDP_Sw_Stat_ST3: upstream-reference=ECU_RBTM_FL_STAR_3_2020_ST3.R_PN14_DDP_Sw_Stat_ST3.PN14_DDP_Sw_Stat_ST3, ecu-extract-reference=COMPOSITIONTYPE.R_PN14_DDP_Sw_Stat_ST3.PN14_DDP_Sw_Stat_ST3
      R_PN14_DDP_Sw_Stat_ST3: upstream-reference=ECU_RBTM_FL_STAR_3_2020_ST3.R_PN14_DDP_Sw_Stat_ST3, ecu-extract-reference=COMPOSITIONTYPE.R_PN14_DDP_Sw_Stat_ST3
      PresfAct_Adj_Pr5_ST3_2joar1a41xrgjqab60epnbplm: upstream-reference=ECU_RBTM_FL_STAR_3_2020_ST3.R_PresfAct_Adj_Pr5_ST3.PresfAct_Adj_Pr5_ST3, ecu-extract-reference=COMPOSITIONTYPE.R_PresfAct_Adj_Pr5_ST3.PresfAct_Adj_Pr5_ST3
      R_PresfAct_Adj_Pr5_ST3: upstream-reference=ECU_RBTM_FL_STAR_3_2020_ST3.R_PresfAct_Adj_Pr5_ST3, ecu-extract-reference=COMPOSITIONTYPE.R_PresfAct_Adj_Pr5_ST3
      PS_Curve_FL_Rq_HU_ST3: upstream-reference=ECU_RBTM_FL_STAR_3_2020_ST3.R_PS_Curve_FL_Rq_HU_ST3.PS_Curve_FL_Rq_HU_ST3, ecu-extract-reference=COMPOSITIONTYPE.R_PS_Curve_FL_Rq_HU_ST3.PS_Curve_FL_Rq_HU_ST3, variation-point=post-build-variant-condition{matching-criterion=Side, value=0}
      R_PS_Curve_FL_Rq_HU_ST3: upstream-reference=ECU_RBTM_FL_STAR_3_2020_ST3.R_PS_Curve_FL_Rq_HU_ST3, ecu-extract-reference=COMPOSITIONTYPE.R_PS_Curve_FL_Rq_HU_ST3
      PT4_PTCoor9_Pr5_ST3_6r95o81sst3tk9w2lzz600cw3: upstream-reference=ECU_RBTM_FL_STAR_3_2020_ST3.R_PT4_PTCoor9_Pr5_ST3.PT4_PTCoor9_Pr5_ST3, ecu-extract-reference=COMPOSITIONTYPE.R_PT4_PTCoor9_Pr5_ST3.PT4_PTCoor9_Pr5_ST3
      R_PT4_PTCoor9_Pr5_ST3: upstream-reference=ECU_RBTM_FL_STAR_3_2020_ST3.R_PT4_PTCoor9_Pr5_ST3, ecu-extract-reference=COMPOSITIONTYPE.R_PT4_PTCoor9_Pr5_ST3
      PT4_PTCoor_DrvPosn_Gear_Pr5_ST3_5p8cvrni3ypvuac33rj2asfy9: upstream-reference=ECU_RBTM_FL_STAR_3_2020_ST3.R_PT4_PTCoor_DrvPosn_Gear_Pr5_ST3.PT4_PTCoor_DrvPosn_Gear_Pr5_ST3, ecu-extract-reference=COMPOSITIONTYPE.R_PT4_PTCoor_DrvPosn_Gear_Pr5_ST3.PT4_PTCoor_DrvPosn_Gear_Pr5_ST3
      R_PT4_PTCoor_DrvPosn_Gear_Pr5_ST3: upstream-reference=ECU_RBTM_FL_STAR_3_2020_ST3.R_PT4_PTCoor_DrvPosn_Gear_Pr5_ST3, ecu-extract-reference=COMPOSITIONTYPE.R_PT4_PTCoor_DrvPosn_Gear_Pr5_ST3
      RevBltTns_FR_ComCyc_Actv_ST3: upstream-reference=ECU_RBTM_FL_STAR_3_2020_ST3.R_RevBltTns_FR_ComCyc_Actv_ST3.RevBltTns_FR_ComCyc_Actv_ST3, ecu-extract-reference=COMPOSITIONTYPE.R_RevBltTns_FR_ComCyc_Actv_ST3.RevBltTns_FR_ComCyc_Actv_ST3, variation-point=post-build-variant-condition{matching-criterion=Side, value=0}
      R_RevBltTns_FR_ComCyc_Actv_ST3: upstream-reference=ECU_RBTM_FL_STAR_3_2020_ST3.R_RevBltTns_FR_ComCyc_Actv_ST3, ecu-extract-reference=COMPOSITIONTYPE.R_RevBltTns_FR_ComCyc_Actv_ST3
      RevBltTns_FR_SafeCyc_Actv_ST3: upstream-reference=ECU_RBTM_FL_STAR_3_2020_ST3.R_RevBltTns_FR_SafeCyc_Actv_ST3.RevBltTns_FR_SafeCyc_Actv_ST3, ecu-extract-reference=COMPOSITIONTYPE.R_RevBltTns_FR_SafeCyc_Actv_ST3.RevBltTns_FR_SafeCyc_Actv_ST3, variation-point=post-build-variant-condition{matching-criterion=Side, value=0}
      R_RevBltTns_FR_SafeCyc_Actv_ST3: upstream-reference=ECU_RBTM_FL_STAR_3_2020_ST3.R_RevBltTns_FR_SafeCyc_Actv_ST3, ecu-extract-reference=COMPOSITIONTYPE.R_RevBltTns_FR_SafeCyc_Actv_ST3
      VehSpd_Disp_ST3: upstream-reference=ECU_RBTM_FL_STAR_3_2020_ST3.R_VehSpd_Disp_ST3.VehSpd_Disp_ST3, ecu-extract-reference=COMPOSITIONTYPE.R_VehSpd_Disp_ST3.VehSpd_Disp_ST3
      R_VehSpd_Disp_ST3: upstream-reference=ECU_RBTM_FL_STAR_3_2020_ST3.R_VehSpd_Disp_ST3, ecu-extract-reference=COMPOSITIONTYPE.R_VehSpd_Disp_ST3
      BltSlckDec_Md_FR_Stat_ST3: upstream-reference=ECU_RBTM_FL_STAR_3_2020_ST3.P_BltSlckDec_Md_XX_Stat_ST3.BltSlckDec_Md_XX_Stat_ST3, ecu-extract-reference=COMPOSITIONTYPE.P_BltSlckDec_Md_XX_Stat_ST3.BltSlckDec_Md_XX_Stat_ST3, variation-point=post-build-variant-condition{matching-criterion=Side, value=1}
      ROE_RBTM_FR_ST3_3f1btonh6ivdn6ytgyuu9rtt1: upstream-reference=ECU_RBTM_FL_STAR_3_2020_ST3.P_ROE.ROE_XX_ST3, ecu-extract-reference=COMPOSITIONTYPE.P_ROE.ROE_XX_ST3, variation-point=post-build-variant-condition{matching-criterion=Side, value=1}
      BeltHdOvr_FR_Stat_ST3: upstream-reference=ECU_RBTM_FL_STAR_3_2020_ST3.R_BeltHdOvr_XX_Stat_ST3.BeltHdOvr_XX_Stat_ST3, ecu-extract-reference=COMPOSITIONTYPE.R_BeltHdOvr_XX_Stat_ST3.BeltHdOvr_XX_Stat_ST3, variation-point=post-build-variant-condition{matching-criterion=Side, value=1}
      Awake_Diag_Actv_RBTM_FR_ST3: upstream-reference=ECU_RBTM_FL_STAR_3_2020_ST3.P_Awake_Diag_Actv_RBTM_FR_ST3.Awake_Diag_Actv_RBTM_FR_ST3, ecu-extract-reference=COMPOSITIONTYPE.P_Awake_Diag_Actv_RBTM_FR_ST3.Awake_Diag_Actv_RBTM_FR_ST3, variation-point=post-build-variant-condition{matching-criterion=Side, value=1}
      P_Awake_Diag_Actv_RBTM_FR_ST3: upstream-reference=ECU_RBTM_FL_STAR_3_2020_ST3.P_Awake_Diag_Actv_RBTM_FR_ST3, ecu-extract-reference=COMPOSITIONTYPE.P_Awake_Diag_Actv_RBTM_FR_ST3
      Awake_Ignition_On_RBTM_FR_ST3: upstream-reference=ECU_RBTM_FL_STAR_3_2020_ST3.P_Awake_Ignition_On_RBTM_FR_ST3.Awake_Ignition_On_RBTM_FR_ST3, ecu-extract-reference=COMPOSITIONTYPE.P_Awake_Ignition_On_RBTM_FR_ST3.Awake_Ignition_On_RBTM_FR_ST3, variation-point=post-build-variant-condition{matching-criterion=Side, value=1}
      P_Awake_Ignition_On_RBTM_FR_ST3: upstream-reference=ECU_RBTM_FL_STAR_3_2020_ST3.P_Awake_Ignition_On_RBTM_FR_ST3, ecu-extract-reference=COMPOSITIONTYPE.P_Awake_Ignition_On_RBTM_FR_ST3
      Awake_NwStart_RBTM_FR_ST3: upstream-reference=ECU_RBTM_FL_STAR_3_2020_ST3.P_Awake_NwStart_RBTM_FR_ST3.Awake_NwStart_RBTM_FR_ST3, ecu-extract-reference=COMPOSITIONTYPE.P_Awake_NwStart_RBTM_FR_ST3.Awake_NwStart_RBTM_FR_ST3, variation-point=post-build-variant-condition{matching-criterion=Side, value=1}
      P_Awake_NwStart_RBTM_FR_ST3: upstream-reference=ECU_RBTM_FL_STAR_3_2020_ST3.P_Awake_NwStart_RBTM_FR_ST3, ecu-extract-reference=COMPOSITIONTYPE.P_Awake_NwStart_RBTM_FR_ST3
      Develop8_Rs_RBTM_FR_ST3_5t18pq0a13t698v0vsj7yvmmm: upstream-reference=ECU_RBTM_FL_STAR_3_2020_ST3.P_Develop8_Rs_RBTM_FR_ST3.Develop8_Rs_RBTM_FR_ST3, ecu-extract-reference=COMPOSITIONTYPE.P_Develop8_Rs_RBTM_FR_ST3.Develop8_Rs_RBTM_FR_ST3, variation-point=post-build-variant-condition{matching-criterion=Side, value=1}
      P_Develop8_Rs_RBTM_FR_ST3: upstream-reference=ECU_RBTM_FL_STAR_3_2020_ST3.P_Develop8_Rs_RBTM_FR_ST3, ecu-extract-reference=COMPOSITIONTYPE.P_Develop8_Rs_RBTM_FR_ST3
      ECU_Id_RBTM_FR_ST3: upstream-reference=ECU_RBTM_FL_STAR_3_2020_ST3.P_ECU_Id_RBTM_FR_ST3.ECU_Id_RBTM_FR_ST3, ecu-extract-reference=COMPOSITIONTYPE.P_ECU_Id_RBTM_FR_ST3.ECU_Id_RBTM_FR_ST3, variation-point=post-build-variant-condition{matching-criterion=Side, value=1}
      P_ECU_Id_RBTM_FR_ST3: upstream-reference=ECU_RBTM_FL_STAR_3_2020_ST3.P_ECU_Id_RBTM_FR_ST3, ecu-extract-reference=COMPOSITIONTYPE.P_ECU_Id_RBTM_FR_ST3
      Meas8_RBTM_FR_ST3_7ba3lhjy9fnhufd3n9dyw0p9p: upstream-reference=ECU_RBTM_FL_STAR_3_2020_ST3.P_Meas_RBTM_FR_ST3.Meas8_RBTM_FR_ST3, ecu-extract-reference=COMPOSITIONTYPE.P_Meas_RBTM_FR_ST3.Meas8_RBTM_FR_ST3, variation-point=post-build-variant-condition{matching-criterion=Side, value=1}
      P_Meas_RBTM_FR_ST3: upstream-reference=ECU_RBTM_FL_STAR_3_2020_ST3.P_Meas_RBTM_FR_ST3, ecu-extract-reference=COMPOSITIONTYPE.P_Meas_RBTM_FR_ST3
      PS_Curve_FR_Stat_ST3: upstream-reference=ECU_RBTM_FL_STAR_3_2020_ST3.P_PS_Curve_FR_Stat_ST3.PS_Curve_FR_Stat_ST3, ecu-extract-reference=COMPOSITIONTYPE.P_PS_Curve_FR_Stat_ST3.PS_Curve_FR_Stat_ST3, variation-point=post-build-variant-condition{matching-criterion=Side, value=1}
      P_PS_Curve_FR_Stat_ST3: upstream-reference=ECU_RBTM_FL_STAR_3_2020_ST3.P_PS_Curve_FR_Stat_ST3, ecu-extract-reference=COMPOSITIONTYPE.P_PS_Curve_FR_Stat_ST3
      RBTM_FR_Disp_Rq_ST3: upstream-reference=ECU_RBTM_FL_STAR_3_2020_ST3.P_RBTM_FR_Disp_Rq_ST3.RBTM_FR_Disp_Rq_ST3, ecu-extract-reference=COMPOSITIONTYPE.P_RBTM_FR_Disp_Rq_ST3.RBTM_FR_Disp_Rq_ST3, variation-point=post-build-variant-condition{matching-criterion=Side, value=1}
      P_RBTM_FR_Disp_Rq_ST3: upstream-reference=ECU_RBTM_FL_STAR_3_2020_ST3.P_RBTM_FR_Disp_Rq_ST3, ecu-extract-reference=COMPOSITIONTYPE.P_RBTM_FR_Disp_Rq_ST3
      RBTM_FR_Tgl_ST3: upstream-reference=ECU_RBTM_FL_STAR_3_2020_ST3.P_RBTM_FR_Tgl_ST3.RBTM_FR_Tgl_ST3, ecu-extract-reference=COMPOSITIONTYPE.P_RBTM_FR_Tgl_ST3.RBTM_FR_Tgl_ST3, variation-point=post-build-variant-condition{matching-criterion=Side, value=1}
      P_RBTM_FR_Tgl_ST3: upstream-reference=ECU_RBTM_FL_STAR_3_2020_ST3.P_RBTM_FR_Tgl_ST3, ecu-extract-reference=COMPOSITIONTYPE.P_RBTM_FR_Tgl_ST3
      RevBltTns_FR_ComCyc_Actv_ST3_001: upstream-reference=ECU_RBTM_FL_STAR_3_2020_ST3.P_RevBltTns_FR_ComCyc_Actv_ST3.RevBltTns_FR_ComCyc_Actv_ST3, ecu-extract-reference=COMPOSITIONTYPE.P_RevBltTns_FR_ComCyc_Actv_ST3.RevBltTns_FR_ComCyc_Actv_ST3, variation-point=post-build-variant-condition{matching-criterion=Side, value=1}
      P_RevBltTns_FR_ComCyc_Actv_ST3: upstream-reference=ECU_RBTM_FL_STAR_3_2020_ST3.P_RevBltTns_FR_ComCyc_Actv_ST3, ecu-extract-reference=COMPOSITIONTYPE.P_RevBltTns_FR_ComCyc_Actv_ST3
      RevBltTns_FR_SafeCyc_Actv_ST3_001: upstream-reference=ECU_RBTM_FL_STAR_3_2020_ST3.P_RevBltTns_FR_SafeCyc_Actv_ST3.RevBltTns_FR_SafeCyc_Actv_ST3, ecu-extract-reference=COMPOSITIONTYPE.P_RevBltTns_FR_SafeCyc_Actv_ST3.RevBltTns_FR_SafeCyc_Actv_ST3, variation-point=post-build-variant-condition{matching-criterion=Side, value=1}
      P_RevBltTns_FR_SafeCyc_Actv_ST3: upstream-reference=ECU_RBTM_FL_STAR_3_2020_ST3.P_RevBltTns_FR_SafeCyc_Actv_ST3, ecu-extract-reference=COMPOSITIONTYPE.P_RevBltTns_FR_SafeCyc_Actv_ST3
      WakeupRsn_RBTM_FR_ST3: upstream-reference=ECU_RBTM_FL_STAR_3_2020_ST3.P_WakeupRsn_RBTM_FR_ST3.WakeupRsn_RBTM_FR_ST3, ecu-extract-reference=COMPOSITIONTYPE.P_WakeupRsn_RBTM_FR_ST3.WakeupRsn_RBTM_FR_ST3, variation-point=post-build-variant-condition{matching-criterion=Side, value=1}
      P_WakeupRsn_RBTM_FR_ST3: upstream-reference=ECU_RBTM_FL_STAR_3_2020_ST3.P_WakeupRsn_RBTM_FR_ST3, ecu-extract-reference=COMPOSITIONTYPE.P_WakeupRsn_RBTM_FR_ST3
      Develop8_Rq_RBTM_FR_ST3_bcqj2sqez8u9spf5qxmu4a35u: upstream-reference=ECU_RBTM_FL_STAR_3_2020_ST3.R_Develop8_Rq_RBTM_FR_ST3.Develop8_Rq_RBTM_FR_ST3, ecu-extract-reference=COMPOSITIONTYPE.R_Develop8_Rq_RBTM_FR_ST3.Develop8_Rq_RBTM_FR_ST3, variation-point=post-build-variant-condition{matching-criterion=Side, value=1}
      R_Develop8_Rq_RBTM_FR_ST3: upstream-reference=ECU_RBTM_FL_STAR_3_2020_ST3.R_Develop8_Rq_RBTM_FR_ST3, ecu-extract-reference=COMPOSITIONTYPE.R_Develop8_Rq_RBTM_FR_ST3
      PS_Curve_FR_Rq_HU_ST3: upstream-reference=ECU_RBTM_FL_STAR_3_2020_ST3.R_PS_Curve_FR_Rq_HU_ST3.PS_Curve_FR_Rq_HU_ST3, ecu-extract-reference=COMPOSITIONTYPE.R_PS_Curve_FR_Rq_HU_ST3.PS_Curve_FR_Rq_HU_ST3, variation-point=post-build-variant-condition{matching-criterion=Side, value=1}
      R_PS_Curve_FR_Rq_HU_ST3: upstream-reference=ECU_RBTM_FL_STAR_3_2020_ST3.R_PS_Curve_FR_Rq_HU_ST3, ecu-extract-reference=COMPOSITIONTYPE.R_PS_Curve_FR_Rq_HU_ST3
      RevBltTns_FL_ComCyc_Actv_ST3_001: upstream-reference=ECU_RBTM_FL_STAR_3_2020_ST3.R_RevBltTns_FL_ComCyc_Actv_ST3.RevBltTns_FL_ComCyc_Actv_ST3, ecu-extract-reference=COMPOSITIONTYPE.R_RevBltTns_FL_ComCyc_Actv_ST3.RevBltTns_FL_ComCyc_Actv_ST3, variation-point=post-build-variant-condition{matching-criterion=Side, value=1}
      R_RevBltTns_FL_ComCyc_Actv_ST3: upstream-reference=ECU_RBTM_FL_STAR_3_2020_ST3.R_RevBltTns_FL_ComCyc_Actv_ST3, ecu-extract-reference=COMPOSITIONTYPE.R_RevBltTns_FL_ComCyc_Actv_ST3
      RevBltTns_FL_SafeCyc_Actv_ST3_001: upstream-reference=ECU_RBTM_FL_STAR_3_2020_ST3.R_RevBltTns_FL_SafeCyc_Actv_ST3.RevBltTns_FL_SafeCyc_Actv_ST3, ecu-extract-reference=COMPOSITIONTYPE.R_RevBltTns_FL_SafeCyc_Actv_ST3.RevBltTns_FL_SafeCyc_Actv_ST3, variation-point=post-build-variant-condition{matching-criterion=Side, value=1}
      R_RevBltTns_FL_SafeCyc_Actv_ST3: upstream-reference=ECU_RBTM_FL_STAR_3_2020_ST3.R_RevBltTns_FL_SafeCyc_Actv_ST3, ecu-extract-reference=COMPOSITIONTYPE.R_RevBltTns_FL_SafeCyc_Actv_ST3
      RBTMFL_Actv_Lvl_ST35: upstream-reference=ECU_RBTM_FL_STAR_3_2020_ST3.P_RBTMFL_Actv_Lvl_ST35.RBTMFL_Actv_Lvl_ST35, ecu-extract-reference=COMPOSITIONTYPE.P_RBTMFL_Actv_Lvl_ST35.RBTMFL_Actv_Lvl_ST35, variation-point=post-build-variant-condition{matching-criterion=Side, value=0}
      P_RBTMFL_Actv_Lvl_ST35: upstream-reference=ECU_RBTM_FL_STAR_3_2020_ST3.P_RBTMFL_Actv_Lvl_ST35, ecu-extract-reference=COMPOSITIONTYPE.P_RBTMFL_Actv_Lvl_ST35
      RBTMFL_SP_ActvClient_ST35: upstream-reference=ECU_RBTM_FL_STAR_3_2020_ST3.P_RBTMFL_SP_ActvClient_ST35.RBTMFL_SP_ActvClient_ST35, ecu-extract-reference=COMPOSITIONTYPE.P_RBTMFL_SP_ActvClient_ST35.RBTMFL_SP_ActvClient_ST35, variation-point=post-build-variant-condition{matching-criterion=Side, value=0}
      P_RBTMFL_SP_ActvClient_ST35: upstream-reference=ECU_RBTM_FL_STAR_3_2020_ST3.P_RBTMFL_SP_ActvClient_ST35, ecu-extract-reference=COMPOSITIONTYPE.P_RBTMFL_SP_ActvClient_ST35
      RBTMFL_SP_FctPrecond_Stat_ST35: upstream-reference=ECU_RBTM_FL_STAR_3_2020_ST3.P_RBTMFL_SP_FctPrecond_Stat_ST35.RBTMFL_SP_FctPrecond_Stat_ST35, ecu-extract-reference=COMPOSITIONTYPE.P_RBTMFL_SP_FctPrecond_Stat_ST35.RBTMFL_SP_FctPrecond_Stat_ST35, variation-point=post-build-variant-condition{matching-criterion=Side, value=0}
      P_RBTMFL_SP_FctPrecond_Stat_ST35: upstream-reference=ECU_RBTM_FL_STAR_3_2020_ST3.P_RBTMFL_SP_FctPrecond_Stat_ST35, ecu-extract-reference=COMPOSITIONTYPE.P_RBTMFL_SP_FctPrecond_Stat_ST35
      SBeltTens_SP_Lvl_Pr5_ST3_4tqpkri37441o5ht9g9ekmyzh: upstream-reference=ECU_RBTM_FL_STAR_3_2020_ST3.R_SBeltTens_SP_Lvl_Pr5_ST3.SBeltTens_SP_Lvl_Pr5_ST3, ecu-extract-reference=COMPOSITIONTYPE.R_SBeltTens_SP_Lvl_Pr5_ST3.SBeltTens_SP_Lvl_Pr5_ST3
      R_SBeltTens_SP_Lvl_Pr5_ST3: upstream-reference=ECU_RBTM_FL_STAR_3_2020_ST3.R_SBeltTens_SP_Lvl_Pr5_ST3, ecu-extract-reference=COMPOSITIONTYPE.R_SBeltTens_SP_Lvl_Pr5_ST3
      RBTMFR_Actv_Lvl_ST35: upstream-reference=ECU_RBTM_FL_STAR_3_2020_ST3.P_RBTMFR_Actv_Lvl_ST35.RBTMFR_Actv_Lvl_ST35, ecu-extract-reference=COMPOSITIONTYPE.P_RBTMFR_Actv_Lvl_ST35.RBTMFR_Actv_Lvl_ST35, variation-point=post-build-variant-condition{matching-criterion=Side, value=1}
      P_RBTMFR_Actv_Lvl_ST35: upstream-reference=ECU_RBTM_FL_STAR_3_2020_ST3.P_RBTMFR_Actv_Lvl_ST35, ecu-extract-reference=COMPOSITIONTYPE.P_RBTMFR_Actv_Lvl_ST35
      RBTMFR_SP_ActvClient_ST35: upstream-reference=ECU_RBTM_FL_STAR_3_2020_ST3.P_RBTMFR_SP_ActvClient_ST35.RBTMFR_SP_ActvClient_ST35, ecu-extract-reference=COMPOSITIONTYPE.P_RBTMFR_SP_ActvClient_ST35.RBTMFR_SP_ActvClient_ST35, variation-point=post-build-variant-condition{matching-criterion=Side, value=1}
      P_RBTMFR_SP_ActvClient_ST35: upstream-reference=ECU_RBTM_FL_STAR_3_2020_ST3.P_RBTMFR_SP_ActvClient_ST35, ecu-extract-reference=COMPOSITIONTYPE.P_RBTMFR_SP_ActvClient_ST35
      RBTMFR_SP_FctPrecond_Stat_ST35: upstream-reference=ECU_RBTM_FL_STAR_3_2020_ST3.P_RBTMFR_SP_FctPrecond_Stat_ST35.RBTMFR_SP_FctPrecond_Stat_ST35, ecu-extract-reference=COMPOSITIONTYPE.P_RBTMFR_SP_FctPrecond_Stat_ST35.RBTMFR_SP_FctPrecond_Stat_ST35, variation-point=post-build-variant-condition{matching-criterion=Side, value=1}
      P_RBTMFR_SP_FctPrecond_Stat_ST35: upstream-reference=ECU_RBTM_FL_STAR_3_2020_ST3.P_RBTMFR_SP_FctPrecond_Stat_ST35, ecu-extract-reference=COMPOSITIONTYPE.P_RBTMFR_SP_FctPrecond_Stat_ST35
