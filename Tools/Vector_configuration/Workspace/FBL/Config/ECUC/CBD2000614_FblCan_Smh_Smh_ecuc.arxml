AUTOSAR XML (schema 4-3-0)
package /ActiveEcuC
  module config Smh: implementation-config-variant=VARIANT-LINK-TIME, module-description=Smh_Impl
    SmhVerification
      SmhMonolithicVerification:
        SmhCRCTotal = false
        SmhExportVerificationWrapper = false
        SmhOperationCountOfWrapper = 4
        SmhCheckAddressRangeOverflow = false
        SmhAssertReadCount = false
        SmhCRCWritten = false
        SmhMemoryAccessMode = ADDRESS
        SmhReadBufferSize = 64
        SmhCRCWrittenGet = false
        SmhDefaultMonolithicVerificationConfig = SmhSecurityClassCCC/SmhSecurityClassCCCConfig
        SmhSecurityClassCCC: SmhDefaultSecurityClassCCCConfig=SmhSecurityClassCCC/SmhSecurityClassCCCConfig
          SmhSecurityClassCCCConfig:
            SmhFunctionName = SecM_VerificationClassCCC_Ed25519Sha512
            SmhIncludeAddressAndLengthInSignature = true
            SmhCRCOffset = 0
            SmhSignatureOffset = 0
            SmhStreamVerificationConfig = SmhSecurityClassCCC/SmhSecurityClassCCCConfig
        SmhSecurityClassDDD: SmhDefaultSecurityClassDDDConfig=SmhSecurityClassDDD/SmhSecurityClassDDDConfig
          SmhSecurityClassDDDConfig:
            SmhFunctionName = SecM_VerificationClassDDD_Crc32
            SmhIncludeAddressAndLengthInSignature = false
            SmhSignatureOffset = 0
            SmhCRCOffset = 0
            SmhStreamVerificationConfig = SmhSecurityClassDDD/SmhSecurityClassDDDConfig
      SmhStreamVerification: SmhDefaultStreamVerificationConfig=SmhSecurityClassCCC/SmhSecurityClassCCCConfig
        SmhSecurityClassCCC: SmhDefaultSecurityClassCCCConfig=SmhSecurityClassCCC/SmhSecurityClassCCCConfig
          SmhSecurityClassCCCConfig:
            SmhFunctionName = SmhSecurityClassCCC_Ed25519Sha512
            SmhUpdateLengthOfHashedData = false
            SmhContextBufferSize = 0
            SmhJobRef = SmhJob_SignatureVerify_Ed25519Sha512/SmhJob_SignatureVerify_Ed25519Sha512
            SmhDiscretHashConfig: SmhJobRef=SmhJob_Sha512/SmhJob_Sha512
        SmhSecurityClassDDD: SmhDefaultSecurityClassDDDConfig=SmhSecurityClassDDD/SmhSecurityClassDDDConfig
          SmhSecurityClassDDDConfig: SmhFunctionName=SecM_VerifyCrc32, SmhUpdateLengthOfHashedData=false, SmhComputationOnly=true
            SmhSecurityClassDDDType
              SmhCrc: SmhCrcRef=SmhCrc32
    SmhCrc: SmhCRCType=CRC_32
      SmhCrc32: SmhComplementValue=4294967295, SmhInitialValue=4294967295, SmhMode=REFLECTED, SmhOptimization=SPEED, SmhPolynomial=3988292384
    SmhGeneral:
      SmhOperationMode = PRODUCTION
      SmhWatchdogCycleCount = 1
      SmhCryptographicKeysLocatedInRAM = false
      SmhProvidevSecPrimRandomFunction = false
      SmhSaveRestoreContext = false
      SmhCustomPrimitiveIds:
        SmhCustomFamilyIdMd5 = 191
        SmhCustomFamilyIdEccAnsi = 129
        SmhCustomFamilyIdEccSec = 130
        SmhCustomModeP224R1 = 148
        SmhCustomModeP256R1 = 128
        SmhCustomModeP384R1 = 131
    SmhCryptographicKeys: SmhElementIdRSAPublicExponent=161, SmhElementIdRSAModulus=160, SmhElementIdRSAPrivateExponent=162
      SmhKeyValue_Verification (SmhKeyValue): SmhValue=, SmhDescription=Verification key reference, SmhSuffix=, SmhCryptoKeyElementRef=Crypto_30_vHsm_LibCv_Fbl_Signature_Ed25519_Key
      SmhKeyValue_SecurityAccess (SmhKeyValue):
        SmhValue = 
        SmhDescription = Public key value for security access
        SmhSuffix = 
        SmhCryptoKeyElementRef = Crypto_30_vHsm_LibCv_Fbl_SecurityAccess_Ed25519_Key
      AesKey (SmhKey): SmhDescription=AES key used for decrpytion of download data, SmhKeyValueRef=AesKeyValue, SmhKeyValueRef=AesIvValue
      AesKeyValue (SmhKeyValue): SmhValue=, SmhSuffix=, SmhDescription=, SmhCryptoKeyElementRef=Crypto_30_vHsm_LibCv_Fbl_Decrypt_Aes128_Key
      AesIvValue (SmhKeyValue): SmhValue=, SmhSuffix=iv, SmhDescription=, SmhCryptoKeyElementRef=Crypto_30_vHsm_LibCv_Fbl_Decrypt_Aes128_Iv
      SmhKey_SecurityAccess (SmhKey): SmhDescription=Public Key for Security Access, SmhKeyValueRef=SmhKeyValue_SecurityAccess
      SmhKey_Verification (SmhKey): SmhDescription=Verification Key Reference, SmhKeyValueRef=SmhKeyValue_Verification
      SmhKeyOperations: SmhCopyKeyElementApi=false, SmhAccessKeyElementApis=false, SmhCopyKeyApi=false
    5 x SmhJob:
      SmhJob_AesDecryption
        SmhJob_AesDecryption (SmhDecryption): SmhCsmJobRef=CsmJob_DecryptionAes128PkcsCbc, SmhCryptographicKeyRef=AesKey
      SmhJob_RandomGenerate
        SmhJob_RandomGenerate (SmhRandomGenerate): SmhCsmJobRef=CsmJob_RandomGenerate
      SmhJob_RandomSeed
        SmhJob_RandomSeed (SmhRandomSeed): SmhCsmKeyRef=CsmKey_Fbl_Rng_Fips186
      SmhJob_Sha512
        SmhJob_Sha512 (SmhHash): SmhCsmJobRef=CsmJob_Sha512
      SmhJob_SignatureVerify_Ed25519Sha512
        SmhJob_SignatureVerify_Ed25519Sha512 (SmhSignatureVerify): SmhCryptographicKeyRef=SmhKey_Verification, SmhCsmJobRef=CsmJob_SigAsymVer_Ed25519Sha512
    SmhEncryption: SmhDecryptionDefaultConfig=SmhDecryptionConfig
      SmhDecryptionConfig: SmhFunctionName=DecryptAes128, SmhJobRef=SmhJob_AesDecryption/SmhJob_AesDecryption
    SmhSeedKey: SmhKeyTimeout=0, SmhCallCycle=0
      SmhSeedConfig: SmhSeedLength=32, SmhSeedType=BYTE_ARRAY
        SmhEntropy: SmhEntropyUsage=EXPLICIT, SmhEntropySize=20, SmhJobRef=SmhJob_RandomSeed/SmhJob_RandomSeed
        SmhSeedGeneration
          SmhCsm: SmhJobRef=SmhJob_RandomGenerate/SmhJob_RandomGenerate
      SmhKeyConfig: SmhKeyLength=64, SmhKeyType=BYTE_ARRAY, SmhExtendedApi=true, SmhExternalComparison=true, SmhKeyConstant=0, SmhSecretKeyLength=0, SmhAsymmetric=false
        SmhKeyJob_VerifyKey (SmhKeyJobs): SmhFunctionName=SmhKeyJob_VerifyKey, SmhJobRef=Smh/SmhJob_SecurityAccessVerify_Ed25519Sha512
    SmhJob_SecurityAccessVerify_Ed25519Sha512 (SmhJob)
      SmhJob_SecurityAccessVerify_Ed25519Sha512 (SmhSignatureVerify): SmhCsmJobRef=CsmJob_SecurityAccess_Ed25519Sha512, SmhCryptographicKeyRef=SmhKey_SecurityAccess
