AUTOSAR XML (schema 4-3-0)
package /ActiveEcuC
  module config Os: implementation-config-variant=VARIANT-PRE-COMPILE
    OsAppMode
    OsOS: OsStackMonitoring=false, OsStatus=STANDARD, OsUseGetServiceId=false, OsUseParameterAccess=false, OsUseResScheduler=true
      OsHooks: OsErrorHook=false, OsPostTaskHook=false, OsPreTaskHook=false, OsShutdownHook=false, OsStartupHook=false, OsProtectionHook=false
    SystemTimer (OsCounter): OsCounterMaxAllowedValue=1, OsCounterMinCycle=1, OsCounterTicksPerBase=1, OsCounterType=HARDWARE, OsSecondsPerTick=0.001
