AUTOSAR XML (schema 4-3-0)
package /Fls
  module config Fls: implementation-config-variant=VARIANT-POST-BUILD, module-description=Fls_Impl
    CommonPublishedInformation:
      ArMajorVersion = 4
      ArMinorVersion = 4
      ArPatchVersion = 0
      ModuleId = 92
      Release = _TRICORE_TC332
      SwMajorVersion = 20
      SwMinorVersion = 0
      SwPatchVersion = 1
      VendorApiInfix = Dmu
      VendorId = 17
    FlsConfigSet:
      FlsAcErase = 1880101320
      FlsAcWrite = 1880101120
      FlsCallCycle = 0.01
      FlsDefaultMode = MEMIF_MODE_FAST
      FlsMaxReadFastMode = 512
      FlsMaxReadNormalMode = 256
      FlsMaxWriteFastMode = 32
      FlsMaxWriteNormalMode = 32
      FlsProtection = 0
      FlsWaitStateErrorCorrection = FLS_17_DMU_WAITSTATE_ERRCOREC_1
      FlsWaitStateRead = FLS_17_DMU_WAITSTATE_READ_9
      FlsEraseVerifyErrNotif = Fee_17_JobEraseErrorNotification
      FlsJobEndNotification = Fee_JobEndNotification
      FlsJobErrorNotification = Fee_JobErrorNotification
      FlsSectorList_0 (FlsSectorList)
        FlsSector_0 (FlsSector): FlsNumberOfSectors=2, FlsPageSize=8, FlsSectorSize=49152, FlsSectorStartaddress=0
    FlsGeneral:
      FlsAcLoadOnJobStart = false
      FlsBaseAddress = 2936012800
      FlsBlankCheckApi = false
      FlsCancelApi = true
      FlsCompareApi = true
      FlsDevErrorDetect = false
      FlsDriverIndex = 0
      FlsEccErrorInfoApi = false
      FlsEraseVerificationEnabled = false
      FlsGetJobResultApi = true
      FlsGetStatusApi = true
      FlsIfxFeeUse = true
      FlsInitApiMode = FLS_17_DMU_MCAL_SUPERVISOR
      FlsInitCheckApi = false
      FlsRunTimeErrorDetect = false
      FlsRuntimeApiMode = FLS_17_DMU_MCAL_SUPERVISOR
      FlsSafetyEnable = false
      FlsSetModeApi = true
      FlsTimeoutSupervisionEnabled = false
      FlsTotalSize = 98304
      FlsUseInterrupts = false
      FlsVersionInfoApi = false
      FlsWriteVerificationEnabled = false
    FlsIfxSpecificConfig: FlsEraseSuspendTimeout=12000, FlsIllegalStateNotification=Fee_17_IllegalStateNotification, FlsStateVarStruct=FlsStateVar, FlsUseEraseSuspend=false
    FlsPublishedInformation:
      FlsAcLocationErase = 0
      FlsAcLocationWrite = 0
      FlsAcSizeErase = 0
      FlsAcSizeWrite = 0
      FlsEraseTime = 1897500
      FlsErasedValue = 0
      FlsExpectedHwId = 0
      FlsSpecifiedEraseCycles = 125000
      FlsWriteTime = 5154
