AUTOSAR XML (schema 4-3-0)
package /ActiveEcuC
  module config vMemAccM: implementation-config-variant=VARIANT-PRE-COMPILE, module-description=vMemAccM_Impl
    AddressArea_B (vMemAccMAddressAreaConfiguration): vMemAccMAddressAreaId=1, vMemAccMAddressAreaPriority=2, vMemAccMReadRequestLength=64
      3 x vMemAccMSubAddressAreaConfiguration, all with vMemAccMvMemFuncPtrTableSymbol=vMem_30_Fbl_FunctionPointerTable, vMemAccMUseEraseBurst=false, vMemAccMUseWriteBurst=false:
        vMemAccMSubAddressAreaConfiguration_B_APPL: vMemAccMNumberOfSectors=28, vMemAccMVirtualStartAddress=2691055616, vMemAccMPhysicalStartAddress=2691055616, vMemAccMSectorRef=PF2_S2_Appl
        vMemAccMSubAddressAreaConfiguration_B_HSM_BM: vMemAccMNumberOfSectors=16, vMemAccMVirtualStartAddress=2684354560, vMemAccMPhysicalStartAddress=2690646016, vMemAccMSectorRef=PF2__S0_HSM_BM
        vMemAccMSubAddressAreaConfiguration_B_FBL: vMemAccMNumberOfSectors=9, vMemAccMVirtualStartAddress=2684616704, vMemAccMPhysicalStartAddress=2690908160, vMemAccMSectorRef=PF2_S1_FBL
    AddressArea_A (vMemAccMAddressAreaConfiguration): vMemAccMAddressAreaId=0, vMemAccMAddressAreaPriority=1, vMemAccMReadRequestLength=64
      3 x vMemAccMSubAddressAreaConfiguration, all with vMemAccMvMemFuncPtrTableSymbol=vMem_30_Fbl_FunctionPointerTable, vMemAccMUseEraseBurst=false, vMemAccMUseWriteBurst=false:
        vMemAccMSubAddressAreaConfiguration_A_HSM_BM: vMemAccMNumberOfSectors=17, vMemAccMVirtualStartAddress=2684354560, vMemAccMPhysicalStartAddress=2684354560, vMemAccMSectorRef=PF0_S0_HSM_BM
        vMemAccMSubAddressAreaConfiguration_A_FBL: vMemAccMNumberOfSectors=9, vMemAccMVirtualStartAddress=2684649472, vMemAccMPhysicalStartAddress=2684649472, vMemAccMSectorRef=PF0_S1_FBL
        vMemAccMSubAddressAreaConfiguration_A_APPL: vMemAccMNumberOfSectors=37, vMemAccMVirtualStartAddress=2684796928, vMemAccMPhysicalStartAddress=2684796928, vMemAccMSectorRef=PF0_S2_Appl
    vMemAccMGeneral:
      vMemAccMVersionInfoApi = false
      vMemAccMMainFunctionPeriod = 0.005
      vMemAccMMainFunctionTriggering = FixedCycleTime
      vMemAccMSafeBswChecks = false
      vMemAccMDevErrorDetect = true
      vMemAccMCompareApi = false
