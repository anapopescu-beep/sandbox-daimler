AUTOSAR XML (schema 4-3-0)
package /ActiveEcuC
  module config Fbl: implementation-config-variant=VARIANT-LINK-TIME, module-description=Fbl_Impl
    FblGeneral:
      FblCommonData = true
      FblDataProcessingBufferSize = 256
      FblDiagnosticBufferSize = 4097
      FblGapFilling = true
      FblInternalMemoryCopy = true
      FblMaximumNumberOfSegments = 10
      FblP2Server = 20
      FblP2StarServer = 2000
      FblProcessedVerification = false
      FblProjectState = INTEGRATION
      FblVerificationSegmentation = 256
      FblWriteSegmentation = 256
      FblWatchdogService = true
      FblUnalignedDataTransfer = true
      FblResponseAfterReset = false
      FblPipelinedVerification = true
      FblOutputVerification = false
      FblPipelinedProgramming = true
      FblApplicationStateTask = false
      FblMaximumAmountOfLogicalBlocks = 3
      FblApplicationTimerTask = true
      FblAdaptiveDataTransferRcrrp = false
      FblGatewaySupport = false
      FblSleepTime = 300000
      FblStayInBoot = false
      FblSuspendDriverOperation = false
      FblVerificationFunction = false
      FblSleepMode = true
      FblUserRoutine = false
      FblS3ServerExtendedSession = 5000
      FblS3ServerProgrammingSession = 5000
      FblFlashDriverUsage = USE_FLASH_DRIVER_FROM_ROM
      FblReprogrammableLbt = false
      FblHeaderAddress = 2684650272
      FblFillCode = 170
      FblPresencePattern = true
      FblStartFunction = true
      FblUserSubfunction = false
      FblUserService = false
      FblWatchdogTriggerCycle = 1
      FblEncryptionMode = true
      FblCompressionMode = true
      FblInputVerification = true
      FblBlockStartAddress = 2684649472
      FblBlockLength = 147456
      FblUserConfigFile = $(DpaProjectFolder)\config\user_config.cfg
      FblHardwareSwap = false
      FblOta = false
      FblOneStepUpdater = false
      FblXcpSupport = false
    FblLogicalBlockTable
      Application (FblLogicalBlock):
        FblLbInputVerification = SecM_VerifySignature
        FblLbProcessedVerification = SecM_VerifySignature
        FblLbPipelinedVerification = SecM_VerifyClassDDD
        FblLbOutputVerification = SecM_VerificationClassDDD
        FblLbDisposability = MANDATORY
        FblLbStartAddress = 2684796928
        FblLbEndAddress = 2685403135
        FblLbMaxReprogAttempts = 0
        FblLbDescription = Demo Application
        FblLbBmHeaderAddress = 2684797152
        FblLbBlockIndex = 1
        FblLbBlockType = CODE
      Bootloader (FblLogicalBlock):
        FblLbInputVerification = SecM_VerifySignature
        FblLbProcessedVerification = SecM_VerifySignature
        FblLbPipelinedVerification = SecM_VerifyClassDDD
        FblLbOutputVerification = SecM_VerificationClassDDD
        FblLbBlockIndex = 0
        FblLbDisposability = OPTIONAL
        FblLbStartAddress = 2684649472
        FblLbEndAddress = 2684796927
        FblLbMaxReprogAttempts = 0
        FblLbDescription = 
        FblLbBmHeaderAddress = 2684650272
        FblLbBlockType = BOOT
    FblFlashBlockTable
      5 x FblFlashBlock:
        FblFlashBlock_0: FblFbStartAddress=2684354560, FblFbEndAddress=2684387327, FblFbDescription=PF0 PS0: 32KB Block (HSM), FblFbMemoryDeviceRef=Protected
        FblFlashBlock_1: FblFbStartAddress=2684387328, FblFbEndAddress=2684567551, FblFbDescription=PF0 PS0: 32KB Block (HSM), FblFbMemoryDeviceRef=Protected
        FblFlashBlock_9: FblFbStartAddress=2684649472, FblFbEndAddress=2684796927, FblFbDescription=PF0 PS0: 148KB Block (FBL), FblFbMemoryDeviceRef=Flash, FblFbLogicalBlockRef=Bootloader
        FblFlashBlock_10: FblFbStartAddress=2684796928, FblFbEndAddress=2685403135, FblFbDescription=PF0 PS1: 622KB Block (APPL), FblFbMemoryDeviceRef=Flash, FblFbLogicalBlockRef=Application
        FblFlashBlock_8: FblFbStartAddress=2684567552, FblFbEndAddress=2684649471, FblFbDescription=PF0 PS0: 64KB Block (BM), FblFbMemoryDeviceRef=Flash
    FblMemoryDeviceTable
      Flash (FblMemoryDevice):
        FblMdSegmentSize = 32
        FblMdErasedValue = 0
        FblMdIndex = 0
        FblMdInitHook = false
        FblMdDeinitHook = false
        FblMdReadHook = true
        FblMdEraseHook = true
        FblMdWriteHook = true
        FblMdVerifyHook = true
      Protected (FblMemoryDevice):
        FblMdErasedValue = 0
        FblMdSegmentSize = 1
        FblMdIndex = 1
        FblMdInitHook = false
        FblMdDeinitHook = false
        FblMdReadHook = false
        FblMdEraseHook = false
        FblMdWriteHook = false
        FblMdVerifyHook = false
    FblDaimler:
      FblEvaluateMemoryStatusInformation = true
      FblResumableProgramming = false
      FblMinimumResumeSectionGranularity = MRSG_256
      FblFlashDownloadSpecification = DDS_R01_01_2020_01
