AUTOSAR XML (schema 4-3-0)
package /ActiveEcuC
  module config Can: implementation-config-variant=VARIANT-POST-BUILD-SELECTABLE, module-description=Can_Impl
    CanGeneral:
      CanIndex = 0
      CanVersionInfoApi = false
      CanUseNestedCANInterrupts = false
      CanChangeBaudrateApi = false
      CanDevErrorDetection = true
      CanHardwareCancellation = false
      CanIdenticalIdCancellation = false
      CanMainFunctionBusoffPeriod = 0.005
      CanMainFunctionModePeriod = 0.005
      CanMainFunctionWakeupPeriod = 0.005
      CanMultiplexedTransmission = false
      CanSetBaudrateApi = false
      CanTimeoutDuration = 0.01
      CanGenericPrecopy = false
      CanHardwareLoopCheck = true
      CanSecureTempBuffer = false
      CanRxFullCANSupport = false
      CanTxFullCANSupport = false
      CanRxBasicCANSupport = true
      CanHardwareCancelByAppl = true
      CanIndividualProcessing = false
      CanGenericConfirmation = false
      CanGenericConfirmationAPI2 = false
      CanRxQueue = false
      CanSupportMixedID = false
      CanRxQueueSize = 10
      CanMultipleBasicCANObjects = false
      CanMultipleBasicCANTxObjects = false
      CanHardwareHandleType = UINT8
      CanOptimizeOneController = false
      CanInterruptCategory = VOIDFUNCVOID
      CanGetStatus = false
      CanInterruptLock = DRIVER
      CanWakeupSupport = false
      CanRamCheck = None
      CanOverrunNotification = DET
      CanReinitStart = false
      CanGenericPreTransmit = false
      CanFdSupport = NONE
      CanRuntimeMeasurementSupport = false
      CanMaxRxDataLen = 8
      CanMaxTxDataLen = 8
      CanUsePeripheralAccessApi = false
      CanMirrorModeSupport = false
      CanUseOsInterruptControl = false
      CanSafeBswChecks = false
      CanSilentModeSupport = false
      CanHwTxFifoSupport = false
      CanMcanRevision = M_CAN_REV_315
      CanCheckWakeupCanRetType = false
      CanFdHardwareBufferOptimization = true
      CanEccInit = true
      CanUseVirtualAddressing = false
      CanEnableSecurityEventReporting = false
      CanFdNISO = ISO_11898
      CanCounterRef = SystemTimer
      CanMainFunctionRWPeriods: CanMainFunctionReadPeriod=0.005, CanMainFunctionWritePeriod=0.005
    CanConfigSet
      RBTM_FL_BODY3_180ddaa4 (CanController):  # BODY3
        CanControllerActivation = true
        CanBusoffProcessing = POLLING
        CanRxProcessing = POLLING
        CanTxProcessing = POLLING
        CanWakeupProcessing = POLLING
        CanControllerBaseAddress = 4028663040
        CanControllerId = 0
        CanWakeupSupport = false
        CanWakeupSourceId = 0
        CanBasisAddressEnum = M_CAN1
        CanTxBufferElementSize = ES_8
        CanRxBufferElementSize = ES_8
        CanRxFifo0ElementSize = ES_8
        CanRxFifo1ElementSize = ES_8
        CanMaxNrOfRxFifo0Elements = 64
        CanMaxNrOfRxFifo1Elements = 64
        CanMaxNrOfRxBuffers = 64
        CanMaxNrOfTxBuffers = 32
        CanIsTTCAN = false
        CanTxEfBufferElementSize = ES_8
        CanIOPort = b_000
        CanInterruptPriority = 48
        CanControllerDefaultBaudrate = RBTM_FL_BODY3_180ddaa4/CanControllerBaudrateConfig
        CanControllerSystemRef = RBTM_FL_BODY3
        CanCpuClockRef = McuClockReferencePoint_MCAN
        variation-point = post-build-variant-condition{matching-criterion=Side, value=0}
        CanControllerBaudrateConfig:
          CanControllerBaudRate = 250
          CanControllerBaudRateConfigID = 0
          CanControllerPropSeg = 11
          CanControllerSeg1 = 4
          CanControllerSeg2 = 4
          CanControllerSyncJumpWidth = 4
          CanBaudrateClock = 80000
          CanBaudratePrescaler = 16
        CanFilterMask: CanFilterMaskValue=4294967038, CanFilterCodeValue=418314376, IsLocked=false
        CanFilterMask_001 (CanFilterMask): CanFilterMaskValue=4294006522, CanFilterCodeValue=417399944, IsLocked=false
      3 x CanHardwareObject, all with CanHandleType=BASIC, CanIdType=EXTENDED, CanIdValue=0, CanHwProcessing=true, CanObjectHwHandle=0, CanMaxDataLen=8, CanFdPaddingValue=0, CanObjectMultiplexedTransmission=false, CanObjectHwFifo=false:
        RBTM_FL_BODY3_8uqv9blm85ehm0msat385m76v_e046a621_Rx: CanObjectType=RECEIVE, CanObjectId=1, CanObjectHwSize=6, CanControllerRef=RBTM_FL_BODY3_180ddaa4, CanFilterMaskRef=RBTM_FL_BODY3_180ddaa4/CanFilterMask, CanFilterMaskRef=RBTM_FL_BODY3_180ddaa4/CanFilterMask_001, variation-point=post-build-variant-condition{matching-criterion=Side, value=0}
        RBTM_FL_BODY3_8uqv9blm85ehm0msat385m76v_03d5f5f6_Tx: CanObjectType=TRANSMIT, CanObjectId=0, CanObjectHwSize=1, CanControllerRef=RBTM_FL_BODY3_180ddaa4, variation-point=post-build-variant-condition{matching-criterion=Side, value=0}
        RBTM_FR_BODY3_4xwwtd59665s787n6ctawh7k8_5b8d9de8_Rx: CanObjectType=RECEIVE, CanObjectId=1, CanObjectHwSize=6, CanControllerRef=RBTM_FR_BODY3_2fec3d37, CanFilterMaskRef=RBTM_FR_BODY3_2fec3d37/CanFilterMask, CanFilterMaskRef=RBTM_FR_BODY3_2fec3d37/CanFilterMask_001, variation-point=post-build-variant-condition{matching-criterion=Side, value=1}
      RBTM_FR_BODY3_2fec3d37 (CanController):  # BODY3
        CanControllerActivation = true
        CanBusoffProcessing = POLLING
        CanRxProcessing = POLLING
        CanTxProcessing = POLLING
        CanWakeupProcessing = POLLING
        CanControllerBaseAddress = 4028663040
        CanControllerId = 0
        CanWakeupSupport = false
        CanWakeupSourceId = 0
        CanBasisAddressEnum = M_CAN1
        CanTxBufferElementSize = ES_8
        CanRxBufferElementSize = ES_8
        CanRxFifo0ElementSize = ES_8
        CanRxFifo1ElementSize = ES_8
        CanMaxNrOfRxFifo0Elements = 64
        CanMaxNrOfRxFifo1Elements = 64
        CanMaxNrOfRxBuffers = 64
        CanMaxNrOfTxBuffers = 32
        CanIsTTCAN = false
        CanIOPort = b_000
        CanTxEfBufferElementSize = ES_8
        CanInterruptPriority = 48
        CanControllerDefaultBaudrate = RBTM_FR_BODY3_2fec3d37/CanControllerBaudrateConfig
        CanControllerSystemRef = RBTM_FR_BODY3
        CanCpuClockRef = McuClockReferencePoint_MCAN
        variation-point = post-build-variant-condition{matching-criterion=Side, value=1}
        CanControllerBaudrateConfig:
          CanControllerBaudRate = 250
          CanControllerBaudRateConfigID = 0
          CanControllerPropSeg = 11
          CanControllerSeg1 = 4
          CanControllerSeg2 = 4
          CanControllerSyncJumpWidth = 4
          CanBaudrateClock = 80000
          CanBaudratePrescaler = 16
        CanFilterMask: CanFilterMaskValue=4294967038, CanFilterCodeValue=418314376, IsLocked=false
        CanFilterMask_001 (CanFilterMask): CanFilterMaskValue=4294006522, CanFilterCodeValue=417399944, IsLocked=false
      RBTM_FR_BODY3_4xwwtd59665s787n6ctawh7k8_23a94727_Tx (CanHardwareObject):
        CanHandleType = BASIC
        CanIdValue = 0
        CanObjectType = TRANSMIT
        CanIdType = EXTENDED
        CanObjectId = 0
        CanHwProcessing = true
        CanObjectHwSize = 1
        CanObjectHwHandle = 0
        CanMaxDataLen = 8
        CanFdPaddingValue = 0
        CanObjectMultiplexedTransmission = false
        CanObjectHwFifo = false
        CanControllerRef = RBTM_FR_BODY3_2fec3d37
        variation-point = post-build-variant-condition{matching-criterion=Side, value=1}
