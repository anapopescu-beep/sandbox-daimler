AUTOSAR XML (schema 4-3-0)
package /ActiveEcuC
  module config CryIf: implementation-config-variant=VARIANT-PRE-COMPILE, module-description=CryIf_Impl
    CryIfGeneral:
      CryIfVersionInfoApi = false
      CryIfDevErrorDetect = true
      CryIfMaxNumberOfKeyElements = 10
      CryIfMaxSizeOfKeyElement = 32
      CryIfRedirection = false
      CryIfSafeBswChecks = false
    CryIfChannel_CryptoCv_Fbl_Aes (CryIfChannel): CryIfChannelId=1, CryIfDriverObjectRef=Crypto_30_LibCv_Aes
    CryIfChannel_CryptoCv_Fbl_Signature (CryIfChannel): CryIfChannelId=3, CryIfDriverObjectRef=Crypto_30_LibCv
    CryIfCryptoModule: CryIfSupportsKeyElementCopyPartial=true, CryIfCancelJobApiUsesJobType=true, CryIfCryptoModuleRef=Crypto
    4 x CryIfKey:
      CryIfKey_Fbl_Decrypt_Aes128: CryIfKeyId=16, CryIfKeyRef=CryptoKey_Fbl_Decrypt_Aes128
      CryIfKey_Fbl_HashDummy: CryIfKeyId=17, CryIfKeyRef=CryptoKey_Fbl_HashDummy
      CryIfKey_Fbl_Signature_Ed25519: CryIfKeyId=19, CryIfKeyRef=CryptoKey_Fbl_Signature_Ed25519
      CryIfKey_Fbl_Rng_Fips186: CryIfKeyId=18, CryIfKeyRef=CryptoKey_Fbl_Fips186
    CryIfChannel_CryptoCv_Fbl_Rng (CryIfChannel): CryIfChannelId=2, CryIfDriverObjectRef=Crypto_30_LibCv_Rng
    CryIfChannel_vHsm_Core (CryIfChannel): CryIfChannelId=4, CryIfDriverObjectRef=Crypto_30_vHsm_Core
    CryIfCryptoModule_Hsm (CryIfCryptoModule): CryIfSupportsKeyElementCopyPartial=true, CryIfCancelJobApiUsesJobType=true, CryIfCryptoModuleRef=Crypto_vHsm
    8 x CryIfKey:
      CryIfKey_vHsm_Custom: CryIfKeyId=56, CryIfKeyRef=vHsm_Custom
      CryIfKey_vHsm_FirmwareUpdate_Signature: CryIfKeyId=57, CryIfKeyRef=vHsm_FirmwareUpdate_Signature
      CryIfKey_vHsm_Hardware: CryIfKeyId=58, CryIfKeyRef=vHsm_Hardware
      CryIfKey_vHsm_Info: CryIfKeyId=59, CryIfKeyRef=vHsm_Info
      CryIfKey_vHsm_RomKey0: CryIfKeyId=61, CryIfKeyRef=vHsm_RomKey0
      CryIfKey_vHsm_Log: CryIfKeyId=60, CryIfKeyRef=vHsm_Log
      CryIfKey_vHsm_TRNG: CryIfKeyId=62, CryIfKeyRef=vHsm_TRNG
      CryIfKey_CryIfKey_vHsm_Info: CryIfKeyId=15, CryIfKeyRef=CryIfKey_vHsm_Info
    CryIfChannel_vHsm_Fw_Update (CryIfChannel): CryIfChannelId=5, CryIfDriverObjectRef=Crypto_30_vHsm_Core
    4 x CryIfKey:
      CryIfKey_CryIfKey_Fbl_Signature_Ed25519: CryIfKeyId=4, CryIfKeyRef=CryIfKey_Fbl_Signature_Ed25519
      CryIfKey_CryIfKey_Fbl_Rng_Fips186: CryIfKeyId=2, CryIfKeyRef=CryIfKey_Fbl_Rng_Fips186
      CryIfKey_CryIfKey_Fbl_HashDummy: CryIfKeyId=1, CryIfKeyRef=CryIfKey_Fbl_HashDummy
      CryIfKey_CryIfKey_Fbl_Decrypt_Aes128: CryIfKeyId=0, CryIfKeyRef=CryIfKey_Fbl_Decrypt_Aes128
    CryIfChannel_vHsm_Hwa (CryIfChannel): CryIfChannelId=0, CryIfDriverObjectRef=Crypto_30_vHsm_Hwa
    47 x CryIfKey:
      CryIfKey_CryIfKey_Fbl_SecurityAccess_Ed25519: CryIfKeyId=3, CryIfKeyRef=CryIfKey_Fbl_SecurityAccess_Ed25519
      CryIfKey_Ssa_SharedSecretExchangeKey: CryIfKeyId=47, CryIfKeyRef=Ssa_SharedSecretExchangeKey
      CryIfKey_SSA_SecOC_Int_MacVerify_COM_C0X_Pdu20_secured_3ef6961f_Rx: CryIfKeyId=32, CryIfKeyRef=SSA_SecOC_Int_MacVerify_COM_C0X_Pdu20_secured_3ef6961f_Rx
      CryIfKey_KeyM_SigVerifyKey_TrustModelBackend: CryIfKeyId=23, CryIfKeyRef=KeyM_SigVerifyKey_TrustModelBackend
      CryIfKey_SSA_SecOC_Int_MacVerify_PT4_PTCoor4: CryIfKeyId=37, CryIfKeyRef=SSA_SecOC_Int_MacVerify_PT4_PTCoor4
      CryIfKey_KeyM_SigVerifyKey_TrustModelEcuPeer: CryIfKeyId=25, CryIfKeyRef=KeyM_SigVerifyKey_TrustModelEcuPeer
      CryIfKey_KeyM_SigVerifyKey_TrustModelBackendPeer: CryIfKeyId=24, CryIfKeyRef=KeyM_SigVerifyKey_TrustModelBackendPeer
      CryIfKey_Ssa_Authentication: CryIfKeyId=40, CryIfKeyRef=Ssa_Authentication
      CryIfKey_Ssa_SharedSecretHash: CryIfKeyId=48, CryIfKeyRef=Ssa_SharedSecretHash
      CryIfKey_CryIfKey_Ssa_TrustModelBackendCert_inHSM: CryIfKeyId=8, CryIfKeyRef=CryIfKey_Ssa_TrustModelBackendCert_inHSM
      CryIfKey_Ssa_RandomSeed: CryIfKeyId=43, CryIfKeyRef=Ssa_RandomSeed
      CryIfKey_SSA_SecOC_Int_MacVerify_PN14_Master_Stat1: CryIfKeyId=36, CryIfKeyRef=SSA_SecOC_Int_MacVerify_PN14_Master_Stat1
      CryIfKey_SSA_SecOC_Int_MacGen_COM_C04_Pdu20_secured_393d7a18_Tx: CryIfKeyId=30, CryIfKeyRef=SSA_SecOC_Int_MacGen_COM_C04_Pdu20_secured_393d7a18_Tx
      CryIfKey_KeyM_ECC_Root: CryIfKeyId=22, CryIfKeyRef=KeyM_ECC_Root
      CryIfKey_CryIfKey_Ssa_TrustModelPrivateEcuUnique_StagingKey: CryIfKeyId=11, CryIfKeyRef=CryIfKey_Ssa_TrustModelPrivateEcuUnique_StagingKey
      CryIfKey_Ssa_RealTime: CryIfKeyId=44, CryIfKeyRef=Ssa_RealTime
      CryIfKey_Ssa_PduKeysMac: CryIfKeyId=42, CryIfKeyRef=Ssa_PduKeysMac
      CryIfKey_CryIfKey_Ssa_TrustModelIntermediateCert_inHSM: CryIfKeyId=10, CryIfKeyRef=CryIfKey_Ssa_TrustModelIntermediateCert_inHSM
      CryIfKey_Ssa_TrustModelEcuPublic_LiveKey: CryIfKeyId=52, CryIfKeyRef=Ssa_TrustModelEcuPublic_LiveKey
      CryIfKey_Ssa_SignatureRamKey: CryIfKeyId=49, CryIfKeyRef=Ssa_SignatureRamKey
      CryIfKey_CryIfKey_Ssa_TrustModel_Ecu_CsrPublicKey: CryIfKeyId=14, CryIfKeyRef=CryIfKey_Ssa_TrustModel_Ecu_CsrPublicKey
      CryIfKey_CryIfKey_Ssa_TrustModelEcuCert_inHSM: CryIfKeyId=9, CryIfKeyRef=CryIfKey_Ssa_TrustModelEcuCert_inHSM
      CryIfKey_CryIfKey_Ssa_SignatureRamKey_replacementAuthority: CryIfKeyId=7, CryIfKeyRef=CryIfKey_Ssa_SignatureRamKey_replacementAuthority
      CryIfKey_Ssa_BackendCert: CryIfKeyId=41, CryIfKeyRef=Ssa_BackendCert
      CryIfKey_Ssa_AesRamKey: CryIfKeyId=39, CryIfKeyRef=Ssa_AesRamKey
      CryIfKey_SSA_SecOC_Int_MacVerify_Ign_Stat: CryIfKeyId=35, CryIfKeyRef=SSA_SecOC_Int_MacVerify_Ign_Stat
      CryIfKey_KeyM_SigVerifyKey_TrustModelIntermediatePeer: CryIfKeyId=27, CryIfKeyRef=KeyM_SigVerifyKey_TrustModelIntermediatePeer
      CryIfKey_Ssa_SecurityAccessPublicKey: CryIfKeyId=46, CryIfKeyRef=Ssa_SecurityAccessPublicKey
      CryIfKey_SSA_SecOC_Int_MacVerify_DI_OdoSpeedometer: CryIfKeyId=34, CryIfKeyRef=SSA_SecOC_Int_MacVerify_DI_OdoSpeedometer
      CryIfKey_KeyM_Cert_Root: CryIfKeyId=20, CryIfKeyRef=KeyM_Cert_Root
      CryIfKey_SSA_SecOC_Int_MacVerify_COM_C0X_Pdu21_secured_298d825c_Rx: CryIfKeyId=33, CryIfKeyRef=SSA_SecOC_Int_MacVerify_COM_C0X_Pdu21_secured_298d825c_Rx
      CryIfKey_CryIfKey_KeyMCertificate_OSSL_X509_ECDSA_P384_IA: CryIfKeyId=6, CryIfKeyRef=CryIfKey_KeyMCertificate_OSSL_X509_ECDSA_P384_IA
      CryIfKey_SSA_SecOC_Int_MacVerify_VehSpd_8: CryIfKeyId=38, CryIfKeyRef=SSA_SecOC_Int_MacVerify_VehSpd_8
      CryIfKey_SSA_SecOC_Int_MacGen_COM_C04_Pdu03_secured_044596e0_Tx: CryIfKeyId=29, CryIfKeyRef=SSA_SecOC_Int_MacGen_COM_C04_Pdu03_secured_044596e0_Tx
      CryIfKey_Ssa_TickCount: CryIfKeyId=50, CryIfKeyRef=Ssa_TickCount
      CryIfKey_vHSM_Custom_HSM_Version: CryIfKeyId=55, CryIfKeyRef=vHSM_Custom_HSM_Version
      CryIfKey_CryIfKey_Ssa_TrustModel_Ecu_CsrPrivateKey: CryIfKeyId=13, CryIfKeyRef=CryIfKey_Ssa_TrustModel_Ecu_CsrPrivateKey
      CryIfKey_KeyM_ECC_Intermediate: CryIfKeyId=21, CryIfKeyRef=KeyM_ECC_Intermediate
      CryIfKey_KeyM_SigVerifyKey_TrustModelIntermediate: CryIfKeyId=26, CryIfKeyRef=KeyM_SigVerifyKey_TrustModelIntermediate
      CryIfKey_Ssa_RootCert: CryIfKeyId=45, CryIfKeyRef=Ssa_RootCert
      CryIfKey_SSA_SecOC_Int_MacGen_COM_C04_Pdu21_secured_2e466e5b_Tx: CryIfKeyId=31, CryIfKeyRef=SSA_SecOC_Int_MacGen_COM_C04_Pdu21_secured_2e466e5b_Tx
      CryIfKey_CryIfKey_Ssa_TrustModelRootCert_inHSM: CryIfKeyId=12, CryIfKeyRef=CryIfKey_Ssa_TrustModelRootCert_inHSM
      CryIfKey_Ssa_TrustModelPrivateEcu_LiveKey: CryIfKeyId=53, CryIfKeyRef=Ssa_TrustModelPrivateEcu_LiveKey
      CryIfKey_KeyM_SigVerifyKey_TrustModelRoot: CryIfKeyId=28, CryIfKeyRef=KeyM_SigVerifyKey_TrustModelRoot
      CryIfKey_Ssa_VIN: CryIfKeyId=54, CryIfKeyRef=Ssa_VIN
      CryIfKey_Ssa_TrustModelEcuPublicCsr_StagingKey: CryIfKeyId=51, CryIfKeyRef=Ssa_TrustModelEcuPublicCsr_StagingKey
      CryIfKey_CryIfKey_KeyMCertificate_OSSL_X509_ECDSA_P384_CA: CryIfKeyId=5, CryIfKeyRef=CryIfKey_KeyMCertificate_OSSL_X509_ECDSA_P384_CA
