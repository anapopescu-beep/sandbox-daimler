AUTOSAR XML (schema 4-3-0)
package /ActiveEcuC
  module config vBRS: implementation-config-variant=VARIANT-PRE-COMPILE, module-description=vBRS_Impl
    vBRSGeneral:
      vBRSFblSupport = FBL_with_EcuMInit
      vBRSEnableEcuMStubGeneration = true
      vBRSEnableSchmStubGeneration = true
      vBRSEnableSupportLEDs = false
      vBRSEnableSafeContextSupport = false
      vBRSEnableMultiCoreSupport = false
      vBRSEnableSupportToggleWdPin = false
      vBRSEnableSupportToggleCustomPin = false
      vBRSDisableSetupSupport = false
      vBRSEnableSchmStubSupportDrvCanAN = false
      vBRSEnableHSMSupport = false
      vBRSEnableCoreSpecificVLinkGenConfig = false
      vBRSExecutionInstance = FBL
      vBRSFirstInstance = true
      vBRSFblSupportEcuMInit = true
      vBRSFblSupportExceptionTableInRam = true
      vBRSEnableSchmStubEmptyExclusiveAreaHandling = false
    vBRSHwConfig:
      vBRSEnablePLLClocksHandling = false
      vBRSEnablePortHandling = false
      vBRSEnableWatchdogHandling = true
      vBRSOscClock = 20000000
      vBRSPeriphClock = 20000000
      vBRSTimebaseClock = 100000000
      vBRSPeriphClockDescription = Initial value for Peripheral Clock: 100MHz GPT=100MHz/8 =12.5MHz
      vBRSPreferPLLWatchdogInit = false
      3 x vBRSEvalBoardInfo:
        TRIBOARD_TC3x7: vBRSEvalBoard=TRIBOARD_TC3x7, vBRSEvalBoardDescription=Toggle Port Group 33 Port 4 for LED support, vBRSEvalBoardOscClock=20000000
        TRIBOARD_TC3x9: vBRSEvalBoard=TRIBOARD_TC3x9, vBRSEvalBoardDescription=Toggle Port Group 33 Port 4 for LED support, vBRSEvalBoardOscClock=20000000
        CUSTOMER_HARDWARE: vBRSEvalBoard=CUSTOMER_HARDWARE, vBRSEvalBoardDescription=This Eval board is used for customer hardware. All pin configuration have to be specify manually in the BrsHw_Ports.h.
      vBRSDriverHandlingCAN:
        vBRSEnableDriverHandlingCAN = true
        vBRSDriverHandlingCAN_channel{0..9} = false
        vBRSDriverHandlingCAN_PeripheralClock = true
        vBRSDriverHandlingCAN_channel{10..19} = false
    vBRSMemoryInit: vBRSInitPatternBlocks=0, vBRSInitPatternHardResetBlocks=0, vBRSInitPatternAreas=0, vBRSInitPatternHardResetAreas=0
