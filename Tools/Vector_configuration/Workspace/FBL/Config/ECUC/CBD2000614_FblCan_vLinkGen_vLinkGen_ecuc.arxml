AUTOSAR XML (schema 4-3-0)
package /ActiveEcuC
  module config vLinkGen: implementation-config-variant=VARIANT-PRE-COMPILE, module-description=vLinkGen_Impl
    vLinkGenMemLayout
      5 x vLinkGenMemoryRegion, all with vLinkGenMemoryRegionAddrOffset=0, vLinkGenMemoryRegionAvailable=true:
        MemRegion_LMU0_NonCached: vLinkGenMemoryRegionSize=8192, vLinkGenMemoryRegionAddress=2952790016, vLinkGenMemoryRegionHwRegion=LMU0_NonCached
          RegionBlock_0_LMU0_vHsm_Shared (vLinkGenMemoryRegionBlock):
            vLinkGenMemoryRegionBlockPosition = 0
            vLinkGenMemoryRegionBlockSize = 8064
            vLinkGenMemoryRegionBlockAddress = 2952790016
            vLinkGenMemoryRegionBlockBoundary = LOWER
            vLinkGenMemoryRegionBlockInitStage = NONE
          RegionBlock_0_LMU0_ReprogrammingData (vLinkGenMemoryRegionBlock):
            vLinkGenMemoryRegionBlockPosition = 1
            vLinkGenMemoryRegionBlockSize = 128
            vLinkGenMemoryRegionBlockAddress = 2952798080
            vLinkGenMemoryRegionBlockBoundary = LOWER
            vLinkGenMemoryRegionBlockInitStage = NONE
        MemRegion_BMHD0: vLinkGenMemoryRegionSize=512, vLinkGenMemoryRegionAddress=2940207104, vLinkGenMemoryRegionHwRegion=BMHD0
          RegionBlock_0_BMHD0 (vLinkGenMemoryRegionBlock):
            vLinkGenMemoryRegionBlockPosition = 0
            vLinkGenMemoryRegionBlockSize = 512
            vLinkGenMemoryRegionBlockAddress = 2940207104
            vLinkGenMemoryRegionBlockBoundary = LOWER
            vLinkGenMemoryRegionBlockInitStage = NONE
        MemRegion_BMHD1: vLinkGenMemoryRegionSize=512, vLinkGenMemoryRegionAddress=2940207616, vLinkGenMemoryRegionHwRegion=BMHD1
          RegionBlock_0_BMHD1 (vLinkGenMemoryRegionBlock):
            vLinkGenMemoryRegionBlockPosition = 0
            vLinkGenMemoryRegionBlockSize = 512
            vLinkGenMemoryRegionBlockAddress = 2940207616
            vLinkGenMemoryRegionBlockBoundary = LOWER
            vLinkGenMemoryRegionBlockInitStage = NONE
        MemRegion_BMHD2: vLinkGenMemoryRegionSize=512, vLinkGenMemoryRegionAddress=2940208128, vLinkGenMemoryRegionHwRegion=BMHD2
          RegionBlock_0_BMHD2 (vLinkGenMemoryRegionBlock):
            vLinkGenMemoryRegionBlockPosition = 0
            vLinkGenMemoryRegionBlockSize = 512
            vLinkGenMemoryRegionBlockAddress = 2940208128
            vLinkGenMemoryRegionBlockBoundary = LOWER
            vLinkGenMemoryRegionBlockInitStage = NONE
        MemRegion_BMHD3: vLinkGenMemoryRegionSize=512, vLinkGenMemoryRegionAddress=2940208640, vLinkGenMemoryRegionHwRegion=BMHD3
          RegionBlock_0_BMHD3 (vLinkGenMemoryRegionBlock):
            vLinkGenMemoryRegionBlockPosition = 0
            vLinkGenMemoryRegionBlockSize = 512
            vLinkGenMemoryRegionBlockAddress = 2940208640
            vLinkGenMemoryRegionBlockBoundary = LOWER
            vLinkGenMemoryRegionBlockInitStage = NONE
      STACK_C0 (vLinkGenLogicalVarGroup): vLinkGenVarGroupPosition=4096, vLinkGenVarGroupInitCore=0, vLinkGenVarGroupRegion=DefaultRamArea_Stack
        STACK_C0 (vLinkGenVarSectionGroup):
          vLinkGenVarSectionGroupAlignment = 4
          vLinkGenVarSectionGroupEndAlignment = 0
          vLinkGenVarSectionGroupSize = 1024
          vLinkGenVarSectionGroupInit = ZERO_INIT
          vLinkGenVarSectionGroupInitStage = EARLY
          vLinkGenVarSectionGroupPosition = 0
          vLinkGenVarSectionGroupFlag = vLinkGenVarGroupFlags/ORDERED
          vLinkGenVarSectionGroupFlag = vLinkGenVarGroupFlags/CONTIGUOUS
          vLinkGenVarSectionGroupFlag = vLinkGenVarGroupFlags/FILL
          vLinkGenVarSectionGroupFlag = vLinkGenVarGroupFlags/READ
          vLinkGenVarSectionGroupFlag = vLinkGenVarGroupFlags/WRITE
      CSA_CORE0 (vLinkGenLogicalVarGroup): vLinkGenVarGroupPosition=0, vLinkGenVarGroupRegion=DefaultRamArea_DSPR0
        CSA_CORE0 (vLinkGenVarSectionGroup):
          vLinkGenVarSectionGroupAlignment = 64
          vLinkGenVarSectionGroupSize = 4096
          vLinkGenVarSectionGroupPosition = 0
          vLinkGenVarSectionGroupInit = NONE
          vLinkGenVarSectionGroupInitStage = ONE
          vLinkGenVarSectionGroupFlag = vLinkGenVarGroupFlags/ORDERED
          vLinkGenVarSectionGroupFlag = vLinkGenVarGroupFlags/CONTIGUOUS
          vLinkGenVarSectionGroupFlag = vLinkGenVarGroupFlags/FILL
          vLinkGenVarSectionGroupFlag = vLinkGenVarGroupFlags/READ
          vLinkGenVarSectionGroupFlag = vLinkGenVarGroupFlags/WRITE
      3 x vLinkGenLogicalSymbolGroup, all with vLinkGenSymbolGroupPosition=0:
        Startup_Labels
          9 x vLinkGenLinkerSymbol, all with vLinkGenLinkerSymbolValue=brsStartupEntry, vLinkGenLinkerSymbolPosition=0:
            Startup_Labels1: vLinkGenLinkerSymbolName=_RESET
            Startup_Labels2: vLinkGenLinkerSymbolName=_start
            Startup_Labels3: vLinkGenLinkerSymbolName=_start_tc0
            Startup_Labels4: vLinkGenLinkerSymbolName=_start_tc1
            Startup_Labels5: vLinkGenLinkerSymbolName=_start_tc2
            Startup_Labels6: vLinkGenLinkerSymbolName=_start_tc3
            Startup_Labels7: vLinkGenLinkerSymbolName=_start_tc4
            Startup_Labels8: vLinkGenLinkerSymbolName=_start_tc5
            Startup_Labels9: vLinkGenLinkerSymbolName=_brsStartupEntry
        CSA_LABELS
          CSA_LABELS1 (vLinkGenLinkerSymbol): vLinkGenLinkerSymbolName=__CSA_BEGIN_CPU0_, vLinkGenLinkerSymbolValue=_CSA_CORE0_START, vLinkGenLinkerSymbolPosition=0
          CSA_LABELS2 (vLinkGenLinkerSymbol): vLinkGenLinkerSymbolName=__CSA_END_CPU0_, vLinkGenLinkerSymbolValue=_CSA_CORE0_LIMIT, vLinkGenLinkerSymbolPosition=0
        Startup_Stack
          Startup_Stack_c0 (vLinkGenLinkerSymbol): vLinkGenLinkerSymbolName=__STARTUPSTACK_CORE0, vLinkGenLinkerSymbolValue=_STACK_C0_LIMIT, vLinkGenLinkerSymbolPosition=0
      vLinkGenLinkerSections
        ProgConditionSection (vLinkGenLinkerVarSection): vLinkGenLinkerVarSectionName=ProgConditionSection, vLinkGenLinkerVarSectionFast=false, vLinkGenLinkerVarSectionAlignment=0
        brsStartupEntry (vLinkGenLinkerCodeSection): vLinkGenLinkerCodeSectionName=brsStartupEntry, vLinkGenLinkerCodeSectionAlignment=8, vLinkGenLinkerCodeSectionFast=false
        brsStartup (vLinkGenLinkerCodeSection): vLinkGenLinkerCodeSectionName=brsStartup, vLinkGenLinkerCodeSectionAlignment=8, vLinkGenLinkerCodeSectionFast=false
        BMHD0 (vLinkGenLinkerConstSection): vLinkGenLinkerConstSectionName=BMHD0, vLinkGenLinkerConstSectionAlignment=32, vLinkGenLinkerConstSectionFast=false
        brsExcVect (vLinkGenLinkerCodeSection): vLinkGenLinkerCodeSectionName=brsExcVect, vLinkGenLinkerCodeSectionFast=false, vLinkGenLinkerCodeSectionAlignment=0
        BmHeaderSection (vLinkGenLinkerConstSection): vLinkGenLinkerConstSectionName=BmHeaderSection, vLinkGenLinkerConstSectionFast=false, vLinkGenLinkerConstSectionAlignment=0
        RamCodeSection (vLinkGenLinkerCodeSection): vLinkGenLinkerCodeSectionName=RamCodeSection, vLinkGenLinkerCodeSectionFast=false, vLinkGenLinkerCodeSectionAlignment=0
        3 x vLinkGenLinkerConstSection, all with vLinkGenLinkerConstSectionFast=false, vLinkGenLinkerConstSectionAlignment=0:
          RamConstSection: vLinkGenLinkerConstSectionName=RamConstSection
          FblHeaderSection: vLinkGenLinkerConstSectionName=FblHeaderSection
          BmHdrHeaderSection: vLinkGenLinkerConstSectionName=BmHdrHeaderSection
        brsResetLabel (vLinkGenLinkerCodeSection): vLinkGenLinkerCodeSectionName=brsResetLabel, vLinkGenLinkerCodeSectionFast=false, vLinkGenLinkerCodeSectionAlignment=0
        FblFlashDrvSection (vLinkGenLinkerVarSection): vLinkGenLinkerVarSectionName=FblFlashDrvSection, vLinkGenLinkerVarSectionFast=false, vLinkGenLinkerVarSectionAlignment=0
        7 x vLinkGenLinkerSpecSection, all with vLinkGenLinkerSpecSectionPad=0, vLinkGenLinkerSpecSectionAlignment=0:
          text: vLinkGenLinkerSpecSectionValue=[.]text*
          rodata: vLinkGenLinkerSpecSectionValue=[.]rodata*
          zrodata: vLinkGenLinkerSpecSectionValue=[.]zrodata*
          data: vLinkGenLinkerSpecSectionValue=[.]data*
          zdata: vLinkGenLinkerSpecSectionValue=[.]zdata*
          bss: vLinkGenLinkerSpecSectionValue=[.]bss*
          zbss: vLinkGenLinkerSpecSectionValue=[.]zbss*
        MagicFlagSection (vLinkGenLinkerVarSection): vLinkGenLinkerVarSectionName=MagicFlagSection, vLinkGenLinkerVarSectionFast=false, vLinkGenLinkerVarSectionAlignment=0
        ApplInfoHeaderSection (vLinkGenLinkerConstSection): vLinkGenLinkerConstSectionName=ApplInfoHeaderSection, vLinkGenLinkerConstSectionFast=false, vLinkGenLinkerConstSectionAlignment=0
        vHsmIpcMemory (vLinkGenLinkerVarSection): vLinkGenLinkerVarSectionName=vHsmIpcMemory, vLinkGenLinkerVarSectionFast=false, vLinkGenLinkerVarSectionAlignment=0
        vHsmGlobalRamBuffer (vLinkGenLinkerVarSection): vLinkGenLinkerVarSectionName=vHsmGlobalRamBuffer, vLinkGenLinkerVarSectionFast=false, vLinkGenLinkerVarSectionAlignment=0
        FblSW_Versions (vLinkGenLinkerConstSection): vLinkGenLinkerConstSectionName=FblSW_Versions, vLinkGenLinkerConstSectionFast=false, vLinkGenLinkerConstSectionAlignment=0
      brsExcVect (vLinkGenLogicalConstGroup): vLinkGenConstGroupPosition=5, vLinkGenConstGroupRegion=FblRom_ExceptionTable
        brsExcVect (vLinkGenConstSectionGroup):
          vLinkGenConstSectionGroupPosition = 0
          vLinkGenConstSectionGroupInit = NONE
          vLinkGenConstSectionGroupInitStage = ONE
          vLinkGenConstSectionGroupAlignment = 256
          vLinkGenConstSectionGroupEndAlignment = 4
          vLinkGenConstSectionGroupFlag = vLinkGenConstGroupFlags/ORDERED
          vLinkGenConstSectionGroupFlag = vLinkGenConstGroupFlags/CONTIGUOUS
          vLinkGenConstSectionGroupFlag = vLinkGenConstGroupFlags/FILL
          vLinkGenConstSectionGroupFlag = vLinkGenConstGroupFlags/READ
          vLinkGenConstSectionGroupFlag = vLinkGenConstGroupFlags/EXECUTE
          vLinkGenConstSectionGroupRef = vLinkGenLinkerSections/brsExcVect
      FlashDrvGroup (vLinkGenLogicalVarGroup): vLinkGenVarGroupPosition=8, vLinkGenVarGroupRegion=FlashDrvArea
        FblFlashDrvSection (vLinkGenVarSectionGroup):
          vLinkGenVarSectionGroupPosition = 0
          vLinkGenVarSectionGroupInitStage = TWO
          vLinkGenVarSectionGroupInit = NONE
          vLinkGenVarSectionGroupAlignment = 16
          vLinkGenVarSectionGroupFlag = vLinkGenVarGroupFlags/ORDERED
          vLinkGenVarSectionGroupFlag = vLinkGenVarGroupFlags/CONTIGUOUS
          vLinkGenVarSectionGroupFlag = vLinkGenVarGroupFlags/FILL
          vLinkGenVarSectionGroupFlag = vLinkGenVarGroupFlags/READ
          vLinkGenVarSectionGroupFlag = vLinkGenVarGroupFlags/WRITE
          vLinkGenVarSectionGroupRef = vLinkGenLinkerSections/FblFlashDrvSection
      3 x vLinkGenMemoryRegion, all with vLinkGenMemoryRegionAvailable=true, vLinkGenMemoryRegionHwRegion=PFlash0_NonCached:
        Rom_BmMemoryArea: vLinkGenMemoryRegionAddrOffset=212992, vLinkGenMemoryRegionSize=81920, vLinkGenMemoryRegionAddress=2684567552
          4 x vLinkGenMemoryRegionBlock, all with vLinkGenMemoryRegionBlockBoundary=LOWER, vLinkGenMemoryRegionBlockInitStage=NONE:
            BmRomArea: vLinkGenMemoryRegionBlockPosition=3, vLinkGenMemoryRegionBlockSize=64736, vLinkGenMemoryRegionBlockAddress=2684568352
            BmHeader: vLinkGenMemoryRegionBlockPosition=2, vLinkGenMemoryRegionBlockSize=32, vLinkGenMemoryRegionBlockAddress=2684568320
            BmRom_Startup: vLinkGenMemoryRegionBlockPosition=0, vLinkGenMemoryRegionBlockSize=512, vLinkGenMemoryRegionBlockAddress=2684567552
            BmRom_ExceptionTable: vLinkGenMemoryRegionBlockPosition=1, vLinkGenMemoryRegionBlockSize=256, vLinkGenMemoryRegionBlockAddress=2684568064
        Rom_FblMemoryArea: vLinkGenMemoryRegionAddrOffset=294912, vLinkGenMemoryRegionSize=147456, vLinkGenMemoryRegionAddress=2684649472
          7 x vLinkGenMemoryRegionBlock, all with vLinkGenMemoryRegionBlockInitStage=NONE:
            FblRomArea: vLinkGenMemoryRegionBlockPosition=4, vLinkGenMemoryRegionBlockBoundary=LOWER, vLinkGenMemoryRegionBlockSize=145600, vLinkGenMemoryRegionBlockAddress=2684650304
            FblBmHdrHeader: vLinkGenMemoryRegionBlockPosition=2, vLinkGenMemoryRegionBlockSize=32, vLinkGenMemoryRegionBlockBoundary=LOWER, vLinkGenMemoryRegionBlockAddress=2684650240
            FblHeader: vLinkGenMemoryRegionBlockPosition=3, vLinkGenMemoryRegionBlockSize=32, vLinkGenMemoryRegionBlockBoundary=LOWER, vLinkGenMemoryRegionBlockAddress=2684650272
            FblRom_Startup: vLinkGenMemoryRegionBlockPosition=1, vLinkGenMemoryRegionBlockBoundary=LOWER, vLinkGenMemoryRegionBlockSize=512, vLinkGenMemoryRegionBlockAddress=2684649728
            FblRomReserved: vLinkGenMemoryRegionBlockPosition=1, vLinkGenMemoryRegionBlockBoundary=UPPER, vLinkGenMemoryRegionBlockSize=848, vLinkGenMemoryRegionBlockAddress=2684796080
            FblRom_ExceptionTable: vLinkGenMemoryRegionBlockPosition=0, vLinkGenMemoryRegionBlockBoundary=LOWER, vLinkGenMemoryRegionBlockSize=256, vLinkGenMemoryRegionBlockAddress=2684649472
            FblRom_SW_Versions: vLinkGenMemoryRegionBlockPosition=0, vLinkGenMemoryRegionBlockSize=80, vLinkGenMemoryRegionBlockAddress=2684796000, vLinkGenMemoryRegionBlockBoundary=UPPER
        Rom_ApplMemoryArea: vLinkGenMemoryRegionAddrOffset=442368, vLinkGenMemoryRegionSize=606208, vLinkGenMemoryRegionAddress=2684796928
          6 x vLinkGenMemoryRegionBlock, all with vLinkGenMemoryRegionBlockInitStage=NONE:
            ApplRomArea: vLinkGenMemoryRegionBlockBoundary=LOWER, vLinkGenMemoryRegionBlockPosition=4, vLinkGenMemoryRegionBlockSize=601088, vLinkGenMemoryRegionBlockAddress=2684797952
            ApplBmHdrHeader: vLinkGenMemoryRegionBlockPosition=1, vLinkGenMemoryRegionBlockSize=32, vLinkGenMemoryRegionBlockBoundary=LOWER, vLinkGenMemoryRegionBlockAddress=2684797152
            AppRomReserved: vLinkGenMemoryRegionBlockBoundary=UPPER, vLinkGenMemoryRegionBlockPosition=0, vLinkGenMemoryRegionBlockSize=4096, vLinkGenMemoryRegionBlockAddress=2685399040
            ApplRom_Startup: vLinkGenMemoryRegionBlockPosition=3, vLinkGenMemoryRegionBlockBoundary=LOWER, vLinkGenMemoryRegionBlockSize=512, vLinkGenMemoryRegionBlockAddress=2684797440
            ApplRom_ExceptionTable: vLinkGenMemoryRegionBlockPosition=2, vLinkGenMemoryRegionBlockBoundary=LOWER, vLinkGenMemoryRegionBlockSize=256, vLinkGenMemoryRegionBlockAddress=2684797184
            ApplInfoHeader: vLinkGenMemoryRegionBlockPosition=0, vLinkGenMemoryRegionBlockSize=224, vLinkGenMemoryRegionBlockAddress=2684796928, vLinkGenMemoryRegionBlockBoundary=LOWER
      RomDefaultGroup (vLinkGenLogicalConstGroup): vLinkGenConstGroupPosition=50, vLinkGenConstGroupRegion=FblRomArea
        Fbl_Rom (vLinkGenConstSectionGroup):
          vLinkGenConstSectionGroupPosition = 20
          vLinkGenConstSectionGroupInit = NONE
          vLinkGenConstSectionGroupInitStage = ONE
          vLinkGenConstSectionGroupFlag = vLinkGenConstGroupFlags/ORDERED
          vLinkGenConstSectionGroupFlag = vLinkGenConstGroupFlags/CONTIGUOUS
          vLinkGenConstSectionGroupFlag = vLinkGenConstGroupFlags/FILL
          vLinkGenConstSectionGroupFlag = vLinkGenConstGroupFlags/READ
          vLinkGenConstSectionGroupFlag = vLinkGenConstGroupFlags/EXECUTE
          vLinkGenConstSectionGroupRef = text
          vLinkGenConstSectionGroupRef = rodata
          vLinkGenConstSectionGroupRef = zrodata
      TargetCompilerSpecificOptions_All (vLinkGenLogicalSymbolGroup): vLinkGenSymbolGroupPosition=4096
        OS_EXCVEC_CORE0_CODE_START (vLinkGenLinkerSymbol): vLinkGenLinkerSymbolPosition=0, vLinkGenLinkerSymbolName=_OS_EXCVEC_CORE0_CODE_START, vLinkGenLinkerSymbolValue=brsStartupEntry
        OS_INTVEC_CORE0_CODE_START (vLinkGenLinkerSymbol): vLinkGenLinkerSymbolPosition=0, vLinkGenLinkerSymbolName=_OS_INTVEC_CORE0_CODE_START, vLinkGenLinkerSymbolValue=brsStartupEntry
      4 x vLinkGenLogicalConstGroup, all with vLinkGenConstGroupPosition=0:
        FblHeaderGroup: vLinkGenConstGroupRegion=FblHeader
          FblHeaderSectionGroup (vLinkGenConstSectionGroup):
            vLinkGenConstSectionGroupPosition = 0
            vLinkGenConstSectionGroupInit = NONE
            vLinkGenConstSectionGroupInitStage = ONE
            vLinkGenConstSectionGroupFlag = vLinkGenConstGroupFlags/ORDERED
            vLinkGenConstSectionGroupFlag = vLinkGenConstGroupFlags/CONTIGUOUS
            vLinkGenConstSectionGroupFlag = vLinkGenConstGroupFlags/FILL
            vLinkGenConstSectionGroupFlag = vLinkGenConstGroupFlags/READ
            vLinkGenConstSectionGroupFlag = vLinkGenConstGroupFlags/EXECUTE
            vLinkGenConstSectionGroupRef = FblHeaderSection
        BmHdrHeaderGroup: vLinkGenConstGroupRegion=FblBmHdrHeader
          FblBmHdrHeaderGroup (vLinkGenConstSectionGroup):
            vLinkGenConstSectionGroupPosition = 0
            vLinkGenConstSectionGroupInit = NONE
            vLinkGenConstSectionGroupInitStage = ONE
            vLinkGenConstSectionGroupFlag = vLinkGenConstGroupFlags/ORDERED
            vLinkGenConstSectionGroupFlag = vLinkGenConstGroupFlags/CONTIGUOUS
            vLinkGenConstSectionGroupFlag = vLinkGenConstGroupFlags/FILL
            vLinkGenConstSectionGroupFlag = vLinkGenConstGroupFlags/READ
            vLinkGenConstSectionGroupFlag = vLinkGenConstGroupFlags/EXECUTE
            vLinkGenConstSectionGroupRef = BmHdrHeaderSection
        StartupGroup: vLinkGenConstGroupRegion=FblRom_Startup
          FblStartup (vLinkGenConstSectionGroup):
            vLinkGenConstSectionGroupPosition = 0
            vLinkGenConstSectionGroupInit = NONE
            vLinkGenConstSectionGroupInitStage = ONE
            vLinkGenConstSectionGroupFlag = vLinkGenConstGroupFlags/ORDERED
            vLinkGenConstSectionGroupFlag = vLinkGenConstGroupFlags/CONTIGUOUS
            vLinkGenConstSectionGroupFlag = vLinkGenConstGroupFlags/FILL
            vLinkGenConstSectionGroupFlag = vLinkGenConstGroupFlags/READ
            vLinkGenConstSectionGroupFlag = vLinkGenConstGroupFlags/EXECUTE
            vLinkGenConstSectionGroupRef = brsResetLabel
            vLinkGenConstSectionGroupRef = brsStartup
            vLinkGenConstSectionGroupRef = brsStartupEntry
        RamConstGroup: vLinkGenConstGroupInitCore=0, vLinkGenConstGroupRegion=FblRomArea, vLinkGenConstGroupRamRegion=DefaultRamArea_DSPR0
          FblRamConstSection (vLinkGenConstSectionGroup):
            vLinkGenConstSectionGroupPosition = 0
            vLinkGenConstSectionGroupInit = COPY_TO_RAM
            vLinkGenConstSectionGroupInitStage = ONE
            vLinkGenConstSectionGroupAlignment = 4
            vLinkGenConstSectionGroupEndAlignment = 4
            vLinkGenConstSectionGroupFlag = vLinkGenConstGroupFlags/ORDERED
            vLinkGenConstSectionGroupFlag = vLinkGenConstGroupFlags/CONTIGUOUS
            vLinkGenConstSectionGroupFlag = vLinkGenConstGroupFlags/FILL
            vLinkGenConstSectionGroupFlag = vLinkGenConstGroupFlags/READ
            vLinkGenConstSectionGroupFlag = vLinkGenConstGroupFlags/EXECUTE
            vLinkGenConstSectionGroupRef = RamConstSection
      Ram_Bss_Zbss_Group (vLinkGenLogicalVarGroup): vLinkGenVarGroupPosition=1000, vLinkGenVarGroupInitCore=0, vLinkGenVarGroupRegion=DefaultRamArea_DSPR0
        bss (vLinkGenVarSectionGroup):
          vLinkGenVarSectionGroupInit = ZERO_INIT
          vLinkGenVarSectionGroupPosition = 0
          vLinkGenVarSectionGroupInitStage = ONE
          vLinkGenVarSectionGroupAlignment = 16
          vLinkGenVarSectionGroupEndAlignment = 4
          vLinkGenVarSectionGroupFlag = vLinkGenVarGroupFlags/ORDERED
          vLinkGenVarSectionGroupFlag = vLinkGenVarGroupFlags/CONTIGUOUS
          vLinkGenVarSectionGroupFlag = vLinkGenVarGroupFlags/FILL
          vLinkGenVarSectionGroupFlag = vLinkGenVarGroupFlags/READ
          vLinkGenVarSectionGroupFlag = vLinkGenVarGroupFlags/WRITE
          vLinkGenVarSectionGroupRef = vLinkGenLinkerSections/bss
        zbss (vLinkGenVarSectionGroup):
          vLinkGenVarSectionGroupInit = ZERO_INIT
          vLinkGenVarSectionGroupPosition = 0
          vLinkGenVarSectionGroupInitStage = ONE
          vLinkGenVarSectionGroupAlignment = 16
          vLinkGenVarSectionGroupEndAlignment = 4
          vLinkGenVarSectionGroupFlag = vLinkGenVarGroupFlags/ORDERED
          vLinkGenVarSectionGroupFlag = vLinkGenVarGroupFlags/CONTIGUOUS
          vLinkGenVarSectionGroupFlag = vLinkGenVarGroupFlags/FILL
          vLinkGenVarSectionGroupFlag = vLinkGenVarGroupFlags/READ
          vLinkGenVarSectionGroupFlag = vLinkGenVarGroupFlags/WRITE
          vLinkGenVarSectionGroupRef = vLinkGenLinkerSections/zbss
      Ram_FlashDrvArea (vLinkGenMemoryRegion):
        vLinkGenMemoryRegionAddrOffset = 0
        vLinkGenMemoryRegionSize = 8192
        vLinkGenMemoryRegionAddress = 1880096768
        vLinkGenMemoryRegionAvailable = true
        vLinkGenMemoryRegionHwRegion = PSPR0
        FlashDrvArea (vLinkGenMemoryRegionBlock):
          vLinkGenMemoryRegionBlockPosition = 0
          vLinkGenMemoryRegionBlockBoundary = LOWER
          vLinkGenMemoryRegionBlockInitStage = NONE
          vLinkGenMemoryRegionBlockSize = 2048
          vLinkGenMemoryRegionBlockAddress = 1880096768
      DataDefaultGroup (vLinkGenLogicalVarGroup): vLinkGenVarGroupPosition=1, vLinkGenVarGroupInitCore=0, vLinkGenVarGroupRegion=DefaultRamArea_DSPR0, vLinkGenVarGroupRomRegion=FblRomArea
        FblDataDefault (vLinkGenVarSectionGroup):
          vLinkGenVarSectionGroupPosition = 0
          vLinkGenVarSectionGroupInit = INIT
          vLinkGenVarSectionGroupInitStage = ONE
          vLinkGenVarSectionGroupAlignment = 16
          vLinkGenVarSectionGroupEndAlignment = 4
          vLinkGenVarSectionGroupFlag = vLinkGenVarGroupFlags/ORDERED
          vLinkGenVarSectionGroupFlag = vLinkGenVarGroupFlags/CONTIGUOUS
          vLinkGenVarSectionGroupFlag = vLinkGenVarGroupFlags/FILL
          vLinkGenVarSectionGroupFlag = vLinkGenVarGroupFlags/READ
          vLinkGenVarSectionGroupFlag = vLinkGenVarGroupFlags/WRITE
          vLinkGenVarSectionGroupRef = data
          vLinkGenVarSectionGroupRef = zdata
      PresencePatternGroup (vLinkGenLogicalConstGroup): vLinkGenConstGroupPosition=0, vLinkGenConstGroupRegion=FblRomReserved
        Fbl_PP (vLinkGenConstSectionGroup):
          vLinkGenConstSectionGroupPosition = 0
          vLinkGenConstSectionGroupInit = NONE
          vLinkGenConstSectionGroupInitStage = ONE
          vLinkGenConstSectionGroupFlag = vLinkGenConstGroupFlags/ORDERED
          vLinkGenConstSectionGroupFlag = vLinkGenConstGroupFlags/CONTIGUOUS
          vLinkGenConstSectionGroupFlag = vLinkGenConstGroupFlags/FILL
          vLinkGenConstSectionGroupFlag = vLinkGenConstGroupFlags/READ
          vLinkGenConstSectionGroupFlag = vLinkGenConstGroupFlags/EXECUTE
      RamCodeGroup_DSPR0 (vLinkGenLogicalConstGroup): vLinkGenConstGroupPosition=1, vLinkGenConstGroupInitCore=0, vLinkGenConstGroupRegion=FblRomArea, vLinkGenConstGroupRamRegion=DefaultRamArea_DSPR0
        FblRamCodeSection (vLinkGenConstSectionGroup):
          vLinkGenConstSectionGroupPosition = 2
          vLinkGenConstSectionGroupInit = COPY_TO_RAM
          vLinkGenConstSectionGroupInitStage = ONE
          vLinkGenConstSectionGroupAlignment = 4
          vLinkGenConstSectionGroupEndAlignment = 4
          vLinkGenConstSectionGroupFlag = vLinkGenConstGroupFlags/ORDERED
          vLinkGenConstSectionGroupFlag = vLinkGenConstGroupFlags/CONTIGUOUS
          vLinkGenConstSectionGroupFlag = vLinkGenConstGroupFlags/FILL
          vLinkGenConstSectionGroupFlag = vLinkGenConstGroupFlags/READ
          vLinkGenConstSectionGroupFlag = vLinkGenConstGroupFlags/EXECUTE
          vLinkGenConstSectionGroupRef = RamCodeSection
      Ram_DefaultRamArea_DSPR0 (vLinkGenMemoryRegion):
        vLinkGenMemoryRegionAddrOffset = 0
        vLinkGenMemoryRegionSize = 98304
        vLinkGenMemoryRegionAddress = 1879048192
        vLinkGenMemoryRegionAvailable = true
        vLinkGenMemoryRegionHwRegion = DSPR0
        DefaultRamArea_DSPR0 (vLinkGenMemoryRegionBlock):
          vLinkGenMemoryRegionBlockPosition = 1
          vLinkGenMemoryRegionBlockBoundary = LOWER
          vLinkGenMemoryRegionBlockInitStage = NONE
          vLinkGenMemoryRegionBlockSize = 97280
          vLinkGenMemoryRegionBlockAddress = 1879049216
        DefaultRamArea_Stack (vLinkGenMemoryRegionBlock):
          vLinkGenMemoryRegionBlockPosition = 0
          vLinkGenMemoryRegionBlockSize = 1024
          vLinkGenMemoryRegionBlockAddress = 1879048192
          vLinkGenMemoryRegionBlockBoundary = LOWER
          vLinkGenMemoryRegionBlockInitStage = NONE
      SharedData_ReprogrammingData (vLinkGenLogicalVarGroup): vLinkGenVarGroupPosition=5, vLinkGenVarGroupRegion=RegionBlock_0_LMU0_ReprogrammingData
        ProgConditions (vLinkGenVarSectionGroup):
          vLinkGenVarSectionGroupPosition = 1
          vLinkGenVarSectionGroupInit = NONE
          vLinkGenVarSectionGroupInitStage = ONE
          vLinkGenVarSectionGroupAlignment = 0
          vLinkGenVarSectionGroupFlag = vLinkGenVarGroupFlags/ORDERED
          vLinkGenVarSectionGroupFlag = vLinkGenVarGroupFlags/CONTIGUOUS
          vLinkGenVarSectionGroupFlag = vLinkGenVarGroupFlags/FILL
          vLinkGenVarSectionGroupFlag = vLinkGenVarGroupFlags/READ
          vLinkGenVarSectionGroupFlag = vLinkGenVarGroupFlags/WRITE
          vLinkGenVarSectionGroupRef = ProgConditionSection
        MagicFlag (vLinkGenVarSectionGroup):
          vLinkGenVarSectionGroupPosition = 0
          vLinkGenVarSectionGroupInit = NONE
          vLinkGenVarSectionGroupInitStage = ONE
          vLinkGenVarSectionGroupAlignment = 16
          vLinkGenVarSectionGroupFlag = vLinkGenVarGroupFlags/ORDERED
          vLinkGenVarSectionGroupFlag = vLinkGenVarGroupFlags/CONTIGUOUS
          vLinkGenVarSectionGroupFlag = vLinkGenVarGroupFlags/FILL
          vLinkGenVarSectionGroupFlag = vLinkGenVarGroupFlags/READ
          vLinkGenVarSectionGroupFlag = vLinkGenVarGroupFlags/WRITE
          vLinkGenVarSectionGroupRef = MagicFlagSection
      SharedData_vHsm (vLinkGenLogicalVarGroup): vLinkGenVarGroupPosition=5, vLinkGenVarGroupRegion=RegionBlock_0_LMU0_vHsm_Shared
        vHsmIpcMemory (vLinkGenVarSectionGroup):
          vLinkGenVarSectionGroupPosition = 0
          vLinkGenVarSectionGroupInit = NONE
          vLinkGenVarSectionGroupInitStage = ONE
          vLinkGenVarSectionGroupAlignment = 16
          vLinkGenVarSectionGroupFlag = vLinkGenVarGroupFlags/ORDERED
          vLinkGenVarSectionGroupFlag = vLinkGenVarGroupFlags/CONTIGUOUS
          vLinkGenVarSectionGroupFlag = vLinkGenVarGroupFlags/FILL
          vLinkGenVarSectionGroupFlag = vLinkGenVarGroupFlags/READ
          vLinkGenVarSectionGroupFlag = vLinkGenVarGroupFlags/WRITE
          vLinkGenVarSectionGroupRef = vLinkGenLinkerSections/vHsmIpcMemory
        vHsmGlobalRamBuffer (vLinkGenVarSectionGroup):
          vLinkGenVarSectionGroupPosition = 100
          vLinkGenVarSectionGroupInit = NONE
          vLinkGenVarSectionGroupInitStage = ONE
          vLinkGenVarSectionGroupAlignment = 16
          vLinkGenVarSectionGroupFlag = vLinkGenVarGroupFlags/ORDERED
          vLinkGenVarSectionGroupFlag = vLinkGenVarGroupFlags/CONTIGUOUS
          vLinkGenVarSectionGroupFlag = vLinkGenVarGroupFlags/FILL
          vLinkGenVarSectionGroupFlag = vLinkGenVarGroupFlags/READ
          vLinkGenVarSectionGroupFlag = vLinkGenVarGroupFlags/WRITE
          vLinkGenVarSectionGroupRef = vLinkGenLinkerSections/vHsmGlobalRamBuffer
      FblSW_Versions (vLinkGenLogicalConstGroup): vLinkGenConstGroupPosition=5, vLinkGenConstGroupRegion=FblRom_SW_Versions
        FblSW_Versions (vLinkGenConstSectionGroup):
          vLinkGenConstSectionGroupPosition = 0
          vLinkGenConstSectionGroupInit = NONE
          vLinkGenConstSectionGroupInitStage = ONE
          vLinkGenConstSectionGroupFlag = vLinkGenConstGroupFlags/ORDERED
          vLinkGenConstSectionGroupFlag = vLinkGenConstGroupFlags/CONTIGUOUS
          vLinkGenConstSectionGroupFlag = vLinkGenConstGroupFlags/FILL
          vLinkGenConstSectionGroupFlag = vLinkGenConstGroupFlags/READ
          vLinkGenConstSectionGroupFlag = vLinkGenConstGroupFlags/EXECUTE
          vLinkGenConstSectionGroupRef = vLinkGenLinkerSections/FblSW_Versions
    vLinkGenGeneral: vLinkGenEntrySymbol=brsStartupEntry, vLinkGenFileGeneration=STANDARD
    vLinkGenPublishedInformation: vLinkGenDefaultVarGroupAlignment=16, vLinkGenGeneration=2, vLinkGenDuplicatedLabels=false
      vLinkGenRegionBlockFlags
        RESERVED (vLinkGenRegionBlockFlag)
      vLinkGenConstGroupFlags
        7 x vLinkGenConstGroupFlag:
          ORDERED
          CONTIGUOUS
          FILL
          NOCOPY
          EXECUTE
          READ
          WRITE
      vLinkGenConstSectionFlags
        KEEP (vLinkGenConstSectionFlag)
      vLinkGenVarGroupFlags
        7 x vLinkGenVarGroupFlag:
          ORDERED
          CONTIGUOUS
          FILL
          NOCOPY
          EXECUTE
          READ
          WRITE
      vLinkGenVarSectionFlags
        KEEP (vLinkGenVarSectionFlag)
      vLinkGenLogicalConstGroupFlags
        FORCE_ZERO_OFFSET (vLinkGenLogicalConstGroupFlag)
      vLinkGenLogicalVarGroupFlags
        FORCE_ZERO_OFFSET (vLinkGenLogicalVarGroupFlag)
    vLinkGenContentTypes
      15 x vLinkGenConstContentType:
        GLOBAL_CODE: vLinkGenConstContentTypeLocal=false
        LOCAL_CODE: vLinkGenConstContentTypeLocal=true
        GLOBAL_CONST: vLinkGenConstContentTypeLocal=false
        LOCAL_CONST: vLinkGenConstContentTypeLocal=true
        GLOBAL_EXCVEC_CODE: vLinkGenConstContentTypeLocal=false
        LOCAL_EXCVEC_CODE: vLinkGenConstContentTypeLocal=true
        GLOBAL_EXCVEC_CONST: vLinkGenConstContentTypeLocal=true
        LOCAL_EXCVEC_CONST: vLinkGenConstContentTypeLocal=true
        GLOBAL_INTVEC_CODE: vLinkGenConstContentTypeLocal=false
        LOCAL_INTVEC_CODE: vLinkGenConstContentTypeLocal=true
        GLOBAL_INTVEC_CONST: vLinkGenConstContentTypeLocal=false
        LOCAL_INTVEC_CONST: vLinkGenConstContentTypeLocal=true
        STARTUP_CODE: vLinkGenConstContentTypeLocal=false
        RAM_CODE: vLinkGenConstContentTypeLocal=false
        RAM_CONST: vLinkGenConstContentTypeLocal=false
      8 x vLinkGenVarContentType:
        GLOBAL_DATA: vLinkGenVarContentTypeLocal=false
        LOCAL_DATA: vLinkGenVarContentTypeLocal=true
        RETENTION_DATA: vLinkGenVarContentTypeLocal=false
        STARTUP_STACK: vLinkGenVarContentTypeLocal=true
        STACKS: vLinkGenVarContentTypeLocal=true
        RAM_CODE_COPY: vLinkGenVarContentTypeLocal=false
        RAM_CONST_COPY: vLinkGenVarContentTypeLocal=false
        SHARED_DATA: vLinkGenVarContentTypeLocal=false
