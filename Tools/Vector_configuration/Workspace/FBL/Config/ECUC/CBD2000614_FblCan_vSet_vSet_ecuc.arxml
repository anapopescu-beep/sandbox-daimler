AUTOSAR XML (schema 4-3-0)
package /ActiveEcuC
  module config vSet: implementation-config-variant=VARIANT-PRE-COMPILE, module-description=vSet_Impl
    vSetCalibration
    vSetGeneral: vSetDummyStatementKind=None
    vSetPlatform:
      vSetByteOrder = LITTLE_ENDIAN
      vSetSizeOfRAMPointer = Size32Bit
      vSetSizeOfROMPointer = Size32Bit
      vSetSizeOfEnum = Size32Bit
      vSetSizeOfInt = Size32Bit
      vSetCPUType = CPU32Bit
      vSetBitOrder = LSB_to_MSB
    vSetBswInitialization
      44 x vSetInitFunction:
        CanIf_Init: vSetHeader=CanIf.h, vSetConfigType=CanIf_ConfigType, vSetConfigPtrClass=CANIF_INIT_DATA, vSetModuleRef=CanIf  # /ActiveEcuC/CanIf PLAIN_TEXT Init function description of CanIf in PostBuildPredefinedVariantView (RBTM_FL) .
          vSetInitFunctionInstance:
            vSetInitPhase = INIT_TWO_IF
            vSetConfigPtrName = CanIf_Config_RBTM_FL_Ptr if post-build-variant-condition{matching-criterion=Side, value=0}
            vSetConfigPtrName = CanIf_Config_RBTM_FR_Ptr if post-build-variant-condition{matching-criterion=Side, value=1}
        CanIf_InitMemory: vSetHeader=CanIf.h, vSetModuleRef=CanIf  # /ActiveEcuC/CanIf PLAIN_TEXT InitMemory function description of CanIf in PostBuildPredefinedVariantView (RBTM_FL) .
          vSetInitFunctionInstance: vSetInitPhase=INIT_MEMORY
        CanSM_Init: vSetHeader=CanSM_EcuM.h, vSetConfigType=CanSM_ConfigType, vSetConfigPtrClass=CANSM_INIT_DATA, vSetModuleRef=CanSM  # /ActiveEcuC/CanSM PLAIN_TEXT Init function description of CanSM in PostBuildPredefinedVariantView (RBTM_FL) .
          vSetInitFunctionInstance:
            vSetInitPhase = INIT_TWO_SM
            vSetConfigPtrName = CanSM_Config_RBTM_FL_Ptr if post-build-variant-condition{matching-criterion=Side, value=0}
            vSetConfigPtrName = CanSM_Config_RBTM_FR_Ptr if post-build-variant-condition{matching-criterion=Side, value=1}
        CanSM_InitMemory: vSetHeader=CanSM_EcuM.h, vSetModuleRef=CanSM  # /ActiveEcuC/CanSM PLAIN_TEXT InitMemory function description of CanSM in PostBuildPredefinedVariantView (RBTM_FL) .
          vSetInitFunctionInstance: vSetInitPhase=INIT_MEMORY
        CanTp_InitMemory: vSetHeader=CanTp.h, vSetModuleRef=CanTp  # /ActiveEcuC/CanTp PLAIN_TEXT InitMemory function description of CanTp in PostBuildPredefinedVariantView (RBTM_FL) .
          vSetInitFunctionInstance: vSetInitPhase=INIT_MEMORY
        CanTp_Init: vSetHeader=CanTp.h, vSetConfigType=CanTp_ConfigType, vSetConfigPtrClass=CANTP_INIT_DATA, vSetModuleRef=CanTp  # /ActiveEcuC/CanTp PLAIN_TEXT Init function description of CanTp in PostBuildPredefinedVariantView (RBTM_FL) .
          vSetInitFunctionInstance:
            vSetInitPhase = INIT_TWO_TP
            vSetConfigPtrName = CanTp_Config_RBTM_FL_Ptr if post-build-variant-condition{matching-criterion=Side, value=0}
            vSetConfigPtrName = CanTp_Config_RBTM_FR_Ptr if post-build-variant-condition{matching-criterion=Side, value=1}
        Can_Init: vSetHeader=Can.h, vSetConfigType=Can_ConfigType, vSetConfigPtrClass=CAN_INIT_DATA, vSetModuleRef=Can  # /ActiveEcuC/Can PLAIN_TEXT Init function description of Can in PostBuildPredefinedVariantView (RBTM_FL) .
          vSetInitFunctionInstance:
            vSetInitPhase = INIT_TWO_DRV
            vSetConfigPtrName = Can_Config_RBTM_FL_Ptr if post-build-variant-condition{matching-criterion=Side, value=0}
            vSetConfigPtrName = Can_Config_RBTM_FR_Ptr if post-build-variant-condition{matching-criterion=Side, value=1}
        Can_InitMemory: vSetHeader=Can.h, vSetModuleRef=Can  # /ActiveEcuC/Can PLAIN_TEXT InitMemory function description of Can in PostBuildPredefinedVariantView (RBTM_FL) .
          vSetInitFunctionInstance: vSetInitPhase=INIT_MEMORY
        ComM_PostInit: vSetHeader=ComM.h, vSetModuleRef=ComM  # /ActiveEcuC/ComM PLAIN_TEXT Post-Initialization of the ComM and its internal state machine
          vSetInitFunctionInstance: vSetInitPhase=INIT_THREE
        ComM_PreInit: vSetHeader=ComM.h, vSetConfigType=ComM_ConfigType, vSetConfigPtrClass=COMM_INIT_DATA, vSetModuleRef=ComM  # /ActiveEcuC/ComM PLAIN_TEXT PreInit function description of ComM in PostBuildPredefinedVariantView (RBTM_FL) .
          vSetInitFunctionInstance:
            vSetInitPhase = INIT_ONE
            vSetConfigPtrName = ComM_Config_RBTM_FL_Ptr if post-build-variant-condition{matching-criterion=Side, value=0}
            vSetConfigPtrName = ComM_Config_RBTM_FR_Ptr if post-build-variant-condition{matching-criterion=Side, value=1}
        ComM_InitMemory: vSetHeader=ComM.h, vSetModuleRef=ComM  # /ActiveEcuC/ComM PLAIN_TEXT InitMemory function description of ComM in PostBuildPredefinedVariantView (RBTM_FL) .
          vSetInitFunctionInstance: vSetInitPhase=INIT_MEMORY
        ComM_Init: vSetHeader=ComM.h, vSetConfigType=ComM_ConfigType, vSetConfigPtrClass=COMM_INIT_DATA, vSetModuleRef=ComM  # /ActiveEcuC/ComM PLAIN_TEXT Init function description of ComM in PostBuildPredefinedVariantView (RBTM_FL) .
          vSetInitFunctionInstance:
            vSetInitPhase = INIT_TWO_POST_NVMREADALL
            vSetConfigPtrName = ComM_Config_RBTM_FL_Ptr if post-build-variant-condition{matching-criterion=Side, value=0}
            vSetConfigPtrName = ComM_Config_RBTM_FR_Ptr if post-build-variant-condition{matching-criterion=Side, value=1}
        CryIf_InitMemory: vSetHeader=CryIf.h, vSetModuleRef=CryIf  # /ActiveEcuC/CryIf PLAIN_TEXT Initializes variables of the Crypto Interface
          vSetInitFunctionInstance: vSetInitPhase=INIT_MEMORY
        CryIf_Init: vSetHeader=CryIf.h, vSetModuleRef=CryIf  # /ActiveEcuC/CryIf PLAIN_TEXT Initializes the Crypto Interface
          vSetInitFunctionInstance: vSetInitPhase=INIT_TWO_IF
        Crypto_30_LibCv_Init: vSetHeader=Crypto_30_LibCv.h, vSetModuleRef=Crypto  # /ActiveEcuC/Crypto PLAIN_TEXT Initializes the Crypto Driver
          vSetInitFunctionInstance: vSetInitPhase=INIT_TWO_DRV
        Crypto_30_LibCv_InitMemory: vSetHeader=Crypto_30_LibCv.h, vSetModuleRef=Crypto  # /ActiveEcuC/Crypto PLAIN_TEXT Initializes variables of the Crypto Driver
          vSetInitFunctionInstance: vSetInitPhase=INIT_MEMORY
        Crypto_30_vHsm_Init: vSetHeader=Crypto_30_vHsm.h, vSetModuleRef=Crypto_vHsm  # /ActiveEcuC/Crypto_vHsm PLAIN_TEXT Initializes the Crypto Driver
          vSetInitFunctionInstance: vSetInitPhase=INIT_TWO_DRV
        Crypto_30_vHsm_InitMemory: vSetHeader=Crypto_30_vHsm.h, vSetModuleRef=Crypto_vHsm  # /ActiveEcuC/Crypto_vHsm PLAIN_TEXT Initializes variables of the Crypto Interface
          vSetInitFunctionInstance: vSetInitPhase=INIT_MEMORY
        Csm_Init: vSetHeader=Csm.h, vSetModuleRef=Csm  # /ActiveEcuC/Csm PLAIN_TEXT Initializes the Crypto Service Manager
          vSetInitFunctionInstance: vSetInitPhase=INIT_TWO_SYS
        Csm_InitMemory: vSetHeader=Csm.h, vSetModuleRef=Csm  # /ActiveEcuC/Csm PLAIN_TEXT Initializes variables of the Crypto Service Manager
          vSetInitFunctionInstance: vSetInitPhase=INIT_MEMORY
        FblCw_Init: vSetHeader=fbl_inc.h, vSetConfigType=FblCw_ConfigType, vSetConfigPtrClass=FBLCW_INIT_DATA, vSetModuleRef=Dcm  # /ActiveEcuC/Dcm PLAIN_TEXT Init function description of FblCw in PostBuildPredefinedVariantView (RBTM_FL) .
          vSetInitFunctionInstance:
            vSetInitPhase = INIT_THREE
            vSetConfigPtrName = FblCw_Config_RBTM_FL_Ptr if post-build-variant-condition{matching-criterion=Side, value=0}
            vSetConfigPtrName = FblCw_Config_RBTM_FR_Ptr if post-build-variant-condition{matching-criterion=Side, value=1}
        FblCw_InitMemory: vSetHeader=fbl_inc.h, vSetModuleRef=Dcm  # /ActiveEcuC/Dcm PLAIN_TEXT InitMemory function description of FblCw in PostBuildPredefinedVariantView (RBTM_FL) .
          vSetInitFunctionInstance: vSetInitPhase=INIT_MEMORY
        Det_InitMemory: vSetHeader=Det.h, vSetModuleRef=Det  # /ActiveEcuC/Det PLAIN_TEXT InitMemory function description of Det in PostBuildInvariantValuesModelView (PostBuildInvariantValuesModelView) .
          vSetInitFunctionInstance: vSetInitPhase=INIT_MEMORY
        Det_Init: vSetHeader=Det.h, vSetConfigType=Det_ConfigType, vSetConfigPtrClass=DET_INIT_DATA, vSetModuleRef=Det  # /ActiveEcuC/Det PLAIN_TEXT Init function description of Det in PostBuildInvariantValuesModelView (PostBuildInvariantValuesModelView) .
          vSetInitFunctionInstance: vSetInitPhase=INIT_ZERO, vSetConfigPtrName=Det_Config_Ptr
        Dio_Init: vSetHeader=Dio.h, vSetModuleRef=Dio  # /Dio/Dio PLAIN_TEXT Created Dio_Init by Extended Init XML Service
          vSetInitFunctionInstance: vSetInitPhase=NO_INIT
        Dma_Init: vSetHeader=Dma.h, vSetConfigType=Dma_ConfigType, vSetConfigPtrClass=AUTOMATIC, vSetModuleRef=Dma  # /ActiveEcuC/Dma PLAIN_TEXT Created Dma_Init by Extended Init XML Service
          vSetInitFunctionInstance: vSetInitPhase=INIT_ONE, vSetConfigPtrName=&Dma_Config
        Fls_17_Dmu_Init: vSetHeader=Fls_17_Dmu.h, vSetConfigType=Fls_17_Dmu_ConfigType, vSetConfigPtrClass=AUTOMATIC, vSetModuleRef=Fls  # /Fls/Fls PLAIN_TEXT Created Fls_17_Dmu_Init by Extended Init XML Service
          vSetInitFunctionInstance: vSetInitPhase=INIT_ONE, vSetConfigPtrName=&Fls_17_Dmu_Config
        McalLib_Init: vSetHeader=McalLib.h, vSetModuleRef=McalLib  # /McalLib/McalLib PLAIN_TEXT Created McalLib_Init by Extended Init XML Service
          vSetInitFunctionInstance: vSetInitPhase=NO_INIT
        Mcu_Init: vSetHeader=Mcu.h, vSetConfigType=Mcu_ConfigType, vSetConfigPtrClass=AUTOMATIC, vSetModuleRef=Mcu  # /Mcu/Mcu PLAIN_TEXT Created Mcu_Init by Extended Init XML Service
          vSetInitFunctionInstance:
            vSetInitPhase = INIT_ONE_EARLY
            vSetConfigPtrName = &Mcu_Config
            vSetAdditionalInitCode = Mcu_InitClock(0);while (MCU_PLL_LOCKED != Mcu_GetPllStatus());Mcu_DistributePllClock();
        PduR_PreInit: vSetHeader=PduR.h, vSetConfigType=PduR_PBConfigType, vSetConfigPtrClass=PDUR_INIT_DATA, vSetModuleRef=PduR  # /ActiveEcuC/PduR PLAIN_TEXT PreInit function description of PduR in PostBuildPredefinedVariantView (RBTM_FL) .
          vSetInitFunctionInstance:
            vSetInitPhase = INIT_ONE
            vSetConfigPtrName = PduR_Config_RBTM_FL_Ptr if post-build-variant-condition{matching-criterion=Side, value=0}
            vSetConfigPtrName = PduR_Config_RBTM_FR_Ptr if post-build-variant-condition{matching-criterion=Side, value=1}
        PduR_Init: vSetHeader=PduR.h, vSetConfigType=PduR_PBConfigType, vSetConfigPtrClass=PDUR_INIT_DATA, vSetModuleRef=PduR  # /ActiveEcuC/PduR PLAIN_TEXT Init function description of PduR in PostBuildPredefinedVariantView (RBTM_FL) .
          vSetInitFunctionInstance:
            vSetInitPhase = INIT_TWO_COM
            vSetConfigPtrName = PduR_Config_RBTM_FL_Ptr if post-build-variant-condition{matching-criterion=Side, value=0}
            vSetConfigPtrName = PduR_Config_RBTM_FR_Ptr if post-build-variant-condition{matching-criterion=Side, value=1}
        PduR_InitMemory: vSetHeader=PduR.h, vSetModuleRef=PduR  # /ActiveEcuC/PduR PLAIN_TEXT InitMemory function description of PduR in PostBuildPredefinedVariantView (RBTM_FL) .
          vSetInitFunctionInstance: vSetInitPhase=INIT_MEMORY
        Port_Init: vSetHeader=Port.h, vSetConfigType=Port_ConfigType, vSetConfigPtrClass=AUTOMATIC, vSetModuleRef=Port  # /Port/Port PLAIN_TEXT Created Port_Init by Extended Init XML Service
          vSetInitFunctionInstance: vSetInitPhase=INIT_ONE_EARLY, vSetConfigPtrName=&Port_Config
        ResourceM_Init: vSetHeader=ResourceM.h, vSetModuleRef=ResourceM  # /ResourceM/ResourceM PLAIN_TEXT Created ResourceM_Init by Extended Init XML Service
          vSetInitFunctionInstance: vSetInitPhase=NO_INIT
        Spi_Init: vSetHeader=Spi.h, vSetConfigType=Spi_ConfigType, vSetConfigPtrClass=AUTOMATIC, vSetModuleRef=Spi  # /ActiveEcuC/Spi PLAIN_TEXT Created Spi_Init by Extended Init XML Service
          vSetInitFunctionInstance: vSetInitPhase=INIT_ONE, vSetConfigPtrName=&Spi_Config
        WrapNv_Init: vSetHeader=WrapNv.h, vSetModuleRef=WrapNv  # /ActiveEcuC/WrapNv PLAIN_TEXT WrapNv_Init function description
          vSetInitFunctionInstance: vSetInitPhase=INIT_TWO_SYS
        Brs_Init: vSetHeader=, vSetModuleRef=vBRS  # /ActiveEcuC/vBRS PLAIN_TEXT Automatically generated by BswInitFctConfigurationService.
          vSetInitFunctionInstance: vSetInitPhase=NO_INIT
        vBaseEnv_Init: vSetHeader=, vSetModuleRef=vBaseEnv  # /ActiveEcuC/vBaseEnv PLAIN_TEXT Created vBaseEnv_Init by Extended Init XML Service
          vSetInitFunctionInstance: vSetInitPhase=NO_INIT
        vLinkGen_Init: vSetHeader=vLinkGen_Lcfg.h, vSetModuleRef=vLinkGen  # /ActiveEcuC/vLinkGen PLAIN_TEXT Dummy initialization of the vLinkGen
          vSetInitFunctionInstance: vSetInitPhase=NO_INIT
        vMemAccM_Init: vSetHeader=vMemAccM.h, vSetModuleRef=vMemAccM  # /ActiveEcuC/vMemAccM PLAIN_TEXT Initializes the vMemAccM.
          vSetInitFunctionInstance: vSetInitPhase=INIT_TWO_DRV
        vMemAccM_InitMemory: vSetHeader=vMemAccM.h, vSetModuleRef=vMemAccM  # /ActiveEcuC/vMemAccM PLAIN_TEXT Initializes all *_INIT_* section variables within the vMemAccM.
          vSetInitFunctionInstance: vSetInitPhase=INIT_MEMORY
        SecM_Init: vSetHeader=Sec.h, vSetModuleRef=Smh  # /ActiveEcuC/Smh PLAIN_TEXT SecM_Init function description
          vSetInitFunctionInstance: vSetInitPhase=INIT_TWO_SYS
        Fee_Init: vSetHeader=Fee.h, vSetConfigType=Fee_ConfigType, vSetConfigPtrClass=AUTOMATIC, vSetModuleRef=Fee, variation-point=post-build-variant-condition{matching-criterion=Side, value=0}  # /ActiveEcuC/Fee PLAIN_TEXT Created Fee_Init by Extended Init XML Service
          vSetInitFunctionInstance: vSetInitPhase=INIT_ONE_LATE, vSetConfigPtrName=&Fee_Config
        Fee_Init: vSetHeader=Fee.h, vSetConfigType=Fee_ConfigType, vSetConfigPtrClass=AUTOMATIC, vSetModuleRef=Fee, variation-point=post-build-variant-condition{matching-criterion=Side, value=1}  # /ActiveEcuC/Fee PLAIN_TEXT Created Fee_Init by Extended Init XML Service
          vSetInitFunctionInstance: vSetInitPhase=INIT_ONE_LATE, vSetConfigPtrName=&Fee_Config
