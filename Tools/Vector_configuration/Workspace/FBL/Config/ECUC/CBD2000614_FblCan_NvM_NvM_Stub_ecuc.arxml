AUTOSAR XML (schema 4-3-0)
package /ActiveEcuC
  module config NvM_Stub: definition=NvM, implementation-config-variant=VARIANT-PRE-COMPILE
    NvMCommon:
      NvMApiConfigClass = NVM_API_CONFIG_CLASS_3
      NvMBswMMultiBlockJobStatusInformation = true
      NvMCompiledConfigId = 1
      NvMCrcNumOfBytes = 2
      NvMDatasetSelectionBits = 2
      NvMDevErrorDetect = true
      NvMDrvModeSwitch = false
      NvMDynamicConfiguration = false
      NvMJobPrioritization = false
      NvMPollingMode = false
      NvMRepeatMirrorOperations = 0
      NvMSetRamBlockStatusApi = false
      NvMSizeStandardJobQueue = 1
      NvMVersionInfoApi = false
    6 x NvMBlockDescriptor, all with NvMBlockJobPriority=0, NvMBlockUseSyncMechanism=false, NvMBlockWriteProt=false, NvMBswMBlockStatusInformation=false, NvMMaxNumOfReadRetries=0, NvMNvBlockBaseNumber=1, NvMNvramBlockIdentifier=2, NvMNvramDeviceId=0, NvMResistantToChangedSw=false, NvMRomBlockNum=0, NvMStaticBlockIDCheck=false, NvMWriteBlockOnce=false, NvMWriteVerification=false, NvMWriteVerificationDataSize=1:
      NvMBlockDescriptor_SecAccessDelayFlag: NvMBlockManagementType=NVM_BLOCK_NATIVE, NvMBlockUseCrc=false, NvMMaxNumOfWriteRetries=0, NvMNvBlockLength=1, NvMNvBlockNum=1, NvMCalcRamBlockCrc=false
        NvMTargetBlockReference
          NvMFeeRef: NvMNameOfFeeBlock=FeeBlockDescriptor_SecAccessDelayFlag
      NvMBlockDescriptor_FblMetaData: NvMBlockManagementType=NVM_BLOCK_DATASET, NvMBlockUseCrc=false, NvMMaxNumOfWriteRetries=0, NvMNvBlockLength=145, NvMNvBlockNum=3, NvMCalcRamBlockCrc=false, NvMBlockCrcType=NVM_CRC16
        NvMTargetBlockReference
          NvMFeeRef: NvMNameOfFeeBlock=FeeBlockDescriptor_FblMetaData
      NvMBlockDescriptor_VerificationKey: NvMBlockManagementType=NVM_BLOCK_NATIVE, NvMBlockUseCrc=false, NvMMaxNumOfWriteRetries=0, NvMNvBlockLength=33, NvMNvBlockNum=1, NvMCalcRamBlockCrc=false
        NvMTargetBlockReference
          NvMFeeRef: NvMNameOfFeeBlock=FeeBlockDescriptor_VerificationKey
      NvMBlockDescriptor_IDEcuLocation: NvMBlockManagementType=NVM_BLOCK_NATIVE, NvMBlockUseCrc=true, NvMMaxNumOfWriteRetries=1, NvMNvBlockLength=3, NvMNvBlockNum=1, NvMCalcRamBlockCrc=false, NvMBlockCrcType=NVM_CRC16
        NvMTargetBlockReference
          NvMFeeRef: NvMNameOfFeeBlock=Fee_NVP_BLOCK_ID_ECU_LOCATION
      NVP_BLOCK_ID_HW_VERSION: NvMBlockManagementType=NVM_BLOCK_NATIVE, NvMBlockUseCrc=true, NvMMaxNumOfWriteRetries=0, NvMNvBlockLength=3, NvMNvBlockNum=1, NvMCalcRamBlockCrc=false, NvMBlockCrcType=NVM_CRC16
        NvMTargetBlockReference
          NvMFeeRef: NvMNameOfFeeBlock=FeeNVP_BLOCK_ID_HW_VERSION
      NVP_BLOCK_ID_HW_PARTNUMBER: NvMBlockManagementType=NVM_BLOCK_NATIVE, NvMBlockUseCrc=true, NvMMaxNumOfWriteRetries=0, NvMNvBlockLength=20, NvMNvBlockNum=1, NvMBlockCrcType=NVM_CRC16
        NvMTargetBlockReference
          NvMFeeRef: NvMNameOfFeeBlock=FeeNVP_BLOCK_ID_HW_PARTNUMBER
