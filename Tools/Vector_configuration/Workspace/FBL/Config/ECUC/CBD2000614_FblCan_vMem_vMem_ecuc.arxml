AUTOSAR XML (schema 4-3-0)
package /ActiveEcuC
  module config vMem: implementation-config-variant=VARIANT-PRE-COMPILE, module-description=vMem_Impl
    vMemInstance: vMemInstanceId=0
      vMemSectorList
        6 x vMemSector, all with vMemPageSize=32, vMemSectorSize=16384:
          PF0_S2_Appl: vMemNumberOfSectors=37, vMemStartAddress=2684796928
          PF0_S1_FBL: vMemNumberOfSectors=9, vMemStartAddress=2684649472
          PF0_S0_HSM_BM: vMemNumberOfSectors=17, vMemStartAddress=2684354560
          PF2__S0_HSM_BM: vMemNumberOfSectors=16, vMemStartAddress=2690646016
          PF2_S1_FBL: vMemNumberOfSectors=9, vMemStartAddress=2690908160
          PF2_S2_Appl: vMemNumberOfSectors=39, vMemStartAddress=2691055616
    vMemInstanceMapping: vMemvMemInstanceRef=vMemInstance, vMemFblMemoryDeviceRef=Flash
    vMemGeneral: vMemUseIsBlank=false, vMemUserMainFunction=false, vMemUserInitFunction=false, vMemCompareAfterWrite=false, vMemInitHandling=ALL_DRIVERS_MANDATORY
