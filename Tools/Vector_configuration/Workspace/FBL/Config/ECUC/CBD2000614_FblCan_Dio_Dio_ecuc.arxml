AUTOSAR XML (schema 4-3-0)
package /Dio
  module config Dio: implementation-config-variant=VARIANT-LINK-TIME, module-description=Dio_Impl
    CommonPublishedInformation:
      ArMajorVersion = 4
      ArMinorVersion = 4
      ArPatchVersion = 0
      ModuleId = 120
      Release = _TRICORE_TC332
      SwMajorVersion = 20
      SwMinorVersion = 0
      SwPatchVersion = 1
      VendorId = 17
    DioConfig
      4 x DioPort:
        DioPort_0: DioPortId=33
          4 x DioChannel:
            DioChannel_1: DioChannelId=6
            DioChannel_2: DioChannelId=7
            DioChannel_LED: DioChannelId=4
            STB2: DioChannelId=10
          DioChannelGroup_LED (DioChannelGroup): DioChannelGroupIdentification=DioChGrpId_P33_0, DioPortMask=224, DioPortOffset=5
        DioPort_1: DioPortId=20
          TRB_LED (DioChannel): DioChannelId=11
        DioPort_2: DioPortId=2
          OCU_CHANNEL_PIN (DioChannel): DioChannelId=5
        DioPort_3: DioPortId=10
          STB (DioChannel): DioChannelId=6
    DioGeneral: DioDevErrorDetect=true, DioFlipChannelApi=true, DioMaskedWritePortApi=false, DioSafetyEnable=true, DioVersionInfoApi=false
