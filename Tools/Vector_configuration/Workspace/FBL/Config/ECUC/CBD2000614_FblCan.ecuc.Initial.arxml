[part 2 of 2: package /InitialEcuC]
AUTOSAR XML (schema 4-3-0)
package /InitialEcuC  (continued)
  module config ComM
    ComMConfigSet: ComMPncEnabled=true
      RBTM_FL_BODY3_8uqv9blm85ehm0msat385m76v_03d5f5f6 (ComMChannel):
        ComMBusType = COMM_BUS_TYPE_CAN
        ComMChannelId = 0
        ComMPncGatewayType = COMM_GATEWAY_TYPE_NONE
        variation-point = post-build-variant-condition{matching-criterion=Side, value=0}
        ComMNetworkManagement: ComMNmVariant=FULL
        RBTM_FL_BODY3_8uqv9blm85ehm0msat385m76v_f6dc70ca (ComMUserPerChannel): ComMUserChannel=RBTM_FL_BODY3_8uqv9blm85ehm0msat385m76v_a4eabb6e
      PNC_00_MAPPING_b2c42696 (ComMPnc):
        ComMPncId = 8
        ComMChannelPerPnc = ComMConfigSet/RBTM_FL_BODY3_8uqv9blm85ehm0msat385m76v_03d5f5f6 if post-build-variant-condition{matching-criterion=Side, value=0}
        ComMUserPerPnc = PNC_00_MAPPING_60241c9f
        ComMChannelPerPnc = ComMConfigSet/RBTM_FR_BODY3_4xwwtd59665s787n6ctawh7k8_23a94727 if post-build-variant-condition{matching-criterion=Side, value=1}
        3 x ComMPncComSignal, all with ComMPncComSignalKind=EIRA:
          ComSignalPnc_EIRA_CAN_Rx_1e4792f2: ComMPncComSignalDirection=RX, ComMPncComSignalRef=ComSignalPnc_EIRA_CAN_Rx
          NM_RBTM_FL_ST3_PNC_785a2d76_Tx_acd61a18: ComMPncComSignalDirection=TX, ComMPncComSignalChannelRef=ComMConfigSet/RBTM_FL_BODY3_8uqv9blm85ehm0msat385m76v_03d5f5f6, ComMPncComSignalRef=NM_RBTM_FL_ST3_PNC_785a2d76_Tx, variation-point=post-build-variant-condition{matching-criterion=Side, value=0}
          NM_RBTM_FR_ST3_PNC_0103a546_Tx_2e08d951: ComMPncComSignalDirection=TX, ComMPncComSignalChannelRef=ComMConfigSet/RBTM_FR_BODY3_4xwwtd59665s787n6ctawh7k8_23a94727, ComMPncComSignalRef=NM_RBTM_FR_ST3_PNC_0103a546_Tx, variation-point=post-build-variant-condition{matching-criterion=Side, value=1}
      PNC_20_MAPPING_796df885 (ComMPnc):
        ComMPncId = 28
        ComMChannelPerPnc = ComMConfigSet/RBTM_FL_BODY3_8uqv9blm85ehm0msat385m76v_03d5f5f6 if post-build-variant-condition{matching-criterion=Side, value=0}
        ComMUserPerPnc = PNC_20_MAPPING_4fe27ecf
        ComMChannelPerPnc = ComMConfigSet/RBTM_FR_BODY3_4xwwtd59665s787n6ctawh7k8_23a94727 if post-build-variant-condition{matching-criterion=Side, value=1}
        3 x ComMPncComSignal, all with ComMPncComSignalKind=EIRA:
          ComSignalPnc_EIRA_CAN_Rx_1e4792f2: ComMPncComSignalDirection=RX, ComMPncComSignalRef=ComSignalPnc_EIRA_CAN_Rx
          NM_RBTM_FL_ST3_PNC_785a2d76_Tx_acd61a18: ComMPncComSignalDirection=TX, ComMPncComSignalChannelRef=ComMConfigSet/RBTM_FL_BODY3_8uqv9blm85ehm0msat385m76v_03d5f5f6, ComMPncComSignalRef=NM_RBTM_FL_ST3_PNC_785a2d76_Tx, variation-point=post-build-variant-condition{matching-criterion=Side, value=0}
          NM_RBTM_FR_ST3_PNC_0103a546_Tx_2e08d951: ComMPncComSignalDirection=TX, ComMPncComSignalChannelRef=ComMConfigSet/RBTM_FR_BODY3_4xwwtd59665s787n6ctawh7k8_23a94727, ComMPncComSignalRef=NM_RBTM_FR_ST3_PNC_0103a546_Tx, variation-point=post-build-variant-condition{matching-criterion=Side, value=1}
      3 x ComMUser:
        PNC_00_MAPPING_60241c9f: ComMUserIdentifier=1
        PNC_20_MAPPING_4fe27ecf: ComMUserIdentifier=2
        RBTM_FL_BODY3_8uqv9blm85ehm0msat385m76v_a4eabb6e: ComMUserIdentifier=0, variation-point=post-build-variant-condition{matching-criterion=Side, value=0}
      RBTM_FR_BODY3_4xwwtd59665s787n6ctawh7k8_23a94727 (ComMChannel):
        ComMBusType = COMM_BUS_TYPE_CAN
        ComMChannelId = 0
        ComMPncGatewayType = COMM_GATEWAY_TYPE_NONE
        variation-point = post-build-variant-condition{matching-criterion=Side, value=1}
        ComMNetworkManagement: ComMNmVariant=FULL
        RBTM_FR_BODY3_4xwwtd59665s787n6ctawh7k8_dbac4b95 (ComMUserPerChannel): ComMUserChannel=RBTM_FR_BODY3_4xwwtd59665s787n6ctawh7k8_1f2180a7
      RBTM_FR_BODY3_4xwwtd59665s787n6ctawh7k8_1f2180a7 (ComMUser): ComMUserIdentifier=0, variation-point=post-build-variant-condition{matching-criterion=Side, value=1}
    ComMGeneral: ComMPncGatewayEnabled=false, ComMPncIdCounting=COMM_PNC_ID_COUNT_FROM_NM_MESSAGE, ComMPncPrepareSleepTimer=1.3, ComMPncSupport=true
  module config Dcm
    DcmConfigSet
      DcmDsl
        DcmDslProtocol
          DcmDslProtocolRow_29812fbf (DcmDslProtocolRow)
            6 x DcmDslConnection:
              DIAG_RBTM_FL_03_ExtCAN_RQ_BODY3_ST3_DIAG_RBTM_FL_03_ExtCAN_RS_BODY3_ST3_2f852a42: variation-point=post-build-variant-condition{matching-criterion=Side, value=0}
                DIAG_RBTM_FL_03_ExtCAN_RQ_BODY3_ST3_DIAG_RBTM_FL_03_ExtCAN_RS_BODY3_ST3_2f852a42 (DcmDslMainConnection): DcmDslProtocolRxTesterSourceAddr=3833
                  SDU_DIAG_GLOBAL_ExtCAN_RQ_BODY3_ST3_18e7f235_Rx_2b322367 (DcmDslProtocolRx):
                    DcmDslProtocolRxAddrType = DCM_FUNCTIONAL_TYPE
                    DcmDslProtocolRxPduId = 1
                    DcmDslProtocolRxComMChannelRef = ComMConfigSet/RBTM_FL_BODY3_8uqv9blm85ehm0msat385m76v_03d5f5f6
                    DcmDslProtocolRxPduRef = SDU_DIAG_GLOBAL_ExtCAN_RQ_BODY3_ST3_18e7f235_Rx
                  SDU_DIAG_RBTM_FL_03_ExtCAN_RQ_BODY3_ST3_ec0e6e12_Rx_2873db84 (DcmDslProtocolRx):
                    DcmDslProtocolRxAddrType = DCM_PHYSICAL_TYPE
                    DcmDslProtocolRxPduId = 2
                    DcmDslProtocolRxComMChannelRef = ComMConfigSet/RBTM_FL_BODY3_8uqv9blm85ehm0msat385m76v_03d5f5f6
                    DcmDslProtocolRxPduRef = SDU_DIAG_RBTM_FL_03_ExtCAN_RQ_BODY3_ST3_ec0e6e12_Rx
                  SDU_DIAG_RBTM_FL_03_ExtCAN_RS_BODY3_ST3_b462d7d3_Tx_70f6d2b0 (DcmDslProtocolTx): DcmDslTxConfirmationPduId=0, DcmDslProtocolTxPduRef=EcucPduCollection/SDU_DIAG_RBTM_FL_03_ExtCAN_RS_BODY3_ST3_b462d7d3_Tx
              DIAG_RBTM_FL_03_ExtEth_RQ_BODY3_ST3_DIAG_RBTM_FL_03_ExtEth_RS_BODY3_ST3_816f6eb3: variation-point=post-build-variant-condition{matching-criterion=Side, value=0}
                DIAG_RBTM_FL_03_ExtEth_RQ_BODY3_ST3_DIAG_RBTM_FL_03_ExtEth_RS_BODY3_ST3_816f6eb3 (DcmDslMainConnection): DcmDslProtocolRxTesterSourceAddr=3832
                  SDU_DIAG_GLOBAL_ExtEth_RQ_BODY3_ST3_81f0b7e5_Rx_d414628a (DcmDslProtocolRx):
                    DcmDslProtocolRxAddrType = DCM_FUNCTIONAL_TYPE
                    DcmDslProtocolRxPduId = 4
                    DcmDslProtocolRxComMChannelRef = ComMConfigSet/RBTM_FL_BODY3_8uqv9blm85ehm0msat385m76v_03d5f5f6
                    DcmDslProtocolRxPduRef = SDU_DIAG_GLOBAL_ExtEth_RQ_BODY3_ST3_81f0b7e5_Rx
                  SDU_DIAG_RBTM_FL_03_ExtEth_RQ_BODY3_ST3_75192bc2_Rx_5a27dd11 (DcmDslProtocolRx):
                    DcmDslProtocolRxAddrType = DCM_PHYSICAL_TYPE
                    DcmDslProtocolRxPduId = 5
                    DcmDslProtocolRxComMChannelRef = ComMConfigSet/RBTM_FL_BODY3_8uqv9blm85ehm0msat385m76v_03d5f5f6
                    DcmDslProtocolRxPduRef = SDU_DIAG_RBTM_FL_03_ExtEth_RQ_BODY3_ST3_75192bc2_Rx
                  SDU_DIAG_RBTM_FL_03_ExtEth_RS_BODY3_ST3_2d759203_Tx_2b590afc (DcmDslProtocolTx): DcmDslTxConfirmationPduId=3, DcmDslProtocolTxPduRef=EcucPduCollection/SDU_DIAG_RBTM_FL_03_ExtEth_RS_BODY3_ST3_2d759203_Tx
              DIAG_RBTM_FL_03_IntEth_RQ_BODY3_ST3_DIAG_RBTM_FL_03_IntEth_RS_BODY3_ST3_1d9ca21c: variation-point=post-build-variant-condition{matching-criterion=Side, value=0}
                DIAG_RBTM_FL_03_IntEth_RQ_BODY3_ST3_DIAG_RBTM_FL_03_IntEth_RS_BODY3_ST3_1d9ca21c (DcmDslMainConnection): DcmDslProtocolRxTesterSourceAddr=3853
                  SDU_DIAG_GLOBAL_IntEth_RQ_BODY3_ST3_41e6471f_Rx_c0cc433b (DcmDslProtocolRx):
                    DcmDslProtocolRxAddrType = DCM_FUNCTIONAL_TYPE
                    DcmDslProtocolRxPduId = 7
                    DcmDslProtocolRxComMChannelRef = ComMConfigSet/RBTM_FL_BODY3_8uqv9blm85ehm0msat385m76v_03d5f5f6
                    DcmDslProtocolRxPduRef = SDU_DIAG_GLOBAL_IntEth_RQ_BODY3_ST3_41e6471f_Rx
                  SDU_DIAG_RBTM_FL_03_IntEth_RQ_BODY3_ST3_b50fdb38_Rx_6a163982 (DcmDslProtocolRx):
                    DcmDslProtocolRxAddrType = DCM_PHYSICAL_TYPE
                    DcmDslProtocolRxPduId = 8
                    DcmDslProtocolRxComMChannelRef = ComMConfigSet/RBTM_FL_BODY3_8uqv9blm85ehm0msat385m76v_03d5f5f6
                    DcmDslProtocolRxPduRef = SDU_DIAG_RBTM_FL_03_IntEth_RQ_BODY3_ST3_b50fdb38_Rx
                  SDU_DIAG_RBTM_FL_03_IntEth_RS_BODY3_ST3_ed6362f9_Tx_3060e687 (DcmDslProtocolTx): DcmDslTxConfirmationPduId=6, DcmDslProtocolTxPduRef=EcucPduCollection/SDU_DIAG_RBTM_FL_03_IntEth_RS_BODY3_ST3_ed6362f9_Tx
              DIAG_RBTM_FR_03_ExtCAN_RQ_BODY3_ST3_DIAG_RBTM_FR_03_ExtCAN_RS_BODY3_ST3_1aaead76: variation-point=post-build-variant-condition{matching-criterion=Side, value=1}
                DIAG_RBTM_FR_03_ExtCAN_RQ_BODY3_ST3_DIAG_RBTM_FR_03_ExtCAN_RS_BODY3_ST3_1aaead76 (DcmDslMainConnection): DcmDslProtocolRxTesterSourceAddr=3833
                  SDU_DIAG_GLOBAL_ExtCAN_RQ_BODY3_ST3_18e7f235_Rx_2b322367 (DcmDslProtocolRx):
                    DcmDslProtocolRxAddrType = DCM_FUNCTIONAL_TYPE
                    DcmDslProtocolRxPduId = 1
                    DcmDslProtocolRxComMChannelRef = ComMConfigSet/RBTM_FR_BODY3_4xwwtd59665s787n6ctawh7k8_23a94727
                    DcmDslProtocolRxPduRef = SDU_DIAG_GLOBAL_ExtCAN_RQ_BODY3_ST3_18e7f235_Rx
                  SDU_DIAG_RBTM_FR_03_ExtCAN_RQ_BODY3_ST3_f1557fc1_Rx_3b6533a8 (DcmDslProtocolRx):
                    DcmDslProtocolRxAddrType = DCM_PHYSICAL_TYPE
                    DcmDslProtocolRxPduId = 2
                    DcmDslProtocolRxComMChannelRef = ComMConfigSet/RBTM_FR_BODY3_4xwwtd59665s787n6ctawh7k8_23a94727
                    DcmDslProtocolRxPduRef = SDU_DIAG_RBTM_FR_03_ExtCAN_RQ_BODY3_ST3_f1557fc1_Rx
                  SDU_DIAG_RBTM_FR_03_ExtCAN_RS_BODY3_ST3_a939c600_Tx_82eb6958 (DcmDslProtocolTx): DcmDslTxConfirmationPduId=0, DcmDslProtocolTxPduRef=EcucPduCollection/SDU_DIAG_RBTM_FR_03_ExtCAN_RS_BODY3_ST3_a939c600_Tx
              DIAG_RBTM_FR_03_ExtEth_RQ_BODY3_ST3_DIAG_RBTM_FR_03_ExtEth_RS_BODY3_ST3_b444e987: variation-point=post-build-variant-condition{matching-criterion=Side, value=1}
                DIAG_RBTM_FR_03_ExtEth_RQ_BODY3_ST3_DIAG_RBTM_FR_03_ExtEth_RS_BODY3_ST3_b444e987 (DcmDslMainConnection): DcmDslProtocolRxTesterSourceAddr=3832
                  SDU_DIAG_GLOBAL_ExtEth_RQ_BODY3_ST3_81f0b7e5_Rx_d414628a (DcmDslProtocolRx):
                    DcmDslProtocolRxAddrType = DCM_FUNCTIONAL_TYPE
                    DcmDslProtocolRxPduId = 4
                    DcmDslProtocolRxComMChannelRef = ComMConfigSet/RBTM_FR_BODY3_4xwwtd59665s787n6ctawh7k8_23a94727
                    DcmDslProtocolRxPduRef = SDU_DIAG_GLOBAL_ExtEth_RQ_BODY3_ST3_81f0b7e5_Rx
                  SDU_DIAG_RBTM_FR_03_ExtEth_RQ_BODY3_ST3_68423a11_Rx_510ebea9 (DcmDslProtocolRx):
                    DcmDslProtocolRxAddrType = DCM_PHYSICAL_TYPE
                    DcmDslProtocolRxPduId = 5
                    DcmDslProtocolRxComMChannelRef = ComMConfigSet/RBTM_FR_BODY3_4xwwtd59665s787n6ctawh7k8_23a94727
                    DcmDslProtocolRxPduRef = SDU_DIAG_RBTM_FR_03_ExtEth_RQ_BODY3_ST3_68423a11_Rx
                  SDU_DIAG_RBTM_FR_03_ExtEth_RS_BODY3_ST3_302e83d0_Tx_afb57ffd (DcmDslProtocolTx): DcmDslTxConfirmationPduId=3, DcmDslProtocolTxPduRef=EcucPduCollection/SDU_DIAG_RBTM_FR_03_ExtEth_RS_BODY3_ST3_302e83d0_Tx
              DIAG_RBTM_FR_03_IntEth_RQ_BODY3_ST3_DIAG_RBTM_FR_03_IntEth_RS_BODY3_ST3_28b72528: variation-point=post-build-variant-condition{matching-criterion=Side, value=1}
                DIAG_RBTM_FR_03_IntEth_RQ_BODY3_ST3_DIAG_RBTM_FR_03_IntEth_RS_BODY3_ST3_28b72528 (DcmDslMainConnection): DcmDslProtocolRxTesterSourceAddr=3853
                  SDU_DIAG_GLOBAL_IntEth_RQ_BODY3_ST3_41e6471f_Rx_c0cc433b (DcmDslProtocolRx):
                    DcmDslProtocolRxAddrType = DCM_FUNCTIONAL_TYPE
                    DcmDslProtocolRxPduId = 7
                    DcmDslProtocolRxComMChannelRef = ComMConfigSet/RBTM_FR_BODY3_4xwwtd59665s787n6ctawh7k8_23a94727
                    DcmDslProtocolRxPduRef = SDU_DIAG_GLOBAL_IntEth_RQ_BODY3_ST3_41e6471f_Rx
                  SDU_DIAG_RBTM_FR_03_IntEth_RQ_BODY3_ST3_a854caeb_Rx_536fd8c4 (DcmDslProtocolRx):
                    DcmDslProtocolRxAddrType = DCM_PHYSICAL_TYPE
                    DcmDslProtocolRxPduId = 8
                    DcmDslProtocolRxComMChannelRef = ComMConfigSet/RBTM_FR_BODY3_4xwwtd59665s787n6ctawh7k8_23a94727
                    DcmDslProtocolRxPduRef = SDU_DIAG_RBTM_FR_03_IntEth_RQ_BODY3_ST3_a854caeb_Rx
                  SDU_DIAG_RBTM_FR_03_IntEth_RS_BODY3_ST3_f038732a_Tx_f8a04d74 (DcmDslProtocolTx): DcmDslTxConfirmationPduId=6, DcmDslProtocolTxPduRef=EcucPduCollection/SDU_DIAG_RBTM_FR_03_IntEth_RS_BODY3_ST3_f038732a_Tx
  module config EcuC
    EcucPduCollection: PduIdTypeEnum=UINT8, PduLengthTypeEnum=UINT16
      161 x Pdu:
        ADAS_POSITION_ST3_0b61d436_Rx: DynamicLength=false, PduLength=8
        ADAS_POSITION_ST3_1ca04d74_Rx: DynamicLength=false, PduLength=8, SysTPduToFrameMappingRef=ADAS_POSITION_ST3
        ADAS_PREDICTION_ST3_1de136c9_Rx: DynamicLength=false, PduLength=8, SysTPduToFrameMappingRef=ADAS_PREDICTION_ST3
        ADAS_PREDICTION_ST3_549e2a63_Rx: DynamicLength=false, PduLength=8
        ADAS_PREDICTION_ST3_6_262b63d1_Rx: DynamicLength=false, PduLength=8
        ADAS_PREDICTION_ST3_7_512c5347_Rx: DynamicLength=false, PduLength=8
        ADAS_PROFILE_SHORT_ST3_1_506b5dfc_Rx: DynamicLength=false, PduLength=8
        ADAS_PROFILE_SHORT_ST3_2225c4a7_Rx: DynamicLength=false, PduLength=8
        ADAS_PROFILE_SHORT_ST3_31_05b1585f_Rx: DynamicLength=false, PduLength=8
        ADAS_PROFILE_SHORT_ST3_894b8265_Rx: DynamicLength=false, PduLength=8, SysTPduToFrameMappingRef=ADAS_PROFILE_SHORT_ST3
        Bckl_Sw_Fx_Stat_ST3_9c2de10c_Rx: DynamicLength=false, PduLength=4
        Bckl_Sw_Fx_Stat_ST3_secured_62272d37_Rx: DynamicLength=false, PduLength=8, SysTPduToFrameMappingRef=Bckl_Sw_Fx_Stat_ST3
        Bckl_Sw_Fx_Stat_ST3_secured_b672d5e7_Rx: DynamicLength=false, PduLength=8
        BeltAdj_FL_Stat_ST3_71e5093a_Tx: DynamicLength=false, PduLength=1, SysTPduToFrameMappingRef=BeltAdj_FL_Stat_ST3, variation-point=post-build-variant-condition{matching-criterion=Side, value=0}
        BeltAdj_FL_Stat_ST3_d2ce0dbb_Tx: DynamicLength=false, PduLength=1, variation-point=post-build-variant-condition{matching-criterion=Side, value=0}
        BeltAdj_FR_Stat_ST3_2b5906f9_Rx: DynamicLength=false, PduLength=1, SysTPduToFrameMappingRef=BeltAdj_FR_Stat_ST3, variation-point=post-build-variant-condition{matching-criterion=Side, value=0}
        BeltAdj_FR_Stat_ST3_eba9bce0_Rx: DynamicLength=false, PduLength=1, variation-point=post-build-variant-condition{matching-criterion=Side, value=0}
        BeltAdj_UI_Set_Rq_ST3_1223a83d_Rx: DynamicLength=false, PduLength=1
        BeltAdj_UI_Set_Rq_ST3_7be22993_Rx: DynamicLength=false, PduLength=1, SysTPduToFrameMappingRef=BeltAdj_UI_Set_Rq_ST3
        BeltHdOvr_FL_State_ST3_0b4fb3a9_Rx: DynamicLength=false, PduLength=4, SysTPduToFrameMappingRef=BeltHdOvr_FL_State_ST3, variation-point=post-build-variant-condition{matching-criterion=Side, value=0}
        BeltHdOvr_FL_State_ST3_342163b7_Rx: DynamicLength=false, PduLength=4, variation-point=post-build-variant-condition{matching-criterion=Side, value=0}
        CLkS_Dr_State_ST3_513e9c19_Rx: DynamicLength=false, PduLength=8
        CLkS_Dr_State_ST3_74337ed5_Rx: DynamicLength=false, PduLength=8, SysTPduToFrameMappingRef=CLkS_Dr_State_ST3
        DIAG_RBTM_FL_03_ExtCAN_RQ_ST3_3f957a34_Rx: DynamicLength=false, PduLength=8, SysTPduToFrameMappingRef=DIAG_RBTM_FL_03_ExtCAN_RQ_ST3, variation-point=post-build-variant-condition{matching-criterion=Side, value=0}
        DIAG_RBTM_FL_03_ExtCAN_RS_ST3_ba6d58fb_Tx: DynamicLength=false, PduLength=8, SysTPduToFrameMappingRef=DIAG_RBTM_FL_03_ExtCAN_RS_ST3, variation-point=post-build-variant-condition{matching-criterion=Side, value=0}
        DIAG_RBTM_FL_03_ExtEth_RQ_ST3_8e910fe6_Rx: DynamicLength=false, PduLength=8, SysTPduToFrameMappingRef=DIAG_RBTM_FL_03_ExtEth_RQ_ST3, variation-point=post-build-variant-condition{matching-criterion=Side, value=0}
        DIAG_RBTM_FL_03_ExtEth_RS_ST3_0b692d29_Tx: DynamicLength=false, PduLength=8, SysTPduToFrameMappingRef=DIAG_RBTM_FL_03_ExtEth_RS_ST3, variation-point=post-build-variant-condition{matching-criterion=Side, value=0}
        DIAG_RBTM_FL_03_IntEth_RQ_ST3_c3ea483d_Rx: DynamicLength=false, PduLength=8, SysTPduToFrameMappingRef=DIAG_RBTM_FL_03_IntEth_RQ_ST3, variation-point=post-build-variant-condition{matching-criterion=Side, value=0}
        DIAG_RBTM_FL_03_IntEth_RS_ST3_46126af2_Tx: DynamicLength=false, PduLength=8, SysTPduToFrameMappingRef=DIAG_RBTM_FL_03_IntEth_RS_ST3, variation-point=post-build-variant-condition{matching-criterion=Side, value=0}
        DIAG_RQ_GLOBAL_ExtCAN_ST3_320b5155_Rx: DynamicLength=false, PduLength=8, SysTPduToFrameMappingRef=DIAG_RQ_GLOBAL_ExtCAN_ST3
        DIAG_RQ_GLOBAL_ExtEth_ST3_3402b191_Rx: DynamicLength=false, PduLength=8, SysTPduToFrameMappingRef=DIAG_RQ_GLOBAL_ExtEth_ST3
        DIAG_RQ_GLOBAL_IntEth_ST3_f8cf566a_Rx: DynamicLength=false, PduLength=8, SysTPduToFrameMappingRef=DIAG_RQ_GLOBAL_IntEth_ST3
        DIAG_Stat_ST3_3a031d4a_Rx: DynamicLength=false, PduLength=4
        DIAG_Stat_ST3_d3ec8369_Rx: DynamicLength=false, PduLength=4, SysTPduToFrameMappingRef=DIAG_Stat_ST3
        DI_OdoSpeedometer_ST3_0665a232_Rx: DynamicLength=false, PduLength=8, SysTPduToFrameMappingRef=DI_OdoSpeedometer_ST3
        DI_OdoSpeedometer_ST3_6fef7507_Rx: DynamicLength=false, PduLength=8
        DPC_Md_Rq_ESP_d1_ST3_5573a8b2_Rx: DynamicLength=false, PduLength=1, SysTPduToFrameMappingRef=DPC_Md_Rq_ESP_d1_ST3
        DPC_Md_Rq_ESP_d1_ST3_e30f951d_Rx: DynamicLength=false, PduLength=1
        Develop8_Rq_RBTM_FL_ST3_0a7cffe6_Rx: DynamicLength=false, PduLength=8, SysTPduToFrameMappingRef=Develop8_Rq_RBTM_FL_ST3, variation-point=post-build-variant-condition{matching-criterion=Side, value=0}
        Develop8_Rq_RBTM_FL_ST3_fa67f89a_Rx: DynamicLength=false, PduLength=8, variation-point=post-build-variant-condition{matching-criterion=Side, value=0}
        Develop8_Rs_RBTM_FL_ST3_711f265e_Tx: DynamicLength=false, PduLength=8, SysTPduToFrameMappingRef=Develop8_Rs_RBTM_FL_ST3, variation-point=post-build-variant-condition{matching-criterion=Side, value=0}
        Develop8_Rs_RBTM_FL_ST3_9a3b4dd1_Tx: DynamicLength=false, PduLength=8, variation-point=post-build-variant-condition{matching-criterion=Side, value=0}
        ECU_Stat_RBTM_FL_ST3_42655720_Tx: DynamicLength=false, PduLength=8, SysTPduToFrameMappingRef=ECU_Stat_RBTM_FL_ST3, variation-point=post-build-variant-condition{matching-criterion=Side, value=0}
        ECU_Stat_RBTM_FL_ST3_f703b6eb_Tx: DynamicLength=false, PduLength=8, variation-point=post-build-variant-condition{matching-criterion=Side, value=0}
        ELC_Lvr_Stat_ST3_d97bab99_Rx: DynamicLength=false, PduLength=4
        ELC_Lvr_Stat_ST3_secured_29d2456c_Rx: DynamicLength=false, PduLength=8, SysTPduToFrameMappingRef=ELC_Lvr_Stat_ST3
        ELC_Lvr_Stat_ST3_secured_7bad7996_Rx: DynamicLength=false, PduLength=8
        EVC_CfgList_01_08_Pr5_ST3_32c5e6fb_Rx: DynamicLength=false, PduLength=8
        EVC_CfgList_01_08_Pr5_ST3_be03dd9d_Rx: DynamicLength=false, PduLength=8, SysTPduToFrameMappingRef=EVC_CfgList_01_08_Pr5_ST3
        GTS_Main_CAN_ST3_dd88dcd5_Rx: DynamicLength=true, PduLength=8, SysTPduToFrameMappingRef=GTS_Main_CAN_ST3
        Ign_Stat_ST3_1e3dc39f_Rx: DynamicLength=false, PduLength=4
        Ign_Stat_ST3_secured_87afaf29_Rx: DynamicLength=false, PduLength=8
        Ign_Stat_ST3_secured_fb0d4f19_Rx: DynamicLength=false, PduLength=8, SysTPduToFrameMappingRef=Ign_Stat_ST3
        Impact2_ST3_e5526ccc_Rx: DynamicLength=false, PduLength=4
        Impact2_ST3_secured_2ba32448_Rx: DynamicLength=false, PduLength=8
        Impact2_ST3_secured_de133629_Rx: DynamicLength=false, PduLength=8, SysTPduToFrameMappingRef=Impact2_ST3
        Impact3_ST3_993f4b56_Rx: DynamicLength=false, PduLength=4, SysTPduToFrameMappingRef=Impact3_ST3
        Impact3_ST3_d832457c_Rx: DynamicLength=false, PduLength=4
        Meas8_RBTM_FL_ST3_a92f14da_Tx: DynamicLength=false, PduLength=8, variation-point=post-build-variant-condition{matching-criterion=Side, value=0}
        Meas8_RBTM_FL_ST3_b4f3e350_Tx: DynamicLength=false, PduLength=8, SysTPduToFrameMappingRef=Meas8_RBTM_FL_ST3, variation-point=post-build-variant-condition{matching-criterion=Side, value=0}
        NM_RBTM_FL_ST3_0cdf2d0f_Tx: PduLength=7, variation-point=post-build-variant-condition{matching-criterion=Side, value=0}
        NM_RBTM_FL_ST3_b7c99fb7_Tx: DynamicLength=false, PduLength=8, SysTPduToFrameMappingRef=NM_RBTM_FL_ST3, variation-point=post-build-variant-condition{matching-criterion=Side, value=0}
        NTG_Master_Navi_ST3_1032e485_Rx: DynamicLength=false, PduLength=2, SysTPduToFrameMappingRef=NTG_Master_Navi_ST3
        NTG_Master_Navi_ST3_dea580a6_Rx: DynamicLength=false, PduLength=2
        PN14_Master_Stat1_ST3_69644078_Rx: DynamicLength=false, PduLength=8, SysTPduToFrameMappingRef=PN14_Master_Stat1_ST3
        PN14_Master_Stat1_ST3_eba3e383_Rx: DynamicLength=false, PduLength=8
        PT4_PTCoor4_ST3_868ca7d3_Rx: DynamicLength=false, PduLength=4, SysTPduToFrameMappingRef=PT4_PTCoor4_ST3
        PT4_PTCoor4_ST3_bf069154_Rx: DynamicLength=false, PduLength=4
        PT4_PTCoor9_d1_BC_F_ST3_da786b84_Rx: DynamicLength=false, PduLength=1
        PT4_PTCoor9_d1_BC_F_ST3_f2a4ec1b_Rx: DynamicLength=false, PduLength=1, SysTPduToFrameMappingRef=PT4_PTCoor9_d1_BC_F_ST3
        PT4_PTCoor_DrvPosn_Gear_ST3_6b508375_Rx: DynamicLength=false, PduLength=8
        PT4_PTCoor_DrvPosn_Gear_ST3_f70358bf_Rx: DynamicLength=false, PduLength=8, SysTPduToFrameMappingRef=PT4_PTCoor_DrvPosn_Gear_ST3
        PduPnc_EIRA_CAN_Rx: PduLength=7
        PresfAct_Adj_ST3_61c58c91_Rx: DynamicLength=false, PduLength=8
        PresfAct_Adj_ST3_81976f17_Rx: DynamicLength=false, PduLength=8, SysTPduToFrameMappingRef=PresfAct_Adj_ST3
        RBTM_FL_BODY3NMNODE_34236992_Rx: PduLength=8, SysTPduToFrameMappingRef=NM_Dummy_ST3, variation-point=post-build-variant-condition{matching-criterion=Side, value=0}
        RBTM_FL_Stat_ST3_d76d14af_Tx: DynamicLength=false, PduLength=8, SysTPduToFrameMappingRef=RBTM_FL_Stat_ST3, variation-point=post-build-variant-condition{matching-criterion=Side, value=0}
        RBTM_FL_Stat_ST3_dd2436a1_Tx: DynamicLength=false, PduLength=8, variation-point=post-build-variant-condition{matching-criterion=Side, value=0}
        RBTM_FL_Tens_ST3_49d8a970_Tx: DynamicLength=false, PduLength=8, SysTPduToFrameMappingRef=RBTM_FL_Tens_ST3, variation-point=post-build-variant-condition{matching-criterion=Side, value=0}
        RBTM_FL_Tens_ST3_553ec607_Tx: DynamicLength=false, PduLength=8, variation-point=post-build-variant-condition{matching-criterion=Side, value=0}
        RBTM_FR_Stat_ST3_8dd11b6c_Rx: DynamicLength=false, PduLength=8, SysTPduToFrameMappingRef=RBTM_FR_Stat_ST3, variation-point=post-build-variant-condition{matching-criterion=Side, value=0}
        RBTM_FR_Stat_ST3_e44387fa_Rx: DynamicLength=false, PduLength=8, variation-point=post-build-variant-condition{matching-criterion=Side, value=0}
        ROE_RBTM_FL_ST3_75ad963a_Tx: DynamicLength=false, PduLength=8, SysTPduToFrameMappingRef=ROE_RBTM_FL_ST3, variation-point=post-build-variant-condition{matching-criterion=Side, value=0}
        ROE_RBTM_FL_ST3_a66ccb5f_Tx: DynamicLength=false, PduLength=8, variation-point=post-build-variant-condition{matching-criterion=Side, value=0}
        SBeltTens_SP_Lvl_ST3_46421e11_Rx: DynamicLength=false, PduLength=8
        SBeltTens_SP_Lvl_ST3_73b20851_Rx: DynamicLength=false, PduLength=8, SysTPduToFrameMappingRef=SBeltTens_SP_Lvl_ST3
        SDU_DIAG_GLOBAL_ExtCAN_RQ_BODY3_ST3_18e7f235_Rx: DynamicLength=true, PduLength=7
        SDU_DIAG_GLOBAL_ExtCAN_RQ_BODY3_ST3_1d96a036_Rx: DynamicLength=true, PduLength=7
        SDU_DIAG_GLOBAL_ExtEth_RQ_BODY3_ST3_38ac71dd_Rx: DynamicLength=true, PduLength=7
        SDU_DIAG_GLOBAL_ExtEth_RQ_BODY3_ST3_81f0b7e5_Rx: DynamicLength=true, PduLength=7
        SDU_DIAG_GLOBAL_IntEth_RQ_BODY3_ST3_41e6471f_Rx: DynamicLength=true, PduLength=7
        SDU_DIAG_GLOBAL_IntEth_RQ_BODY3_ST3_6efa2066_Rx: DynamicLength=true, PduLength=7
        SDU_DIAG_RBTM_FL_03_ExtCAN_RQ_BODY3_ST3_6d2a29a5_Rx: DynamicLength=true, PduLength=4095, variation-point=post-build-variant-condition{matching-criterion=Side, value=0}
        SDU_DIAG_RBTM_FL_03_ExtCAN_RQ_BODY3_ST3_ec0e6e12_Rx: DynamicLength=true, PduLength=4095, variation-point=post-build-variant-condition{matching-criterion=Side, value=0}
        SDU_DIAG_RBTM_FL_03_ExtCAN_RS_BODY3_ST3_92b91e83_Tx: DynamicLength=true, PduLength=4095, variation-point=post-build-variant-condition{matching-criterion=Side, value=0}
        SDU_DIAG_RBTM_FL_03_ExtCAN_RS_BODY3_ST3_b462d7d3_Tx: DynamicLength=true, PduLength=4095, variation-point=post-build-variant-condition{matching-criterion=Side, value=0}
        SDU_DIAG_RBTM_FL_03_ExtEth_RQ_BODY3_ST3_4810f84e_Rx: DynamicLength=true, PduLength=4095, variation-point=post-build-variant-condition{matching-criterion=Side, value=0}
        SDU_DIAG_RBTM_FL_03_ExtEth_RQ_BODY3_ST3_75192bc2_Rx: DynamicLength=true, PduLength=4095, variation-point=post-build-variant-condition{matching-criterion=Side, value=0}
        SDU_DIAG_RBTM_FL_03_ExtEth_RS_BODY3_ST3_2d759203_Tx: DynamicLength=true, PduLength=4095, variation-point=post-build-variant-condition{matching-criterion=Side, value=0}
        SDU_DIAG_RBTM_FL_03_ExtEth_RS_BODY3_ST3_b783cf68_Tx: DynamicLength=true, PduLength=4095, variation-point=post-build-variant-condition{matching-criterion=Side, value=0}
        SDU_DIAG_RBTM_FL_03_IntEth_RQ_BODY3_ST3_1e46a9f5_Rx: DynamicLength=true, PduLength=4095, variation-point=post-build-variant-condition{matching-criterion=Side, value=0}
        SDU_DIAG_RBTM_FL_03_IntEth_RQ_BODY3_ST3_b50fdb38_Rx: DynamicLength=true, PduLength=4095, variation-point=post-build-variant-condition{matching-criterion=Side, value=0}
        SDU_DIAG_RBTM_FL_03_IntEth_RS_BODY3_ST3_e1d59ed3_Tx: DynamicLength=true, PduLength=4095, variation-point=post-build-variant-condition{matching-criterion=Side, value=0}
        SDU_DIAG_RBTM_FL_03_IntEth_RS_BODY3_ST3_ed6362f9_Tx: DynamicLength=true, PduLength=4095, variation-point=post-build-variant-condition{matching-criterion=Side, value=0}
        VSS_TP_Auth_ST3_29a0d419_Rx: DynamicLength=false, PduLength=8, SysTPduToFrameMappingRef=VSS_TP_Auth_ST3
        VSS_TP_Auth_ST3_7c9f23ce_Rx: DynamicLength=false, PduLength=8
        VSS_TP_RealTmOffset_ST3_62955a84_Rx: DynamicLength=false, PduLength=8
        VSS_TP_RealTmOffset_ST3_d6d134b3_Rx: DynamicLength=false, PduLength=8, SysTPduToFrameMappingRef=VSS_TP_RealTmOffset_ST3
        VSS_TP_SecTickCount_Lvl2_ST3_4917056b_Rx: DynamicLength=false, PduLength=8
        VSS_TP_SecTickCount_Lvl2_ST3_c0c3ca3b_Rx: DynamicLength=false, PduLength=8, SysTPduToFrameMappingRef=VSS_TP_SecTickCount_Lvl2_ST3
        VSS_TP_SharedSecret_ST3_605b0fee_Rx: DynamicLength=false, PduLength=8
        VSS_TP_SharedSecret_ST3_6d7ca724_Rx: DynamicLength=false, PduLength=8, SysTPduToFrameMappingRef=VSS_TP_SharedSecret_ST3
        VSS_TP_VIN_ST3_8e87972a_Rx: DynamicLength=false, PduLength=8
        VSS_TP_VIN_ST3_f7ab6516_Rx: DynamicLength=false, PduLength=8, SysTPduToFrameMappingRef=VSS_TP_VIN_ST3
        XCP8_Rq_RBTM_FL_ST3_480c7aac_Rx: DynamicLength=true, PduLength=8, SysTPduToFrameMappingRef=XCP8_Rq_RBTM_FL_ST3, variation-point=post-build-variant-condition{matching-criterion=Side, value=0}
        XCP8_Rs_RBTM_FL_ST3_336fa314_Tx: DynamicLength=true, PduLength=8, SysTPduToFrameMappingRef=XCP8_Rs_RBTM_FL_ST3, variation-point=post-build-variant-condition{matching-criterion=Side, value=0}
        BeltAdj_FL_Stat_ST3_71e5093a_Rx: DynamicLength=false, PduLength=1, SysTPduToFrameMappingRef=BeltAdj_FL_Stat_ST3, variation-point=post-build-variant-condition{matching-criterion=Side, value=1}
        BeltAdj_FL_Stat_ST3_d2ce0dbb_Rx: DynamicLength=false, PduLength=1, variation-point=post-build-variant-condition{matching-criterion=Side, value=1}
        BeltAdj_FR_Stat_ST3_2b5906f9_Tx: DynamicLength=false, PduLength=1, SysTPduToFrameMappingRef=BeltAdj_FR_Stat_ST3, variation-point=post-build-variant-condition{matching-criterion=Side, value=1}
        BeltAdj_FR_Stat_ST3_eba9bce0_Tx: DynamicLength=false, PduLength=1, variation-point=post-build-variant-condition{matching-criterion=Side, value=1}
        BeltHdOvr_FR_State_ST3_09789cac_Rx: DynamicLength=false, PduLength=4, SysTPduToFrameMappingRef=BeltHdOvr_FR_State_ST3, variation-point=post-build-variant-condition{matching-criterion=Side, value=1}
        BeltHdOvr_FR_State_ST3_c8a18c7a_Rx: DynamicLength=false, PduLength=4, variation-point=post-build-variant-condition{matching-criterion=Side, value=1}
        DIAG_RBTM_FR_03_ExtCAN_RQ_ST3_225f4e6d_Rx: DynamicLength=false, PduLength=8, SysTPduToFrameMappingRef=DIAG_RBTM_FR_03_ExtCAN_RQ_ST3, variation-point=post-build-variant-condition{matching-criterion=Side, value=1}
        DIAG_RBTM_FR_03_ExtCAN_RS_ST3_a7a76ca2_Tx: DynamicLength=false, PduLength=8, SysTPduToFrameMappingRef=DIAG_RBTM_FR_03_ExtCAN_RS_ST3, variation-point=post-build-variant-condition{matching-criterion=Side, value=1}
        DIAG_RBTM_FR_03_ExtEth_RQ_ST3_935b3bbf_Rx: DynamicLength=false, PduLength=8, SysTPduToFrameMappingRef=DIAG_RBTM_FR_03_ExtEth_RQ_ST3, variation-point=post-build-variant-condition{matching-criterion=Side, value=1}
        DIAG_RBTM_FR_03_ExtEth_RS_ST3_16a31970_Tx: DynamicLength=false, PduLength=8, SysTPduToFrameMappingRef=DIAG_RBTM_FR_03_ExtEth_RS_ST3, variation-point=post-build-variant-condition{matching-criterion=Side, value=1}
        DIAG_RBTM_FR_03_IntEth_RQ_ST3_de207c64_Rx: DynamicLength=false, PduLength=8, SysTPduToFrameMappingRef=DIAG_RBTM_FR_03_IntEth_RQ_ST3, variation-point=post-build-variant-condition{matching-criterion=Side, value=1}
        DIAG_RBTM_FR_03_IntEth_RS_ST3_5bd85eab_Tx: DynamicLength=false, PduLength=8, SysTPduToFrameMappingRef=DIAG_RBTM_FR_03_IntEth_RS_ST3, variation-point=post-build-variant-condition{matching-criterion=Side, value=1}
        Develop8_Rq_RBTM_FR_ST3_25b7d179_Rx: DynamicLength=false, PduLength=8, variation-point=post-build-variant-condition{matching-criterion=Side, value=1}
        Develop8_Rq_RBTM_FR_ST3_d1911cf7_Rx: DynamicLength=false, PduLength=8, SysTPduToFrameMappingRef=Develop8_Rq_RBTM_FR_ST3, variation-point=post-build-variant-condition{matching-criterion=Side, value=1}
        Develop8_Rs_RBTM_FR_ST3_45eb6432_Tx: DynamicLength=false, PduLength=8, variation-point=post-build-variant-condition{matching-criterion=Side, value=1}
        Develop8_Rs_RBTM_FR_ST3_aaf2c54f_Tx: DynamicLength=false, PduLength=8, SysTPduToFrameMappingRef=Develop8_Rs_RBTM_FR_ST3, variation-point=post-build-variant-condition{matching-criterion=Side, value=1}
        ECU_Stat_RBTM_FR_ST3_28d39f08_Tx: DynamicLength=false, PduLength=8, variation-point=post-build-variant-condition{matching-criterion=Side, value=1}
        ECU_Stat_RBTM_FR_ST3_9988b431_Tx: DynamicLength=false, PduLength=8, SysTPduToFrameMappingRef=ECU_Stat_RBTM_FR_ST3, variation-point=post-build-variant-condition{matching-criterion=Side, value=1}
        Meas8_RBTM_FR_ST3_6f1e0041_Tx: DynamicLength=false, PduLength=8, SysTPduToFrameMappingRef=Meas8_RBTM_FR_ST3, variation-point=post-build-variant-condition{matching-criterion=Side, value=1}
        Meas8_RBTM_FR_ST3_76ff3d39_Tx: DynamicLength=false, PduLength=8, variation-point=post-build-variant-condition{matching-criterion=Side, value=1}
        NM_RBTM_FR_ST3_6c247ca6_Tx: DynamicLength=false, PduLength=8, SysTPduToFrameMappingRef=NM_RBTM_FR_ST3, variation-point=post-build-variant-condition{matching-criterion=Side, value=1}
        NM_RBTM_FR_ST3_d30f04ec_Tx: PduLength=7, variation-point=post-build-variant-condition{matching-criterion=Side, value=1}
        RBTM_FL_Stat_ST3_d76d14af_Rx: DynamicLength=false, PduLength=8, SysTPduToFrameMappingRef=RBTM_FL_Stat_ST3, variation-point=post-build-variant-condition{matching-criterion=Side, value=1}
        RBTM_FL_Stat_ST3_dd2436a1_Rx: DynamicLength=false, PduLength=8, variation-point=post-build-variant-condition{matching-criterion=Side, value=1}
        RBTM_FR_BODY3NMNODE_e285a2b9_Rx: PduLength=8, SysTPduToFrameMappingRef=NM_Dummy_ST3, variation-point=post-build-variant-condition{matching-criterion=Side, value=1}
        RBTM_FR_Stat_ST3_8dd11b6c_Tx: DynamicLength=false, PduLength=8, SysTPduToFrameMappingRef=RBTM_FR_Stat_ST3, variation-point=post-build-variant-condition{matching-criterion=Side, value=1}
        RBTM_FR_Stat_ST3_e44387fa_Tx: DynamicLength=false, PduLength=8, variation-point=post-build-variant-condition{matching-criterion=Side, value=1}
        RBTM_FR_Tens_ST3_1364a6b3_Tx: DynamicLength=false, PduLength=8, SysTPduToFrameMappingRef=RBTM_FR_Tens_ST3, variation-point=post-build-variant-condition{matching-criterion=Side, value=1}
        RBTM_FR_Tens_ST3_6c59775c_Tx: DynamicLength=false, PduLength=8, variation-point=post-build-variant-condition{matching-criterion=Side, value=1}
        ROE_RBTM_FR_ST3_79bce2bc_Tx: DynamicLength=false, PduLength=8, variation-point=post-build-variant-condition{matching-criterion=Side, value=1}
        ROE_RBTM_FR_ST3_ae40752b_Tx: DynamicLength=false, PduLength=8, SysTPduToFrameMappingRef=ROE_RBTM_FR_ST3, variation-point=post-build-variant-condition{matching-criterion=Side, value=1}
        SDU_DIAG_RBTM_FR_03_ExtCAN_RQ_BODY3_ST3_1f04509d_Rx: DynamicLength=true, PduLength=4095, variation-point=post-build-variant-condition{matching-criterion=Side, value=1}
        SDU_DIAG_RBTM_FR_03_ExtCAN_RQ_BODY3_ST3_f1557fc1_Rx: DynamicLength=true, PduLength=4095, variation-point=post-build-variant-condition{matching-criterion=Side, value=1}
        SDU_DIAG_RBTM_FR_03_ExtCAN_RS_BODY3_ST3_a939c600_Tx: DynamicLength=true, PduLength=4095, variation-point=post-build-variant-condition{matching-criterion=Side, value=1}
        SDU_DIAG_RBTM_FR_03_ExtCAN_RS_BODY3_ST3_e09767bb_Tx: DynamicLength=true, PduLength=4095, variation-point=post-build-variant-condition{matching-criterion=Side, value=1}
        SDU_DIAG_RBTM_FR_03_ExtEth_RQ_BODY3_ST3_3a3e8176_Rx: DynamicLength=true, PduLength=4095, variation-point=post-build-variant-condition{matching-criterion=Side, value=1}
        SDU_DIAG_RBTM_FR_03_ExtEth_RQ_BODY3_ST3_68423a11_Rx: DynamicLength=true, PduLength=4095, variation-point=post-build-variant-condition{matching-criterion=Side, value=1}
        SDU_DIAG_RBTM_FR_03_ExtEth_RS_BODY3_ST3_302e83d0_Tx: DynamicLength=true, PduLength=4095, variation-point=post-build-variant-condition{matching-criterion=Side, value=1}
        SDU_DIAG_RBTM_FR_03_ExtEth_RS_BODY3_ST3_c5adb650_Tx: DynamicLength=true, PduLength=4095, variation-point=post-build-variant-condition{matching-criterion=Side, value=1}
        SDU_DIAG_RBTM_FR_03_IntEth_RQ_BODY3_ST3_6c68d0cd_Rx: DynamicLength=true, PduLength=4095, variation-point=post-build-variant-condition{matching-criterion=Side, value=1}
        SDU_DIAG_RBTM_FR_03_IntEth_RQ_BODY3_ST3_a854caeb_Rx: DynamicLength=true, PduLength=4095, variation-point=post-build-variant-condition{matching-criterion=Side, value=1}
        SDU_DIAG_RBTM_FR_03_IntEth_RS_BODY3_ST3_93fbe7eb_Tx: DynamicLength=true, PduLength=4095, variation-point=post-build-variant-condition{matching-criterion=Side, value=1}
        SDU_DIAG_RBTM_FR_03_IntEth_RS_BODY3_ST3_f038732a_Tx: DynamicLength=true, PduLength=4095, variation-point=post-build-variant-condition{matching-criterion=Side, value=1}
        XCP8_Rq_RBTM_FR_ST3_93e199bd_Rx: DynamicLength=true, PduLength=8, SysTPduToFrameMappingRef=XCP8_Rq_RBTM_FR_ST3, variation-point=post-build-variant-condition{matching-criterion=Side, value=1}
        XCP8_Rs_RBTM_FR_ST3_e8824005_Tx: DynamicLength=true, PduLength=8, SysTPduToFrameMappingRef=XCP8_Rs_RBTM_FR_ST3, variation-point=post-build-variant-condition{matching-criterion=Side, value=1}
  module config EcuM
    EcuMConfiguration
      EcuMCommonConfiguration
        EcuMDriverInitListOne
        EcuMDriverRestartList
        RBTM_FL_BODY3_8uqv9blm85ehm0msat385m76v_03d5f5f6 (EcuMWakeupSource):
          EcuMWakeupSourceId = 5
          EcuMComMChannelRef = ComMConfigSet/RBTM_FL_BODY3_8uqv9blm85ehm0msat385m76v_03d5f5f6
          variation-point = post-build-variant-condition{matching-criterion=Side, value=0}
        RBTM_FR_BODY3_4xwwtd59665s787n6ctawh7k8_23a94727 (EcuMWakeupSource):
          EcuMWakeupSourceId = 5
          EcuMComMChannelRef = ComMConfigSet/RBTM_FR_BODY3_4xwwtd59665s787n6ctawh7k8_23a94727
          variation-point = post-build-variant-condition{matching-criterion=Side, value=1}
      EcuMFlexConfiguration: EcuMFlexModuleConfigurationRef=CanConfigSet
  module config IpduM
    IpduMConfig
      ADAS_PREDICTION_ST3_549e2a63_Rx (IpduMRxPathway)
        IpduMRxIndication_33e88c66 (IpduMRxIndication): IpduMByteOrder=LITTLE_ENDIAN, IpduMRxIndicationPduRef=EcucPduCollection/ADAS_PREDICTION_ST3_549e2a63_Rx
          ADAS_PREDICTION_ST3_aeaf2bf1 (IpduMRxDynamicPart): IpduMRxSelectorValue=6, IpduMOutgoingDynamicPduRef=EcucPduCollection/ADAS_PREDICTION_ST3_6_262b63d1_Rx
            IpduMSegment_0 (IpduMSegment): IpduMSegmentLength=64, IpduMSegmentPosition=0
          ADAS_PREDICTION_ST3_d9a81b67 (IpduMRxDynamicPart): IpduMRxSelectorValue=7, IpduMOutgoingDynamicPduRef=EcucPduCollection/ADAS_PREDICTION_ST3_7_512c5347_Rx
            IpduMSegment_0 (IpduMSegment): IpduMSegmentLength=64, IpduMSegmentPosition=0
          IpduMSelectorFieldPosition: IpduMSelectorFieldLength=3, IpduMSelectorFieldPosition=0
      ADAS_PROFILE_SHORT_ST3_2225c4a7_Rx (IpduMRxPathway)
        IpduMRxIndication_17ccd7a3 (IpduMRxIndication): IpduMByteOrder=LITTLE_ENDIAN, IpduMRxIndicationPduRef=EcucPduCollection/ADAS_PROFILE_SHORT_ST3_2225c4a7_Rx
          ADAS_PROFILE_SHORT_ST3_01fee412 (IpduMRxDynamicPart): IpduMRxSelectorValue=1, IpduMOutgoingDynamicPduRef=EcucPduCollection/ADAS_PROFILE_SHORT_ST3_1_506b5dfc_Rx
            IpduMSegment_0 (IpduMSegment): IpduMSegmentLength=64, IpduMSegmentPosition=0
          ADAS_PROFILE_SHORT_ST3_42520299 (IpduMRxDynamicPart): IpduMRxSelectorValue=31, IpduMOutgoingDynamicPduRef=EcucPduCollection/ADAS_PROFILE_SHORT_ST3_31_05b1585f_Rx
            IpduMSegment_0 (IpduMSegment): IpduMSegmentLength=64, IpduMSegmentPosition=0
          IpduMSelectorFieldPosition: IpduMSelectorFieldLength=5, IpduMSelectorFieldPosition=27
    IpduMGeneral: IpduMStaticPartExists=false
  module config Nm
    RBTM_FL_BODY3_8uqv9blm85ehm0msat385m76v_03d5f5f6 (NmChannelConfig):
      NmChannelSleepMaster = false
      NmSynchronizingNetwork = false
      NmComMChannelRef = ComMConfigSet/RBTM_FL_BODY3_8uqv9blm85ehm0msat385m76v_03d5f5f6
      variation-point = post-build-variant-condition{matching-criterion=Side, value=0}
      BODY3_8b033453 (NmBusType)
        NmStandardBusNmConfig: NmStandardBusType=NM_BUSNM_CANNM  # BODY3
    NmGlobalConfig
      NmGlobalFeatures:
        NmComControlEnabled = true
        NmComUserDataSupport = true
        NmNodeDetectionEnabled = false
        NmNodeIdEnabled = false
        NmRemoteSleepIndEnabled = true
        NmRepeatMsgIndEnabled = false
        NmUserDataEnabled = false
      NmGlobalProperties
    RBTM_FR_BODY3_4xwwtd59665s787n6ctawh7k8_23a94727 (NmChannelConfig):
      NmChannelSleepMaster = false
      NmSynchronizingNetwork = false
      NmComMChannelRef = ComMConfigSet/RBTM_FR_BODY3_4xwwtd59665s787n6ctawh7k8_23a94727
      variation-point = post-build-variant-condition{matching-criterion=Side, value=1}
      BODY3_8b033453 (NmBusType)
        NmStandardBusNmConfig: NmStandardBusType=NM_BUSNM_CANNM  # BODY3
  module config PduR
    PduRGeneral
    PduRRoutingTables
      PduRRoutingTable
        74 x PduRRoutingPath:
          ADAS_POSITION_ST3_1ca04d74_Rx
            ADAS_POSITION_ST3_1ca04d74_Rx_fa09a036_Rx (PduRDestPdu): PduRDestPduRef=EcucPduCollection/ADAS_POSITION_ST3_0b61d436_Rx
            PduRSrcPdu_fa09a036 (PduRSrcPdu): PduRSrcPduRef=EcucPduCollection/ADAS_POSITION_ST3_1ca04d74_Rx
          ADAS_PREDICTION_ST3_1de136c9_Rx
            ADAS_PREDICTION_ST3_1de136c9_Rx_0518217c_Rx (PduRDestPdu): PduRDestPduRef=EcucPduCollection/ADAS_PREDICTION_ST3_549e2a63_Rx
            PduRSrcPdu_0518217c (PduRSrcPdu): PduRSrcPduRef=EcucPduCollection/ADAS_PREDICTION_ST3_1de136c9_Rx
          ADAS_PREDICTION_ST3_6_262b63d1_Rx
            ADAS_PREDICTION_ST3_6_262b63d1_Rx (PduRDestPdu): PduRDestPduRef=EcucPduCollection/ADAS_PREDICTION_ST3_6_262b63d1_Rx
            PduRSrcPdu_27f93d01 (PduRSrcPdu): PduRSrcPduRef=EcucPduCollection/ADAS_PREDICTION_ST3_6_262b63d1_Rx
          ADAS_PREDICTION_ST3_7_512c5347_Rx
            ADAS_PREDICTION_ST3_7_512c5347_Rx (PduRDestPdu): PduRDestPduRef=EcucPduCollection/ADAS_PREDICTION_ST3_7_512c5347_Rx
            PduRSrcPdu_d1b2606a (PduRSrcPdu): PduRSrcPduRef=EcucPduCollection/ADAS_PREDICTION_ST3_7_512c5347_Rx
          ADAS_PROFILE_SHORT_ST3_1_506b5dfc_Rx
            ADAS_PROFILE_SHORT_ST3_1_506b5dfc_Rx (PduRDestPdu): PduRDestPduRef=EcucPduCollection/ADAS_PROFILE_SHORT_ST3_1_506b5dfc_Rx
            PduRSrcPdu_d645a86c (PduRSrcPdu): PduRSrcPduRef=EcucPduCollection/ADAS_PROFILE_SHORT_ST3_1_506b5dfc_Rx
          ADAS_PROFILE_SHORT_ST3_31_05b1585f_Rx
            ADAS_PROFILE_SHORT_ST3_31_05b1585f_Rx (PduRDestPdu): PduRDestPduRef=EcucPduCollection/ADAS_PROFILE_SHORT_ST3_31_05b1585f_Rx
            PduRSrcPdu_9e880434 (PduRSrcPdu): PduRSrcPduRef=EcucPduCollection/ADAS_PROFILE_SHORT_ST3_31_05b1585f_Rx
          ADAS_PROFILE_SHORT_ST3_894b8265_Rx
            ADAS_PROFILE_SHORT_ST3_894b8265_Rx_e0198081_Rx (PduRDestPdu): PduRDestPduRef=EcucPduCollection/ADAS_PROFILE_SHORT_ST3_2225c4a7_Rx
            PduRSrcPdu_e0198081 (PduRSrcPdu): PduRSrcPduRef=EcucPduCollection/ADAS_PROFILE_SHORT_ST3_894b8265_Rx
          Bckl_Sw_Fx_Stat_ST3_9c2de10c_Rx
            Bckl_Sw_Fx_Stat_ST3_9c2de10c_Rx (PduRDestPdu): PduRDestPduRef=EcucPduCollection/Bckl_Sw_Fx_Stat_ST3_9c2de10c_Rx
            PduRSrcPdu_6e617592 (PduRSrcPdu): PduRSrcPduRef=EcucPduCollection/Bckl_Sw_Fx_Stat_ST3_9c2de10c_Rx
          Bckl_Sw_Fx_Stat_ST3_secured_62272d37_Rx
            Bckl_Sw_Fx_Stat_ST3_secured_62272d37_Rx_79ab8c0b_Rx (PduRDestPdu): PduRDestPduRef=EcucPduCollection/Bckl_Sw_Fx_Stat_ST3_secured_b672d5e7_Rx
            PduRSrcPdu_79ab8c0b (PduRSrcPdu): PduRSrcPduRef=EcucPduCollection/Bckl_Sw_Fx_Stat_ST3_secured_62272d37_Rx
          BeltAdj_FL_Stat_ST3_d2ce0dbb_Tx: variation-point=post-build-variant-condition{matching-criterion=Side, value=0}
            BeltAdj_FL_Stat_ST3_71e5093a_Tx (PduRDestPdu): PduRDestPduRef=EcucPduCollection/BeltAdj_FL_Stat_ST3_71e5093a_Tx
            PduRSrcPdu_4459b19c (PduRSrcPdu): PduRSrcPduRef=EcucPduCollection/BeltAdj_FL_Stat_ST3_d2ce0dbb_Tx
          BeltAdj_FR_Stat_ST3_2b5906f9_Rx: variation-point=post-build-variant-condition{matching-criterion=Side, value=0}
            BeltAdj_FR_Stat_ST3_2b5906f9_Rx_f252e81e_Rx (PduRDestPdu): PduRDestPduRef=EcucPduCollection/BeltAdj_FR_Stat_ST3_eba9bce0_Rx
            PduRSrcPdu_f252e81e (PduRSrcPdu): PduRSrcPduRef=EcucPduCollection/BeltAdj_FR_Stat_ST3_2b5906f9_Rx
          BeltAdj_UI_Set_Rq_ST3_7be22993_Rx
            BeltAdj_UI_Set_Rq_ST3_7be22993_Rx_350798fb_Rx (PduRDestPdu): PduRDestPduRef=EcucPduCollection/BeltAdj_UI_Set_Rq_ST3_1223a83d_Rx
            PduRSrcPdu_350798fb (PduRSrcPdu): PduRSrcPduRef=EcucPduCollection/BeltAdj_UI_Set_Rq_ST3_7be22993_Rx
          BeltHdOvr_FL_State_ST3_0b4fb3a9_Rx: variation-point=post-build-variant-condition{matching-criterion=Side, value=0}
            BeltHdOvr_FL_State_ST3_0b4fb3a9_Rx_11170208_Rx (PduRDestPdu): PduRDestPduRef=EcucPduCollection/BeltHdOvr_FL_State_ST3_342163b7_Rx
            PduRSrcPdu_11170208 (PduRSrcPdu): PduRSrcPduRef=EcucPduCollection/BeltHdOvr_FL_State_ST3_0b4fb3a9_Rx
          CLkS_Dr_State_ST3_74337ed5_Rx
            CLkS_Dr_State_ST3_74337ed5_Rx_0fa9281f_Rx (PduRDestPdu): PduRDestPduRef=EcucPduCollection/CLkS_Dr_State_ST3_513e9c19_Rx
            PduRSrcPdu_0fa9281f (PduRSrcPdu): PduRSrcPduRef=EcucPduCollection/CLkS_Dr_State_ST3_74337ed5_Rx
          ComIPduPnc_EIRA_CAN_Rx_cca0f11f_Rx
            ComIPduPnc_EIRA_CAN_Rx_cca0f11f_Rx_bb7efc37_Rx (PduRDestPdu): PduRDestPduRef=PduPnc_EIRA_CAN_Rx
            PduRSrcPdu_bb7efc37 (PduRSrcPdu): PduRSrcPduRef=PduPnc_EIRA_CAN_Rx
          DIAG_Stat_ST3_d3ec8369_Rx
            DIAG_Stat_ST3_d3ec8369_Rx_65d40bec_Rx (PduRDestPdu): PduRDestPduRef=EcucPduCollection/DIAG_Stat_ST3_3a031d4a_Rx
            PduRSrcPdu_65d40bec (PduRSrcPdu): PduRSrcPduRef=EcucPduCollection/DIAG_Stat_ST3_d3ec8369_Rx
          DI_OdoSpeedometer_ST3_0665a232_Rx
            DI_OdoSpeedometer_ST3_0665a232_Rx_3e9512b9_Rx (PduRDestPdu): PduRDestPduRef=EcucPduCollection/DI_OdoSpeedometer_ST3_6fef7507_Rx
            PduRSrcPdu_3e9512b9 (PduRSrcPdu): PduRSrcPduRef=EcucPduCollection/DI_OdoSpeedometer_ST3_0665a232_Rx
          DPC_Md_Rq_ESP_d1_ST3_5573a8b2_Rx
            DPC_Md_Rq_ESP_d1_ST3_5573a8b2_Rx_ee8d9c90_Rx (PduRDestPdu): PduRDestPduRef=EcucPduCollection/DPC_Md_Rq_ESP_d1_ST3_e30f951d_Rx
            PduRSrcPdu_ee8d9c90 (PduRSrcPdu): PduRSrcPduRef=EcucPduCollection/DPC_Md_Rq_ESP_d1_ST3_5573a8b2_Rx
          Develop8_Rq_RBTM_FL_ST3_0a7cffe6_Rx: variation-point=post-build-variant-condition{matching-criterion=Side, value=0}
            Develop8_Rq_RBTM_FL_ST3_0a7cffe6_Rx_c2dcef25_Rx (PduRDestPdu): PduRDestPduRef=EcucPduCollection/Develop8_Rq_RBTM_FL_ST3_fa67f89a_Rx
            PduRSrcPdu_c2dcef25 (PduRSrcPdu): PduRSrcPduRef=EcucPduCollection/Develop8_Rq_RBTM_FL_ST3_0a7cffe6_Rx
          Develop8_Rs_RBTM_FL_ST3_9a3b4dd1_Tx: variation-point=post-build-variant-condition{matching-criterion=Side, value=0}
            Develop8_Rs_RBTM_FL_ST3_711f265e_Tx (PduRDestPdu): PduRDestPduRef=EcucPduCollection/Develop8_Rs_RBTM_FL_ST3_711f265e_Tx
            PduRSrcPdu_b7de4975 (PduRSrcPdu): PduRSrcPduRef=EcucPduCollection/Develop8_Rs_RBTM_FL_ST3_9a3b4dd1_Tx
          ECU_Stat_RBTM_FL_ST3_f703b6eb_Tx: variation-point=post-build-variant-condition{matching-criterion=Side, value=0}
            ECU_Stat_RBTM_FL_ST3_42655720_Tx (PduRDestPdu): PduRDestPduRef=EcucPduCollection/ECU_Stat_RBTM_FL_ST3_42655720_Tx
            PduRSrcPdu_140ec449 (PduRSrcPdu): PduRSrcPduRef=EcucPduCollection/ECU_Stat_RBTM_FL_ST3_f703b6eb_Tx
          ELC_Lvr_Stat_ST3_d97bab99_Rx
            ELC_Lvr_Stat_ST3_d97bab99_Rx (PduRDestPdu): PduRDestPduRef=EcucPduCollection/ELC_Lvr_Stat_ST3_d97bab99_Rx
            PduRSrcPdu_ae29c120 (PduRSrcPdu): PduRSrcPduRef=EcucPduCollection/ELC_Lvr_Stat_ST3_d97bab99_Rx
          ELC_Lvr_Stat_ST3_secured_29d2456c_Rx
            ELC_Lvr_Stat_ST3_secured_29d2456c_Rx_d27a099a_Rx (PduRDestPdu): PduRDestPduRef=EcucPduCollection/ELC_Lvr_Stat_ST3_secured_7bad7996_Rx
            PduRSrcPdu_d27a099a (PduRSrcPdu): PduRSrcPduRef=EcucPduCollection/ELC_Lvr_Stat_ST3_secured_29d2456c_Rx
          EVC_CfgList_01_08_Pr5_ST3_be03dd9d_Rx
            EVC_CfgList_01_08_Pr5_ST3_be03dd9d_Rx_4b27d50a_Rx (PduRDestPdu): PduRDestPduRef=EcucPduCollection/EVC_CfgList_01_08_Pr5_ST3_32c5e6fb_Rx
            PduRSrcPdu_4b27d50a (PduRSrcPdu): PduRSrcPduRef=EcucPduCollection/EVC_CfgList_01_08_Pr5_ST3_be03dd9d_Rx
          Ign_Stat_ST3_1e3dc39f_Rx
            Ign_Stat_ST3_1e3dc39f_Rx (PduRDestPdu): PduRDestPduRef=EcucPduCollection/Ign_Stat_ST3_1e3dc39f_Rx
            PduRSrcPdu_c9c2269b (PduRSrcPdu): PduRSrcPduRef=EcucPduCollection/Ign_Stat_ST3_1e3dc39f_Rx
          Ign_Stat_ST3_secured_fb0d4f19_Rx
            Ign_Stat_ST3_secured_fb0d4f19_Rx_f57d7485_Rx (PduRDestPdu): PduRDestPduRef=EcucPduCollection/Ign_Stat_ST3_secured_87afaf29_Rx
            PduRSrcPdu_f57d7485 (PduRSrcPdu): PduRSrcPduRef=EcucPduCollection/Ign_Stat_ST3_secured_fb0d4f19_Rx
          Impact2_ST3_e5526ccc_Rx
            Impact2_ST3_e5526ccc_Rx (PduRDestPdu): PduRDestPduRef=EcucPduCollection/Impact2_ST3_e5526ccc_Rx
            PduRSrcPdu_22492bdd (PduRSrcPdu): PduRSrcPduRef=EcucPduCollection/Impact2_ST3_e5526ccc_Rx
          Impact2_ST3_secured_de133629_Rx
            Impact2_ST3_secured_de133629_Rx_02199b24_Rx (PduRDestPdu): PduRDestPduRef=EcucPduCollection/Impact2_ST3_secured_2ba32448_Rx
            PduRSrcPdu_02199b24 (PduRSrcPdu): PduRSrcPduRef=EcucPduCollection/Impact2_ST3_secured_de133629_Rx
          Impact3_ST3_993f4b56_Rx
            Impact3_ST3_993f4b56_Rx_7842cc32_Rx (PduRDestPdu): PduRDestPduRef=EcucPduCollection/Impact3_ST3_d832457c_Rx
            PduRSrcPdu_7842cc32 (PduRSrcPdu): PduRSrcPduRef=EcucPduCollection/Impact3_ST3_993f4b56_Rx
          Meas8_RBTM_FL_ST3_a92f14da_Tx: variation-point=post-build-variant-condition{matching-criterion=Side, value=0}
            Meas8_RBTM_FL_ST3_b4f3e350_Tx (PduRDestPdu): PduRDestPduRef=EcucPduCollection/Meas8_RBTM_FL_ST3_b4f3e350_Tx
            PduRSrcPdu_d98cd95c (PduRSrcPdu): PduRSrcPduRef=EcucPduCollection/Meas8_RBTM_FL_ST3_a92f14da_Tx
          NM_RBTM_FL_ST3_0cdf2d0f_Tx: variation-point=post-build-variant-condition{matching-criterion=Side, value=0}
            NM_RBTM_FL_ST3_0cdf2d0f_Tx_78db9cf2_Tx (PduRDestPdu): PduRDestPduRef=EcucPduCollection/NM_RBTM_FL_ST3_0cdf2d0f_Tx
            PduRSrcPdu_78db9cf2 (PduRSrcPdu): PduRSrcPduRef=EcucPduCollection/NM_RBTM_FL_ST3_0cdf2d0f_Tx
          NTG_Master_Navi_ST3_1032e485_Rx
            NTG_Master_Navi_ST3_1032e485_Rx_8a45ba67_Rx (PduRDestPdu): PduRDestPduRef=EcucPduCollection/NTG_Master_Navi_ST3_dea580a6_Rx
            PduRSrcPdu_8a45ba67 (PduRSrcPdu): PduRSrcPduRef=EcucPduCollection/NTG_Master_Navi_ST3_1032e485_Rx
          PN14_Master_Stat1_ST3_69644078_Rx
            PN14_Master_Stat1_ST3_69644078_Rx_a0c57bb3_Rx (PduRDestPdu): PduRDestPduRef=EcucPduCollection/PN14_Master_Stat1_ST3_eba3e383_Rx
            PduRSrcPdu_a0c57bb3 (PduRSrcPdu): PduRSrcPduRef=EcucPduCollection/PN14_Master_Stat1_ST3_69644078_Rx
          PT4_PTCoor4_ST3_868ca7d3_Rx
            PT4_PTCoor4_ST3_868ca7d3_Rx_a7894e67_Rx (PduRDestPdu): PduRDestPduRef=EcucPduCollection/PT4_PTCoor4_ST3_bf069154_Rx
            PduRSrcPdu_a7894e67 (PduRSrcPdu): PduRSrcPduRef=EcucPduCollection/PT4_PTCoor4_ST3_868ca7d3_Rx
          PT4_PTCoor9_d1_BC_F_ST3_f2a4ec1b_Rx
            PT4_PTCoor9_d1_BC_F_ST3_f2a4ec1b_Rx_470e8c8b_Rx (PduRDestPdu): PduRDestPduRef=EcucPduCollection/PT4_PTCoor9_d1_BC_F_ST3_da786b84_Rx
            PduRSrcPdu_470e8c8b (PduRSrcPdu): PduRSrcPduRef=EcucPduCollection/PT4_PTCoor9_d1_BC_F_ST3_f2a4ec1b_Rx
          PT4_PTCoor_DrvPosn_Gear_ST3_f70358bf_Rx
            PT4_PTCoor_DrvPosn_Gear_ST3_f70358bf_Rx_3ba6bace_Rx (PduRDestPdu): PduRDestPduRef=EcucPduCollection/PT4_PTCoor_DrvPosn_Gear_ST3_6b508375_Rx
            PduRSrcPdu_3ba6bace (PduRSrcPdu): PduRSrcPduRef=EcucPduCollection/PT4_PTCoor_DrvPosn_Gear_ST3_f70358bf_Rx
          PresfAct_Adj_ST3_81976f17_Rx
            PresfAct_Adj_ST3_81976f17_Rx_7d3a747f_Rx (PduRDestPdu): PduRDestPduRef=EcucPduCollection/PresfAct_Adj_ST3_61c58c91_Rx
            PduRSrcPdu_7d3a747f (PduRSrcPdu): PduRSrcPduRef=EcucPduCollection/PresfAct_Adj_ST3_81976f17_Rx
          RBTM_FL_Stat_ST3_dd2436a1_Tx: variation-point=post-build-variant-condition{matching-criterion=Side, value=0}
            RBTM_FL_Stat_ST3_d76d14af_Tx (PduRDestPdu): PduRDestPduRef=EcucPduCollection/RBTM_FL_Stat_ST3_d76d14af_Tx
            PduRSrcPdu_9690baaa (PduRSrcPdu): PduRSrcPduRef=EcucPduCollection/RBTM_FL_Stat_ST3_dd2436a1_Tx
          RBTM_FL_Tens_ST3_553ec607_Tx: variation-point=post-build-variant-condition{matching-criterion=Side, value=0}
            RBTM_FL_Tens_ST3_49d8a970_Tx (PduRDestPdu): PduRDestPduRef=EcucPduCollection/RBTM_FL_Tens_ST3_49d8a970_Tx
            PduRSrcPdu_074527d1 (PduRSrcPdu): PduRSrcPduRef=EcucPduCollection/RBTM_FL_Tens_ST3_553ec607_Tx
          RBTM_FR_Stat_ST3_8dd11b6c_Rx: variation-point=post-build-variant-condition{matching-criterion=Side, value=0}
            RBTM_FR_Stat_ST3_8dd11b6c_Rx_7234ddac_Rx (PduRDestPdu): PduRDestPduRef=EcucPduCollection/RBTM_FR_Stat_ST3_e44387fa_Rx
            PduRSrcPdu_7234ddac (PduRSrcPdu): PduRSrcPduRef=EcucPduCollection/RBTM_FR_Stat_ST3_8dd11b6c_Rx
          ROE_RBTM_FL_ST3_a66ccb5f_Tx: variation-point=post-build-variant-condition{matching-criterion=Side, value=0}
            ROE_RBTM_FL_ST3_75ad963a_Tx (PduRDestPdu): PduRDestPduRef=EcucPduCollection/ROE_RBTM_FL_ST3_75ad963a_Tx
            PduRSrcPdu_25bb0169 (PduRSrcPdu): PduRSrcPduRef=EcucPduCollection/ROE_RBTM_FL_ST3_a66ccb5f_Tx
          SBeltTens_SP_Lvl_ST3_73b20851_Rx
            SBeltTens_SP_Lvl_ST3_73b20851_Rx_c609bb6e_Rx (PduRDestPdu): PduRDestPduRef=EcucPduCollection/SBeltTens_SP_Lvl_ST3_46421e11_Rx
            PduRSrcPdu_c609bb6e (PduRSrcPdu): PduRSrcPduRef=EcucPduCollection/SBeltTens_SP_Lvl_ST3_73b20851_Rx
          SDU_DIAG_GLOBAL_ExtCAN_RQ_BODY3_ST3_1d96a036_Rx
            SDU_DIAG_GLOBAL_ExtCAN_RQ_BODY3_ST3_1d96a036_Rx_19a79fac_Rx (PduRDestPdu): PduRDestPduRef=SDU_DIAG_GLOBAL_ExtCAN_RQ_BODY3_ST3_18e7f235_Rx
            PduRSrcPdu_19a79fac (PduRSrcPdu): PduRSrcPduRef=EcucPduCollection/SDU_DIAG_GLOBAL_ExtCAN_RQ_BODY3_ST3_1d96a036_Rx
          SDU_DIAG_GLOBAL_ExtEth_RQ_BODY3_ST3_38ac71dd_Rx
            SDU_DIAG_GLOBAL_ExtEth_RQ_BODY3_ST3_38ac71dd_Rx_0e266b08_Rx (PduRDestPdu): PduRDestPduRef=SDU_DIAG_GLOBAL_ExtEth_RQ_BODY3_ST3_81f0b7e5_Rx
            PduRSrcPdu_0e266b08 (PduRSrcPdu): PduRSrcPduRef=EcucPduCollection/SDU_DIAG_GLOBAL_ExtEth_RQ_BODY3_ST3_38ac71dd_Rx
          SDU_DIAG_GLOBAL_IntEth_RQ_BODY3_ST3_6efa2066_Rx
            SDU_DIAG_GLOBAL_IntEth_RQ_BODY3_ST3_6efa2066_Rx_1a629478_Rx (PduRDestPdu): PduRDestPduRef=SDU_DIAG_GLOBAL_IntEth_RQ_BODY3_ST3_41e6471f_Rx
            PduRSrcPdu_1a629478 (PduRSrcPdu): PduRSrcPduRef=EcucPduCollection/SDU_DIAG_GLOBAL_IntEth_RQ_BODY3_ST3_6efa2066_Rx
          SDU_DIAG_RBTM_FL_03_ExtCAN_RQ_BODY3_ST3_6d2a29a5_Rx: variation-point=post-build-variant-condition{matching-criterion=Side, value=0}
            SDU_DIAG_RBTM_FL_03_ExtCAN_RQ_BODY3_ST3_6d2a29a5_Rx_a44b5ded_Rx (PduRDestPdu): PduRDestPduRef=SDU_DIAG_RBTM_FL_03_ExtCAN_RQ_BODY3_ST3_ec0e6e12_Rx
            PduRSrcPdu_a44b5ded (PduRSrcPdu): PduRSrcPduRef=EcucPduCollection/SDU_DIAG_RBTM_FL_03_ExtCAN_RQ_BODY3_ST3_6d2a29a5_Rx
          SDU_DIAG_RBTM_FL_03_ExtCAN_RS_BODY3_ST3_b462d7d3_Tx: variation-point=post-build-variant-condition{matching-criterion=Side, value=0}
            SDU_DIAG_RBTM_FL_03_ExtCAN_RS_BODY3_ST3_92b91e83_Tx (PduRDestPdu): PduRDestPduRef=EcucPduCollection/SDU_DIAG_RBTM_FL_03_ExtCAN_RS_BODY3_ST3_92b91e83_Tx
            PduRSrcPdu_7f35c914 (PduRSrcPdu): PduRSrcPduRef=EcucPduCollection/SDU_DIAG_RBTM_FL_03_ExtCAN_RS_BODY3_ST3_b462d7d3_Tx
          SDU_DIAG_RBTM_FL_03_ExtEth_RQ_BODY3_ST3_4810f84e_Rx: variation-point=post-build-variant-condition{matching-criterion=Side, value=0}
            SDU_DIAG_RBTM_FL_03_ExtEth_RQ_BODY3_ST3_4810f84e_Rx_80d1f2da_Rx (PduRDestPdu): PduRDestPduRef=SDU_DIAG_RBTM_FL_03_ExtEth_RQ_BODY3_ST3_75192bc2_Rx
            PduRSrcPdu_80d1f2da (PduRSrcPdu): PduRSrcPduRef=EcucPduCollection/SDU_DIAG_RBTM_FL_03_ExtEth_RQ_BODY3_ST3_4810f84e_Rx
          SDU_DIAG_RBTM_FL_03_ExtEth_RS_BODY3_ST3_2d759203_Tx: variation-point=post-build-variant-condition{matching-criterion=Side, value=0}
            SDU_DIAG_RBTM_FL_03_ExtEth_RS_BODY3_ST3_b783cf68_Tx (PduRDestPdu): PduRDestPduRef=EcucPduCollection/SDU_DIAG_RBTM_FL_03_ExtEth_RS_BODY3_ST3_b783cf68_Tx
            PduRSrcPdu_249a1158 (PduRSrcPdu): PduRSrcPduRef=EcucPduCollection/SDU_DIAG_RBTM_FL_03_ExtEth_RS_BODY3_ST3_2d759203_Tx
          SDU_DIAG_RBTM_FL_03_IntEth_RQ_BODY3_ST3_1e46a9f5_Rx: variation-point=post-build-variant-condition{matching-criterion=Side, value=0}
            SDU_DIAG_RBTM_FL_03_IntEth_RQ_BODY3_ST3_1e46a9f5_Rx_03bff274_Rx (PduRDestPdu): PduRDestPduRef=SDU_DIAG_RBTM_FL_03_IntEth_RQ_BODY3_ST3_b50fdb38_Rx
            PduRSrcPdu_03bff274 (PduRSrcPdu): PduRSrcPduRef=EcucPduCollection/SDU_DIAG_RBTM_FL_03_IntEth_RQ_BODY3_ST3_1e46a9f5_Rx
          SDU_DIAG_RBTM_FL_03_IntEth_RS_BODY3_ST3_ed6362f9_Tx: variation-point=post-build-variant-condition{matching-criterion=Side, value=0}
            SDU_DIAG_RBTM_FL_03_IntEth_RS_BODY3_ST3_e1d59ed3_Tx (PduRDestPdu): PduRDestPduRef=EcucPduCollection/SDU_DIAG_RBTM_FL_03_IntEth_RS_BODY3_ST3_e1d59ed3_Tx
            PduRSrcPdu_3fa3fd23 (PduRSrcPdu): PduRSrcPduRef=EcucPduCollection/SDU_DIAG_RBTM_FL_03_IntEth_RS_BODY3_ST3_ed6362f9_Tx
          VSS_TP_Auth_ST3_29a0d419_Rx
            VSS_TP_Auth_ST3_29a0d419_Rx_c76c8221_Rx (PduRDestPdu): PduRDestPduRef=EcucPduCollection/VSS_TP_Auth_ST3_7c9f23ce_Rx
            PduRSrcPdu_c76c8221 (PduRSrcPdu): PduRSrcPduRef=EcucPduCollection/VSS_TP_Auth_ST3_29a0d419_Rx
          VSS_TP_RealTmOffset_ST3_d6d134b3_Rx
            VSS_TP_RealTmOffset_ST3_d6d134b3_Rx_9136979d_Rx (PduRDestPdu): PduRDestPduRef=EcucPduCollection/VSS_TP_RealTmOffset_ST3_62955a84_Rx
            PduRSrcPdu_9136979d (PduRSrcPdu): PduRSrcPduRef=EcucPduCollection/VSS_TP_RealTmOffset_ST3_d6d134b3_Rx
          VSS_TP_SecTickCount_Lvl2_ST3_c0c3ca3b_Rx
            VSS_TP_SecTickCount_Lvl2_ST3_c0c3ca3b_Rx_13123c17_Rx (PduRDestPdu): PduRDestPduRef=EcucPduCollection/VSS_TP_SecTickCount_Lvl2_ST3_4917056b_Rx
            PduRSrcPdu_13123c17 (PduRSrcPdu): PduRSrcPduRef=EcucPduCollection/VSS_TP_SecTickCount_Lvl2_ST3_c0c3ca3b_Rx
          VSS_TP_SharedSecret_ST3_6d7ca724_Rx
            VSS_TP_SharedSecret_ST3_6d7ca724_Rx_44cfb2dc_Rx (PduRDestPdu): PduRDestPduRef=EcucPduCollection/VSS_TP_SharedSecret_ST3_605b0fee_Rx
            PduRSrcPdu_44cfb2dc (PduRSrcPdu): PduRSrcPduRef=EcucPduCollection/VSS_TP_SharedSecret_ST3_6d7ca724_Rx
          VSS_TP_VIN_ST3_f7ab6516_Rx
            VSS_TP_VIN_ST3_f7ab6516_Rx_da8efc5d_Rx (PduRDestPdu): PduRDestPduRef=EcucPduCollection/VSS_TP_VIN_ST3_8e87972a_Rx
            PduRSrcPdu_da8efc5d (PduRSrcPdu): PduRSrcPduRef=EcucPduCollection/VSS_TP_VIN_ST3_f7ab6516_Rx
          BeltAdj_FL_Stat_ST3_71e5093a_Rx: variation-point=post-build-variant-condition{matching-criterion=Side, value=1}
            BeltAdj_FL_Stat_ST3_71e5093a_Rx_9982cecc_Rx (PduRDestPdu): PduRDestPduRef=EcucPduCollection/BeltAdj_FL_Stat_ST3_d2ce0dbb_Rx
            PduRSrcPdu_9982cecc (PduRSrcPdu): PduRSrcPduRef=EcucPduCollection/BeltAdj_FL_Stat_ST3_71e5093a_Rx
          BeltAdj_FR_Stat_ST3_eba9bce0_Tx: variation-point=post-build-variant-condition{matching-criterion=Side, value=1}
            BeltAdj_FR_Stat_ST3_2b5906f9_Tx (PduRDestPdu): PduRDestPduRef=EcucPduCollection/BeltAdj_FR_Stat_ST3_2b5906f9_Tx
            PduRSrcPdu_0892c3c5 (PduRSrcPdu): PduRSrcPduRef=EcucPduCollection/BeltAdj_FR_Stat_ST3_eba9bce0_Tx
          BeltHdOvr_FR_State_ST3_09789cac_Rx: variation-point=post-build-variant-condition{matching-criterion=Side, value=1}
            BeltHdOvr_FR_State_ST3_09789cac_Rx_4c2f4fea_Rx (PduRDestPdu): PduRDestPduRef=EcucPduCollection/BeltHdOvr_FR_State_ST3_c8a18c7a_Rx
            PduRSrcPdu_4c2f4fea (PduRSrcPdu): PduRSrcPduRef=EcucPduCollection/BeltHdOvr_FR_State_ST3_09789cac_Rx
          Develop8_Rq_RBTM_FR_ST3_d1911cf7_Rx: variation-point=post-build-variant-condition{matching-criterion=Side, value=1}
            Develop8_Rq_RBTM_FR_ST3_d1911cf7_Rx_73b8d236_Rx (PduRDestPdu): PduRDestPduRef=EcucPduCollection/Develop8_Rq_RBTM_FR_ST3_25b7d179_Rx
            PduRSrcPdu_73b8d236 (PduRSrcPdu): PduRSrcPduRef=EcucPduCollection/Develop8_Rq_RBTM_FR_ST3_d1911cf7_Rx
          Develop8_Rs_RBTM_FR_ST3_45eb6432_Tx: variation-point=post-build-variant-condition{matching-criterion=Side, value=1}
            Develop8_Rs_RBTM_FR_ST3_aaf2c54f_Tx (PduRDestPdu): PduRDestPduRef=EcucPduCollection/Develop8_Rs_RBTM_FR_ST3_aaf2c54f_Tx
            PduRSrcPdu_981fdebc (PduRSrcPdu): PduRSrcPduRef=EcucPduCollection/Develop8_Rs_RBTM_FR_ST3_45eb6432_Tx
          ECU_Stat_RBTM_FR_ST3_28d39f08_Tx: variation-point=post-build-variant-condition{matching-criterion=Side, value=1}
            ECU_Stat_RBTM_FR_ST3_9988b431_Tx (PduRDestPdu): PduRDestPduRef=EcucPduCollection/ECU_Stat_RBTM_FR_ST3_9988b431_Tx
            PduRSrcPdu_2db65a34 (PduRSrcPdu): PduRSrcPduRef=EcucPduCollection/ECU_Stat_RBTM_FR_ST3_28d39f08_Tx
          Meas8_RBTM_FR_ST3_76ff3d39_Tx: variation-point=post-build-variant-condition{matching-criterion=Side, value=1}
            Meas8_RBTM_FR_ST3_6f1e0041_Tx (PduRDestPdu): PduRDestPduRef=EcucPduCollection/Meas8_RBTM_FR_ST3_6f1e0041_Tx
            PduRSrcPdu_dedcc96f (PduRSrcPdu): PduRSrcPduRef=EcucPduCollection/Meas8_RBTM_FR_ST3_76ff3d39_Tx
          NM_RBTM_FR_ST3_d30f04ec_Tx: variation-point=post-build-variant-condition{matching-criterion=Side, value=1}
            NM_RBTM_FR_ST3_d30f04ec_Tx_2c5f6cda_Tx (PduRDestPdu): PduRDestPduRef=EcucPduCollection/NM_RBTM_FR_ST3_d30f04ec_Tx
            PduRSrcPdu_2c5f6cda (PduRSrcPdu): PduRSrcPduRef=EcucPduCollection/NM_RBTM_FR_ST3_d30f04ec_Tx
          RBTM_FL_Stat_ST3_d76d14af_Rx: variation-point=post-build-variant-condition{matching-criterion=Side, value=1}
            RBTM_FL_Stat_ST3_d76d14af_Rx_16ae0594_Rx (PduRDestPdu): PduRDestPduRef=EcucPduCollection/RBTM_FL_Stat_ST3_dd2436a1_Rx
            PduRSrcPdu_16ae0594 (PduRSrcPdu): PduRSrcPduRef=EcucPduCollection/RBTM_FL_Stat_ST3_d76d14af_Rx
          RBTM_FR_Stat_ST3_e44387fa_Tx: variation-point=post-build-variant-condition{matching-criterion=Side, value=1}
            RBTM_FR_Stat_ST3_8dd11b6c_Tx (PduRDestPdu): PduRDestPduRef=EcucPduCollection/RBTM_FR_Stat_ST3_8dd11b6c_Tx
            PduRSrcPdu_45e6f19d (PduRSrcPdu): PduRSrcPduRef=EcucPduCollection/RBTM_FR_Stat_ST3_e44387fa_Tx
          RBTM_FR_Tens_ST3_6c59775c_Tx: variation-point=post-build-variant-condition{matching-criterion=Side, value=1}
            RBTM_FR_Tens_ST3_1364a6b3_Tx (PduRDestPdu): PduRDestPduRef=EcucPduCollection/RBTM_FR_Tens_ST3_1364a6b3_Tx
            PduRSrcPdu_a9321799 (PduRSrcPdu): PduRSrcPduRef=EcucPduCollection/RBTM_FR_Tens_ST3_6c59775c_Tx
          ROE_RBTM_FR_ST3_79bce2bc_Tx: variation-point=post-build-variant-condition{matching-criterion=Side, value=1}
            ROE_RBTM_FR_ST3_ae40752b_Tx (PduRDestPdu): PduRDestPduRef=EcucPduCollection/ROE_RBTM_FR_ST3_ae40752b_Tx
            PduRSrcPdu_efc3e236 (PduRSrcPdu): PduRSrcPduRef=EcucPduCollection/ROE_RBTM_FR_ST3_79bce2bc_Tx
          SDU_DIAG_RBTM_FR_03_ExtCAN_RQ_BODY3_ST3_1f04509d_Rx: variation-point=post-build-variant-condition{matching-criterion=Side, value=1}
            SDU_DIAG_RBTM_FR_03_ExtCAN_RQ_BODY3_ST3_1f04509d_Rx_7beeea72_Rx (PduRDestPdu): PduRDestPduRef=SDU_DIAG_RBTM_FR_03_ExtCAN_RQ_BODY3_ST3_f1557fc1_Rx
            PduRSrcPdu_7beeea72 (PduRSrcPdu): PduRSrcPduRef=EcucPduCollection/SDU_DIAG_RBTM_FR_03_ExtCAN_RQ_BODY3_ST3_1f04509d_Rx
          SDU_DIAG_RBTM_FR_03_ExtCAN_RS_BODY3_ST3_a939c600_Tx: variation-point=post-build-variant-condition{matching-criterion=Side, value=1}
            SDU_DIAG_RBTM_FR_03_ExtCAN_RS_BODY3_ST3_e09767bb_Tx (PduRDestPdu): PduRDestPduRef=EcucPduCollection/SDU_DIAG_RBTM_FR_03_ExtCAN_RS_BODY3_ST3_e09767bb_Tx
            PduRSrcPdu_8d2872fc (PduRSrcPdu): PduRSrcPduRef=EcucPduCollection/SDU_DIAG_RBTM_FR_03_ExtCAN_RS_BODY3_ST3_a939c600_Tx
          SDU_DIAG_RBTM_FR_03_ExtEth_RQ_BODY3_ST3_3a3e8176_Rx: variation-point=post-build-variant-condition{matching-criterion=Side, value=1}
            SDU_DIAG_RBTM_FR_03_ExtEth_RQ_BODY3_ST3_3a3e8176_Rx_4d07a2cf_Rx (PduRDestPdu): PduRDestPduRef=SDU_DIAG_RBTM_FR_03_ExtEth_RQ_BODY3_ST3_68423a11_Rx
            PduRSrcPdu_4d07a2cf (PduRSrcPdu): PduRSrcPduRef=EcucPduCollection/SDU_DIAG_RBTM_FR_03_ExtEth_RQ_BODY3_ST3_3a3e8176_Rx
          SDU_DIAG_RBTM_FR_03_ExtEth_RS_BODY3_ST3_302e83d0_Tx: variation-point=post-build-variant-condition{matching-criterion=Side, value=1}
            SDU_DIAG_RBTM_FR_03_ExtEth_RS_BODY3_ST3_c5adb650_Tx (PduRDestPdu): PduRDestPduRef=EcucPduCollection/SDU_DIAG_RBTM_FR_03_ExtEth_RS_BODY3_ST3_c5adb650_Tx
            PduRSrcPdu_a0766459 (PduRSrcPdu): PduRSrcPduRef=EcucPduCollection/SDU_DIAG_RBTM_FR_03_ExtEth_RS_BODY3_ST3_302e83d0_Tx
          SDU_DIAG_RBTM_FR_03_IntEth_RQ_BODY3_ST3_6c68d0cd_Rx: variation-point=post-build-variant-condition{matching-criterion=Side, value=1}
            SDU_DIAG_RBTM_FR_03_IntEth_RQ_BODY3_ST3_6c68d0cd_Rx_8aa11052_Rx (PduRDestPdu): PduRDestPduRef=SDU_DIAG_RBTM_FR_03_IntEth_RQ_BODY3_ST3_a854caeb_Rx
            PduRSrcPdu_8aa11052 (PduRSrcPdu): PduRSrcPduRef=EcucPduCollection/SDU_DIAG_RBTM_FR_03_IntEth_RQ_BODY3_ST3_6c68d0cd_Rx
          SDU_DIAG_RBTM_FR_03_IntEth_RS_BODY3_ST3_f038732a_Tx: variation-point=post-build-variant-condition{matching-criterion=Side, value=1}
            SDU_DIAG_RBTM_FR_03_IntEth_RS_BODY3_ST3_93fbe7eb_Tx (PduRDestPdu): PduRDestPduRef=EcucPduCollection/SDU_DIAG_RBTM_FR_03_IntEth_RS_BODY3_ST3_93fbe7eb_Tx
            PduRSrcPdu_f76356d0 (PduRSrcPdu): PduRSrcPduRef=EcucPduCollection/SDU_DIAG_RBTM_FR_03_IntEth_RS_BODY3_ST3_f038732a_Tx
  module config SecOC
    4 x SecOCRxPduProcessing, all with SecOCAuthInfoTxLength=24, SecOCAuthenticationVerifyAttempts=0, SecOCFreshnessValueId=1, SecOCFreshnessValueLength=40, SecOCFreshnessValueTxLength=8:
      Bckl_Sw_Fx_Stat_ST3_secured_b672d5e7_Rx: SecOCDataId=15576
        Bckl_Sw_Fx_Stat_ST3_9c2de10c_Rx (SecOCRxAuthenticPduLayer): SecOCRxAuthenticLayerPduRef=EcucPduCollection/Bckl_Sw_Fx_Stat_ST3_9c2de10c_Rx
        SecOCRxSecuredPduLayer
          Bckl_Sw_Fx_Stat_ST3_secured_b672d5e7_Rx (SecOCRxSecuredPdu): SecOCRxSecuredLayerPduRef=EcucPduCollection/Bckl_Sw_Fx_Stat_ST3_secured_b672d5e7_Rx
      ELC_Lvr_Stat_ST3_secured_7bad7996_Rx: SecOCDataId=37177
        ELC_Lvr_Stat_ST3_d97bab99_Rx (SecOCRxAuthenticPduLayer): SecOCRxAuthenticLayerPduRef=EcucPduCollection/ELC_Lvr_Stat_ST3_d97bab99_Rx
        SecOCRxSecuredPduLayer
          ELC_Lvr_Stat_ST3_secured_7bad7996_Rx (SecOCRxSecuredPdu): SecOCRxSecuredLayerPduRef=EcucPduCollection/ELC_Lvr_Stat_ST3_secured_7bad7996_Rx
      Ign_Stat_ST3_secured_87afaf29_Rx: SecOCDataId=28212
        Ign_Stat_ST3_1e3dc39f_Rx (SecOCRxAuthenticPduLayer): SecOCRxAuthenticLayerPduRef=EcucPduCollection/Ign_Stat_ST3_1e3dc39f_Rx
        SecOCRxSecuredPduLayer
          Ign_Stat_ST3_secured_87afaf29_Rx (SecOCRxSecuredPdu): SecOCRxSecuredLayerPduRef=EcucPduCollection/Ign_Stat_ST3_secured_87afaf29_Rx
      Impact2_ST3_secured_2ba32448_Rx: SecOCDataId=27103
        Impact2_ST3_e5526ccc_Rx (SecOCRxAuthenticPduLayer): SecOCRxAuthenticLayerPduRef=EcucPduCollection/Impact2_ST3_e5526ccc_Rx
        SecOCRxSecuredPduLayer
          Impact2_ST3_secured_2ba32448_Rx (SecOCRxSecuredPdu): SecOCRxSecuredLayerPduRef=EcucPduCollection/Impact2_ST3_secured_2ba32448_Rx
  module config StbM
    GTD_BODY3_0_14e64f11 (StbMSynchronizedTimeBase): StbMSynchronizedTimeBaseIdentifier=0
  module config Xcp
    XcpConfig
      4 x XcpPdu:
        XCP8_Rq_RBTM_FL_ST3_480c7aac_Rx: variation-point=post-build-variant-condition{matching-criterion=Side, value=0}
          XCP8_Rq_RBTM_FL_ST3_480c7aac_Rx (XcpRxPdu): XcpRxPduRef=EcucPduCollection/XCP8_Rq_RBTM_FL_ST3_480c7aac_Rx
        XCP8_Rs_RBTM_FL_ST3_336fa314_Tx: variation-point=post-build-variant-condition{matching-criterion=Side, value=0}
          XCP8_Rs_RBTM_FL_ST3_336fa314_Tx (XcpTxPdu): XcpTxPduRef=EcucPduCollection/XCP8_Rs_RBTM_FL_ST3_336fa314_Tx
        XCP8_Rq_RBTM_FR_ST3_93e199bd_Rx: variation-point=post-build-variant-condition{matching-criterion=Side, value=1}
          XCP8_Rq_RBTM_FR_ST3_93e199bd_Rx (XcpRxPdu): XcpRxPduRef=EcucPduCollection/XCP8_Rq_RBTM_FR_ST3_93e199bd_Rx
        XCP8_Rs_RBTM_FR_ST3_e8824005_Tx: variation-point=post-build-variant-condition{matching-criterion=Side, value=1}
          XCP8_Rs_RBTM_FR_ST3_e8824005_Tx (XcpTxPdu): XcpTxPduRef=EcucPduCollection/XCP8_Rs_RBTM_FR_ST3_e8824005_Tx
    XcpGeneral
