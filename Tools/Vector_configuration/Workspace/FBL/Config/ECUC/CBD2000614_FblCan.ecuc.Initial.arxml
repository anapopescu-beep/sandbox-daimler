[part 1 of 2: package /InitialEcuC]
AUTOSAR XML (schema 4-3-0)
package /InitialEcuC
  ecuc value collection InitialEcuC: ecuc-values=[Can, CanIf, CanNm, CanSM, CanTSyn, CanTp, Com, ComM, Dcm, EcuC, EcuM, IpduM, Nm, PduR, SecOC, StbM, Xcp]
  module config Can
    CanConfigSet
      RBTM_FL_BODY3_180ddaa4 (CanController):  # BODY3
        CanControllerActivation = true
        CanControllerDefaultBaudrate = RBTM_FL_BODY3_180ddaa4/CanControllerBaudrateConfig
        CanControllerSystemRef = RBTM_FL_BODY3
        CanWakeupSourceRef = EcuMCommonConfiguration/RBTM_FL_BODY3_8uqv9blm85ehm0msat385m76v_03d5f5f6
        variation-point = post-build-variant-condition{matching-criterion=Side, value=0}
        CanControllerBaudrateConfig: CanControllerBaudRate=250
      3 x CanHardwareObject, all with CanHandleType=BASIC, CanIdValue=0, CanControllerRef=CanConfigSet/RBTM_FL_BODY3_180ddaa4, variation-point=post-build-variant-condition{matching-criterion=Side, value=0}:
        RBTM_FL_BODY3_8uqv9blm85ehm0msat385m76v_03d5f5f6_Tx: CanObjectType=TRANSMIT
        RBTM_FL_BODY3_8uqv9blm85ehm0msat385m76v_d50cf0d9_Rx: CanIdType=STANDARD, CanObjectType=RECEIVE
        RBTM_FL_BODY3_8uqv9blm85ehm0msat385m76v_e046a621_Rx: CanIdType=EXTENDED, CanObjectType=RECEIVE
      RBTM_FR_BODY3_2fec3d37 (CanController):  # BODY3
        CanControllerActivation = true
        CanControllerDefaultBaudrate = RBTM_FR_BODY3_2fec3d37/CanControllerBaudrateConfig
        CanControllerSystemRef = RBTM_FR_BODY3
        CanWakeupSourceRef = EcuMCommonConfiguration/RBTM_FR_BODY3_4xwwtd59665s787n6ctawh7k8_23a94727
        variation-point = post-build-variant-condition{matching-criterion=Side, value=1}
        CanControllerBaudrateConfig: CanControllerBaudRate=250
      3 x CanHardwareObject, all with CanHandleType=BASIC, CanIdValue=0, CanControllerRef=CanConfigSet/RBTM_FR_BODY3_2fec3d37, variation-point=post-build-variant-condition{matching-criterion=Side, value=1}:
        RBTM_FR_BODY3_4xwwtd59665s787n6ctawh7k8_23a94727_Tx: CanObjectType=TRANSMIT
        RBTM_FR_BODY3_4xwwtd59665s787n6ctawh7k8_5b8d9de8_Rx: CanIdType=EXTENDED, CanObjectType=RECEIVE
        RBTM_FR_BODY3_4xwwtd59665s787n6ctawh7k8_6ec7cb10_Rx: CanIdType=STANDARD, CanObjectType=RECEIVE
    CanGeneral: CanIndex=0
  module config CanIf
    CanIfCtrlDrvCfg_7d254554 (CanIfCtrlDrvCfg): CanIfCtrlDrvInitHohConfigRef=CanIfInitHohCfg, CanIfCtrlDrvNameRef=CanGeneral
      RBTM_FL_BODY3_180ddaa4 (CanIfCtrlCfg): CanIfCtrlCanCtrlRef=CanConfigSet/RBTM_FL_BODY3_180ddaa4, variation-point=post-build-variant-condition{matching-criterion=Side, value=0}
      RBTM_FR_BODY3_2fec3d37 (CanIfCtrlCfg): CanIfCtrlCanCtrlRef=CanConfigSet/RBTM_FR_BODY3_2fec3d37, variation-point=post-build-variant-condition{matching-criterion=Side, value=1}
    CanIfInitCfg
      BODY3_bccb160f (CanIfBufferCfg):
        CanIfBufferSize = 0
        CanIfBufferHthRef = CanIfInitHohCfg/RBTM_FL_BODY3_8uqv9blm85ehm0msat385m76v_03d5f5f6_Tx if post-build-variant-condition{matching-criterion=Side, value=0}
        CanIfBufferHthRef = CanIfInitHohCfg/RBTM_FR_BODY3_4xwwtd59665s787n6ctawh7k8_23a94727_Tx if post-build-variant-condition{matching-criterion=Side, value=1}
      CanIfInitHohCfg: CanIfInitRefCfgSet=CanConfigSet
        RBTM_FL_BODY3_8uqv9blm85ehm0msat385m76v_d50cf0d9_Rx (CanIfHrhCfg):
          CanIfHrhCanCtrlIdRef = CanIfCtrlDrvCfg_7d254554/RBTM_FL_BODY3_180ddaa4
          CanIfHrhIdSymRef = CanConfigSet/RBTM_FL_BODY3_8uqv9blm85ehm0msat385m76v_d50cf0d9_Rx
          variation-point = post-build-variant-condition{matching-criterion=Side, value=0}
        RBTM_FL_BODY3_8uqv9blm85ehm0msat385m76v_e046a621_Rx (CanIfHrhCfg):
          CanIfHrhCanCtrlIdRef = CanIfCtrlDrvCfg_7d254554/RBTM_FL_BODY3_180ddaa4
          CanIfHrhIdSymRef = CanConfigSet/RBTM_FL_BODY3_8uqv9blm85ehm0msat385m76v_e046a621_Rx
          variation-point = post-build-variant-condition{matching-criterion=Side, value=0}
        RBTM_FL_BODY3_8uqv9blm85ehm0msat385m76v_03d5f5f6_Tx (CanIfHthCfg):
          CanIfHthCanCtrlIdRef = CanIfCtrlDrvCfg_7d254554/RBTM_FL_BODY3_180ddaa4
          CanIfHthIdSymRef = CanConfigSet/RBTM_FL_BODY3_8uqv9blm85ehm0msat385m76v_03d5f5f6_Tx
          variation-point = post-build-variant-condition{matching-criterion=Side, value=0}
        RBTM_FR_BODY3_4xwwtd59665s787n6ctawh7k8_5b8d9de8_Rx (CanIfHrhCfg):
          CanIfHrhCanCtrlIdRef = CanIfCtrlDrvCfg_7d254554/RBTM_FR_BODY3_2fec3d37
          CanIfHrhIdSymRef = CanConfigSet/RBTM_FR_BODY3_4xwwtd59665s787n6ctawh7k8_5b8d9de8_Rx
          variation-point = post-build-variant-condition{matching-criterion=Side, value=1}
        RBTM_FR_BODY3_4xwwtd59665s787n6ctawh7k8_6ec7cb10_Rx (CanIfHrhCfg):
          CanIfHrhCanCtrlIdRef = CanIfCtrlDrvCfg_7d254554/RBTM_FR_BODY3_2fec3d37
          CanIfHrhIdSymRef = CanConfigSet/RBTM_FR_BODY3_4xwwtd59665s787n6ctawh7k8_6ec7cb10_Rx
          variation-point = post-build-variant-condition{matching-criterion=Side, value=1}
        RBTM_FR_BODY3_4xwwtd59665s787n6ctawh7k8_23a94727_Tx (CanIfHthCfg):
          CanIfHthCanCtrlIdRef = CanIfCtrlDrvCfg_7d254554/RBTM_FR_BODY3_2fec3d37
          CanIfHthIdSymRef = CanConfigSet/RBTM_FR_BODY3_4xwwtd59665s787n6ctawh7k8_23a94727_Tx
          variation-point = post-build-variant-condition{matching-criterion=Side, value=1}
      39 x CanIfRxPduCfg:
        ADAS_POSITION_ST3_bc4541a2_Rx: CanIfRxPduCanId=1686, CanIfRxPduCanIdType=STANDARD_CAN, CanIfRxPduDlc=8, CanIfRxPduUserRxIndicationName=PduR_CanIfRxIndication, CanIfRxPduUserRxIndicationUL=PDUR, CanIfRxPduHrhIdRef=CanIfInitHohCfg/RBTM_FL_BODY3_8uqv9blm85ehm0msat385m76v_d50cf0d9_Rx if post-build-variant-condition{matching-criterion=Side, value=0}, CanIfRxPduRef=EcucPduCollection/ADAS_POSITION_ST3_1ca04d74_Rx, CanIfRxPduHrhIdRef=CanIfInitHohCfg/RBTM_FR_BODY3_4xwwtd59665s787n6ctawh7k8_6ec7cb10_Rx if post-build-variant-condition{matching-criterion=Side, value=1}
        ADAS_PREDICTION_ST3_7c36fc01_Rx: CanIfRxPduCanId=1766, CanIfRxPduCanIdType=STANDARD_CAN, CanIfRxPduDlc=8, CanIfRxPduUserRxIndicationName=PduR_CanIfRxIndication, CanIfRxPduUserRxIndicationUL=PDUR, CanIfRxPduHrhIdRef=CanIfInitHohCfg/RBTM_FL_BODY3_8uqv9blm85ehm0msat385m76v_d50cf0d9_Rx if post-build-variant-condition{matching-criterion=Side, value=0}, CanIfRxPduRef=EcucPduCollection/ADAS_PREDICTION_ST3_1de136c9_Rx, CanIfRxPduHrhIdRef=CanIfInitHohCfg/RBTM_FR_BODY3_4xwwtd59665s787n6ctawh7k8_6ec7cb10_Rx if post-build-variant-condition{matching-criterion=Side, value=1}
        ADAS_PROFILE_SHORT_ST3_7ff16020_Rx: CanIfRxPduCanId=1341, CanIfRxPduCanIdType=STANDARD_CAN, CanIfRxPduDlc=8, CanIfRxPduUserRxIndicationName=PduR_CanIfRxIndication, CanIfRxPduUserRxIndicationUL=PDUR, CanIfRxPduHrhIdRef=CanIfInitHohCfg/RBTM_FL_BODY3_8uqv9blm85ehm0msat385m76v_d50cf0d9_Rx if post-build-variant-condition{matching-criterion=Side, value=0}, CanIfRxPduRef=EcucPduCollection/ADAS_PROFILE_SHORT_ST3_894b8265_Rx, CanIfRxPduHrhIdRef=CanIfInitHohCfg/RBTM_FR_BODY3_4xwwtd59665s787n6ctawh7k8_6ec7cb10_Rx if post-build-variant-condition{matching-criterion=Side, value=1}
        Bckl_Sw_Fx_Stat_ST3_secured_b4b7136c_Rx: CanIfRxPduCanId=1699, CanIfRxPduCanIdType=STANDARD_CAN, CanIfRxPduDlc=8, CanIfRxPduUserRxIndicationName=PduR_CanIfRxIndication, CanIfRxPduUserRxIndicationUL=PDUR, CanIfRxPduHrhIdRef=CanIfInitHohCfg/RBTM_FL_BODY3_8uqv9blm85ehm0msat385m76v_d50cf0d9_Rx if post-build-variant-condition{matching-criterion=Side, value=0}, CanIfRxPduRef=EcucPduCollection/Bckl_Sw_Fx_Stat_ST3_secured_62272d37_Rx, CanIfRxPduHrhIdRef=CanIfInitHohCfg/RBTM_FR_BODY3_4xwwtd59665s787n6ctawh7k8_6ec7cb10_Rx if post-build-variant-condition{matching-criterion=Side, value=1}
        BeltAdj_FR_Stat_ST3_070be586_Rx: CanIfRxPduCanId=1697, CanIfRxPduCanIdType=STANDARD_CAN, CanIfRxPduDlc=1, CanIfRxPduUserRxIndicationName=PduR_CanIfRxIndication, CanIfRxPduUserRxIndicationUL=PDUR, CanIfRxPduHrhIdRef=CanIfInitHohCfg/RBTM_FL_BODY3_8uqv9blm85ehm0msat385m76v_d50cf0d9_Rx, CanIfRxPduRef=EcucPduCollection/BeltAdj_FR_Stat_ST3_2b5906f9_Rx, variation-point=post-build-variant-condition{matching-criterion=Side, value=0}
        BeltAdj_UI_Set_Rq_ST3_0cef232d_Rx: CanIfRxPduCanId=1698, CanIfRxPduCanIdType=STANDARD_CAN, CanIfRxPduDlc=1, CanIfRxPduUserRxIndicationName=PduR_CanIfRxIndication, CanIfRxPduUserRxIndicationUL=PDUR, CanIfRxPduHrhIdRef=CanIfInitHohCfg/RBTM_FL_BODY3_8uqv9blm85ehm0msat385m76v_d50cf0d9_Rx if post-build-variant-condition{matching-criterion=Side, value=0}, CanIfRxPduRef=EcucPduCollection/BeltAdj_UI_Set_Rq_ST3_7be22993_Rx, CanIfRxPduHrhIdRef=CanIfInitHohCfg/RBTM_FR_BODY3_4xwwtd59665s787n6ctawh7k8_6ec7cb10_Rx if post-build-variant-condition{matching-criterion=Side, value=1}
        BeltHdOvr_FL_State_ST3_b4846ceb_Rx: CanIfRxPduCanId=1532, CanIfRxPduCanIdType=STANDARD_CAN, CanIfRxPduDlc=4, CanIfRxPduUserRxIndicationName=PduR_CanIfRxIndication, CanIfRxPduUserRxIndicationUL=PDUR, CanIfRxPduHrhIdRef=CanIfInitHohCfg/RBTM_FL_BODY3_8uqv9blm85ehm0msat385m76v_d50cf0d9_Rx, CanIfRxPduRef=EcucPduCollection/BeltHdOvr_FL_State_ST3_0b4fb3a9_Rx, variation-point=post-build-variant-condition{matching-criterion=Side, value=0}
        CLkS_Dr_State_ST3_27f55e1e_Rx: CanIfRxPduCanId=1426, CanIfRxPduCanIdType=STANDARD_CAN, CanIfRxPduDlc=8, CanIfRxPduUserRxIndicationName=PduR_CanIfRxIndication, CanIfRxPduUserRxIndicationUL=PDUR, CanIfRxPduHrhIdRef=CanIfInitHohCfg/RBTM_FL_BODY3_8uqv9blm85ehm0msat385m76v_d50cf0d9_Rx if post-build-variant-condition{matching-criterion=Side, value=0}, CanIfRxPduRef=EcucPduCollection/CLkS_Dr_State_ST3_74337ed5_Rx, CanIfRxPduHrhIdRef=CanIfInitHohCfg/RBTM_FR_BODY3_4xwwtd59665s787n6ctawh7k8_6ec7cb10_Rx if post-build-variant-condition{matching-criterion=Side, value=1}
        DIAG_RBTM_FL_03_ExtCAN_RQ_ST3_688ae269_Rx: CanIfRxPduCanId=417440905, CanIfRxPduCanIdType=EXTENDED_CAN, CanIfRxPduDlc=8, CanIfRxPduUserRxIndicationName=CanTp_RxIndication, CanIfRxPduUserRxIndicationType=PDUID_PDUINFOPTR, CanIfRxPduUserRxIndicationUL=CAN_TP, CanIfRxPduHrhIdRef=CanIfInitHohCfg/RBTM_FL_BODY3_8uqv9blm85ehm0msat385m76v_e046a621_Rx, CanIfRxPduRef=DIAG_RBTM_FL_03_ExtCAN_RQ_ST3_3f957a34_Rx, variation-point=post-build-variant-condition{matching-criterion=Side, value=0}
        DIAG_RBTM_FL_03_ExtEth_RQ_ST3_89267c36_Rx: CanIfRxPduCanId=417440904, CanIfRxPduCanIdType=EXTENDED_CAN, CanIfRxPduDlc=8, CanIfRxPduUserRxIndicationName=CanTp_RxIndication, CanIfRxPduUserRxIndicationType=PDUID_PDUINFOPTR, CanIfRxPduUserRxIndicationUL=CAN_TP, CanIfRxPduHrhIdRef=CanIfInitHohCfg/RBTM_FL_BODY3_8uqv9blm85ehm0msat385m76v_e046a621_Rx, CanIfRxPduRef=DIAG_RBTM_FL_03_ExtEth_RQ_ST3_8e910fe6_Rx, variation-point=post-build-variant-condition{matching-criterion=Side, value=0}
        DIAG_RBTM_FL_03_IntEth_RQ_ST3_91813a5c_Rx: CanIfRxPduCanId=417440909, CanIfRxPduCanIdType=EXTENDED_CAN, CanIfRxPduDlc=8, CanIfRxPduUserRxIndicationName=CanTp_RxIndication, CanIfRxPduUserRxIndicationType=PDUID_PDUINFOPTR, CanIfRxPduUserRxIndicationUL=CAN_TP, CanIfRxPduHrhIdRef=CanIfInitHohCfg/RBTM_FL_BODY3_8uqv9blm85ehm0msat385m76v_e046a621_Rx, CanIfRxPduRef=DIAG_RBTM_FL_03_IntEth_RQ_ST3_c3ea483d_Rx, variation-point=post-build-variant-condition{matching-criterion=Side, value=0}
        DIAG_RQ_GLOBAL_ExtCAN_ST3_c34d4a41_Rx: CanIfRxPduCanId=418314633, CanIfRxPduCanIdType=EXTENDED_CAN, CanIfRxPduDlc=8, CanIfRxPduUserRxIndicationName=CanTp_RxIndication, CanIfRxPduUserRxIndicationType=PDUID_PDUINFOPTR, CanIfRxPduUserRxIndicationUL=CAN_TP, CanIfRxPduHrhIdRef=CanIfInitHohCfg/RBTM_FL_BODY3_8uqv9blm85ehm0msat385m76v_e046a621_Rx if post-build-variant-condition{matching-criterion=Side, value=0}, CanIfRxPduRef=DIAG_RQ_GLOBAL_ExtCAN_ST3_320b5155_Rx, CanIfRxPduHrhIdRef=CanIfInitHohCfg/RBTM_FR_BODY3_4xwwtd59665s787n6ctawh7k8_5b8d9de8_Rx if post-build-variant-condition{matching-criterion=Side, value=1}
        DIAG_RQ_GLOBAL_ExtEth_ST3_c52e42e8_Rx: CanIfRxPduCanId=418314376, CanIfRxPduCanIdType=EXTENDED_CAN, CanIfRxPduDlc=8, CanIfRxPduUserRxIndicationName=CanTp_RxIndication, CanIfRxPduUserRxIndicationType=PDUID_PDUINFOPTR, CanIfRxPduUserRxIndicationUL=CAN_TP, CanIfRxPduHrhIdRef=CanIfInitHohCfg/RBTM_FL_BODY3_8uqv9blm85ehm0msat385m76v_e046a621_Rx if post-build-variant-condition{matching-criterion=Side, value=0}, CanIfRxPduRef=DIAG_RQ_GLOBAL_ExtEth_ST3_3402b191_Rx, CanIfRxPduHrhIdRef=CanIfInitHohCfg/RBTM_FR_BODY3_4xwwtd59665s787n6ctawh7k8_5b8d9de8_Rx if post-build-variant-condition{matching-criterion=Side, value=1}
        DIAG_RQ_GLOBAL_IntEth_ST3_dc07327b_Rx: CanIfRxPduCanId=418319757, CanIfRxPduCanIdType=EXTENDED_CAN, CanIfRxPduDlc=8, CanIfRxPduUserRxIndicationName=CanTp_RxIndication, CanIfRxPduUserRxIndicationType=PDUID_PDUINFOPTR, CanIfRxPduUserRxIndicationUL=CAN_TP, CanIfRxPduHrhIdRef=CanIfInitHohCfg/RBTM_FL_BODY3_8uqv9blm85ehm0msat385m76v_e046a621_Rx if post-build-variant-condition{matching-criterion=Side, value=0}, CanIfRxPduRef=DIAG_RQ_GLOBAL_IntEth_ST3_f8cf566a_Rx, CanIfRxPduHrhIdRef=CanIfInitHohCfg/RBTM_FR_BODY3_4xwwtd59665s787n6ctawh7k8_5b8d9de8_Rx if post-build-variant-condition{matching-criterion=Side, value=1}
        DIAG_Stat_ST3_7f697120_Rx: CanIfRxPduCanId=1744, CanIfRxPduCanIdType=STANDARD_CAN, CanIfRxPduDlc=4, CanIfRxPduUserRxIndicationName=PduR_CanIfRxIndication, CanIfRxPduUserRxIndicationUL=PDUR, CanIfRxPduHrhIdRef=CanIfInitHohCfg/RBTM_FL_BODY3_8uqv9blm85ehm0msat385m76v_d50cf0d9_Rx if post-build-variant-condition{matching-criterion=Side, value=0}, CanIfRxPduRef=EcucPduCollection/DIAG_Stat_ST3_d3ec8369_Rx, CanIfRxPduHrhIdRef=CanIfInitHohCfg/RBTM_FR_BODY3_4xwwtd59665s787n6ctawh7k8_6ec7cb10_Rx if post-build-variant-condition{matching-criterion=Side, value=1}
        DI_OdoSpeedometer_ST3_11e98e6f_Rx: CanIfRxPduCanId=1381, CanIfRxPduCanIdType=STANDARD_CAN, CanIfRxPduDlc=8, CanIfRxPduUserRxIndicationName=PduR_CanIfRxIndication, CanIfRxPduUserRxIndicationUL=PDUR, CanIfRxPduHrhIdRef=CanIfInitHohCfg/RBTM_FL_BODY3_8uqv9blm85ehm0msat385m76v_d50cf0d9_Rx if post-build-variant-condition{matching-criterion=Side, value=0}, CanIfRxPduRef=EcucPduCollection/DI_OdoSpeedometer_ST3_0665a232_Rx, CanIfRxPduHrhIdRef=CanIfInitHohCfg/RBTM_FR_BODY3_4xwwtd59665s787n6ctawh7k8_6ec7cb10_Rx if post-build-variant-condition{matching-criterion=Side, value=1}
        DPC_Md_Rq_ESP_d1_ST3_92dc8d11_Rx: CanIfRxPduCanId=1731, CanIfRxPduCanIdType=STANDARD_CAN, CanIfRxPduDlc=1, CanIfRxPduUserRxIndicationName=PduR_CanIfRxIndication, CanIfRxPduUserRxIndicationUL=PDUR, CanIfRxPduHrhIdRef=CanIfInitHohCfg/RBTM_FL_BODY3_8uqv9blm85ehm0msat385m76v_d50cf0d9_Rx if post-build-variant-condition{matching-criterion=Side, value=0}, CanIfRxPduRef=EcucPduCollection/DPC_Md_Rq_ESP_d1_ST3_5573a8b2_Rx, CanIfRxPduHrhIdRef=CanIfInitHohCfg/RBTM_FR_BODY3_4xwwtd59665s787n6ctawh7k8_6ec7cb10_Rx if post-build-variant-condition{matching-criterion=Side, value=1}
        Develop8_Rq_RBTM_FL_ST3_fe216789_Rx: CanIfRxPduCanId=417440833, CanIfRxPduCanIdType=EXTENDED_CAN, CanIfRxPduDlc=8, CanIfRxPduUserRxIndicationName=PduR_CanIfRxIndication, CanIfRxPduUserRxIndicationUL=PDUR, CanIfRxPduHrhIdRef=CanIfInitHohCfg/RBTM_FL_BODY3_8uqv9blm85ehm0msat385m76v_e046a621_Rx, CanIfRxPduRef=EcucPduCollection/Develop8_Rq_RBTM_FL_ST3_0a7cffe6_Rx, variation-point=post-build-variant-condition{matching-criterion=Side, value=0}
        ELC_Lvr_Stat_ST3_secured_612a2882_Rx: CanIfRxPduCanId=1733, CanIfRxPduCanIdType=STANDARD_CAN, CanIfRxPduDlc=8, CanIfRxPduUserRxIndicationName=PduR_CanIfRxIndication, CanIfRxPduUserRxIndicationUL=PDUR, CanIfRxPduHrhIdRef=CanIfInitHohCfg/RBTM_FL_BODY3_8uqv9blm85ehm0msat385m76v_d50cf0d9_Rx if post-build-variant-condition{matching-criterion=Side, value=0}, CanIfRxPduRef=EcucPduCollection/ELC_Lvr_Stat_ST3_secured_29d2456c_Rx, CanIfRxPduHrhIdRef=CanIfInitHohCfg/RBTM_FR_BODY3_4xwwtd59665s787n6ctawh7k8_6ec7cb10_Rx if post-build-variant-condition{matching-criterion=Side, value=1}
        EVC_CfgList_01_08_Pr5_ST3_2e9e0d1a_Rx: CanIfRxPduCanId=1760, CanIfRxPduCanIdType=STANDARD_CAN, CanIfRxPduDlc=8, CanIfRxPduUserRxIndicationName=PduR_CanIfRxIndication, CanIfRxPduUserRxIndicationUL=PDUR, CanIfRxPduHrhIdRef=CanIfInitHohCfg/RBTM_FL_BODY3_8uqv9blm85ehm0msat385m76v_d50cf0d9_Rx if post-build-variant-condition{matching-criterion=Side, value=0}, CanIfRxPduRef=EcucPduCollection/EVC_CfgList_01_08_Pr5_ST3_be03dd9d_Rx, CanIfRxPduHrhIdRef=CanIfInitHohCfg/RBTM_FR_BODY3_4xwwtd59665s787n6ctawh7k8_6ec7cb10_Rx if post-build-variant-condition{matching-criterion=Side, value=1}
        GTS_Main_CAN_ST3_007ffebc_Rx: CanIfRxPduCanId=121, CanIfRxPduCanIdType=STANDARD_CAN, CanIfRxPduDlc=8, CanIfRxPduUserRxIndicationName=CanTSyn_CanIfRxIndication, CanIfRxPduUserRxIndicationUL=CAN_TSYN, CanIfRxPduHrhIdRef=CanIfInitHohCfg/RBTM_FL_BODY3_8uqv9blm85ehm0msat385m76v_d50cf0d9_Rx if post-build-variant-condition{matching-criterion=Side, value=0}, CanIfRxPduRef=EcucPduCollection/GTS_Main_CAN_ST3_dd88dcd5_Rx, CanIfRxPduHrhIdRef=CanIfInitHohCfg/RBTM_FR_BODY3_4xwwtd59665s787n6ctawh7k8_6ec7cb10_Rx if post-build-variant-condition{matching-criterion=Side, value=1}
        Ign_Stat_ST3_secured_07d79dc2_Rx: CanIfRxPduCanId=127, CanIfRxPduCanIdType=STANDARD_CAN, CanIfRxPduDlc=8, CanIfRxPduUserRxIndicationName=PduR_CanIfRxIndication, CanIfRxPduUserRxIndicationUL=PDUR, CanIfRxPduHrhIdRef=CanIfInitHohCfg/RBTM_FL_BODY3_8uqv9blm85ehm0msat385m76v_d50cf0d9_Rx if post-build-variant-condition{matching-criterion=Side, value=0}, CanIfRxPduRef=EcucPduCollection/Ign_Stat_ST3_secured_fb0d4f19_Rx, CanIfRxPduHrhIdRef=CanIfInitHohCfg/RBTM_FR_BODY3_4xwwtd59665s787n6ctawh7k8_6ec7cb10_Rx if post-build-variant-condition{matching-criterion=Side, value=1}
        Impact2_ST3_secured_5de175a2_Rx: CanIfRxPduCanId=1123, CanIfRxPduCanIdType=STANDARD_CAN, CanIfRxPduDlc=8, CanIfRxPduUserRxIndicationName=PduR_CanIfRxIndication, CanIfRxPduUserRxIndicationUL=PDUR, CanIfRxPduHrhIdRef=CanIfInitHohCfg/RBTM_FL_BODY3_8uqv9blm85ehm0msat385m76v_d50cf0d9_Rx if post-build-variant-condition{matching-criterion=Side, value=0}, CanIfRxPduRef=EcucPduCollection/Impact2_ST3_secured_de133629_Rx, CanIfRxPduHrhIdRef=CanIfInitHohCfg/RBTM_FR_BODY3_4xwwtd59665s787n6ctawh7k8_6ec7cb10_Rx if post-build-variant-condition{matching-criterion=Side, value=1}
        Impact3_ST3_c1d5b894_Rx: CanIfRxPduCanId=1125, CanIfRxPduCanIdType=STANDARD_CAN, CanIfRxPduDlc=4, CanIfRxPduUserRxIndicationName=PduR_CanIfRxIndication, CanIfRxPduUserRxIndicationUL=PDUR, CanIfRxPduHrhIdRef=CanIfInitHohCfg/RBTM_FL_BODY3_8uqv9blm85ehm0msat385m76v_d50cf0d9_Rx if post-build-variant-condition{matching-criterion=Side, value=0}, CanIfRxPduRef=EcucPduCollection/Impact3_ST3_993f4b56_Rx, CanIfRxPduHrhIdRef=CanIfInitHohCfg/RBTM_FR_BODY3_4xwwtd59665s787n6ctawh7k8_6ec7cb10_Rx if post-build-variant-condition{matching-criterion=Side, value=1}
        NTG_Master_Navi_ST3_1e826461_Rx: CanIfRxPduCanId=1732, CanIfRxPduCanIdType=STANDARD_CAN, CanIfRxPduDlc=2, CanIfRxPduUserRxIndicationName=PduR_CanIfRxIndication, CanIfRxPduUserRxIndicationUL=PDUR, CanIfRxPduHrhIdRef=CanIfInitHohCfg/RBTM_FL_BODY3_8uqv9blm85ehm0msat385m76v_d50cf0d9_Rx if post-build-variant-condition{matching-criterion=Side, value=0}, CanIfRxPduRef=EcucPduCollection/NTG_Master_Navi_ST3_1032e485_Rx, CanIfRxPduHrhIdRef=CanIfInitHohCfg/RBTM_FR_BODY3_4xwwtd59665s787n6ctawh7k8_6ec7cb10_Rx if post-build-variant-condition{matching-criterion=Side, value=1}
        PN14_Master_Stat1_ST3_56fd286b_Rx: CanIfRxPduCanId=1124, CanIfRxPduCanIdType=STANDARD_CAN, CanIfRxPduDlc=8, CanIfRxPduUserRxIndicationName=PduR_CanIfRxIndication, CanIfRxPduUserRxIndicationUL=PDUR, CanIfRxPduHrhIdRef=CanIfInitHohCfg/RBTM_FL_BODY3_8uqv9blm85ehm0msat385m76v_d50cf0d9_Rx if post-build-variant-condition{matching-criterion=Side, value=0}, CanIfRxPduRef=EcucPduCollection/PN14_Master_Stat1_ST3_69644078_Rx, CanIfRxPduHrhIdRef=CanIfInitHohCfg/RBTM_FR_BODY3_4xwwtd59665s787n6ctawh7k8_6ec7cb10_Rx if post-build-variant-condition{matching-criterion=Side, value=1}
        PT4_PTCoor4_ST3_59056fb4_Rx: CanIfRxPduCanId=863, CanIfRxPduCanIdType=STANDARD_CAN, CanIfRxPduDlc=4, CanIfRxPduUserRxIndicationName=PduR_CanIfRxIndication, CanIfRxPduUserRxIndicationUL=PDUR, CanIfRxPduHrhIdRef=CanIfInitHohCfg/RBTM_FL_BODY3_8uqv9blm85ehm0msat385m76v_d50cf0d9_Rx if post-build-variant-condition{matching-criterion=Side, value=0}, CanIfRxPduRef=EcucPduCollection/PT4_PTCoor4_ST3_868ca7d3_Rx, CanIfRxPduHrhIdRef=CanIfInitHohCfg/RBTM_FR_BODY3_4xwwtd59665s787n6ctawh7k8_6ec7cb10_Rx if post-build-variant-condition{matching-criterion=Side, value=1}
        PT4_PTCoor9_d1_BC_F_ST3_4460ebae_Rx: CanIfRxPduCanId=772, CanIfRxPduCanIdType=STANDARD_CAN, CanIfRxPduDlc=1, CanIfRxPduUserRxIndicationName=PduR_CanIfRxIndication, CanIfRxPduUserRxIndicationUL=PDUR, CanIfRxPduHrhIdRef=CanIfInitHohCfg/RBTM_FL_BODY3_8uqv9blm85ehm0msat385m76v_d50cf0d9_Rx if post-build-variant-condition{matching-criterion=Side, value=0}, CanIfRxPduRef=EcucPduCollection/PT4_PTCoor9_d1_BC_F_ST3_f2a4ec1b_Rx, CanIfRxPduHrhIdRef=CanIfInitHohCfg/RBTM_FR_BODY3_4xwwtd59665s787n6ctawh7k8_6ec7cb10_Rx if post-build-variant-condition{matching-criterion=Side, value=1}
        PT4_PTCoor_DrvPosn_Gear_ST3_aabed571_Rx: CanIfRxPduCanId=1410, CanIfRxPduCanIdType=STANDARD_CAN, CanIfRxPduDlc=8, CanIfRxPduUserRxIndicationName=PduR_CanIfRxIndication, CanIfRxPduUserRxIndicationUL=PDUR, CanIfRxPduHrhIdRef=CanIfInitHohCfg/RBTM_FL_BODY3_8uqv9blm85ehm0msat385m76v_d50cf0d9_Rx if post-build-variant-condition{matching-criterion=Side, value=0}, CanIfRxPduRef=EcucPduCollection/PT4_PTCoor_DrvPosn_Gear_ST3_f70358bf_Rx, CanIfRxPduHrhIdRef=CanIfInitHohCfg/RBTM_FR_BODY3_4xwwtd59665s787n6ctawh7k8_6ec7cb10_Rx if post-build-variant-condition{matching-criterion=Side, value=1}
        PresfAct_Adj_ST3_87d3ccaf_Rx: CanIfRxPduCanId=1685, CanIfRxPduCanIdType=STANDARD_CAN, CanIfRxPduDlc=8, CanIfRxPduUserRxIndicationName=PduR_CanIfRxIndication, CanIfRxPduUserRxIndicationUL=PDUR, CanIfRxPduHrhIdRef=CanIfInitHohCfg/RBTM_FL_BODY3_8uqv9blm85ehm0msat385m76v_d50cf0d9_Rx if post-build-variant-condition{matching-criterion=Side, value=0}, CanIfRxPduRef=EcucPduCollection/PresfAct_Adj_ST3_81976f17_Rx, CanIfRxPduHrhIdRef=CanIfInitHohCfg/RBTM_FR_BODY3_4xwwtd59665s787n6ctawh7k8_6ec7cb10_Rx if post-build-variant-condition{matching-criterion=Side, value=1}
        RBTM_FL_BODY3NMNODE_032841d9_Rx: CanIfRxPduCanIdType=EXTENDED_CAN, CanIfRxPduDlc=8, CanIfRxPduUserRxIndicationName=CanNm_RxIndication, CanIfRxPduUserRxIndicationUL=CAN_NM, CanIfRxPduHrhIdRef=CanIfInitHohCfg/RBTM_FL_BODY3_8uqv9blm85ehm0msat385m76v_e046a621_Rx, CanIfRxPduRef=RBTM_FL_BODY3NMNODE_34236992_Rx, variation-point=post-build-variant-condition{matching-criterion=Side, value=0}
          BODY3_a3c1981a (CanIfRxPduCanIdRange): CanIfRxPduCanIdRangeLowerCanId=339869696, CanIfRxPduCanIdRangeUpperCanId=339873791
        RBTM_FR_Stat_ST3_b20121fa_Rx: CanIfRxPduCanId=1689, CanIfRxPduCanIdType=STANDARD_CAN, CanIfRxPduDlc=8, CanIfRxPduUserRxIndicationName=PduR_CanIfRxIndication, CanIfRxPduUserRxIndicationUL=PDUR, CanIfRxPduHrhIdRef=CanIfInitHohCfg/RBTM_FL_BODY3_8uqv9blm85ehm0msat385m76v_d50cf0d9_Rx, CanIfRxPduRef=EcucPduCollection/RBTM_FR_Stat_ST3_8dd11b6c_Rx, variation-point=post-build-variant-condition{matching-criterion=Side, value=0}
        SBeltTens_SP_Lvl_ST3_7cf5644e_Rx: CanIfRxPduCanId=782, CanIfRxPduCanIdType=STANDARD_CAN, CanIfRxPduDlc=8, CanIfRxPduUserRxIndicationName=PduR_CanIfRxIndication, CanIfRxPduUserRxIndicationUL=PDUR, CanIfRxPduHrhIdRef=CanIfInitHohCfg/RBTM_FL_BODY3_8uqv9blm85ehm0msat385m76v_d50cf0d9_Rx if post-build-variant-condition{matching-criterion=Side, value=0}, CanIfRxPduRef=EcucPduCollection/SBeltTens_SP_Lvl_ST3_73b20851_Rx, CanIfRxPduHrhIdRef=CanIfInitHohCfg/RBTM_FR_BODY3_4xwwtd59665s787n6ctawh7k8_6ec7cb10_Rx if post-build-variant-condition{matching-criterion=Side, value=1}
        VSS_TP_Auth_ST3_1d67253f_Rx: CanIfRxPduCanId=749, CanIfRxPduCanIdType=STANDARD_CAN, CanIfRxPduDlc=8, CanIfRxPduUserRxIndicationName=PduR_CanIfRxIndication, CanIfRxPduUserRxIndicationUL=PDUR, CanIfRxPduHrhIdRef=CanIfInitHohCfg/RBTM_FL_BODY3_8uqv9blm85ehm0msat385m76v_d50cf0d9_Rx if post-build-variant-condition{matching-criterion=Side, value=0}, CanIfRxPduRef=EcucPduCollection/VSS_TP_Auth_ST3_29a0d419_Rx, CanIfRxPduHrhIdRef=CanIfInitHohCfg/RBTM_FR_BODY3_4xwwtd59665s787n6ctawh7k8_6ec7cb10_Rx if post-build-variant-condition{matching-criterion=Side, value=1}
        VSS_TP_RealTmOffset_ST3_012f1a71_Rx: CanIfRxPduCanId=741, CanIfRxPduCanIdType=STANDARD_CAN, CanIfRxPduDlc=8, CanIfRxPduUserRxIndicationName=PduR_CanIfRxIndication, CanIfRxPduUserRxIndicationUL=PDUR, CanIfRxPduHrhIdRef=CanIfInitHohCfg/RBTM_FL_BODY3_8uqv9blm85ehm0msat385m76v_d50cf0d9_Rx if post-build-variant-condition{matching-criterion=Side, value=0}, CanIfRxPduRef=EcucPduCollection/VSS_TP_RealTmOffset_ST3_d6d134b3_Rx, CanIfRxPduHrhIdRef=CanIfInitHohCfg/RBTM_FR_BODY3_4xwwtd59665s787n6ctawh7k8_6ec7cb10_Rx if post-build-variant-condition{matching-criterion=Side, value=1}
        VSS_TP_SecTickCount_Lvl2_ST3_2123eaf8_Rx: CanIfRxPduCanId=746, CanIfRxPduCanIdType=STANDARD_CAN, CanIfRxPduDlc=8, CanIfRxPduUserRxIndicationName=PduR_CanIfRxIndication, CanIfRxPduUserRxIndicationUL=PDUR, CanIfRxPduHrhIdRef=CanIfInitHohCfg/RBTM_FL_BODY3_8uqv9blm85ehm0msat385m76v_d50cf0d9_Rx if post-build-variant-condition{matching-criterion=Side, value=0}, CanIfRxPduRef=EcucPduCollection/VSS_TP_SecTickCount_Lvl2_ST3_c0c3ca3b_Rx, CanIfRxPduHrhIdRef=CanIfInitHohCfg/RBTM_FR_BODY3_4xwwtd59665s787n6ctawh7k8_6ec7cb10_Rx if post-build-variant-condition{matching-criterion=Side, value=1}
        VSS_TP_SharedSecret_ST3_70962814_Rx: CanIfRxPduCanId=751, CanIfRxPduCanIdType=STANDARD_CAN, CanIfRxPduDlc=8, CanIfRxPduUserRxIndicationName=PduR_CanIfRxIndication, CanIfRxPduUserRxIndicationUL=PDUR, CanIfRxPduHrhIdRef=CanIfInitHohCfg/RBTM_FL_BODY3_8uqv9blm85ehm0msat385m76v_d50cf0d9_Rx if post-build-variant-condition{matching-criterion=Side, value=0}, CanIfRxPduRef=EcucPduCollection/VSS_TP_SharedSecret_ST3_6d7ca724_Rx, CanIfRxPduHrhIdRef=CanIfInitHohCfg/RBTM_FR_BODY3_4xwwtd59665s787n6ctawh7k8_6ec7cb10_Rx if post-build-variant-condition{matching-criterion=Side, value=1}
        VSS_TP_VIN_ST3_b3b4e778_Rx: CanIfRxPduCanId=747, CanIfRxPduCanIdType=STANDARD_CAN, CanIfRxPduDlc=8, CanIfRxPduUserRxIndicationName=PduR_CanIfRxIndication, CanIfRxPduUserRxIndicationUL=PDUR, CanIfRxPduHrhIdRef=CanIfInitHohCfg/RBTM_FL_BODY3_8uqv9blm85ehm0msat385m76v_d50cf0d9_Rx if post-build-variant-condition{matching-criterion=Side, value=0}, CanIfRxPduRef=EcucPduCollection/VSS_TP_VIN_ST3_f7ab6516_Rx, CanIfRxPduHrhIdRef=CanIfInitHohCfg/RBTM_FR_BODY3_4xwwtd59665s787n6ctawh7k8_6ec7cb10_Rx if post-build-variant-condition{matching-criterion=Side, value=1}
        XCP8_Rq_RBTM_FL_ST3_8d155fa4_Rx: CanIfRxPduCanId=417440777, CanIfRxPduCanIdType=EXTENDED_CAN, CanIfRxPduDlc=8, CanIfRxPduUserRxIndicationName=Xcp_CanIfRxIndication, CanIfRxPduUserRxIndicationUL=XCP, CanIfRxPduHrhIdRef=CanIfInitHohCfg/RBTM_FL_BODY3_8uqv9blm85ehm0msat385m76v_e046a621_Rx, CanIfRxPduRef=EcucPduCollection/XCP8_Rq_RBTM_FL_ST3_480c7aac_Rx, variation-point=post-build-variant-condition{matching-criterion=Side, value=0}
      12 x CanIfTxPduCfg, all with CanIfTxPduBufferRef=CanIfInitCfg/BODY3_bccb160f, variation-point=post-build-variant-condition{matching-criterion=Side, value=0}:
        BeltAdj_FL_Stat_ST3_df27ce55_Tx: CanIfTxPduCanId=1696, CanIfTxPduCanIdType=STANDARD_CAN, CanIfTxPduDlc=1, CanIfTxPduUserTxConfirmationName=PduR_CanIfTxConfirmation, CanIfTxPduUserTxConfirmationUL=PDUR, CanIfTxPduRef=EcucPduCollection/BeltAdj_FL_Stat_ST3_71e5093a_Tx
        DIAG_RBTM_FL_03_ExtCAN_RS_ST3_70f788c0_Tx: CanIfTxPduCanId=417440897, CanIfTxPduCanIdType=EXTENDED_CAN, CanIfTxPduDlc=8, CanIfTxPduUserTxConfirmationName=CanTp_TxConfirmation, CanIfTxPduUserTxConfirmationUL=CAN_TP, CanIfTxPduRef=DIAG_RBTM_FL_03_ExtCAN_RS_ST3_ba6d58fb_Tx
        DIAG_RBTM_FL_03_ExtEth_RS_ST3_5af4aefa_Tx: CanIfTxPduCanId=417440896, CanIfTxPduCanIdType=EXTENDED_CAN, CanIfTxPduDlc=8, CanIfTxPduUserTxConfirmationName=CanTp_TxConfirmation, CanIfTxPduUserTxConfirmationUL=CAN_TP, CanIfTxPduRef=DIAG_RBTM_FL_03_ExtEth_RS_ST3_0b692d29_Tx
        DIAG_RBTM_FL_03_IntEth_RS_ST3_de5e5f30_Tx: CanIfTxPduCanId=417440901, CanIfTxPduCanIdType=EXTENDED_CAN, CanIfTxPduDlc=8, CanIfTxPduUserTxConfirmationName=CanTp_TxConfirmation, CanIfTxPduUserTxConfirmationUL=CAN_TP, CanIfTxPduRef=DIAG_RBTM_FL_03_IntEth_RS_ST3_46126af2_Tx
        Develop8_Rs_RBTM_FL_ST3_474b54d0_Tx: CanIfTxPduCanId=417440832, CanIfTxPduCanIdType=EXTENDED_CAN, CanIfTxPduDlc=8, CanIfTxPduUserTxConfirmationName=PduR_CanIfTxConfirmation, CanIfTxPduUserTxConfirmationUL=PDUR, CanIfTxPduRef=EcucPduCollection/Develop8_Rs_RBTM_FL_ST3_711f265e_Tx
        ECU_Stat_RBTM_FL_ST3_b7e6aa56_Tx: CanIfTxPduCanId=373424548, CanIfTxPduCanIdType=EXTENDED_CAN, CanIfTxPduDlc=8, CanIfTxPduUserTxConfirmationName=PduR_CanIfTxConfirmation, CanIfTxPduUserTxConfirmationUL=PDUR, CanIfTxPduRef=EcucPduCollection/ECU_Stat_RBTM_FL_ST3_42655720_Tx
        Meas8_RBTM_FL_ST3_a87f4b23_Tx: CanIfTxPduCanId=417440912, CanIfTxPduCanIdType=EXTENDED_CAN, CanIfTxPduDlc=8, CanIfTxPduUserTxConfirmationName=PduR_CanIfTxConfirmation, CanIfTxPduUserTxConfirmationUL=PDUR, CanIfTxPduRef=EcucPduCollection/Meas8_RBTM_FL_ST3_b4f3e350_Tx
        NM_RBTM_FL_ST3_8b5cec70_Tx: CanIfTxPduCanId=339870116, CanIfTxPduCanIdType=EXTENDED_CAN, CanIfTxPduDlc=8, CanIfTxPduUserTxConfirmationName=CanNm_TxConfirmation, CanIfTxPduUserTxConfirmationUL=CAN_NM, CanIfTxPduRef=EcucPduCollection/NM_RBTM_FL_ST3_b7c99fb7_Tx
        RBTM_FL_Stat_ST3_558a33d8_Tx: CanIfTxPduCanId=1688, CanIfTxPduCanIdType=STANDARD_CAN, CanIfTxPduDlc=8, CanIfTxPduUserTxConfirmationName=PduR_CanIfTxConfirmation, CanIfTxPduUserTxConfirmationUL=PDUR, CanIfTxPduRef=EcucPduCollection/RBTM_FL_Stat_ST3_d76d14af_Tx
        RBTM_FL_Tens_ST3_1446be6f_Tx: CanIfTxPduCanId=783, CanIfTxPduCanIdType=STANDARD_CAN, CanIfTxPduDlc=8, CanIfTxPduUserTxConfirmationName=PduR_CanIfTxConfirmation, CanIfTxPduUserTxConfirmationUL=PDUR, CanIfTxPduRef=EcucPduCollection/RBTM_FL_Tens_ST3_49d8a970_Tx
        ROE_RBTM_FL_ST3_e9956dfc_Tx: CanIfTxPduCanId=417440768, CanIfTxPduCanIdType=EXTENDED_CAN, CanIfTxPduDlc=8, CanIfTxPduUserTxConfirmationName=PduR_CanIfTxConfirmation, CanIfTxPduUserTxConfirmationUL=PDUR, CanIfTxPduRef=EcucPduCollection/ROE_RBTM_FL_ST3_75ad963a_Tx
        XCP8_Rs_RBTM_FL_ST3_8343908c_Tx: CanIfTxPduCanId=417440776, CanIfTxPduCanIdType=EXTENDED_CAN, CanIfTxPduDlc=8, CanIfTxPduUserTxConfirmationName=Xcp_CanIfTxConfirmation, CanIfTxPduUserTxConfirmationUL=XCP, CanIfTxPduRef=EcucPduCollection/XCP8_Rs_RBTM_FL_ST3_336fa314_Tx
      9 x CanIfRxPduCfg, all with variation-point=post-build-variant-condition{matching-criterion=Side, value=1}:
        BeltAdj_FL_Stat_ST3_df27ce55_Rx: CanIfRxPduCanId=1696, CanIfRxPduCanIdType=STANDARD_CAN, CanIfRxPduDlc=1, CanIfRxPduUserRxIndicationName=PduR_CanIfRxIndication, CanIfRxPduUserRxIndicationUL=PDUR, CanIfRxPduHrhIdRef=CanIfInitHohCfg/RBTM_FR_BODY3_4xwwtd59665s787n6ctawh7k8_6ec7cb10_Rx, CanIfRxPduRef=EcucPduCollection/BeltAdj_FL_Stat_ST3_71e5093a_Rx
        BeltHdOvr_FR_State_ST3_61b04b2f_Rx: CanIfRxPduCanId=1533, CanIfRxPduCanIdType=STANDARD_CAN, CanIfRxPduDlc=4, CanIfRxPduUserRxIndicationName=PduR_CanIfRxIndication, CanIfRxPduUserRxIndicationUL=PDUR, CanIfRxPduHrhIdRef=CanIfInitHohCfg/RBTM_FR_BODY3_4xwwtd59665s787n6ctawh7k8_6ec7cb10_Rx, CanIfRxPduRef=EcucPduCollection/BeltHdOvr_FR_State_ST3_09789cac_Rx
        DIAG_RBTM_FR_03_ExtCAN_RQ_ST3_72fbd255_Rx: CanIfRxPduCanId=417441161, CanIfRxPduCanIdType=EXTENDED_CAN, CanIfRxPduDlc=8, CanIfRxPduUserRxIndicationName=CanTp_RxIndication, CanIfRxPduUserRxIndicationType=PDUID_PDUINFOPTR, CanIfRxPduUserRxIndicationUL=CAN_TP, CanIfRxPduHrhIdRef=CanIfInitHohCfg/RBTM_FR_BODY3_4xwwtd59665s787n6ctawh7k8_5b8d9de8_Rx, CanIfRxPduRef=DIAG_RBTM_FR_03_ExtCAN_RQ_ST3_225f4e6d_Rx
        DIAG_RBTM_FR_03_ExtEth_RQ_ST3_0a9e12f4_Rx: CanIfRxPduCanId=417441160, CanIfRxPduCanIdType=EXTENDED_CAN, CanIfRxPduDlc=8, CanIfRxPduUserRxIndicationName=CanTp_RxIndication, CanIfRxPduUserRxIndicationType=PDUID_PDUINFOPTR, CanIfRxPduUserRxIndicationUL=CAN_TP, CanIfRxPduHrhIdRef=CanIfInitHohCfg/RBTM_FR_BODY3_4xwwtd59665s787n6ctawh7k8_5b8d9de8_Rx, CanIfRxPduRef=DIAG_RBTM_FR_03_ExtEth_RQ_ST3_935b3bbf_Rx
        DIAG_RBTM_FR_03_IntEth_RQ_ST3_fad47561_Rx: CanIfRxPduCanId=417441165, CanIfRxPduCanIdType=EXTENDED_CAN, CanIfRxPduDlc=8, CanIfRxPduUserRxIndicationName=CanTp_RxIndication, CanIfRxPduUserRxIndicationType=PDUID_PDUINFOPTR, CanIfRxPduUserRxIndicationUL=CAN_TP, CanIfRxPduHrhIdRef=CanIfInitHohCfg/RBTM_FR_BODY3_4xwwtd59665s787n6ctawh7k8_5b8d9de8_Rx, CanIfRxPduRef=DIAG_RBTM_FR_03_IntEth_RQ_ST3_de207c64_Rx
        Develop8_Rq_RBTM_FR_ST3_197eb912_Rx: CanIfRxPduCanId=417441089, CanIfRxPduCanIdType=EXTENDED_CAN, CanIfRxPduDlc=8, CanIfRxPduUserRxIndicationName=PduR_CanIfRxIndication, CanIfRxPduUserRxIndicationUL=PDUR, CanIfRxPduHrhIdRef=CanIfInitHohCfg/RBTM_FR_BODY3_4xwwtd59665s787n6ctawh7k8_5b8d9de8_Rx, CanIfRxPduRef=EcucPduCollection/Develop8_Rq_RBTM_FR_ST3_d1911cf7_Rx
        RBTM_FL_Stat_ST3_558a33d8_Rx: CanIfRxPduCanId=1688, CanIfRxPduCanIdType=STANDARD_CAN, CanIfRxPduDlc=8, CanIfRxPduUserRxIndicationName=PduR_CanIfRxIndication, CanIfRxPduUserRxIndicationUL=PDUR, CanIfRxPduHrhIdRef=CanIfInitHohCfg/RBTM_FR_BODY3_4xwwtd59665s787n6ctawh7k8_6ec7cb10_Rx, CanIfRxPduRef=EcucPduCollection/RBTM_FL_Stat_ST3_d76d14af_Rx
        RBTM_FR_BODY3NMNODE_65b97d54_Rx: CanIfRxPduCanIdType=EXTENDED_CAN, CanIfRxPduDlc=8, CanIfRxPduUserRxIndicationName=CanNm_RxIndication, CanIfRxPduUserRxIndicationUL=CAN_NM, CanIfRxPduHrhIdRef=CanIfInitHohCfg/RBTM_FR_BODY3_4xwwtd59665s787n6ctawh7k8_5b8d9de8_Rx, CanIfRxPduRef=RBTM_FR_BODY3NMNODE_e285a2b9_Rx
          BODY3_ed203270 (CanIfRxPduCanIdRange): CanIfRxPduCanIdRangeLowerCanId=339869696, CanIfRxPduCanIdRangeUpperCanId=339873791
        XCP8_Rq_RBTM_FR_ST3_e015abc0_Rx: CanIfRxPduCanId=417441033, CanIfRxPduCanIdType=EXTENDED_CAN, CanIfRxPduDlc=8, CanIfRxPduUserRxIndicationName=Xcp_CanIfRxIndication, CanIfRxPduUserRxIndicationUL=XCP, CanIfRxPduHrhIdRef=CanIfInitHohCfg/RBTM_FR_BODY3_4xwwtd59665s787n6ctawh7k8_5b8d9de8_Rx, CanIfRxPduRef=EcucPduCollection/XCP8_Rq_RBTM_FR_ST3_93e199bd_Rx
      12 x CanIfTxPduCfg, all with CanIfTxPduBufferRef=CanIfInitCfg/BODY3_bccb160f, variation-point=post-build-variant-condition{matching-criterion=Side, value=1}:
        BeltAdj_FR_Stat_ST3_070be586_Tx: CanIfTxPduCanId=1697, CanIfTxPduCanIdType=STANDARD_CAN, CanIfTxPduDlc=1, CanIfTxPduUserTxConfirmationName=PduR_CanIfTxConfirmation, CanIfTxPduUserTxConfirmationUL=PDUR, CanIfTxPduRef=EcucPduCollection/BeltAdj_FR_Stat_ST3_2b5906f9_Tx
        DIAG_RBTM_FR_03_ExtCAN_RS_ST3_d977ea77_Tx: CanIfTxPduCanId=417441153, CanIfTxPduCanIdType=EXTENDED_CAN, CanIfTxPduDlc=8, CanIfTxPduUserTxConfirmationName=CanTp_TxConfirmation, CanIfTxPduUserTxConfirmationUL=CAN_TP, CanIfTxPduRef=DIAG_RBTM_FR_03_ExtCAN_RS_ST3_a7a76ca2_Tx
        DIAG_RBTM_FR_03_ExtEth_RS_ST3_25545cfe_Tx: CanIfTxPduCanId=417441152, CanIfTxPduCanIdType=EXTENDED_CAN, CanIfTxPduDlc=8, CanIfTxPduUserTxConfirmationName=CanTp_TxConfirmation, CanIfTxPduUserTxConfirmationUL=CAN_TP, CanIfTxPduRef=DIAG_RBTM_FR_03_ExtEth_RS_ST3_16a31970_Tx
        DIAG_RBTM_FR_03_IntEth_RS_ST3_6c8422ac_Tx: CanIfTxPduCanId=417441157, CanIfTxPduCanIdType=EXTENDED_CAN, CanIfTxPduDlc=8, CanIfTxPduUserTxConfirmationName=CanTp_TxConfirmation, CanIfTxPduUserTxConfirmationUL=CAN_TP, CanIfTxPduRef=DIAG_RBTM_FR_03_IntEth_RS_ST3_5bd85eab_Tx
        Develop8_Rs_RBTM_FR_ST3_1a924f62_Tx: CanIfTxPduCanId=417441088, CanIfTxPduCanIdType=EXTENDED_CAN, CanIfTxPduDlc=8, CanIfTxPduUserTxConfirmationName=PduR_CanIfTxConfirmation, CanIfTxPduUserTxConfirmationUL=PDUR, CanIfTxPduRef=EcucPduCollection/Develop8_Rs_RBTM_FR_ST3_aaf2c54f_Tx
        ECU_Stat_RBTM_FR_ST3_430ba797_Tx: CanIfTxPduCanId=373424549, CanIfTxPduCanIdType=EXTENDED_CAN, CanIfTxPduDlc=8, CanIfTxPduUserTxConfirmationName=PduR_CanIfTxConfirmation, CanIfTxPduUserTxConfirmationUL=PDUR, CanIfTxPduRef=EcucPduCollection/ECU_Stat_RBTM_FR_ST3_9988b431_Tx
        Meas8_RBTM_FR_ST3_492d97af_Tx: CanIfTxPduCanId=417441168, CanIfTxPduCanIdType=EXTENDED_CAN, CanIfTxPduDlc=8, CanIfTxPduUserTxConfirmationName=PduR_CanIfTxConfirmation, CanIfTxPduUserTxConfirmationUL=PDUR, CanIfTxPduRef=EcucPduCollection/Meas8_RBTM_FR_ST3_6f1e0041_Tx
        NM_RBTM_FR_ST3_d6dddcba_Tx: CanIfTxPduCanId=339870117, CanIfTxPduCanIdType=EXTENDED_CAN, CanIfTxPduDlc=8, CanIfTxPduUserTxConfirmationName=CanNm_TxConfirmation, CanIfTxPduUserTxConfirmationUL=CAN_NM, CanIfTxPduRef=EcucPduCollection/NM_RBTM_FR_ST3_6c247ca6_Tx
        RBTM_FR_Stat_ST3_b20121fa_Tx: CanIfTxPduCanId=1689, CanIfTxPduCanIdType=STANDARD_CAN, CanIfTxPduDlc=8, CanIfTxPduUserTxConfirmationName=PduR_CanIfTxConfirmation, CanIfTxPduUserTxConfirmationUL=PDUR, CanIfTxPduRef=EcucPduCollection/RBTM_FR_Stat_ST3_8dd11b6c_Tx
        RBTM_FR_Tens_ST3_019feca0_Tx: CanIfTxPduCanId=784, CanIfTxPduCanIdType=STANDARD_CAN, CanIfTxPduDlc=8, CanIfTxPduUserTxConfirmationName=PduR_CanIfTxConfirmation, CanIfTxPduUserTxConfirmationUL=PDUR, CanIfTxPduRef=EcucPduCollection/RBTM_FR_Tens_ST3_1364a6b3_Tx
        ROE_RBTM_FR_ST3_d7dfdf54_Tx: CanIfTxPduCanId=417441024, CanIfTxPduCanIdType=EXTENDED_CAN, CanIfTxPduDlc=8, CanIfTxPduUserTxConfirmationName=PduR_CanIfTxConfirmation, CanIfTxPduUserTxConfirmationUL=PDUR, CanIfTxPduRef=EcucPduCollection/ROE_RBTM_FR_ST3_ae40752b_Tx
        XCP8_Rs_RBTM_FR_ST3_fde109ec_Tx: CanIfTxPduCanId=417441032, CanIfTxPduCanIdType=EXTENDED_CAN, CanIfTxPduDlc=8, CanIfTxPduUserTxConfirmationName=Xcp_CanIfTxConfirmation, CanIfTxPduUserTxConfirmationUL=XCP, CanIfTxPduRef=EcucPduCollection/XCP8_Rs_RBTM_FR_ST3_e8824005_Tx
    CanIfPrivateCfg: CanIfPrivateSoftwareFilterType=LINEAR
    CanIfPublicCfg: CanIfPublicPnSupport=true
  module config CanNm
    CanNmGlobalConfig:
      CanNmBusLoadReductionEnabled = false
      CanNmComControlEnabled = true
      CanNmComUserDataSupport = true
      CanNmImmediateRestartEnabled = false
      CanNmPassiveModeEnabled = false
      CanNmPnEiraCalcEnabled = true
      CanNmPnResetTime = 1.1
      CanNmRemoteSleepIndEnabled = true
      CanNmRepeatMsgIndEnabled = false
      CanNmUserDataEnabled = false
      CanNmPnEiraRxNSduRef = PduPnc_EIRA_CAN_Rx
      BODY3_8b033453 (CanNmChannelConfig):
        CanNmBusLoadReductionActive = false
        CanNmImmediateNmCycleTime = 0.02
        CanNmImmediateNmTransmissions = 6
        CanNmMsgCycleOffset = 0
        CanNmMsgCycleTime = 1
        CanNmMsgTimeoutTime = 0.5
        CanNmPduCbvPosition = CANNM_PDU_BYTE_0
        CanNmPduNidPosition = CANNM_PDU_OFF
        CanNmPnEnabled = true
        CanNmPnEraCalcEnabled = false
        CanNmRemoteSleepIndTime = 2.5
        CanNmRepeatMessageTime = 3
        CanNmTimeoutTime = 2.5
        CanNmUserDataLength = 7
        CanNmWaitBusSleepTime = 1.5
        CanNmComMNetworkHandleRef = ComMConfigSet/RBTM_FL_BODY3_8uqv9blm85ehm0msat385m76v_03d5f5f6 if post-build-variant-condition{matching-criterion=Side, value=0}
        CanNmComMNetworkHandleRef = ComMConfigSet/RBTM_FR_BODY3_4xwwtd59665s787n6ctawh7k8_23a94727 if post-build-variant-condition{matching-criterion=Side, value=1}
        BODY3_8b033453_Rx (CanNmRxPdu):
          CanNmRxPduRef = RBTM_FL_BODY3NMNODE_34236992_Rx if post-build-variant-condition{matching-criterion=Side, value=0}
          CanNmRxPduRef = RBTM_FR_BODY3NMNODE_e285a2b9_Rx if post-build-variant-condition{matching-criterion=Side, value=1}
        NM_RBTM_FL_ST3_b7c99fb7_Tx (CanNmTxPdu): CanNmTxPduRef=EcucPduCollection/NM_RBTM_FL_ST3_b7c99fb7_Tx, variation-point=post-build-variant-condition{matching-criterion=Side, value=0}
        NM_RBTM_FL_ST3_e414ee7b (CanNmUserDataTxPdu):
          CanNmTxUserDataPduRef = EcucPduCollection/NM_RBTM_FL_ST3_0cdf2d0f_Tx
          variation-point = post-build-variant-condition{matching-criterion=Side, value=0}
        NM_RBTM_FR_ST3_6c247ca6_Tx (CanNmTxPdu): CanNmTxPduRef=EcucPduCollection/NM_RBTM_FR_ST3_6c247ca6_Tx, variation-point=post-build-variant-condition{matching-criterion=Side, value=1}
        NM_RBTM_FR_ST3_f94fffa8 (CanNmUserDataTxPdu):
          CanNmTxUserDataPduRef = EcucPduCollection/NM_RBTM_FR_ST3_d30f04ec_Tx
          variation-point = post-build-variant-condition{matching-criterion=Side, value=1}
      CanNmPnInfo: CanNmPnInfoLength=7, CanNmPnInfoOffset=1
        7 x CanNmPnFilterMaskByte:
          CanNmPnFilterMaskByte_0: CanNmPnFilterMaskByteIndex=0, CanNmPnFilterMaskByteValue=1
          CanNmPnFilterMaskByte_1: CanNmPnFilterMaskByteIndex=1, CanNmPnFilterMaskByteValue=0
          CanNmPnFilterMaskByte_2: CanNmPnFilterMaskByteIndex=2, CanNmPnFilterMaskByteValue=16
          CanNmPnFilterMaskByte_{3..6}: CanNmPnFilterMaskByteIndex={3..6}, CanNmPnFilterMaskByteValue=0
  module config CanSM
    CanSMConfiguration
      BODY3_bccb160f (CanSMManagerNetwork):
        CanSMComMNetworkHandleRef = ComMConfigSet/RBTM_FL_BODY3_8uqv9blm85ehm0msat385m76v_03d5f5f6 if post-build-variant-condition{matching-criterion=Side, value=0}
        CanSMComMNetworkHandleRef = ComMConfigSet/RBTM_FR_BODY3_4xwwtd59665s787n6ctawh7k8_23a94727 if post-build-variant-condition{matching-criterion=Side, value=1}
        RBTM_FL_BODY3_001d3ccc (CanSMController):
          CanSMControllerId = CanIfCtrlDrvCfg_7d254554/RBTM_FL_BODY3_180ddaa4
          variation-point = post-build-variant-condition{matching-criterion=Side, value=0}
        RBTM_FR_BODY3_d6bbf7e7 (CanSMController):
          CanSMControllerId = CanIfCtrlDrvCfg_7d254554/RBTM_FR_BODY3_2fec3d37
          variation-point = post-build-variant-condition{matching-criterion=Side, value=1}
  module config CanTSyn
    GTD_BODY3_0_14e64f11 (CanTSynGlobalTimeDomain): CanTSynGlobalTimeDomainId=0, CanTSynSynchronizedTimeBaseRef=StbM/GTD_BODY3_0_14e64f11
      GTS_RBTM_FL_0_f14a8f52 (CanTSynGlobalTimeSlave): CanTSynRxCrcValidated=CRC_VALIDATED, variation-point=post-build-variant-condition{matching-criterion=Side, value=0}
        GTS_Main_CAN_ST3_dd88dcd5_Rx (CanTSynGlobalTimeSlavePdu): CanTSynGlobalTimePduRef=EcucPduCollection/GTS_Main_CAN_ST3_dd88dcd5_Rx
      GTS_RBTM_FR_0_e7f20128 (CanTSynGlobalTimeSlave): CanTSynRxCrcValidated=CRC_VALIDATED, variation-point=post-build-variant-condition{matching-criterion=Side, value=1}
        GTS_Main_CAN_ST3_dd88dcd5_Rx (CanTSynGlobalTimeSlavePdu): CanTSynGlobalTimePduRef=EcucPduCollection/GTS_Main_CAN_ST3_dd88dcd5_Rx
  module config CanTp
    CanTpConfig
      12 x CanTpChannel:
        BODY3_DIAG_GLOBAL_ExtCAN_RQ_BODY3_ST3_1b970870: CanTpChannelMode=CANTP_MODE_HALF_DUPLEX, variation-point=post-build-variant-condition{matching-criterion=Side, value=0}
          CanTpRxNSdu_e35239dd (CanTpRxNSdu):
            CanTpRxAddressingFormat = CANTP_STANDARD
            CanTpRxDl = 8
            CanTpRxPaddingActivation = CANTP_ON
            CanTpRxTaType = CANTP_FUNCTIONAL
            CanTpRxNSduRef = EcucPduCollection/SDU_DIAG_GLOBAL_ExtCAN_RQ_BODY3_ST3_1d96a036_Rx
            CanTpRxNPdu_a8dd74b8 (CanTpRxNPdu): CanTpRxNPduRef=DIAG_RQ_GLOBAL_ExtCAN_ST3_320b5155_Rx
        BODY3_DIAG_GLOBAL_ExtEth_RQ_BODY3_ST3_55538ea6: CanTpChannelMode=CANTP_MODE_HALF_DUPLEX, variation-point=post-build-variant-condition{matching-criterion=Side, value=0}
          CanTpRxNSdu_4a102435 (CanTpRxNSdu):
            CanTpRxAddressingFormat = CANTP_STANDARD
            CanTpRxDl = 8
            CanTpRxPaddingActivation = CANTP_ON
            CanTpRxTaType = CANTP_FUNCTIONAL
            CanTpRxNSduRef = EcucPduCollection/SDU_DIAG_GLOBAL_ExtEth_RQ_BODY3_ST3_38ac71dd_Rx
            CanTpRxNPdu_2dd5cd3e (CanTpRxNPdu): CanTpRxNPduRef=DIAG_RQ_GLOBAL_ExtEth_ST3_3402b191_Rx
        BODY3_DIAG_GLOBAL_IntEth_RQ_BODY3_ST3_01a72909: CanTpChannelMode=CANTP_MODE_HALF_DUPLEX, variation-point=post-build-variant-condition{matching-criterion=Side, value=0}
          CanTpRxNSdu_44714e59 (CanTpRxNSdu):
            CanTpRxAddressingFormat = CANTP_STANDARD
            CanTpRxDl = 8
            CanTpRxPaddingActivation = CANTP_ON
            CanTpRxTaType = CANTP_FUNCTIONAL
            CanTpRxNSduRef = EcucPduCollection/SDU_DIAG_GLOBAL_IntEth_RQ_BODY3_ST3_6efa2066_Rx
            CanTpRxNPdu_29880c5f (CanTpRxNPdu): CanTpRxNPduRef=DIAG_RQ_GLOBAL_IntEth_ST3_f8cf566a_Rx
        BODY3_DIAG_RBTM_FL_03_ExtCAN_RQ_BODY3_ST3_DIAG_RBTM_FL_03_ExtCAN_RS_BODY3_ST3_83aa84a1: CanTpChannelMode=CANTP_MODE_FULL_DUPLEX, variation-point=post-build-variant-condition{matching-criterion=Side, value=0}
          CanTpRxNSdu_530d12e8 (CanTpRxNSdu):
            CanTpBs = 0
            CanTpRxAddressingFormat = CANTP_STANDARD
            CanTpRxDl = 8
            CanTpRxPaddingActivation = CANTP_ON
            CanTpRxTaType = CANTP_PHYSICAL
            CanTpSTmin = 0.01
            CanTpRxNSduRef = EcucPduCollection/SDU_DIAG_RBTM_FL_03_ExtCAN_RQ_BODY3_ST3_6d2a29a5_Rx
            CanTpRxNPdu_7e251f75 (CanTpRxNPdu): CanTpRxNPduRef=DIAG_RBTM_FL_03_ExtCAN_RQ_ST3_3f957a34_Rx
            CanTpTxFcNPdu_7e251f75 (CanTpTxFcNPdu): CanTpTxFcNPduRef=DIAG_RBTM_FL_03_ExtCAN_RS_ST3_ba6d58fb_Tx
          CanTpTxNSdu_530d12e8 (CanTpTxNSdu):
            CanTpTxAddressingFormat = CANTP_STANDARD
            CanTpTxDl = 8
            CanTpTxPaddingActivation = CANTP_ON
            CanTpTxTaType = CANTP_PHYSICAL
            CanTpTxNSduRef = EcucPduCollection/SDU_DIAG_RBTM_FL_03_ExtCAN_RS_BODY3_ST3_92b91e83_Tx
            CanTpRxFcNPdu_5cdfcb87 (CanTpRxFcNPdu): CanTpRxFcNPduRef=DIAG_RBTM_FL_03_ExtCAN_RQ_ST3_3f957a34_Rx
            CanTpTxNPdu_5cdfcb87 (CanTpTxNPdu): CanTpTxNPduRef=DIAG_RBTM_FL_03_ExtCAN_RS_ST3_ba6d58fb_Tx
        BODY3_DIAG_RBTM_FL_03_ExtEth_RQ_BODY3_ST3_DIAG_RBTM_FL_03_ExtEth_RS_BODY3_ST3_6c739aa3: CanTpChannelMode=CANTP_MODE_FULL_DUPLEX, variation-point=post-build-variant-condition{matching-criterion=Side, value=0}
          CanTpRxNSdu_690fe637 (CanTpRxNSdu):
            CanTpBs = 0
            CanTpRxAddressingFormat = CANTP_STANDARD
            CanTpRxDl = 8
            CanTpRxPaddingActivation = CANTP_ON
            CanTpRxTaType = CANTP_PHYSICAL
            CanTpSTmin = 0.01
            CanTpRxNSduRef = EcucPduCollection/SDU_DIAG_RBTM_FL_03_ExtEth_RQ_BODY3_ST3_4810f84e_Rx
            CanTpRxNPdu_2f8b5959 (CanTpRxNPdu): CanTpRxNPduRef=DIAG_RBTM_FL_03_ExtEth_RQ_ST3_8e910fe6_Rx
            CanTpTxFcNPdu_2f8b5959 (CanTpTxFcNPdu): CanTpTxFcNPduRef=DIAG_RBTM_FL_03_ExtEth_RS_ST3_0b692d29_Tx
          CanTpTxNSdu_690fe637 (CanTpTxNSdu):
            CanTpTxAddressingFormat = CANTP_STANDARD
            CanTpTxDl = 8
            CanTpTxPaddingActivation = CANTP_ON
            CanTpTxTaType = CANTP_PHYSICAL
            CanTpTxNSduRef = EcucPduCollection/SDU_DIAG_RBTM_FL_03_ExtEth_RS_BODY3_ST3_b783cf68_Tx
            CanTpRxFcNPdu_0d718dab (CanTpRxFcNPdu): CanTpRxFcNPduRef=DIAG_RBTM_FL_03_ExtEth_RQ_ST3_8e910fe6_Rx
            CanTpTxNPdu_0d718dab (CanTpTxNPdu): CanTpTxNPduRef=DIAG_RBTM_FL_03_ExtEth_RS_ST3_0b692d29_Tx
        BODY3_DIAG_RBTM_FL_03_IntEth_RQ_BODY3_ST3_DIAG_RBTM_FL_03_IntEth_RS_BODY3_ST3_794384a5: CanTpChannelMode=CANTP_MODE_FULL_DUPLEX, variation-point=post-build-variant-condition{matching-criterion=Side, value=0}
          CanTpRxNSdu_b61ae5cc (CanTpRxNSdu):
            CanTpBs = 0
            CanTpRxAddressingFormat = CANTP_STANDARD
            CanTpRxDl = 8
            CanTpRxPaddingActivation = CANTP_ON
            CanTpRxTaType = CANTP_PHYSICAL
            CanTpSTmin = 0.01
            CanTpRxNSduRef = EcucPduCollection/SDU_DIAG_RBTM_FL_03_IntEth_RQ_BODY3_ST3_1e46a9f5_Rx
            CanTpRxNPdu_afe154c1 (CanTpRxNPdu): CanTpRxNPduRef=DIAG_RBTM_FL_03_IntEth_RQ_ST3_c3ea483d_Rx
            CanTpTxFcNPdu_afe154c1 (CanTpTxFcNPdu): CanTpTxFcNPduRef=DIAG_RBTM_FL_03_IntEth_RS_ST3_46126af2_Tx
          CanTpTxNSdu_b61ae5cc (CanTpTxNSdu):
            CanTpTxAddressingFormat = CANTP_STANDARD
            CanTpTxDl = 8
            CanTpTxPaddingActivation = CANTP_ON
            CanTpTxTaType = CANTP_PHYSICAL
            CanTpTxNSduRef = EcucPduCollection/SDU_DIAG_RBTM_FL_03_IntEth_RS_BODY3_ST3_e1d59ed3_Tx
            CanTpRxFcNPdu_8d1b8033 (CanTpRxFcNPdu): CanTpRxFcNPduRef=DIAG_RBTM_FL_03_IntEth_RQ_ST3_c3ea483d_Rx
            CanTpTxNPdu_8d1b8033 (CanTpTxNPdu): CanTpTxNPduRef=DIAG_RBTM_FL_03_IntEth_RS_ST3_46126af2_Tx
        BODY3_DIAG_GLOBAL_ExtCAN_RQ_BODY3_ST3_c9615aa1: CanTpChannelMode=CANTP_MODE_HALF_DUPLEX, variation-point=post-build-variant-condition{matching-criterion=Side, value=1}
          CanTpRxNSdu_64c01817 (CanTpRxNSdu):
            CanTpRxAddressingFormat = CANTP_STANDARD
            CanTpRxDl = 8
            CanTpRxPaddingActivation = CANTP_ON
            CanTpRxTaType = CANTP_FUNCTIONAL
            CanTpRxNSduRef = EcucPduCollection/SDU_DIAG_GLOBAL_ExtCAN_RQ_BODY3_ST3_1d96a036_Rx
            CanTpRxNPdu_42fcb720 (CanTpRxNPdu): CanTpRxNPduRef=DIAG_RQ_GLOBAL_ExtCAN_ST3_320b5155_Rx
        BODY3_DIAG_GLOBAL_ExtEth_RQ_BODY3_ST3_66205a56: CanTpChannelMode=CANTP_MODE_HALF_DUPLEX, variation-point=post-build-variant-condition{matching-criterion=Side, value=1}
          CanTpRxNSdu_84669b72 (CanTpRxNSdu):
            CanTpRxAddressingFormat = CANTP_STANDARD
            CanTpRxDl = 8
            CanTpRxPaddingActivation = CANTP_ON
            CanTpRxTaType = CANTP_FUNCTIONAL
            CanTpRxNSduRef = EcucPduCollection/SDU_DIAG_GLOBAL_ExtEth_RQ_BODY3_ST3_38ac71dd_Rx
            CanTpRxNPdu_4461701a (CanTpRxNPdu): CanTpRxNPduRef=DIAG_RQ_GLOBAL_ExtEth_ST3_3402b191_Rx
        BODY3_DIAG_GLOBAL_IntEth_RQ_BODY3_ST3_e279a650: CanTpChannelMode=CANTP_MODE_HALF_DUPLEX, variation-point=post-build-variant-condition{matching-criterion=Side, value=1}
          CanTpRxNSdu_dbf7577d (CanTpRxNSdu):
            CanTpRxAddressingFormat = CANTP_STANDARD
            CanTpRxDl = 8
            CanTpRxPaddingActivation = CANTP_ON
            CanTpRxTaType = CANTP_FUNCTIONAL
            CanTpRxNSduRef = EcucPduCollection/SDU_DIAG_GLOBAL_IntEth_RQ_BODY3_ST3_6efa2066_Rx
            CanTpRxNPdu_68607596 (CanTpRxNPdu): CanTpRxNPduRef=DIAG_RQ_GLOBAL_IntEth_ST3_f8cf566a_Rx
        BODY3_DIAG_RBTM_FR_03_ExtCAN_RQ_BODY3_ST3_DIAG_RBTM_FR_03_ExtCAN_RS_BODY3_ST3_ef54550a: CanTpChannelMode=CANTP_MODE_FULL_DUPLEX, variation-point=post-build-variant-condition{matching-criterion=Side, value=1}
          CanTpRxNSdu_036251db (CanTpRxNSdu):
            CanTpBs = 0
            CanTpRxAddressingFormat = CANTP_STANDARD
            CanTpRxDl = 8
            CanTpRxPaddingActivation = CANTP_ON
            CanTpRxTaType = CANTP_PHYSICAL
            CanTpSTmin = 0.01
            CanTpRxNSduRef = EcucPduCollection/SDU_DIAG_RBTM_FR_03_ExtCAN_RQ_BODY3_ST3_1f04509d_Rx
            CanTpRxNPdu_c9101043 (CanTpRxNPdu): CanTpRxNPduRef=DIAG_RBTM_FR_03_ExtCAN_RQ_ST3_225f4e6d_Rx
            CanTpTxFcNPdu_c9101043 (CanTpTxFcNPdu): CanTpTxFcNPduRef=DIAG_RBTM_FR_03_ExtCAN_RS_ST3_a7a76ca2_Tx
          CanTpTxNSdu_036251db (CanTpTxNSdu):
            CanTpTxAddressingFormat = CANTP_STANDARD
            CanTpTxDl = 8
            CanTpTxPaddingActivation = CANTP_ON
            CanTpTxTaType = CANTP_PHYSICAL
            CanTpTxNSduRef = EcucPduCollection/SDU_DIAG_RBTM_FR_03_ExtCAN_RS_BODY3_ST3_e09767bb_Tx
            CanTpRxFcNPdu_ebeac4b1 (CanTpRxFcNPdu): CanTpRxFcNPduRef=DIAG_RBTM_FR_03_ExtCAN_RQ_ST3_225f4e6d_Rx
            CanTpTxNPdu_ebeac4b1 (CanTpTxNPdu): CanTpTxNPduRef=DIAG_RBTM_FR_03_ExtCAN_RS_ST3_a7a76ca2_Tx
        BODY3_DIAG_RBTM_FR_03_ExtEth_RQ_BODY3_ST3_DIAG_RBTM_FR_03_ExtEth_RS_BODY3_ST3_008d4b08: CanTpChannelMode=CANTP_MODE_FULL_DUPLEX, variation-point=post-build-variant-condition{matching-criterion=Side, value=1}
          CanTpRxNSdu_b14888e8 (CanTpRxNSdu):
            CanTpBs = 0
            CanTpRxAddressingFormat = CANTP_STANDARD
            CanTpRxDl = 8
            CanTpRxPaddingActivation = CANTP_ON
            CanTpRxTaType = CANTP_PHYSICAL
            CanTpSTmin = 0.01
            CanTpRxNSduRef = EcucPduCollection/SDU_DIAG_RBTM_FR_03_ExtEth_RQ_BODY3_ST3_3a3e8176_Rx
            CanTpRxNPdu_436031f4 (CanTpRxNPdu): CanTpRxNPduRef=DIAG_RBTM_FR_03_ExtEth_RQ_ST3_935b3bbf_Rx
            CanTpTxFcNPdu_436031f4 (CanTpTxFcNPdu): CanTpTxFcNPduRef=DIAG_RBTM_FR_03_ExtEth_RS_ST3_16a31970_Tx
          CanTpTxNSdu_b14888e8 (CanTpTxNSdu):
            CanTpTxAddressingFormat = CANTP_STANDARD
            CanTpTxDl = 8
            CanTpTxPaddingActivation = CANTP_ON
            CanTpTxTaType = CANTP_PHYSICAL
            CanTpTxNSduRef = EcucPduCollection/SDU_DIAG_RBTM_FR_03_ExtEth_RS_BODY3_ST3_c5adb650_Tx
            CanTpRxFcNPdu_619ae506 (CanTpRxFcNPdu): CanTpRxFcNPduRef=DIAG_RBTM_FR_03_ExtEth_RQ_ST3_935b3bbf_Rx
            CanTpTxNPdu_619ae506 (CanTpTxNPdu): CanTpTxNPduRef=DIAG_RBTM_FR_03_ExtEth_RS_ST3_16a31970_Tx
        BODY3_DIAG_RBTM_FR_03_IntEth_RQ_BODY3_ST3_DIAG_RBTM_FR_03_IntEth_RS_BODY3_ST3_15bd550e: CanTpChannelMode=CANTP_MODE_FULL_DUPLEX, variation-point=post-build-variant-condition{matching-criterion=Side, value=1}
          CanTpRxNSdu_6f7c1760 (CanTpRxNSdu):
            CanTpBs = 0
            CanTpRxAddressingFormat = CANTP_STANDARD
            CanTpRxDl = 8
            CanTpRxPaddingActivation = CANTP_ON
            CanTpRxTaType = CANTP_PHYSICAL
            CanTpSTmin = 0.01
            CanTpRxNSduRef = EcucPduCollection/SDU_DIAG_RBTM_FR_03_IntEth_RQ_BODY3_ST3_6c68d0cd_Rx
            CanTpRxNPdu_4b1f8ee6 (CanTpRxNPdu): CanTpRxNPduRef=DIAG_RBTM_FR_03_IntEth_RQ_ST3_de207c64_Rx
            CanTpTxFcNPdu_4b1f8ee6 (CanTpTxFcNPdu): CanTpTxFcNPduRef=DIAG_RBTM_FR_03_IntEth_RS_ST3_5bd85eab_Tx
          CanTpTxNSdu_6f7c1760 (CanTpTxNSdu):
            CanTpTxAddressingFormat = CANTP_STANDARD
            CanTpTxDl = 8
            CanTpTxPaddingActivation = CANTP_ON
            CanTpTxTaType = CANTP_PHYSICAL
            CanTpTxNSduRef = EcucPduCollection/SDU_DIAG_RBTM_FR_03_IntEth_RS_BODY3_ST3_93fbe7eb_Tx
            CanTpRxFcNPdu_69e55a14 (CanTpRxFcNPdu): CanTpRxFcNPduRef=DIAG_RBTM_FR_03_IntEth_RQ_ST3_de207c64_Rx
            CanTpTxNPdu_69e55a14 (CanTpTxNPdu): CanTpTxNPduRef=DIAG_RBTM_FR_03_IntEth_RS_ST3_5bd85eab_Tx
  module config Com
    ComConfig
      41 x ComIPdu:
        ADAS_POSITION_ST3_0b61d436_Rx: ComIPduDirection=RECEIVE, ComIPduType=NORMAL, ComIPduGroupRef=RBTM_FL_BODY3_Rx_PNC_20_54c591d6 if post-build-variant-condition{matching-criterion=Side, value=0}, ComIPduGroupRef=RBTM_FL_BODY3_Rx_PNC_All_Active_46e8c3b2 if post-build-variant-condition{matching-criterion=Side, value=0}, ComIPduSignalGroupRef=ADAS_Posn_ST3_cre9f2x2lehhx0k4gxnl4u9sg_7bfda340_Rx, ComPduIdRef=EcucPduCollection/ADAS_POSITION_ST3_0b61d436_Rx, ComIPduGroupRef=RBTM_FR_BODY3_Rx_PNC_20_02b0f03d if post-build-variant-condition{matching-criterion=Side, value=1}, ComIPduGroupRef=RBTM_FR_BODY3_Rx_PNC_All_Active_592f1bcd if post-build-variant-condition{matching-criterion=Side, value=1}
        ADAS_PREDICTION_ST3_6_262b63d1_Rx: ComIPduDirection=RECEIVE, ComIPduType=NORMAL, ComIPduGroupRef=RBTM_FL_BODY3_Rx_PNC_20_54c591d6 if post-build-variant-condition{matching-criterion=Side, value=0}, ComIPduGroupRef=RBTM_FL_BODY3_Rx_PNC_All_Active_46e8c3b2 if post-build-variant-condition{matching-criterion=Side, value=0}, ComIPduSignalGroupRef=ADAS_Meta_ST3_40sly585w5zu8pqjwib3nr7y7_6_d1dcd94d_Rx, ComIPduSignalRef=ADAS_Prediction_MsgTyp_ST36_11a04f12_Rx, ComPduIdRef=EcucPduCollection/ADAS_PREDICTION_ST3_6_262b63d1_Rx, ComIPduGroupRef=RBTM_FR_BODY3_Rx_PNC_20_02b0f03d if post-build-variant-condition{matching-criterion=Side, value=1}, ComIPduGroupRef=RBTM_FR_BODY3_Rx_PNC_All_Active_592f1bcd if post-build-variant-condition{matching-criterion=Side, value=1}
        ADAS_PREDICTION_ST3_7_512c5347_Rx: ComIPduDirection=RECEIVE, ComIPduType=NORMAL, ComIPduGroupRef=RBTM_FL_BODY3_Rx_PNC_20_54c591d6 if post-build-variant-condition{matching-criterion=Side, value=0}, ComIPduGroupRef=RBTM_FL_BODY3_Rx_PNC_All_Active_46e8c3b2 if post-build-variant-condition{matching-criterion=Side, value=0}, ComIPduSignalRef=ADAS_Prediction_MsgTyp_ST37_66a77f84_Rx, ComPduIdRef=EcucPduCollection/ADAS_PREDICTION_ST3_7_512c5347_Rx, ComIPduGroupRef=RBTM_FR_BODY3_Rx_PNC_20_02b0f03d if post-build-variant-condition{matching-criterion=Side, value=1}, ComIPduGroupRef=RBTM_FR_BODY3_Rx_PNC_All_Active_592f1bcd if post-build-variant-condition{matching-criterion=Side, value=1}
        ADAS_PROFILE_SHORT_ST3_1_506b5dfc_Rx: ComIPduDirection=RECEIVE, ComIPduType=NORMAL, ComIPduGroupRef=RBTM_FL_BODY3_Rx_PNC_20_54c591d6 if post-build-variant-condition{matching-criterion=Side, value=0}, ComIPduGroupRef=RBTM_FL_BODY3_Rx_PNC_All_Active_46e8c3b2 if post-build-variant-condition{matching-criterion=Side, value=0}, ComIPduSignalGroupRef=ADAS_Profile_Short_CurvLn_ST3_96e9ejcafisp13h7moqj5malh_1_aac62a51_Rx, ComIPduSignalRef=ADAS_ProfShort_ProfTyp_ST31_a96eaafe_Rx, ComPduIdRef=EcucPduCollection/ADAS_PROFILE_SHORT_ST3_1_506b5dfc_Rx, ComIPduGroupRef=RBTM_FR_BODY3_Rx_PNC_20_02b0f03d if post-build-variant-condition{matching-criterion=Side, value=1}, ComIPduGroupRef=RBTM_FR_BODY3_Rx_PNC_All_Active_592f1bcd if post-build-variant-condition{matching-criterion=Side, value=1}
        ADAS_PROFILE_SHORT_ST3_31_05b1585f_Rx: ComIPduDirection=RECEIVE, ComIPduType=NORMAL, ComIPduGroupRef=RBTM_FL_BODY3_Rx_PNC_20_54c591d6 if post-build-variant-condition{matching-criterion=Side, value=0}, ComIPduGroupRef=RBTM_FL_BODY3_Rx_PNC_All_Active_46e8c3b2 if post-build-variant-condition{matching-criterion=Side, value=0}, ComIPduSignalRef=ADAS_ProfShort_ProfTyp_ST331_eb463c84_Rx, ComPduIdRef=EcucPduCollection/ADAS_PROFILE_SHORT_ST3_31_05b1585f_Rx, ComIPduGroupRef=RBTM_FR_BODY3_Rx_PNC_20_02b0f03d if post-build-variant-condition{matching-criterion=Side, value=1}, ComIPduGroupRef=RBTM_FR_BODY3_Rx_PNC_All_Active_592f1bcd if post-build-variant-condition{matching-criterion=Side, value=1}
        Bckl_Sw_Fx_Stat_ST3_9c2de10c_Rx: ComIPduDirection=RECEIVE, ComIPduType=NORMAL, ComIPduGroupRef=RBTM_FL_BODY3_Rx_PNC_20_54c591d6 if post-build-variant-condition{matching-criterion=Side, value=0}, ComIPduGroupRef=RBTM_FL_BODY3_Rx_PNC_All_Active_46e8c3b2 if post-build-variant-condition{matching-criterion=Side, value=0}, ComIPduSignalGroupRef=Bckl_Sw_Fx_Stat_Pr5_ST3_dihag5a55iw4h5qk539fx0kup_4c948f24_Rx, ComPduIdRef=EcucPduCollection/Bckl_Sw_Fx_Stat_ST3_9c2de10c_Rx, ComIPduGroupRef=RBTM_FR_BODY3_Rx_PNC_20_02b0f03d if post-build-variant-condition{matching-criterion=Side, value=1}, ComIPduGroupRef=RBTM_FR_BODY3_Rx_PNC_All_Active_592f1bcd if post-build-variant-condition{matching-criterion=Side, value=1}
        BeltAdj_FL_Stat_ST3_d2ce0dbb_Tx: ComIPduDirection=SEND, ComIPduType=NORMAL, ComIPduGroupRef=RBTM_FL_BODY3_Tx_PNC_20_27dfe85c, ComIPduGroupRef=RBTM_FL_BODY3_Tx_PNC_All_Active_e1dc74ba, ComIPduSignalRef=BltSlckDec_Md_FL_Stat_ST3_e47e790a_Tx, ComIPduSignalRef=RevBltTns_FL_ComCyc_Actv_ST3_4c5f745f_Tx, ComPduIdRef=EcucPduCollection/BeltAdj_FL_Stat_ST3_d2ce0dbb_Tx, variation-point=post-build-variant-condition{matching-criterion=Side, value=0}
          ComTxIPdu: ComMinimumDelayTime=0.04, ComTxIPduUnusedAreasDefault=255
            ComTxModeTrue
              ComTxMode: ComTxModeMode=MIXED, ComTxModeNumberOfRepetitions=0, ComTxModeTimeOffset=0.01, ComTxModeTimePeriod=1
        BeltAdj_FR_Stat_ST3_eba9bce0_Rx: ComIPduDirection=RECEIVE, ComIPduType=NORMAL, ComIPduGroupRef=RBTM_FL_BODY3_Rx_PNC_20_54c591d6, ComIPduGroupRef=RBTM_FL_BODY3_Rx_PNC_All_Active_46e8c3b2, ComIPduSignalRef=RevBltTns_FR_ComCyc_Actv_ST3_4c00d29e_Rx, ComPduIdRef=EcucPduCollection/BeltAdj_FR_Stat_ST3_eba9bce0_Rx, variation-point=post-build-variant-condition{matching-criterion=Side, value=0}
        BeltAdj_UI_Set_Rq_ST3_1223a83d_Rx: ComIPduDirection=RECEIVE, ComIPduType=NORMAL, ComIPduGroupRef=RBTM_FL_BODY3_Rx_PNC_20_54c591d6 if post-build-variant-condition{matching-criterion=Side, value=0}, ComIPduGroupRef=RBTM_FL_BODY3_Rx_PNC_All_Active_46e8c3b2 if post-build-variant-condition{matching-criterion=Side, value=0}, ComIPduSignalRef=BltSlckDec_Md_Rq_HU_ST3_64a95ccf_Rx, ComIPduSignalRef=PS_Curve_FL_Rq_HU_ST3_6cd299ba_Rx if post-build-variant-condition{matching-criterion=Side, value=0}, ComPduIdRef=EcucPduCollection/BeltAdj_UI_Set_Rq_ST3_1223a83d_Rx, ComIPduGroupRef=RBTM_FR_BODY3_Rx_PNC_20_02b0f03d if post-build-variant-condition{matching-criterion=Side, value=1}, ComIPduGroupRef=RBTM_FR_BODY3_Rx_PNC_All_Active_592f1bcd if post-build-variant-condition{matching-criterion=Side, value=1}, ComIPduSignalRef=PS_Curve_FR_Rq_HU_ST3_90527677_Rx if post-build-variant-condition{matching-criterion=Side, value=1}
        BeltHdOvr_FL_State_ST3_342163b7_Rx: ComIPduDirection=RECEIVE, ComIPduType=NORMAL, ComIPduGroupRef=RBTM_FL_BODY3_Rx_PNC_20_54c591d6, ComIPduGroupRef=RBTM_FL_BODY3_Rx_PNC_All_Active_46e8c3b2, ComIPduSignalRef=BeltHdOvr_FL_Stat_ST3_3489841d_Rx, ComPduIdRef=EcucPduCollection/BeltHdOvr_FL_State_ST3_342163b7_Rx, variation-point=post-build-variant-condition{matching-criterion=Side, value=0}
        CLkS_Dr_State_ST3_513e9c19_Rx: ComIPduDirection=RECEIVE, ComIPduType=NORMAL, ComIPduGroupRef=RBTM_FL_BODY3_Rx_PNC_20_54c591d6 if post-build-variant-condition{matching-criterion=Side, value=0}, ComIPduGroupRef=RBTM_FL_BODY3_Rx_PNC_All_Active_46e8c3b2 if post-build-variant-condition{matching-criterion=Side, value=0}, ComIPduSignalGroupRef=CLkS_DrRltch_Stat_Pr5_ST3_7at68qvnk0r9npofyykyfq82v_10e0cb0e_Rx, ComPduIdRef=EcucPduCollection/CLkS_Dr_State_ST3_513e9c19_Rx, ComIPduGroupRef=RBTM_FR_BODY3_Rx_PNC_20_02b0f03d if post-build-variant-condition{matching-criterion=Side, value=1}, ComIPduGroupRef=RBTM_FR_BODY3_Rx_PNC_All_Active_592f1bcd if post-build-variant-condition{matching-criterion=Side, value=1}
        ComIPduPnc_EIRA_CAN_Rx: ComIPduDirection=RECEIVE, ComIPduSignalRef=ComSignalPnc_EIRA_CAN_Rx, ComPduIdRef=PduPnc_EIRA_CAN_Rx
        DIAG_Stat_ST3_3a031d4a_Rx: ComIPduDirection=RECEIVE, ComIPduType=NORMAL, ComIPduGroupRef=RBTM_FL_BODY3_Rx_PNC_20_54c591d6 if post-build-variant-condition{matching-criterion=Side, value=0}, ComIPduGroupRef=RBTM_FL_BODY3_Rx_PNC_All_Active_46e8c3b2 if post-build-variant-condition{matching-criterion=Side, value=0}, ComIPduSignalRef=DidA_ExtTest_Pres_ST3_7e50ca1d_Rx, ComPduIdRef=EcucPduCollection/DIAG_Stat_ST3_3a031d4a_Rx, ComIPduGroupRef=RBTM_FR_BODY3_Rx_PNC_20_02b0f03d if post-build-variant-condition{matching-criterion=Side, value=1}, ComIPduGroupRef=RBTM_FR_BODY3_Rx_PNC_All_Active_592f1bcd if post-build-variant-condition{matching-criterion=Side, value=1}
        DI_OdoSpeedometer_ST3_6fef7507_Rx: ComIPduDirection=RECEIVE, ComIPduType=NORMAL, ComIPduGroupRef=RBTM_FL_BODY3_Rx_PNC_20_54c591d6 if post-build-variant-condition{matching-criterion=Side, value=0}, ComIPduGroupRef=RBTM_FL_BODY3_Rx_PNC_All_Active_46e8c3b2 if post-build-variant-condition{matching-criterion=Side, value=0}, ComIPduSignalGroupRef=DI_Odo_Pr5_ST3_e68xmtlkywxgxsdwekdjjhw3t_eb760b63_Rx, ComIPduSignalRef=VehSpd_Disp_ST3_4922a2fd_Rx, ComPduIdRef=EcucPduCollection/DI_OdoSpeedometer_ST3_6fef7507_Rx, ComIPduGroupRef=RBTM_FR_BODY3_Rx_PNC_20_02b0f03d if post-build-variant-condition{matching-criterion=Side, value=1}, ComIPduGroupRef=RBTM_FR_BODY3_Rx_PNC_All_Active_592f1bcd if post-build-variant-condition{matching-criterion=Side, value=1}
        DPC_Md_Rq_ESP_d1_ST3_e30f951d_Rx: ComIPduDirection=RECEIVE, ComIPduType=NORMAL, ComIPduGroupRef=RBTM_FL_BODY3_Rx_PNC_20_54c591d6 if post-build-variant-condition{matching-criterion=Side, value=0}, ComIPduGroupRef=RBTM_FL_BODY3_Rx_PNC_All_Active_46e8c3b2 if post-build-variant-condition{matching-criterion=Side, value=0}, ComIPduSignalGroupRef=DPC_Md_Rq_ESP_Pr5_ST3_dcsny138uwpesz5bmssj1scqi_6b0a3c02_Rx, ComPduIdRef=EcucPduCollection/DPC_Md_Rq_ESP_d1_ST3_e30f951d_Rx, ComIPduGroupRef=RBTM_FR_BODY3_Rx_PNC_20_02b0f03d if post-build-variant-condition{matching-criterion=Side, value=1}, ComIPduGroupRef=RBTM_FR_BODY3_Rx_PNC_All_Active_592f1bcd if post-build-variant-condition{matching-criterion=Side, value=1}
        Develop8_Rq_RBTM_FL_ST3_fa67f89a_Rx: ComIPduDirection=RECEIVE, ComIPduType=NORMAL, ComIPduGroupRef=RBTM_FL_BODY3_Rx_PNC_20_54c591d6, ComIPduGroupRef=RBTM_FL_BODY3_Rx_PNC_All_Active_46e8c3b2, ComIPduSignalGroupRef=Develop8_Rq_RBTM_FL_ST3_48g6nu8rjjp9s4bhq1x3pz06u_6f2fac01_Rx, ComPduIdRef=EcucPduCollection/Develop8_Rq_RBTM_FL_ST3_fa67f89a_Rx, variation-point=post-build-variant-condition{matching-criterion=Side, value=0}
        Develop8_Rs_RBTM_FL_ST3_9a3b4dd1_Tx: ComIPduDirection=SEND, ComIPduType=NORMAL, ComIPduGroupRef=TxMess_RBTM_FL_BODY3_e804245a, ComIPduSignalGroupRef=Develop8_Rs_RBTM_FL_ST3_7jg1r8p1skn6yj1t9z2s157vt_a69dcfbb_Tx, ComPduIdRef=EcucPduCollection/Develop8_Rs_RBTM_FL_ST3_9a3b4dd1_Tx, variation-point=post-build-variant-condition{matching-criterion=Side, value=0}
          ComTxIPdu: ComMinimumDelayTime=0.02, ComTxIPduUnusedAreasDefault=0
            ComTxModeTrue
              ComTxMode: ComTxModeMode=DIRECT, ComTxModeNumberOfRepetitions=0
        ECU_Stat_RBTM_FL_ST3_f703b6eb_Tx: ComIPduDirection=SEND, ComIPduType=NORMAL, ComIPduGroupRef=RBTM_FL_BODY3_Tx_PNC_20_27dfe85c, ComIPduGroupRef=RBTM_FL_BODY3_Tx_PNC_All_Active_e1dc74ba, ComIPduSignalRef=Awake_Diag_Actv_RBTM_FL_ST3_5efe61d8_Tx, ComIPduSignalRef=Awake_Ignition_On_RBTM_FL_ST3_49d22bbd_Tx, ComIPduSignalRef=Awake_NwStart_RBTM_FL_ST3_393ce9b3_Tx, ComIPduSignalRef=ECU_Id_RBTM_FL_ST3_b4de0ce2_Tx, ComIPduSignalRef=WakeupRsn_RBTM_FL_ST3_91bb10a0_Tx, ComPduIdRef=EcucPduCollection/ECU_Stat_RBTM_FL_ST3_f703b6eb_Tx, variation-point=post-build-variant-condition{matching-criterion=Side, value=0}
          ComTxIPdu: ComTxIPduUnusedAreasDefault=0
            ComTxModeTrue
              ComTxMode: ComTxModeMode=PERIODIC, ComTxModeTimeOffset=0, ComTxModeTimePeriod=1
        ELC_Lvr_Stat_ST3_d97bab99_Rx: ComIPduDirection=RECEIVE, ComIPduType=NORMAL, ComIPduGroupRef=RBTM_FL_BODY3_Rx_PNC_20_54c591d6 if post-build-variant-condition{matching-criterion=Side, value=0}, ComIPduGroupRef=RBTM_FL_BODY3_Rx_PNC_All_Active_46e8c3b2 if post-build-variant-condition{matching-criterion=Side, value=0}, ComIPduSignalGroupRef=ELC_Lvr_Stat_Pr5_ST3_7b68ktfwrvsk1oyozi7cntryn_cd318e5f_Rx, ComPduIdRef=EcucPduCollection/ELC_Lvr_Stat_ST3_d97bab99_Rx, ComIPduGroupRef=RBTM_FR_BODY3_Rx_PNC_20_02b0f03d if post-build-variant-condition{matching-criterion=Side, value=1}, ComIPduGroupRef=RBTM_FR_BODY3_Rx_PNC_All_Active_592f1bcd if post-build-variant-condition{matching-criterion=Side, value=1}
        EVC_CfgList_01_08_Pr5_ST3_32c5e6fb_Rx: ComIPduDirection=RECEIVE, ComIPduType=NORMAL, ComIPduGroupRef=RBTM_FL_BODY3_Rx_PNC_20_54c591d6 if post-build-variant-condition{matching-criterion=Side, value=0}, ComIPduGroupRef=RBTM_FL_BODY3_Rx_PNC_All_Active_46e8c3b2 if post-build-variant-condition{matching-criterion=Side, value=0}, ComIPduSignalGroupRef=EVC_CfgList_01_08_Pr5_ST3_co3q1mwsf7pwxo2ix5jryc04x_3a43a00a_Rx, ComPduIdRef=EcucPduCollection/EVC_CfgList_01_08_Pr5_ST3_32c5e6fb_Rx, ComIPduGroupRef=RBTM_FR_BODY3_Rx_PNC_20_02b0f03d if post-build-variant-condition{matching-criterion=Side, value=1}, ComIPduGroupRef=RBTM_FR_BODY3_Rx_PNC_All_Active_592f1bcd if post-build-variant-condition{matching-criterion=Side, value=1}
        Ign_Stat_ST3_1e3dc39f_Rx: ComIPduDirection=RECEIVE, ComIPduType=NORMAL, ComIPduGroupRef=RBTM_FL_BODY3_Rx_PNC_20_54c591d6 if post-build-variant-condition{matching-criterion=Side, value=0}, ComIPduGroupRef=RBTM_FL_BODY3_Rx_PNC_All_Active_46e8c3b2 if post-build-variant-condition{matching-criterion=Side, value=0}, ComIPduSignalGroupRef=Ign_Stat_Pr5_ST3_csgs1dv6drms80o1i9p49677w_7bdae87d_Rx, ComPduIdRef=EcucPduCollection/Ign_Stat_ST3_1e3dc39f_Rx, ComIPduGroupRef=RBTM_FR_BODY3_Rx_PNC_20_02b0f03d if post-build-variant-condition{matching-criterion=Side, value=1}, ComIPduGroupRef=RBTM_FR_BODY3_Rx_PNC_All_Active_592f1bcd if post-build-variant-condition{matching-criterion=Side, value=1}
        Impact2_ST3_e5526ccc_Rx: ComIPduDirection=RECEIVE, ComIPduType=NORMAL, ComIPduGroupRef=RBTM_FL_BODY3_Rx_PNC_20_54c591d6 if post-build-variant-condition{matching-criterion=Side, value=0}, ComIPduGroupRef=RBTM_FL_BODY3_Rx_PNC_All_Active_46e8c3b2 if post-build-variant-condition{matching-criterion=Side, value=0}, ComIPduSignalGroupRef=ORC_Impact2_Pr5_ST3_b9l09rrslyv7vj3o92j69irnd_2f5ae8ac_Rx, ComPduIdRef=EcucPduCollection/Impact2_ST3_e5526ccc_Rx, ComIPduGroupRef=RBTM_FR_BODY3_Rx_PNC_20_02b0f03d if post-build-variant-condition{matching-criterion=Side, value=1}, ComIPduGroupRef=RBTM_FR_BODY3_Rx_PNC_All_Active_592f1bcd if post-build-variant-condition{matching-criterion=Side, value=1}
        Impact3_ST3_d832457c_Rx: ComIPduDirection=RECEIVE, ComIPduType=NORMAL, ComIPduGroupRef=RBTM_FL_BODY3_Rx_PNC_20_54c591d6 if post-build-variant-condition{matching-criterion=Side, value=0}, ComIPduGroupRef=RBTM_FL_BODY3_Rx_PNC_All_Active_46e8c3b2 if post-build-variant-condition{matching-criterion=Side, value=0}, ComIPduSignalGroupRef=ORC_Impact3_Pr5_ST3_c4pqnkonfjwv3uiohsxhe9dwu_1bc89a3a_Rx, ComPduIdRef=EcucPduCollection/Impact3_ST3_d832457c_Rx, ComIPduGroupRef=RBTM_FR_BODY3_Rx_PNC_20_02b0f03d if post-build-variant-condition{matching-criterion=Side, value=1}, ComIPduGroupRef=RBTM_FR_BODY3_Rx_PNC_All_Active_592f1bcd if post-build-variant-condition{matching-criterion=Side, value=1}
        Meas8_RBTM_FL_ST3_a92f14da_Tx: ComIPduDirection=SEND, ComIPduType=NORMAL, ComIPduGroupRef=TxMess_RBTM_FL_BODY3_e804245a, ComIPduSignalGroupRef=Meas8_RBTM_FL_ST3_72jyquhuktrmjm0hkqempja37_23ddfefa_Tx, ComPduIdRef=EcucPduCollection/Meas8_RBTM_FL_ST3_a92f14da_Tx, variation-point=post-build-variant-condition{matching-criterion=Side, value=0}
          ComTxIPdu: ComMinimumDelayTime=0.02, ComTxIPduUnusedAreasDefault=0
            ComTxModeTrue
              ComTxMode: ComTxModeMode=DIRECT, ComTxModeNumberOfRepetitions=0
        NM_RBTM_FL_ST3_0cdf2d0f_Tx: ComIPduDirection=SEND, ComIPduType=NORMAL, ComIPduSignalRef=NM_RBTM_FL_ST3_PNC_785a2d76_Tx, ComPduIdRef=EcucPduCollection/NM_RBTM_FL_ST3_0cdf2d0f_Tx, variation-point=post-build-variant-condition{matching-criterion=Side, value=0}
          ComTxIPdu: ComTxIPduUnusedAreasDefault=0  # NM_RBTM_FL_ST3
        NTG_Master_Navi_ST3_dea580a6_Rx: ComIPduDirection=RECEIVE, ComIPduType=NORMAL, ComIPduGroupRef=RBTM_FL_BODY3_Rx_PNC_20_54c591d6 if post-build-variant-condition{matching-criterion=Side, value=0}, ComIPduGroupRef=RBTM_FL_BODY3_Rx_PNC_All_Active_46e8c3b2 if post-build-variant-condition{matching-criterion=Side, value=0}, ComIPduSignalRef=Navi_RouteGuidance_Stat_ST3_ac3bae27_Rx, ComPduIdRef=EcucPduCollection/NTG_Master_Navi_ST3_dea580a6_Rx, ComIPduGroupRef=RBTM_FR_BODY3_Rx_PNC_20_02b0f03d if post-build-variant-condition{matching-criterion=Side, value=1}, ComIPduGroupRef=RBTM_FR_BODY3_Rx_PNC_All_Active_592f1bcd if post-build-variant-condition{matching-criterion=Side, value=1}
        PN14_Master_Stat1_ST3_eba3e383_Rx: ComIPduDirection=RECEIVE, ComIPduType=NORMAL, ComIPduGroupRef=RBTM_FL_BODY3_Rx_PNC_20_54c591d6 if post-build-variant-condition{matching-criterion=Side, value=0}, ComIPduGroupRef=RBTM_FL_BODY3_Rx_PNC_All_Active_46e8c3b2 if post-build-variant-condition{matching-criterion=Side, value=0}, ComIPduSignalRef=PN14_DDP_Sw_Stat_ST3_568ad7e6_Rx, ComIPduSignalRef=PN14_ProdMd_Stat_ST3_be2b5dfe_Rx, ComIPduSignalRef=PN14_SupBat_Volt_ST3_946fd9c6_Rx, ComIPduSignalRef=PN14_TransMd_Stat_ST3_2208da29_Rx, ComPduIdRef=EcucPduCollection/PN14_Master_Stat1_ST3_eba3e383_Rx, ComIPduGroupRef=RBTM_FR_BODY3_Rx_PNC_20_02b0f03d if post-build-variant-condition{matching-criterion=Side, value=1}, ComIPduGroupRef=RBTM_FR_BODY3_Rx_PNC_All_Active_592f1bcd if post-build-variant-condition{matching-criterion=Side, value=1}
        PT4_PTCoor4_ST3_bf069154_Rx: ComIPduDirection=RECEIVE, ComIPduType=NORMAL, ComIPduGroupRef=RBTM_FL_BODY3_Rx_PNC_20_54c591d6 if post-build-variant-condition{matching-criterion=Side, value=0}, ComIPduGroupRef=RBTM_FL_BODY3_Rx_PNC_All_Active_46e8c3b2 if post-build-variant-condition{matching-criterion=Side, value=0}, ComIPduSignalGroupRef=PT4_PTCoor4_Pr5_ST3_af4fxb1ykieox3itqdfzs0kpb_2277a854_Rx, ComPduIdRef=EcucPduCollection/PT4_PTCoor4_ST3_bf069154_Rx, ComIPduGroupRef=RBTM_FR_BODY3_Rx_PNC_20_02b0f03d if post-build-variant-condition{matching-criterion=Side, value=1}, ComIPduGroupRef=RBTM_FR_BODY3_Rx_PNC_All_Active_592f1bcd if post-build-variant-condition{matching-criterion=Side, value=1}
        PT4_PTCoor9_d1_BC_F_ST3_da786b84_Rx: ComIPduDirection=RECEIVE, ComIPduType=NORMAL, ComIPduGroupRef=RBTM_FL_BODY3_Rx_PNC_20_54c591d6 if post-build-variant-condition{matching-criterion=Side, value=0}, ComIPduGroupRef=RBTM_FL_BODY3_Rx_PNC_All_Active_46e8c3b2 if post-build-variant-condition{matching-criterion=Side, value=0}, ComIPduSignalGroupRef=PT4_PTCoor9_Pr5_ST3_6r95o81sst3tk9w2lzz600cw3_5dfe4b97_Rx, ComPduIdRef=EcucPduCollection/PT4_PTCoor9_d1_BC_F_ST3_da786b84_Rx, ComIPduGroupRef=RBTM_FR_BODY3_Rx_PNC_20_02b0f03d if post-build-variant-condition{matching-criterion=Side, value=1}, ComIPduGroupRef=RBTM_FR_BODY3_Rx_PNC_All_Active_592f1bcd if post-build-variant-condition{matching-criterion=Side, value=1}
        PT4_PTCoor_DrvPosn_Gear_ST3_6b508375_Rx: ComIPduDirection=RECEIVE, ComIPduType=NORMAL, ComIPduGroupRef=RBTM_FL_BODY3_Rx_PNC_20_54c591d6 if post-build-variant-condition{matching-criterion=Side, value=0}, ComIPduGroupRef=RBTM_FL_BODY3_Rx_PNC_All_Active_46e8c3b2 if post-build-variant-condition{matching-criterion=Side, value=0}, ComIPduSignalGroupRef=PT4_PTCoor_DrvPosn_Gear_Pr5_ST3_5p8cvrni3ypvuac33rj2asfy9_2f73a7b3_Rx, ComPduIdRef=EcucPduCollection/PT4_PTCoor_DrvPosn_Gear_ST3_6b508375_Rx, ComIPduGroupRef=RBTM_FR_BODY3_Rx_PNC_20_02b0f03d if post-build-variant-condition{matching-criterion=Side, value=1}, ComIPduGroupRef=RBTM_FR_BODY3_Rx_PNC_All_Active_592f1bcd if post-build-variant-condition{matching-criterion=Side, value=1}
        PresfAct_Adj_ST3_61c58c91_Rx: ComIPduDirection=RECEIVE, ComIPduType=NORMAL, ComIPduGroupRef=RBTM_FL_BODY3_Rx_PNC_20_54c591d6 if post-build-variant-condition{matching-criterion=Side, value=0}, ComIPduGroupRef=RBTM_FL_BODY3_Rx_PNC_All_Active_46e8c3b2 if post-build-variant-condition{matching-criterion=Side, value=0}, ComIPduSignalGroupRef=PresfAct_Adj_Pr5_ST3_2joar1a41xrgjqab60epnbplm_25141edc_Rx, ComPduIdRef=EcucPduCollection/PresfAct_Adj_ST3_61c58c91_Rx, ComIPduGroupRef=RBTM_FR_BODY3_Rx_PNC_20_02b0f03d if post-build-variant-condition{matching-criterion=Side, value=1}, ComIPduGroupRef=RBTM_FR_BODY3_Rx_PNC_All_Active_592f1bcd if post-build-variant-condition{matching-criterion=Side, value=1}
        RBTM_FL_Stat_ST3_dd2436a1_Tx: ComIPduDirection=SEND, ComIPduType=NORMAL, ComIPduGroupRef=RBTM_FL_BODY3_Tx_PNC_20_27dfe85c, ComIPduGroupRef=RBTM_FL_BODY3_Tx_PNC_All_Active_e1dc74ba, ComIPduSignalRef=PS_Curve_FL_Stat_ST3_b0d41119_Tx, ComIPduSignalRef=RBTM_FL_Disp_Rq_ST3_c372540c_Tx, ComIPduSignalRef=RBTM_FL_Tgl_ST3_1fe530ed_Tx, ComIPduSignalRef=RevBltTns_FL_SafeCyc_Actv_ST3_b0efc754_Tx, ComPduIdRef=EcucPduCollection/RBTM_FL_Stat_ST3_dd2436a1_Tx, variation-point=post-build-variant-condition{matching-criterion=Side, value=0}
          ComTxIPdu: ComMinimumDelayTime=0.04, ComTxIPduUnusedAreasDefault=255
            ComTxModeTrue
              ComTxMode: ComTxModeMode=MIXED, ComTxModeNumberOfRepetitions=0, ComTxModeTimeOffset=0.02, ComTxModeTimePeriod=1
        RBTM_FL_Tens_ST3_553ec607_Tx: ComIPduDirection=SEND, ComIPduType=NORMAL, ComIPduGroupRef=RBTM_FL_BODY3_Tx_PNC_20_27dfe85c, ComIPduGroupRef=RBTM_FL_BODY3_Tx_PNC_All_Active_e1dc74ba, ComIPduSignalRef=RBTMFL_Actv_Lvl_ST35_6199228f_Tx, ComIPduSignalRef=RBTMFL_SP_ActvClient_ST35_bec76928_Tx, ComIPduSignalRef=RBTMFL_SP_FctPrecond_Stat_ST35_bbfa2c80_Tx, ComPduIdRef=EcucPduCollection/RBTM_FL_Tens_ST3_553ec607_Tx, variation-point=post-build-variant-condition{matching-criterion=Side, value=0}
          ComTxIPdu: ComMinimumDelayTime=0.02, ComTxIPduUnusedAreasDefault=255
            ComTxModeTrue
              ComTxMode: ComTxModeMode=MIXED, ComTxModeNumberOfRepetitions=0, ComTxModeTimeOffset=0.005, ComTxModeTimePeriod=0.5
        RBTM_FR_Stat_ST3_e44387fa_Rx: ComIPduDirection=RECEIVE, ComIPduType=NORMAL, ComIPduGroupRef=RBTM_FL_BODY3_Rx_PNC_20_54c591d6, ComIPduGroupRef=RBTM_FL_BODY3_Rx_PNC_All_Active_46e8c3b2, ComIPduSignalRef=RevBltTns_FR_SafeCyc_Actv_ST3_5c8c6ad4_Rx, ComPduIdRef=EcucPduCollection/RBTM_FR_Stat_ST3_e44387fa_Rx, variation-point=post-build-variant-condition{matching-criterion=Side, value=0}
        ROE_RBTM_FL_ST3_a66ccb5f_Tx: ComIPduDirection=SEND, ComIPduType=NORMAL, ComIPduGroupRef=RBTM_FL_BODY3_Tx_PNC_20_27dfe85c, ComIPduGroupRef=RBTM_FL_BODY3_Tx_PNC_All_Active_e1dc74ba, ComIPduSignalGroupRef=ROE_RBTM_FL_ST3_6e0rxnifai2txra0wamb18g4m_4feaeebf_Tx, ComPduIdRef=EcucPduCollection/ROE_RBTM_FL_ST3_a66ccb5f_Tx, variation-point=post-build-variant-condition{matching-criterion=Side, value=0}
          ComTxIPdu: ComMinimumDelayTime=0.2, ComTxIPduUnusedAreasDefault=0
            ComTxModeTrue
              ComTxMode: ComTxModeMode=DIRECT, ComTxModeNumberOfRepetitions=0
        SBeltTens_SP_Lvl_ST3_46421e11_Rx: ComIPduDirection=RECEIVE, ComIPduType=NORMAL, ComIPduGroupRef=RBTM_FL_BODY3_Rx_PNC_20_54c591d6 if post-build-variant-condition{matching-criterion=Side, value=0}, ComIPduGroupRef=RBTM_FL_BODY3_Rx_PNC_All_Active_46e8c3b2 if post-build-variant-condition{matching-criterion=Side, value=0}, ComIPduSignalGroupRef=SBeltTens_SP_Lvl_Pr5_ST3_4tqpkri37441o5ht9g9ekmyzh_4719328f_Rx, ComPduIdRef=EcucPduCollection/SBeltTens_SP_Lvl_ST3_46421e11_Rx, ComIPduGroupRef=RBTM_FR_BODY3_Rx_PNC_20_02b0f03d if post-build-variant-condition{matching-criterion=Side, value=1}, ComIPduGroupRef=RBTM_FR_BODY3_Rx_PNC_All_Active_592f1bcd if post-build-variant-condition{matching-criterion=Side, value=1}
        VSS_TP_Auth_ST3_7c9f23ce_Rx: ComIPduDirection=RECEIVE, ComIPduType=NORMAL, ComIPduGroupRef=RBTM_FL_BODY3_Rx_PNC_20_54c591d6 if post-build-variant-condition{matching-criterion=Side, value=0}, ComIPduGroupRef=RBTM_FL_BODY3_Rx_PNC_All_Active_46e8c3b2 if post-build-variant-condition{matching-criterion=Side, value=0}, ComIPduSignalGroupRef=VSS_TP_Auth_ST3_6j4id7sghlvlbroli4wjozjik_2ac87786_Rx, ComPduIdRef=EcucPduCollection/VSS_TP_Auth_ST3_7c9f23ce_Rx, ComIPduGroupRef=RBTM_FR_BODY3_Rx_PNC_20_02b0f03d if post-build-variant-condition{matching-criterion=Side, value=1}, ComIPduGroupRef=RBTM_FR_BODY3_Rx_PNC_All_Active_592f1bcd if post-build-variant-condition{matching-criterion=Side, value=1}
        VSS_TP_RealTmOffset_ST3_62955a84_Rx: ComIPduDirection=RECEIVE, ComIPduType=NORMAL, ComIPduGroupRef=RBTM_FL_BODY3_Rx_PNC_20_54c591d6 if post-build-variant-condition{matching-criterion=Side, value=0}, ComIPduGroupRef=RBTM_FL_BODY3_Rx_PNC_All_Active_46e8c3b2 if post-build-variant-condition{matching-criterion=Side, value=0}, ComIPduSignalGroupRef=VSS_TP_RealTmOffset_ST3_1t7vc44gftc0wv35k5kgc2in9_d3385ce4_Rx, ComPduIdRef=EcucPduCollection/VSS_TP_RealTmOffset_ST3_62955a84_Rx, ComIPduGroupRef=RBTM_FR_BODY3_Rx_PNC_20_02b0f03d if post-build-variant-condition{matching-criterion=Side, value=1}, ComIPduGroupRef=RBTM_FR_BODY3_Rx_PNC_All_Active_592f1bcd if post-build-variant-condition{matching-criterion=Side, value=1}
        VSS_TP_SecTickCount_Lvl2_ST3_4917056b_Rx: ComIPduDirection=RECEIVE, ComIPduType=NORMAL, ComIPduGroupRef=RBTM_FL_BODY3_Rx_PNC_20_54c591d6 if post-build-variant-condition{matching-criterion=Side, value=0}, ComIPduGroupRef=RBTM_FL_BODY3_Rx_PNC_All_Active_46e8c3b2 if post-build-variant-condition{matching-criterion=Side, value=0}, ComIPduSignalGroupRef=VSS_TP_SecTickCount_Lvl2_ST3_9eubq13iosat764o0lqh5xb6r_01efe31e_Rx, ComPduIdRef=EcucPduCollection/VSS_TP_SecTickCount_Lvl2_ST3_4917056b_Rx, ComIPduGroupRef=RBTM_FR_BODY3_Rx_PNC_20_02b0f03d if post-build-variant-condition{matching-criterion=Side, value=1}, ComIPduGroupRef=RBTM_FR_BODY3_Rx_PNC_All_Active_592f1bcd if post-build-variant-condition{matching-criterion=Side, value=1}
        VSS_TP_SharedSecret_ST3_605b0fee_Rx: ComIPduDirection=RECEIVE, ComIPduType=NORMAL, ComIPduGroupRef=RBTM_FL_BODY3_Rx_PNC_20_54c591d6 if post-build-variant-condition{matching-criterion=Side, value=0}, ComIPduGroupRef=RBTM_FL_BODY3_Rx_PNC_All_Active_46e8c3b2 if post-build-variant-condition{matching-criterion=Side, value=0}, ComIPduSignalGroupRef=VSS_TP_SharedSecret_ST3_8pj4t8t4rm3tw3pk5hj7vonti_d9a21e4b_Rx, ComPduIdRef=EcucPduCollection/VSS_TP_SharedSecret_ST3_605b0fee_Rx, ComIPduGroupRef=RBTM_FR_BODY3_Rx_PNC_20_02b0f03d if post-build-variant-condition{matching-criterion=Side, value=1}, ComIPduGroupRef=RBTM_FR_BODY3_Rx_PNC_All_Active_592f1bcd if post-build-variant-condition{matching-criterion=Side, value=1}
        VSS_TP_VIN_ST3_8e87972a_Rx: ComIPduDirection=RECEIVE, ComIPduType=NORMAL, ComIPduGroupRef=RBTM_FL_BODY3_Rx_PNC_20_54c591d6 if post-build-variant-condition{matching-criterion=Side, value=0}, ComIPduGroupRef=RBTM_FL_BODY3_Rx_PNC_All_Active_46e8c3b2 if post-build-variant-condition{matching-criterion=Side, value=0}, ComIPduSignalGroupRef=VSS_TP_VIN_ST3_bz1xsv84cxzl09j028gn39p69_f31ab3e3_Rx, ComPduIdRef=EcucPduCollection/VSS_TP_VIN_ST3_8e87972a_Rx, ComIPduGroupRef=RBTM_FR_BODY3_Rx_PNC_20_02b0f03d if post-build-variant-condition{matching-criterion=Side, value=1}, ComIPduGroupRef=RBTM_FR_BODY3_Rx_PNC_All_Active_592f1bcd if post-build-variant-condition{matching-criterion=Side, value=1}
      5 x ComIPduGroup, all with variation-point=post-build-variant-condition{matching-criterion=Side, value=0}:
        RBTM_FL_BODY3_Rx_PNC_20_54c591d6
        RBTM_FL_BODY3_Rx_PNC_All_Active_46e8c3b2
        RBTM_FL_BODY3_Tx_PNC_20_27dfe85c
        RBTM_FL_BODY3_Tx_PNC_All_Active_e1dc74ba
        TxMess_RBTM_FL_BODY3_e804245a
      32 x ComSignal:
        ADAS_Prediction_MsgTyp_ST36_11a04f12_Rx: ComBitPosition=0, ComBitSize=3, ComSignalDataInvalidValue=7, ComSignalEndianness=LITTLE_ENDIAN, ComSignalInitValue=7, ComSignalType=UINT8, ComSystemTemplateSystemSignalRef=ADAS_Prediction_MsgTyp_ST36
        ADAS_Prediction_MsgTyp_ST37_66a77f84_Rx: ComBitPosition=0, ComBitSize=3, ComSignalDataInvalidValue=7, ComSignalEndianness=LITTLE_ENDIAN, ComSignalInitValue=7, ComSignalType=UINT8, ComSystemTemplateSystemSignalRef=ADAS_Prediction_MsgTyp_ST37
        ADAS_ProfShort_ProfTyp_ST31_a96eaafe_Rx: ComBitPosition=27, ComBitSize=5, ComSignalDataInvalidValue=31, ComSignalEndianness=LITTLE_ENDIAN, ComSignalInitValue=31, ComSignalType=UINT8, ComSystemTemplateSystemSignalRef=ADAS_ProfShort_ProfTyp_ST31
        ADAS_ProfShort_ProfTyp_ST331_eb463c84_Rx: ComBitPosition=27, ComBitSize=5, ComSignalDataInvalidValue=31, ComSignalEndianness=LITTLE_ENDIAN, ComSignalInitValue=31, ComSignalType=UINT8, ComSystemTemplateSystemSignalRef=ADAS_ProfShort_ProfTyp_ST331
        Awake_Diag_Actv_RBTM_FL_ST3_5efe61d8_Tx: ComBitPosition=30, ComBitSize=1, ComSignalEndianness=LITTLE_ENDIAN, ComSignalInitValue=0, ComSignalType=BOOLEAN, ComTransferProperty=PENDING, ComSystemTemplateSystemSignalRef=Awake_Diag_Actv_RBTM_FL_ST3, variation-point=post-build-variant-condition{matching-criterion=Side, value=0}
        Awake_Ignition_On_RBTM_FL_ST3_49d22bbd_Tx: ComBitPosition=32, ComBitSize=1, ComSignalEndianness=LITTLE_ENDIAN, ComSignalInitValue=0, ComSignalType=BOOLEAN, ComTransferProperty=PENDING, ComSystemTemplateSystemSignalRef=Awake_Ignition_On_RBTM_FL_ST3, variation-point=post-build-variant-condition{matching-criterion=Side, value=0}
        Awake_NwStart_RBTM_FL_ST3_393ce9b3_Tx: ComBitPosition=31, ComBitSize=1, ComSignalEndianness=LITTLE_ENDIAN, ComSignalInitValue=0, ComSignalType=BOOLEAN, ComTransferProperty=PENDING, ComSystemTemplateSystemSignalRef=Awake_NwStart_RBTM_FL_ST3, variation-point=post-build-variant-condition{matching-criterion=Side, value=0}
        BeltHdOvr_FL_Stat_ST3_3489841d_Rx: ComBitPosition=0, ComBitSize=2, ComSignalDataInvalidValue=3, ComSignalEndianness=LITTLE_ENDIAN, ComSignalInitValue=3, ComSignalType=UINT8, ComTimeout=5.25, ComSystemTemplateSystemSignalRef=BeltHdOvr_FL_Stat_ST3, variation-point=post-build-variant-condition{matching-criterion=Side, value=0}
        BltSlckDec_Md_FL_Stat_ST3_e47e790a_Tx: ComBitPosition=0, ComBitSize=2, ComSignalDataInvalidValue=3, ComSignalEndianness=LITTLE_ENDIAN, ComSignalInitValue=3, ComSignalType=UINT8, ComTransferProperty=TRIGGERED_ON_CHANGE, ComSystemTemplateSystemSignalRef=BltSlckDec_Md_FL_Stat_ST3, variation-point=post-build-variant-condition{matching-criterion=Side, value=0}
        BltSlckDec_Md_Rq_HU_ST3_64a95ccf_Rx: ComBitPosition=0, ComBitSize=2, ComSignalDataInvalidValue=3, ComSignalEndianness=LITTLE_ENDIAN, ComSignalInitValue=3, ComSignalType=UINT8, ComTimeout=60.5, ComSystemTemplateSystemSignalRef=BltSlckDec_Md_Rq_HU_ST3
        ComSignalPnc_EIRA_CAN_Rx: ComSignalInitValue=0 0 0 0 0 0 0, ComSignalLength=7, ComSignalType=UINT8_N
        DidA_ExtTest_Pres_ST3_7e50ca1d_Rx: ComBitPosition=2, ComBitSize=2, ComSignalDataInvalidValue=3, ComSignalEndianness=LITTLE_ENDIAN, ComSignalInitValue=3, ComSignalType=UINT8, ComSystemTemplateSystemSignalRef=DidA_ExtTest_Pres_ST3
        ECU_Id_RBTM_FL_ST3_b4de0ce2_Tx: ComBitPosition=0, ComBitSize=12, ComSignalDataInvalidValue=4095, ComSignalEndianness=LITTLE_ENDIAN, ComSignalInitValue=420, ComSignalType=UINT16, ComTransferProperty=PENDING, ComSystemTemplateSystemSignalRef=ECU_Id_RBTM_FL_ST3, variation-point=post-build-variant-condition{matching-criterion=Side, value=0}
        NM_RBTM_FL_ST3_PNC_785a2d76_Tx: ComBitPosition=0, ComSignalEndianness=opaque, ComSignalInitValue=0 0 0 0 0 0 0, ComSignalLength=7, ComSignalType=UINT8_N, ComTransferProperty=PENDING, ComSystemTemplateSystemSignalRef=NM_RBTM_FL_ST3_PNC, variation-point=post-build-variant-condition{matching-criterion=Side, value=0}
        Navi_RouteGuidance_Stat_ST3_ac3bae27_Rx: ComBitPosition=8, ComBitSize=2, ComSignalDataInvalidValue=3, ComSignalEndianness=LITTLE_ENDIAN, ComSignalInitValue=3, ComSignalType=UINT8, ComTimeout=10.1, ComSystemTemplateSystemSignalRef=Navi_RouteGuidance_Stat_ST3
        PN14_DDP_Sw_Stat_ST3_568ad7e6_Rx: ComBitPosition=2, ComBitSize=3, ComSignalDataInvalidValue=7, ComSignalEndianness=LITTLE_ENDIAN, ComSignalInitValue=0, ComSignalType=UINT8, ComSystemTemplateSystemSignalRef=PN14_DDP_Sw_Stat_ST3
        PN14_ProdMd_Stat_ST3_be2b5dfe_Rx: ComBitPosition=5, ComBitSize=3, ComSignalDataInvalidValue=7, ComSignalEndianness=LITTLE_ENDIAN, ComSignalInitValue=7, ComSignalType=UINT8, ComSystemTemplateSystemSignalRef=PN14_ProdMd_Stat_ST3
        PN14_SupBat_Volt_ST3_946fd9c6_Rx: ComBitPosition=22, ComBitSize=10, ComSignalDataInvalidValue=1023, ComSignalEndianness=LITTLE_ENDIAN, ComSignalInitValue=1023, ComSignalType=UINT16, ComSystemTemplateSystemSignalRef=PN14_SupBat_Volt_ST3
        PN14_TransMd_Stat_ST3_2208da29_Rx: ComBitPosition=0, ComBitSize=2, ComSignalDataInvalidValue=3, ComSignalEndianness=LITTLE_ENDIAN, ComSignalInitValue=3, ComSignalType=UINT8, ComSystemTemplateSystemSignalRef=PN14_TransMd_Stat_ST3
        PS_Curve_FL_Rq_HU_ST3_6cd299ba_Rx: ComBitPosition=2, ComBitSize=2, ComSignalDataInvalidValue=3, ComSignalEndianness=LITTLE_ENDIAN, ComSignalInitValue=3, ComSignalType=UINT8, ComTimeout=10.1, ComSystemTemplateSystemSignalRef=PS_Curve_FL_Rq_HU_ST3, variation-point=post-build-variant-condition{matching-criterion=Side, value=0}
        PS_Curve_FL_Stat_ST3_b0d41119_Tx: ComBitPosition=2, ComBitSize=2, ComSignalDataInvalidValue=3, ComSignalEndianness=LITTLE_ENDIAN, ComSignalInitValue=3, ComSignalType=UINT8, ComTransferProperty=TRIGGERED_ON_CHANGE, ComSystemTemplateSystemSignalRef=PS_Curve_FL_Stat_ST3, variation-point=post-build-variant-condition{matching-criterion=Side, value=0}
        RBTMFL_Actv_Lvl_ST35_6199228f_Tx: ComBitPosition=10, ComBitSize=6, ComSignalDataInvalidValue=63, ComSignalEndianness=LITTLE_ENDIAN, ComSignalInitValue=0, ComSignalType=UINT8, ComTransferProperty=TRIGGERED_ON_CHANGE, ComSystemTemplateSystemSignalRef=RBTMFL_Actv_Lvl_ST35, variation-point=post-build-variant-condition{matching-criterion=Side, value=0}
        RBTMFL_SP_ActvClient_ST35_bec76928_Tx: ComBitPosition=16, ComBitSize=4, ComSignalDataInvalidValue=15, ComSignalEndianness=LITTLE_ENDIAN, ComSignalInitValue=0, ComSignalType=UINT8, ComTransferProperty=TRIGGERED_ON_CHANGE, ComSystemTemplateSystemSignalRef=RBTMFL_SP_ActvClient_ST35, variation-point=post-build-variant-condition{matching-criterion=Side, value=0}
        RBTMFL_SP_FctPrecond_Stat_ST35_bbfa2c80_Tx: ComBitPosition=0, ComBitSize=10, ComSignalEndianness=LITTLE_ENDIAN, ComSignalInitValue=0, ComSignalType=UINT16, ComTransferProperty=TRIGGERED_ON_CHANGE, ComSystemTemplateSystemSignalRef=RBTMFL_SP_FctPrecond_Stat_ST35, variation-point=post-build-variant-condition{matching-criterion=Side, value=0}
        RBTM_FL_Disp_Rq_ST3_c372540c_Tx: ComBitPosition=24, ComBitSize=2, ComSignalEndianness=LITTLE_ENDIAN, ComSignalInitValue=0, ComSignalType=UINT8, ComTransferProperty=TRIGGERED_ON_CHANGE, ComSystemTemplateSystemSignalRef=RBTM_FL_Disp_Rq_ST3, variation-point=post-build-variant-condition{matching-criterion=Side, value=0}
        RBTM_FL_Tgl_ST3_1fe530ed_Tx: ComBitPosition=26, ComBitSize=1, ComSignalEndianness=LITTLE_ENDIAN, ComSignalInitValue=0, ComSignalType=BOOLEAN, ComTransferProperty=PENDING, ComSystemTemplateSystemSignalRef=RBTM_FL_Tgl_ST3, variation-point=post-build-variant-condition{matching-criterion=Side, value=0}
        RevBltTns_FL_ComCyc_Actv_ST3_4c5f745f_Tx: ComBitPosition=2, ComBitSize=2, ComSignalDataInvalidValue=3, ComSignalEndianness=LITTLE_ENDIAN, ComSignalInitValue=3, ComSignalType=UINT8, ComTransferProperty=TRIGGERED_ON_CHANGE, ComSystemTemplateSystemSignalRef=RevBltTns_FL_ComCyc_Actv_ST3, variation-point=post-build-variant-condition{matching-criterion=Side, value=0}
        RevBltTns_FL_SafeCyc_Actv_ST3_b0efc754_Tx: ComBitPosition=0, ComBitSize=2, ComSignalDataInvalidValue=3, ComSignalEndianness=LITTLE_ENDIAN, ComSignalInitValue=3, ComSignalType=UINT8, ComTransferProperty=TRIGGERED_ON_CHANGE, ComSystemTemplateSystemSignalRef=RevBltTns_FL_SafeCyc_Actv_ST3, variation-point=post-build-variant-condition{matching-criterion=Side, value=0}
        RevBltTns_FR_ComCyc_Actv_ST3_4c00d29e_Rx: ComBitPosition=2, ComBitSize=2, ComSignalDataInvalidValue=3, ComSignalEndianness=LITTLE_ENDIAN, ComSignalInitValue=3, ComSignalType=UINT8, ComSystemTemplateSystemSignalRef=RevBltTns_FR_ComCyc_Actv_ST3, variation-point=post-build-variant-condition{matching-criterion=Side, value=0}
        RevBltTns_FR_SafeCyc_Actv_ST3_5c8c6ad4_Rx: ComBitPosition=0, ComBitSize=2, ComSignalDataInvalidValue=3, ComSignalEndianness=LITTLE_ENDIAN, ComSignalInitValue=3, ComSignalType=UINT8, ComSystemTemplateSystemSignalRef=RevBltTns_FR_SafeCyc_Actv_ST3, variation-point=post-build-variant-condition{matching-criterion=Side, value=0}
        VehSpd_Disp_ST3_4922a2fd_Rx: ComBitPosition=48, ComBitSize=12, ComSignalDataInvalidValue=4095, ComSignalEndianness=LITTLE_ENDIAN, ComSignalInitValue=4095, ComSignalType=UINT16, ComTimeout=10.5, ComSystemTemplateSystemSignalRef=VehSpd_Disp_ST3
        WakeupRsn_RBTM_FL_ST3_91bb10a0_Tx: ComBitPosition=20, ComBitSize=10, ComSignalDataInvalidValue=1023, ComSignalEndianness=LITTLE_ENDIAN, ComSignalInitValue=1023, ComSignalType=UINT16, ComTransferProperty=PENDING, ComSystemTemplateSystemSignalRef=WakeupRsn_RBTM_FL_ST3, variation-point=post-build-variant-condition{matching-criterion=Side, value=0}
      26 x ComSignalGroup:
        ADAS_Meta_ST3_40sly585w5zu8pqjwib3nr7y7_6_d1dcd94d_Rx: ComTimeout=10.1, ComTransferProperty=PENDING, ComSystemTemplateSignalGroupRef=ADAS_Meta_ST3_40sly585w5zu8pqjwib3nr7y7
          12 x ComGroupSignal, all with ComSignalEndianness=LITTLE_ENDIAN:
            ADAS_Meta_CountryCode_ST36_533f1e2d_Rx: ComBitPosition=6, ComBitSize=10, ComSignalDataInvalidValue=1023, ComSignalInitValue=0, ComSignalType=UINT16, ComSystemTemplateSystemSignalRef=ADAS_Meta_CountryCode_ST36
            ADAS_Meta_CycCnt_ST36_bb9cdf27_Rx: ComBitPosition=22, ComBitSize=2, ComSignalInitValue=0, ComSignalType=UINT8, ComSystemTemplateSystemSignalRef=ADAS_Meta_CycCnt_ST36
            ADAS_Meta_DrvSide_ST36_22c578f2_Rx: ComBitPosition=16, ComBitSize=1, ComSignalInitValue=1, ComSignalType=UINT8, ComSystemTemplateSystemSignalRef=ADAS_Meta_DrvSide_ST36
            ADAS_Meta_HwVer_ST36_1eda5958_Rx: ComBitPosition=24, ComBitSize=9, ComSignalInitValue=0, ComSignalType=UINT16, ComSystemTemplateSystemSignalRef=ADAS_Meta_HwVer_ST36
            ADAS_Meta_MapProvid_ST36_a95ee03c_Rx: ComBitPosition=3, ComBitSize=3, ComSignalDataInvalidValue=7, ComSignalInitValue=7, ComSignalType=UINT8, ComSystemTemplateSystemSignalRef=ADAS_Meta_MapProvid_ST36
            ADAS_Meta_MapVerQuar_ST36_c498289a_Rx: ComBitPosition=54, ComBitSize=2, ComSignalInitValue=0, ComSignalType=UINT8, ComSystemTemplateSystemSignalRef=ADAS_Meta_MapVerQuar_ST36
            ADAS_Meta_MapVerYear_ST36_03fbbba9_Rx: ComBitPosition=48, ComBitSize=6, ComSignalDataInvalidValue=63, ComSignalInitValue=63, ComSignalType=UINT8, ComSystemTemplateSystemSignalRef=ADAS_Meta_MapVerYear_ST36
            ADAS_Meta_ProtVer_Major_ST36_db37cb7d_Rx: ComBitPosition=20, ComBitSize=2, ComSignalInitValue=0, ComSignalType=UINT8, ComSystemTemplateSystemSignalRef=ADAS_Meta_ProtVer_Major_ST36
            ADAS_Meta_ProtVer_MinorSub_ST36_acb19add_Rx: ComBitPosition=17, ComBitSize=3, ComSignalInitValue=0, ComSignalType=UINT8, ComSystemTemplateSystemSignalRef=ADAS_Meta_ProtVer_MinorSub_ST36
            ADAS_Meta_ProtVer_Minor_ST36_e4a5679f_Rx: ComBitPosition=56, ComBitSize=4, ComSignalInitValue=0, ComSignalType=UINT8, ComSystemTemplateSystemSignalRef=ADAS_Meta_ProtVer_Minor_ST36
            ADAS_Meta_RegionCode_ST36_9e8c91d6_Rx: ComBitPosition=33, ComBitSize=15, ComSignalDataInvalidValue=32767, ComSignalInitValue=32767, ComSignalType=UINT16, ComSystemTemplateSystemSignalRef=ADAS_Meta_RegionCode_ST36
            ADAS_Meta_SpdUnits_ST36_b689c97b_Rx: ComBitPosition=60, ComBitSize=1, ComSignalInitValue=0, ComSignalType=UINT8, ComSystemTemplateSystemSignalRef=ADAS_Meta_SpdUnits_ST36
        ADAS_Posn_ST3_cre9f2x2lehhx0k4gxnl4u9sg_7bfda340_Rx: ComTimeout=5.1, ComTransferProperty=PENDING, ComSystemTemplateSignalGroupRef=ADAS_Posn_ST3_cre9f2x2lehhx0k4gxnl4u9sg
          11 x ComGroupSignal, all with ComSignalEndianness=LITTLE_ENDIAN:
            ADAS_Posn_Age_ST3_5a9b03e1_Rx: ComBitPosition=32, ComBitSize=9, ComSignalDataInvalidValue=511, ComSignalInitValue=511, ComSignalType=UINT32, ComSystemTemplateSystemSignalRef=ADAS_Posn_Age_ST3
            ADAS_Posn_CurLane_ST3_a4b581c7_Rx: ComBitPosition=41, ComBitSize=3, ComSignalDataInvalidValue=7, ComSignalInitValue=0, ComSignalType=UINT8, ComSystemTemplateSystemSignalRef=ADAS_Posn_CurLane_ST3
            ADAS_Posn_CycCnt_ST3_1a5fd650_Rx: ComBitPosition=22, ComBitSize=2, ComSignalInitValue=0, ComSignalType=UINT8, ComSystemTemplateSystemSignalRef=ADAS_Posn_CycCnt_ST3
            ADAS_Posn_Idx_ST3_77906c1b_Rx: ComBitPosition=30, ComBitSize=2, ComSignalInitValue=0, ComSignalType=UINT8, ComSystemTemplateSystemSignalRef=ADAS_Posn_Idx_ST3
            ADAS_Posn_MsgTyp_ST3_5cd85424_Rx: ComBitPosition=0, ComBitSize=3, ComSignalDataInvalidValue=7, ComSignalInitValue=1, ComSignalType=UINT8, ComSystemTemplateSystemSignalRef=ADAS_Posn_MsgTyp_ST3
            ADAS_Posn_Offset_ST3_f95ee08b_Rx: ComBitPosition=3, ComBitSize=13, ComSignalDataInvalidValue=8191, ComSignalInitValue=8191, ComSignalType=UINT16, ComSystemTemplateSystemSignalRef=ADAS_Posn_Offset_ST3
            ADAS_Posn_PathIdx_ST3_767b1017_Rx: ComBitPosition=16, ComBitSize=6, ComSignalInitValue=0, ComSignalType=UINT8, ComSystemTemplateSystemSignalRef=ADAS_Posn_PathIdx_ST3
            ADAS_Posn_PosConfdc_ST3_48dd3431_Rx: ComBitPosition=44, ComBitSize=3, ComSignalDataInvalidValue=7, ComSignalInitValue=7, ComSignalType=UINT8, ComSystemTemplateSystemSignalRef=ADAS_Posn_PosConfdc_ST3
            ADAS_Posn_PosProbb_ST3_8f4d30bf_Rx: ComBitPosition=25, ComBitSize=5, ComSignalDataInvalidValue=31, ComSignalInitValue=31, ComSignalType=UINT8, ComSystemTemplateSystemSignalRef=ADAS_Posn_PosProbb_ST3
            ADAS_Posn_RelHead_ST3_3452334b_Rx: ComBitPosition=56, ComBitSize=8, ComSignalDataInvalidValue=255, ComSignalInitValue=255, ComSignalType=UINT8, ComSystemTemplateSystemSignalRef=ADAS_Posn_RelHead_ST3
            ADAS_Posn_Spd_ST3_89699595_Rx: ComBitPosition=47, ComBitSize=9, ComSignalDataInvalidValue=511, ComSignalInitValue=511, ComSignalType=UINT16, ComSystemTemplateSystemSignalRef=ADAS_Posn_Spd_ST3
        ADAS_Profile_Short_CurvLn_ST3_96e9ejcafisp13h7moqj5malh_1_aac62a51_Rx: ComTimeout=1.1, ComTransferProperty=PENDING, ComSystemTemplateSignalGroupRef=ADAS_Profile_Short_CurvLn_ST3_96e9ejcafisp13h7moqj5malh
          11 x ComGroupSignal, all with ComSignalEndianness=LITTLE_ENDIAN:
            ADAS_ProfShort_AccurClass_CL_ST31_f1371770_Rx: ComBitPosition=32, ComBitSize=2, ComSignalInitValue=0, ComSignalType=UINT8, ComSystemTemplateSystemSignalRef=ADAS_ProfShort_AccurClass_CL_ST31
            ADAS_ProfShort_CtrlPoint_CL_ST31_6fbe8af5_Rx: ComBitPosition=26, ComBitSize=1, ComSignalInitValue=0, ComSignalType=UINT8, ComSystemTemplateSystemSignalRef=ADAS_ProfShort_CtrlPoint_CL_ST31
            ADAS_ProfShort_CycCnt_CL_ST31_a9579c2f_Rx: ComBitPosition=22, ComBitSize=2, ComSignalInitValue=0, ComSignalType=UINT8, ComSystemTemplateSystemSignalRef=ADAS_ProfShort_CycCnt_CL_ST31
            ADAS_ProfShort_Dist1_CL_ST31_455ed63e_Rx: ComBitPosition=44, ComBitSize=10, ComSignalDataInvalidValue=1023, ComSignalInitValue=0, ComSignalType=UINT16, ComSystemTemplateSystemSignalRef=ADAS_ProfShort_Dist1_CL_ST31
            ADAS_ProfShort_MsgTyp_CL_ST31_44c68e23_Rx: ComBitPosition=0, ComBitSize=3, ComSignalDataInvalidValue=7, ComSignalInitValue=4, ComSignalType=UINT8, ComSystemTemplateSystemSignalRef=ADAS_ProfShort_MsgTyp_CL_ST31
            ADAS_ProfShort_Offset_CL_ST31_58fcb916_Rx: ComBitPosition=3, ComBitSize=13, ComSignalDataInvalidValue=8191, ComSignalInitValue=8191, ComSignalType=UINT16, ComSystemTemplateSystemSignalRef=ADAS_ProfShort_Offset_CL_ST31
            ADAS_ProfShort_PathIdx_CL_ST31_9989379b_Rx: ComBitPosition=16, ComBitSize=6, ComSignalInitValue=0, ComSignalType=UINT8, ComSystemTemplateSystemSignalRef=ADAS_ProfShort_PathIdx_CL_ST31
            ADAS_ProfShort_ReTr_CL_ST31_8166ae07_Rx: ComBitPosition=25, ComBitSize=1, ComSignalInitValue=0, ComSignalType=UINT8, ComSystemTemplateSystemSignalRef=ADAS_ProfShort_ReTr_CL_ST31
            ADAS_ProfShort_Updt_CL_ST31_31b6d4b3_Rx: ComBitPosition=24, ComBitSize=1, ComSignalInitValue=0, ComSignalType=UINT8, ComSystemTemplateSystemSignalRef=ADAS_ProfShort_Updt_CL_ST31
            ADAS_ProfShort_Value0_CL_ST31_6c970c4b_Rx: ComBitPosition=34, ComBitSize=10, ComSignalDataInvalidValue=1023, ComSignalInitValue=1023, ComSignalType=UINT16, ComSystemTemplateSystemSignalRef=ADAS_ProfShort_Value0_CL_ST31
            ADAS_ProfShort_Value1_CL_ST31_7bec1808_Rx: ComBitPosition=54, ComBitSize=10, ComSignalDataInvalidValue=1023, ComSignalInitValue=0, ComSignalType=UINT16, ComSystemTemplateSystemSignalRef=ADAS_ProfShort_Value1_CL_ST31
        Bckl_Sw_Fx_Stat_Pr5_ST3_dihag5a55iw4h5qk539fx0kup_4c948f24_Rx: ComTimeout=1.1, ComTransferProperty=TRIGGERED_ON_CHANGE, ComSystemTemplateSignalGroupRef=Bckl_Sw_Fx_Stat_Pr5_ST3_dihag5a55iw4h5qk539fx0kup
          5 x ComGroupSignal, all with ComSignalEndianness=LITTLE_ENDIAN:
            Bckl_Sw_D_Stat_ST3_cb403d1d_Rx: ComBitPosition=24, ComBitSize=2, ComSignalDataInvalidValue=3, ComSignalInitValue=3, ComSignalType=UINT8, ComSystemTemplateSystemSignalRef=Bckl_Sw_D_Stat_ST3
            Bckl_Sw_FP_Stat_ST3_0736b261_Rx: ComBitPosition=26, ComBitSize=2, ComSignalDataInvalidValue=3, ComSignalInitValue=3, ComSignalType=UINT8, ComSystemTemplateSystemSignalRef=Bckl_Sw_FP_Stat_ST3
            CRC_Bckl_Sw_Fx_Stat_Pr5_ST3_e761a2ea_Rx: ComBitPosition=0, ComBitSize=16, ComSignalInitValue=33522, ComSignalType=UINT16, ComSystemTemplateSystemSignalRef=CRC_Bckl_Sw_Fx_Stat_Pr5_ST3
            Rsrv1_Bckl_Sw_Fx_Stat_ST3_8584783a_Rx: ComBitPosition=28, ComBitSize=4, ComSignalDataInvalidValue=15, ComSignalInitValue=15, ComSignalType=UINT8, ComSystemTemplateSystemSignalRef=Rsrv1_Bckl_Sw_Fx_Stat_ST3
            SQC_Bckl_Sw_Fx_Stat_Pr5_ST3_4b42e447_Rx: ComBitPosition=16, ComBitSize=8, ComSignalInitValue=0, ComSignalType=UINT8, ComSystemTemplateSystemSignalRef=SQC_Bckl_Sw_Fx_Stat_Pr5_ST3
        CLkS_DrRltch_Stat_Pr5_ST3_7at68qvnk0r9npofyykyfq82v_10e0cb0e_Rx: ComTransferProperty=TRIGGERED_ON_CHANGE, ComSystemTemplateSignalGroupRef=CLkS_DrRltch_Stat_Pr5_ST3_7at68qvnk0r9npofyykyfq82v
          6 x ComGroupSignal, all with ComSignalEndianness=LITTLE_ENDIAN:
            CRC_CLkS_DrRltch_Stat_Pr5_ST3_911c4673_Rx: ComBitPosition=0, ComBitSize=16, ComSignalInitValue=18640, ComSignalType=UINT16, ComSystemTemplateSystemSignalRef=CRC_CLkS_DrRltch_Stat_Pr5_ST3
            DrRLtch_FL_Stat_ST3_ce64a199_Rx: ComBitPosition=24, ComBitSize=2, ComSignalDataInvalidValue=3, ComSignalInitValue=3, ComSignalType=UINT8, ComSystemTemplateSystemSignalRef=DrRLtch_FL_Stat_ST3
            DrRLtch_FR_Stat_ST3_f70310c2_Rx: ComBitPosition=26, ComBitSize=2, ComSignalDataInvalidValue=3, ComSignalInitValue=3, ComSignalType=UINT8, ComSystemTemplateSystemSignalRef=DrRLtch_FR_Stat_ST3
            DrRLtch_RL_Stat_ST3_d04b16d0_Rx: ComBitPosition=28, ComBitSize=2, ComSignalDataInvalidValue=3, ComSignalInitValue=3, ComSignalType=UINT8, ComSystemTemplateSystemSignalRef=DrRLtch_RL_Stat_ST3
            DrRLtch_RR_Stat_ST3_e92ca78b_Rx: ComBitPosition=30, ComBitSize=2, ComSignalDataInvalidValue=3, ComSignalInitValue=3, ComSignalType=UINT8, ComSystemTemplateSystemSignalRef=DrRLtch_RR_Stat_ST3
            SQC_CLkS_DrRltch_Stat_Pr5_ST3_150acc51_Rx: ComBitPosition=16, ComBitSize=8, ComSignalInitValue=0, ComSignalType=UINT8, ComSystemTemplateSystemSignalRef=SQC_CLkS_DrRltch_Stat_Pr5_ST3
        DI_Odo_Pr5_ST3_e68xmtlkywxgxsdwekdjjhw3t_eb760b63_Rx: ComTransferProperty=TRIGGERED_ON_CHANGE, ComUpdateBitPosition=63, ComSystemTemplateSignalGroupRef=DI_Odo_Pr5_ST3_e68xmtlkywxgxsdwekdjjhw3t
          3 x ComGroupSignal, all with ComSignalEndianness=LITTLE_ENDIAN:
            CRC_DI_Odo_Pr5_ST3_ca96419c_Rx: ComBitPosition=0, ComBitSize=16, ComSignalInitValue=8633, ComSignalType=UINT16, ComSystemTemplateSystemSignalRef=CRC_DI_Odo_Pr5_ST3
            Odo_ST3_657046b6_Rx: ComBitPosition=24, ComBitSize=24, ComSignalDataInvalidValue=16777215, ComSignalInitValue=16777215, ComSignalType=UINT32, ComSystemTemplateSystemSignalRef=Odo_ST3
            SQC_DI_Odo_Pr5_ST3_b7af4600_Rx: ComBitPosition=16, ComBitSize=8, ComSignalInitValue=0, ComSignalType=UINT8, ComSystemTemplateSystemSignalRef=SQC_DI_Odo_Pr5_ST3
        DPC_Md_Rq_ESP_Pr5_ST3_dcsny138uwpesz5bmssj1scqi_6b0a3c02_Rx: ComTransferProperty=TRIGGERED_ON_CHANGE, ComUpdateBitPosition=5, ComSystemTemplateSignalGroupRef=DPC_Md_Rq_ESP_Pr5_ST3_dcsny138uwpesz5bmssj1scqi
          DPC_Md_PT_Rq_ST3_221f27a4_Rx (ComGroupSignal):
            ComBitPosition = 0
            ComBitSize = 5
            ComSignalDataInvalidValue = 31
            ComSignalEndianness = LITTLE_ENDIAN
            ComSignalInitValue = 0
            ComSignalType = UINT8
            ComSystemTemplateSystemSignalRef = DPC_Md_PT_Rq_ST3
        Develop8_Rq_RBTM_FL_ST3_48g6nu8rjjp9s4bhq1x3pz06u_6f2fac01_Rx: ComTransferProperty=TRIGGERED, ComSystemTemplateSignalGroupRef=Develop8_Rq_RBTM_FL_ST3_48g6nu8rjjp9s4bhq1x3pz06u, variation-point=post-build-variant-condition{matching-criterion=Side, value=0}
          8 x ComGroupSignal, all with ComBitSize=8, ComSignalEndianness=LITTLE_ENDIAN, ComSignalInitValue=0, ComSignalType=UINT8:
            Develop_Rq_RBTM_FL_01_ST3_60c4ffa1_Rx: ComBitPosition=0, ComSystemTemplateSystemSignalRef=Develop_Rq_RBTM_FL_01_ST3
            Develop_Rq_RBTM_FL_02_ST3_27648571_Rx: ComBitPosition=8, ComSystemTemplateSystemSignalRef=Develop_Rq_RBTM_FL_02_ST3
            Develop_Rq_RBTM_FL_03_ST3_1a04acc1_Rx: ComBitPosition=16, ComSystemTemplateSystemSignalRef=Develop_Rq_RBTM_FL_03_ST3
            Develop_Rq_RBTM_FL_04_ST3_a82470d1_Rx: ComBitPosition=24, ComSystemTemplateSystemSignalRef=Develop_Rq_RBTM_FL_04_ST3
            Develop_Rq_RBTM_FL_05_ST3_95445961_Rx: ComBitPosition=32, ComSystemTemplateSystemSignalRef=Develop_Rq_RBTM_FL_05_ST3
            Develop_Rq_RBTM_FL_06_ST3_d2e423b1_Rx: ComBitPosition=40, ComSystemTemplateSystemSignalRef=Develop_Rq_RBTM_FL_06_ST3
            Develop_Rq_RBTM_FL_07_ST3_ef840a01_Rx: ComBitPosition=48, ComSystemTemplateSystemSignalRef=Develop_Rq_RBTM_FL_07_ST3
            Develop_Rq_RBTM_FL_08_ST3_6dd49dd0_Rx: ComBitPosition=56, ComSystemTemplateSystemSignalRef=Develop_Rq_RBTM_FL_08_ST3
        Develop8_Rs_RBTM_FL_ST3_7jg1r8p1skn6yj1t9z2s157vt_a69dcfbb_Tx: ComTransferProperty=TRIGGERED, ComSystemTemplateSignalGroupRef=Develop8_Rs_RBTM_FL_ST3_7jg1r8p1skn6yj1t9z2s157vt, variation-point=post-build-variant-condition{matching-criterion=Side, value=0}
          8 x ComGroupSignal, all with ComBitSize=8, ComSignalEndianness=LITTLE_ENDIAN, ComSignalInitValue=0, ComSignalType=UINT8:
            Develop_Rs_RBTM_FL_01_ST3_7a76cd90_Tx: ComBitPosition=0, ComSystemTemplateSystemSignalRef=Develop_Rs_RBTM_FL_01_ST3
            Develop_Rs_RBTM_FL_02_ST3_3dd6b740_Tx: ComBitPosition=8, ComSystemTemplateSystemSignalRef=Develop_Rs_RBTM_FL_02_ST3
            Develop_Rs_RBTM_FL_03_ST3_00b69ef0_Tx: ComBitPosition=16, ComSystemTemplateSystemSignalRef=Develop_Rs_RBTM_FL_03_ST3
            Develop_Rs_RBTM_FL_04_ST3_b29642e0_Tx: ComBitPosition=24, ComSystemTemplateSystemSignalRef=Develop_Rs_RBTM_FL_04_ST3
            Develop_Rs_RBTM_FL_05_ST3_8ff66b50_Tx: ComBitPosition=32, ComSystemTemplateSystemSignalRef=Develop_Rs_RBTM_FL_05_ST3
            Develop_Rs_RBTM_FL_06_ST3_c8561180_Tx: ComBitPosition=40, ComSystemTemplateSystemSignalRef=Develop_Rs_RBTM_FL_06_ST3
            Develop_Rs_RBTM_FL_07_ST3_f5363830_Tx: ComBitPosition=48, ComSystemTemplateSystemSignalRef=Develop_Rs_RBTM_FL_07_ST3
            Develop_Rs_RBTM_FL_08_ST3_7766afe1_Tx: ComBitPosition=56, ComSystemTemplateSystemSignalRef=Develop_Rs_RBTM_FL_08_ST3
        ELC_Lvr_Stat_Pr5_ST3_7b68ktfwrvsk1oyozi7cntryn_cd318e5f_Rx: ComTimeout=1.1, ComTransferProperty=TRIGGERED_ON_CHANGE, ComSystemTemplateSignalGroupRef=ELC_Lvr_Stat_Pr5_ST3_7b68ktfwrvsk1oyozi7cntryn
          5 x ComGroupSignal, all with ComSignalEndianness=LITTLE_ENDIAN:
            CRC_ELC_Lvr_Stat_Pr5_ST3_0624156b_Rx: ComBitPosition=0, ComBitSize=16, ComSignalInitValue=40318, ComSignalType=UINT16, ComSystemTemplateSystemSignalRef=CRC_ELC_Lvr_Stat_Pr5_ST3
            ELC_HiBmLvr_Stat_ST3_e6f8b687_Rx: ComBitPosition=26, ComBitSize=2, ComSignalDataInvalidValue=3, ComSignalInitValue=0, ComSignalType=UINT8, ComSystemTemplateSystemSignalRef=ELC_HiBmLvr_Stat_ST3
            ELC_TurnIndLvr_Stat_ST3_16708a3c_Rx: ComBitPosition=24, ComBitSize=2, ComSignalDataInvalidValue=3, ComSignalInitValue=0, ComSignalType=UINT8, ComSystemTemplateSystemSignalRef=ELC_TurnIndLvr_Stat_ST3
            Rsrv1_ELC_Lvr_Stat_Pr5_ST3_f3d8e141_Rx: ComBitPosition=28, ComBitSize=4, ComSignalDataInvalidValue=15, ComSignalInitValue=15, ComSignalType=UINT8, ComSystemTemplateSystemSignalRef=Rsrv1_ELC_Lvr_Stat_Pr5_ST3
            SQC_ELC_Lvr_Stat_Pr5_ST3_0faa536b_Rx: ComBitPosition=16, ComBitSize=8, ComSignalInitValue=0, ComSignalType=UINT8, ComSystemTemplateSystemSignalRef=SQC_ELC_Lvr_Stat_Pr5_ST3
        EVC_CfgList_01_08_Pr5_ST3_co3q1mwsf7pwxo2ix5jryc04x_3a43a00a_Rx: ComTimeout=2.5, ComTransferProperty=PENDING, ComSystemTemplateSignalGroupRef=EVC_CfgList_01_08_Pr5_ST3_co3q1mwsf7pwxo2ix5jryc04x
          11 x ComGroupSignal, all with ComSignalEndianness=LITTLE_ENDIAN:
            CRC_EVC_CfgList_01_08_Pr5_ST3_4f3aab12_Rx: ComBitPosition=0, ComBitSize=16, ComSignalInitValue=46137, ComSignalType=UINT16, ComSystemTemplateSystemSignalRef=CRC_EVC_CfgList_01_08_Pr5_ST3
            EVC_CfgList_01_08_Stat_ST3_93476784_Rx: ComBitPosition=24, ComBitSize=2, ComSignalDataInvalidValue=3, ComSignalInitValue=3, ComSignalType=UINT8, ComSystemTemplateSystemSignalRef=EVC_CfgList_01_08_Stat_ST3
            EVC_List01_BodyStyle_ST3_a3504531_Rx: ComBitPosition=26, ComBitSize=6, ComSignalInitValue=63, ComSignalType=UINT8, ComSystemTemplateSystemSignalRef=EVC_List01_BodyStyle_ST3
            EVC_List02_VehLine_ST3_bbfa2725_Rx: ComBitPosition=32, ComBitSize=6, ComSignalInitValue=63, ComSignalType=UINT8, ComSystemTemplateSystemSignalRef=EVC_List02_VehLine_ST3
            EVC_List03_StStyle_ST3_0f0d9336_Rx: ComBitPosition=38, ComBitSize=2, ComSignalDataInvalidValue=3, ComSignalInitValue=3, ComSignalType=UINT8, ComSystemTemplateSystemSignalRef=EVC_List03_StStyle_ST3
            EVC_List04_YrOfModf_2_ST3_3da05805_Rx: ComBitPosition=40, ComBitSize=4, ComSignalInitValue=15, ComSignalType=UINT8, ComSystemTemplateSystemSignalRef=EVC_List04_YrOfModf_2_ST3
            EVC_List05_YrOfModf_1_ST3_d468b344_Rx: ComBitPosition=44, ComBitSize=4, ComSignalInitValue=15, ComSignalType=UINT8, ComSystemTemplateSystemSignalRef=EVC_List05_YrOfModf_1_ST3
            EVC_List06_Country_ST3_82113093_Rx: ComBitPosition=48, ComBitSize=8, ComSignalInitValue=255, ComSignalType=UINT8, ComSystemTemplateSystemSignalRef=EVC_List06_Country_ST3
            EVC_List07_TxStyle_ST3_fcb30cad_Rx: ComBitPosition=56, ComBitSize=4, ComSignalInitValue=15, ComSignalType=UINT8, ComSystemTemplateSystemSignalRef=EVC_List07_TxStyle_ST3
            EVC_List08_HL_Style_ST3_f988c239_Rx: ComBitPosition=60, ComBitSize=4, ComSignalInitValue=15, ComSignalType=UINT8, ComSystemTemplateSystemSignalRef=EVC_List08_HL_Style_ST3
            SQC_EVC_CfgList_01_08_Pr5_ST3_cb2c2130_Rx: ComBitPosition=16, ComBitSize=8, ComSignalInitValue=0, ComSignalType=UINT8, ComSystemTemplateSystemSignalRef=SQC_EVC_CfgList_01_08_Pr5_ST3
        Ign_Stat_Pr5_ST3_csgs1dv6drms80o1i9p49677w_7bdae87d_Rx: ComTimeout=1.05, ComTransferProperty=TRIGGERED_ON_CHANGE, ComSystemTemplateSignalGroupRef=Ign_Stat_Pr5_ST3_csgs1dv6drms80o1i9p49677w
          5 x ComGroupSignal, all with ComSignalEndianness=LITTLE_ENDIAN:
            CRC_Ign_Stat_Pr5_ST3_ef30f764_Rx: ComBitPosition=0, ComBitSize=16, ComSignalInitValue=20886, ComSignalType=UINT16, ComSystemTemplateSystemSignalRef=CRC_Ign_Stat_Pr5_ST3
            ISw_Stat_ST3_20c6e8e0_Rx: ComBitPosition=24, ComBitSize=3, ComSignalDataInvalidValue=7, ComSignalInitValue=7, ComSignalType=UINT8, ComSystemTemplateSystemSignalRef=ISw_Stat_ST3
            KG_StartSw_Psd_ST3_b1980089_Rx: ComBitPosition=31, ComBitSize=1, ComSignalInitValue=0, ComSignalType=BOOLEAN, ComSystemTemplateSystemSignalRef=KG_StartSw_Psd_ST3
            SQC_Ign_Stat_Pr5_ST3_aca0dae8_Rx: ComBitPosition=16, ComBitSize=8, ComSignalInitValue=0, ComSignalType=UINT8, ComSystemTemplateSystemSignalRef=SQC_Ign_Stat_Pr5_ST3
            Veh_Op_Mode_ST3_e0acb0c9_Rx: ComBitPosition=27, ComBitSize=4, ComSignalDataInvalidValue=15, ComSignalInitValue=0, ComSignalType=UINT8, ComSystemTemplateSystemSignalRef=Veh_Op_Mode_ST3
        Meas8_RBTM_FL_ST3_72jyquhuktrmjm0hkqempja37_23ddfefa_Tx: ComTransferProperty=TRIGGERED, ComSystemTemplateSignalGroupRef=Meas8_RBTM_FL_ST3_72jyquhuktrmjm0hkqempja37, variation-point=post-build-variant-condition{matching-criterion=Side, value=0}
          8 x ComGroupSignal, all with ComBitSize=8, ComSignalEndianness=LITTLE_ENDIAN, ComSignalInitValue=0, ComSignalType=UINT8:
            Meas_RBTM_FL_01_ST3_1999cf4b_Tx: ComBitPosition=0, ComSystemTemplateSystemSignalRef=Meas_RBTM_FL_01_ST3
            Meas_RBTM_FL_02_ST3_5e39b59b_Tx: ComBitPosition=8, ComSystemTemplateSystemSignalRef=Meas_RBTM_FL_02_ST3
            Meas_RBTM_FL_03_ST3_63599c2b_Tx: ComBitPosition=16, ComSystemTemplateSystemSignalRef=Meas_RBTM_FL_03_ST3
            Meas_RBTM_FL_04_ST3_d179403b_Tx: ComBitPosition=24, ComSystemTemplateSystemSignalRef=Meas_RBTM_FL_04_ST3
            Meas_RBTM_FL_05_ST3_ec19698b_Tx: ComBitPosition=32, ComSystemTemplateSystemSignalRef=Meas_RBTM_FL_05_ST3
            Meas_RBTM_FL_06_ST3_abb9135b_Tx: ComBitPosition=40, ComSystemTemplateSystemSignalRef=Meas_RBTM_FL_06_ST3
            Meas_RBTM_FL_07_ST3_96d93aeb_Tx: ComBitPosition=48, ComSystemTemplateSystemSignalRef=Meas_RBTM_FL_07_ST3
            Meas_RBTM_FL_08_ST3_1489ad3a_Tx: ComBitPosition=56, ComSystemTemplateSystemSignalRef=Meas_RBTM_FL_08_ST3
        ORC_Impact2_Pr5_ST3_b9l09rrslyv7vj3o92j69irnd_2f5ae8ac_Rx: ComTransferProperty=PENDING, ComSystemTemplateSignalGroupRef=ORC_Impact2_Pr5_ST3_b9l09rrslyv7vj3o92j69irnd
          8 x ComGroupSignal, all with ComSignalEndianness=LITTLE_ENDIAN:
            CRC_ORC_Impact2_Pr5_ST3_54ead0a9_Rx: ComBitPosition=0, ComBitSize=16, ComSignalInitValue=38142, ComSignalType=UINT16, ComSystemTemplateSystemSignalRef=CRC_ORC_Impact2_Pr5_ST3
            Impact_P_ST3_83cd5435_Rx: ComBitPosition=28, ComBitSize=1, ComSignalInitValue=0, ComSignalType=BOOLEAN, ComSystemTemplateSystemSignalRef=Impact_P_ST3
            Impact_R1_ST3_350dbb96_Rx: ComBitPosition=27, ComBitSize=1, ComSignalInitValue=0, ComSignalType=BOOLEAN, ComSystemTemplateSystemSignalRef=Impact_R1_ST3
            Impact_R2_ST3_72adc146_Rx: ComBitPosition=26, ComBitSize=1, ComSignalInitValue=0, ComSignalType=BOOLEAN, ComSystemTemplateSystemSignalRef=Impact_R2_ST3
            Impact_Y_ST3_8edd3644_Rx: ComBitPosition=24, ComBitSize=1, ComSignalInitValue=0, ComSignalType=BOOLEAN, ComSystemTemplateSystemSignalRef=Impact_Y_ST3
            Impact_minor_ST3_4534635b_Rx: ComBitPosition=25, ComBitSize=1, ComSignalInitValue=0, ComSignalType=BOOLEAN, ComSystemTemplateSystemSignalRef=Impact_minor_ST3
            SQC_ORC_Impact2_Pr5_ST3_6ce0fba5_Rx: ComBitPosition=16, ComBitSize=8, ComSignalInitValue=0, ComSignalType=UINT8, ComSystemTemplateSystemSignalRef=SQC_ORC_Impact2_Pr5_ST3
            VehPosn_ST3_ea170185_Rx: ComBitPosition=29, ComBitSize=3, ComSignalDataInvalidValue=7, ComSignalInitValue=0, ComSignalType=UINT8, ComSystemTemplateSystemSignalRef=VehPosn_ST3
        ORC_Impact3_Pr5_ST3_c4pqnkonfjwv3uiohsxhe9dwu_1bc89a3a_Rx: ComTransferProperty=PENDING, ComSystemTemplateSignalGroupRef=ORC_Impact3_Pr5_ST3_c4pqnkonfjwv3uiohsxhe9dwu
          10 x ComGroupSignal, all with ComSignalEndianness=LITTLE_ENDIAN:
            CRC_ORC_Impact3_Pr5_ST3_20961dce_Rx: ComBitPosition=0, ComBitSize=16, ComSignalInitValue=11251, ComSignalType=UINT16, ComSystemTemplateSystemSignalRef=CRC_ORC_Impact3_Pr5_ST3
            Impact_F1_ST3_7aa87b43_Rx: ComBitPosition=24, ComBitSize=1, ComSignalInitValue=0, ComSignalType=BOOLEAN, ComSystemTemplateSystemSignalRef=Impact_F1_ST3
            Impact_F2_ST3_3d080193_Rx: ComBitPosition=25, ComBitSize=1, ComSignalInitValue=0, ComSignalType=BOOLEAN, ComSystemTemplateSystemSignalRef=Impact_F2_ST3
            Impact_F3_ST3_00682823_Rx: ComBitPosition=26, ComBitSize=1, ComSignalInitValue=0, ComSignalType=BOOLEAN, ComSystemTemplateSystemSignalRef=Impact_F3_ST3
            Impact_RO_type1_ST3_6d14f528_Rx: ComBitPosition=29, ComBitSize=1, ComSignalInitValue=0, ComSignalType=BOOLEAN, ComSystemTemplateSystemSignalRef=Impact_RO_type1_ST3
            Impact_RO_type2_ST3_2ab48ff8_Rx: ComBitPosition=30, ComBitSize=1, ComSignalInitValue=0, ComSignalType=BOOLEAN, ComSystemTemplateSystemSignalRef=Impact_RO_type2_ST3
            Impact_S1_ST3_29b3e86b_Rx: ComBitPosition=27, ComBitSize=1, ComSignalInitValue=0, ComSignalType=BOOLEAN, ComSystemTemplateSystemSignalRef=Impact_S1_ST3
            Impact_S2_ST3_6e1392bb_Rx: ComBitPosition=28, ComBitSize=1, ComSignalInitValue=0, ComSignalType=BOOLEAN, ComSystemTemplateSystemSignalRef=Impact_S2_ST3
            Impact_X_ST3_5cefa915_Rx: ComBitPosition=31, ComBitSize=1, ComSignalInitValue=0, ComSignalType=BOOLEAN, ComSystemTemplateSystemSignalRef=Impact_X_ST3
            SQC_ORC_Impact3_Pr5_ST3_189c36c2_Rx: ComBitPosition=16, ComBitSize=8, ComSignalInitValue=0, ComSignalType=UINT8, ComSystemTemplateSystemSignalRef=SQC_ORC_Impact3_Pr5_ST3
        PT4_PTCoor4_Pr5_ST3_af4fxb1ykieox3itqdfzs0kpb_2277a854_Rx: ComTimeout=1.05, ComTransferProperty=TRIGGERED_ON_CHANGE, ComSystemTemplateSignalGroupRef=PT4_PTCoor4_Pr5_ST3_af4fxb1ykieox3itqdfzs0kpb
          6 x ComGroupSignal, all with ComSignalEndianness=LITTLE_ENDIAN:
            CRC_PT4_PTCoor4_Pr5_ST3_7d33cb58_Rx: ComBitPosition=0, ComBitSize=16, ComSignalInitValue=4203, ComSignalType=UINT16, ComSystemTemplateSystemSignalRef=CRC_PT4_PTCoor4_Pr5_ST3
            PT4_PTCoor_EngStartPN14_Stat_ST3_b3436bd4_Rx: ComBitPosition=28, ComBitSize=3, ComSignalDataInvalidValue=7, ComSignalInitValue=0, ComSignalType=UINT8, ComSystemTemplateSystemSignalRef=PT4_PTCoor_EngStartPN14_Stat_ST3
            PT4_PTCoor_PT_Rdy_ST3_3039cfe2_Rx: ComBitPosition=24, ComBitSize=2, ComSignalDataInvalidValue=3, ComSignalInitValue=0, ComSignalType=UINT8, ComSystemTemplateSystemSignalRef=PT4_PTCoor_PT_Rdy_ST3
            PT4_PTCoor_SSA_EngSp_ST3_b458926e_Rx: ComBitPosition=26, ComBitSize=2, ComSignalDataInvalidValue=3, ComSignalInitValue=3, ComSignalType=UINT8, ComSystemTemplateSystemSignalRef=PT4_PTCoor_SSA_EngSp_ST3
            Rsrv1_PT4_PTCoor_PT_Rdy_Pr5_ST3_e7f327eb_Rx: ComBitPosition=31, ComBitSize=1, ComSignalDataInvalidValue=1, ComSignalInitValue=1, ComSignalType=UINT8, ComSystemTemplateSystemSignalRef=Rsrv1_PT4_PTCoor_PT_Rdy_Pr5_ST3
            SQC_PT4_PTCoor4_Pr5_ST3_4539e054_Rx: ComBitPosition=16, ComBitSize=8, ComSignalInitValue=0, ComSignalType=UINT8, ComSystemTemplateSystemSignalRef=SQC_PT4_PTCoor4_Pr5_ST3
        PT4_PTCoor9_Pr5_ST3_6r95o81sst3tk9w2lzz600cw3_5dfe4b97_Rx: ComTimeout=5.1, ComTransferProperty=TRIGGERED_ON_CHANGE, ComUpdateBitPosition=7, ComSystemTemplateSignalGroupRef=PT4_PTCoor9_Pr5_ST3_6r95o81sst3tk9w2lzz600cw3
          PT4_PTCoor_Accel_Md_ST3_cd32fba3_Rx (ComGroupSignal):
            ComBitPosition = 0
            ComBitSize = 3
            ComSignalDataInvalidValue = 7
            ComSignalEndianness = LITTLE_ENDIAN
            ComSignalInitValue = 7
            ComSignalType = UINT8
            ComSystemTemplateSystemSignalRef = PT4_PTCoor_Accel_Md_ST3
        PT4_PTCoor_DrvPosn_Gear_Pr5_ST3_5p8cvrni3ypvuac33rj2asfy9_2f73a7b3_Rx: ComTransferProperty=TRIGGERED_ON_CHANGE, ComSystemTemplateSignalGroupRef=PT4_PTCoor_DrvPosn_Gear_Pr5_ST3_5p8cvrni3ypvuac33rj2asfy9
          15 x ComGroupSignal, all with ComSignalEndianness=LITTLE_ENDIAN:
            CRC_PT4_PTCoor_DrvPosn_Gear_Pr5_ST3_b671dc67_Rx: ComBitPosition=0, ComBitSize=16, ComSignalInitValue=47286, ComSignalType=UINT16, ComSystemTemplateSystemSignalRef=CRC_PT4_PTCoor_DrvPosn_Gear_Pr5_ST3
            PT4_PTCoor_DrvPosn_Disp_Rq_ST3_d775bf02_Rx: ComBitPosition=38, ComBitSize=8, ComSignalDataInvalidValue=255, ComSignalInitValue=255, ComSignalType=UINT8, ComSystemTemplateSystemSignalRef=PT4_PTCoor_DrvPosn_Disp_Rq_ST3
            PT4_PTCoor_DrvPosn_N_Actv_ST3_209a5852_Rx: ComBitPosition=28, ComBitSize=2, ComSignalDataInvalidValue=3, ComSignalInitValue=3, ComSignalType=UINT8, ComSystemTemplateSystemSignalRef=PT4_PTCoor_DrvPosn_N_Actv_ST3
            PT4_PTCoor_DrvPosn_Stat_ST3_af5d60f3_Rx: ComBitPosition=24, ComBitSize=4, ComSignalDataInvalidValue=15, ComSignalInitValue=15, ComSignalType=UINT8, ComSystemTemplateSystemSignalRef=PT4_PTCoor_DrvPosn_Stat_ST3
            PT4_PTCoor_DrvPosn_Target_ST3_bba2a0e0_Rx: ComBitPosition=48, ComBitSize=4, ComSignalDataInvalidValue=15, ComSignalInitValue=15, ComSignalType=UINT8, ComSystemTemplateSystemSignalRef=PT4_PTCoor_DrvPosn_Target_ST3
            PT4_PTCoor_Gr_ST3_dd0b905e_Rx: ComBitPosition=30, ComBitSize=4, ComSignalDataInvalidValue=15, ComSignalInitValue=15, ComSignalType=UINT8, ComSystemTemplateSystemSignalRef=PT4_PTCoor_Gr_ST3
            PT4_PTCoor_Gr_Target_ST3_b5aa8bc3_Rx: ComBitPosition=34, ComBitSize=4, ComSignalDataInvalidValue=15, ComSignalInitValue=15, ComSignalType=UINT8, ComSystemTemplateSystemSignalRef=PT4_PTCoor_Gr_Target_ST3
            PT4_PTCoor_SSA_Standby_Stat_ST3_3cbc753b_Rx: ComBitPosition=56, ComBitSize=2, ComSignalDataInvalidValue=3, ComSignalInitValue=0, ComSignalType=UINT8, ComSystemTemplateSystemSignalRef=PT4_PTCoor_SSA_Standby_Stat_ST3
            PT4_PTCoor_ShW_MnTrctAxl_D_Allowed_ST3_f3898bec_Rx: ComBitPosition=46, ComBitSize=2, ComSignalDataInvalidValue=3, ComSignalInitValue=3, ComSignalType=UINT8, ComSystemTemplateSystemSignalRef=PT4_PTCoor_ShW_MnTrctAxl_D_Allowed_ST3
            PT4_PTCoor_ShW_MnTrctAxl_N_Allowed_ST3_c9d6edca_Rx: ComBitPosition=52, ComBitSize=2, ComSignalDataInvalidValue=3, ComSignalInitValue=3, ComSignalType=UINT8, ComSystemTemplateSystemSignalRef=PT4_PTCoor_ShW_MnTrctAxl_N_Allowed_ST3
            PT4_PTCoor_ShW_MnTrctAxl_P_Allow_Drv_ST3_901488c0_Rx: ComBitPosition=60, ComBitSize=2, ComSignalDataInvalidValue=3, ComSignalInitValue=3, ComSignalType=UINT8, ComSystemTemplateSystemSignalRef=PT4_PTCoor_ShW_MnTrctAxl_P_Allow_Drv_ST3
            PT4_PTCoor_ShW_MnTrctAxl_P_Allowed_ST3_873747a0_Rx: ComBitPosition=54, ComBitSize=2, ComSignalDataInvalidValue=3, ComSignalInitValue=3, ComSignalType=UINT8, ComSystemTemplateSystemSignalRef=PT4_PTCoor_ShW_MnTrctAxl_P_Allowed_ST3
            PT4_PTCoor_ShW_MnTrctAxl_R_Allowed_ST3_e76bf2eb_Rx: ComBitPosition=58, ComBitSize=2, ComSignalDataInvalidValue=3, ComSignalInitValue=3, ComSignalType=UINT8, ComSystemTemplateSystemSignalRef=PT4_PTCoor_ShW_MnTrctAxl_R_Allowed_ST3
            Rsrv1_PT4_PTCoor_DrvPosn_Gear_Pr5_ST3_83426982_Rx: ComBitPosition=62, ComBitSize=2, ComSignalDataInvalidValue=3, ComSignalInitValue=3, ComSignalType=UINT8, ComSystemTemplateSystemSignalRef=Rsrv1_PT4_PTCoor_DrvPosn_Gear_Pr5_ST3
            SQC_PT4_PTCoor_DrvPosn_Gear_Pr5_ST3_940d6b76_Rx: ComBitPosition=16, ComBitSize=8, ComSignalInitValue=0, ComSignalType=UINT8, ComSystemTemplateSystemSignalRef=SQC_PT4_PTCoor_DrvPosn_Gear_Pr5_ST3
        PresfAct_Adj_Pr5_ST3_2joar1a41xrgjqab60epnbplm_25141edc_Rx: ComTimeout=2.1, ComTransferProperty=PENDING, ComSystemTemplateSignalGroupRef=PresfAct_Adj_Pr5_ST3_2joar1a41xrgjqab60epnbplm
          11 x ComGroupSignal, all with ComSignalEndianness=LITTLE_ENDIAN:
            CRC_PresfAct_Adj_Pr5_ST3_901db976_Rx: ComBitPosition=0, ComBitSize=16, ComSignalInitValue=56639, ComSignalType=UINT16, ComSystemTemplateSystemSignalRef=CRC_PresfAct_Adj_Pr5_ST3
            PresfAccelReset_NotExcd_ST3_c7c4d546_Rx: ComBitPosition=24, ComBitSize=2, ComSignalDataInvalidValue=3, ComSignalInitValue=2, ComSignalType=UINT8, ComSystemTemplateSystemSignalRef=PresfAccelReset_NotExcd_ST3
            PresfAct_Adj_Rq_ST3_e5b37ffb_Rx: ComBitPosition=32, ComBitSize=13, ComSignalInitValue=0, ComSignalType=UINT32, ComSystemTemplateSystemSignalRef=PresfAct_Adj_Rq_ST3
            PresfAct_TensSupp_Rq_ST3_62b93d7a_Rx: ComBitPosition=49, ComBitSize=3, ComSignalDataInvalidValue=7, ComSignalInitValue=7, ComSignalType=UINT8, ComSystemTemplateSystemSignalRef=PresfAct_TensSupp_Rq_ST3
            Presf_Enbl_ST3_40bed323_Rx: ComBitPosition=45, ComBitSize=2, ComSignalDataInvalidValue=3, ComSignalInitValue=3, ComSignalType=UINT8, ComSystemTemplateSystemSignalRef=Presf_Enbl_ST3
            Presf_FricCoeff_Estim_ST3_b142a105_Rx: ComBitPosition=52, ComBitSize=4, ComSignalDataInvalidValue=15, ComSignalInitValue=15, ComSignalType=UINT8, ComSystemTemplateSystemSignalRef=Presf_FricCoeff_Estim_ST3
            Presf_Fric_Fctr_Lo_ST3_9b2a29ac_Rx: ComBitPosition=47, ComBitSize=2, ComSignalDataInvalidValue=3, ComSignalInitValue=3, ComSignalType=UINT8, ComSystemTemplateSystemSignalRef=Presf_Fric_Fctr_Lo_ST3
            Presf_Lvl_ST3_dc8c82ac_Rx: ComBitPosition=28, ComBitSize=4, ComSignalDataInvalidValue=15, ComSignalInitValue=0, ComSignalType=UINT8, ComSystemTemplateSystemSignalRef=Presf_Lvl_ST3
            Presf_Snd_Rq_ST3_6cb03b74_Rx: ComBitPosition=26, ComBitSize=2, ComSignalDataInvalidValue=3, ComSignalInitValue=0, ComSignalType=UINT8, ComSystemTemplateSystemSignalRef=Presf_Snd_Rq_ST3
            Rsrv6_Presf_Adj_ST3_f21bcfa6_Rx: ComBitPosition=56, ComBitSize=8, ComSignalDataInvalidValue=255, ComSignalInitValue=255, ComSignalType=UINT8, ComSystemTemplateSystemSignalRef=Rsrv6_Presf_Adj_ST3
            SQC_PresfAct_Adj_Pr5_ST3_9993ff76_Rx: ComBitPosition=16, ComBitSize=8, ComSignalInitValue=0, ComSignalType=UINT8, ComSystemTemplateSystemSignalRef=SQC_PresfAct_Adj_Pr5_ST3
        ROE_RBTM_FL_ST3_6e0rxnifai2txra0wamb18g4m_4feaeebf_Tx: ComTransferProperty=TRIGGERED, ComSystemTemplateSignalGroupRef=ROE_RBTM_FL_ST3_6e0rxnifai2txra0wamb18g4m, variation-point=post-build-variant-condition{matching-criterion=Side, value=0}
          8 x ComGroupSignal, all with ComBitSize=8, ComSignalEndianness=LITTLE_ENDIAN, ComSignalInitValue=0, ComSignalType=UINT8:
            ROE_0_RBTM_FL_ST3_7255ce21_Tx: ComBitPosition=0, ComSystemTemplateSystemSignalRef=ROE_0_RBTM_FL_ST3
            ROE_1_RBTM_FL_ST3_afc317a4_Tx: ComBitPosition=8, ComSystemTemplateSystemSignalRef=ROE_1_RBTM_FL_ST3
            ROE_2_RBTM_FL_ST3_12097b6a_Tx: ComBitPosition=16, ComSystemTemplateSystemSignalRef=ROE_2_RBTM_FL_ST3
            ROE_3_RBTM_FL_ST3_cf9fa2ef_Tx: ComBitPosition=24, ComSystemTemplateSystemSignalRef=ROE_3_RBTM_FL_ST3
            ROE_4_RBTM_FL_ST3_b2eca4b7_Tx: ComBitPosition=32, ComSystemTemplateSystemSignalRef=ROE_4_RBTM_FL_ST3
            ROE_5_RBTM_FL_ST3_6f7a7d32_Tx: ComBitPosition=40, ComSystemTemplateSystemSignalRef=ROE_5_RBTM_FL_ST3
            ROE_6_RBTM_FL_ST3_d2b011fc_Tx: ComBitPosition=48, ComSystemTemplateSystemSignalRef=ROE_6_RBTM_FL_ST3
            ROE_7_RBTM_FL_ST3_0f26c879_Tx: ComBitPosition=56, ComSystemTemplateSystemSignalRef=ROE_7_RBTM_FL_ST3
        SBeltTens_SP_Lvl_Pr5_ST3_4tqpkri37441o5ht9g9ekmyzh_4719328f_Rx: ComTimeout=2, ComTransferProperty=TRIGGERED_ON_CHANGE, ComSystemTemplateSignalGroupRef=SBeltTens_SP_Lvl_Pr5_ST3_4tqpkri37441o5ht9g9ekmyzh
          5 x ComGroupSignal, all with ComSignalEndianness=LITTLE_ENDIAN:
            CRC_SBeltTens_SP_Lvl_Pr5_ST3_ef88391d_Rx: ComBitPosition=0, ComBitSize=16, ComSignalInitValue=10339, ComSignalType=UINT16, ComSystemTemplateSystemSignalRef=CRC_SBeltTens_SP_Lvl_Pr5_ST3
            RBTMFL_SP_Lvl_Rq_ST35_1b9e7376_Rx: ComBitPosition=24, ComBitSize=6, ComSignalDataInvalidValue=63, ComSignalInitValue=0, ComSignalType=UINT8, ComSystemTemplateSystemSignalRef=RBTMFL_SP_Lvl_Rq_ST35
            RBTMFR_SP_Lvl_Rq_ST35_dd3bbb43_Rx: ComBitPosition=30, ComBitSize=6, ComSignalDataInvalidValue=63, ComSignalInitValue=0, ComSignalType=UINT8, ComSystemTemplateSystemSignalRef=RBTMFR_SP_Lvl_Rq_ST35
            Rsrv0_SBeltTens_SP_Lvl_Pr5_ST3_aa2f8d25_Rx: ComBitPosition=36, ComBitSize=4, ComSignalDataInvalidValue=15, ComSignalInitValue=15, ComSignalType=UINT8, ComSystemTemplateSystemSignalRef=Rsrv0_SBeltTens_SP_Lvl_Pr5_ST3
            SQC_SBeltTens_SP_Lvl_Pr5_ST3_4743c50e_Rx: ComBitPosition=16, ComBitSize=8, ComSignalInitValue=0, ComSignalType=UINT8, ComSystemTemplateSystemSignalRef=SQC_SBeltTens_SP_Lvl_Pr5_ST3
        VSS_TP_Auth_ST3_6j4id7sghlvlbroli4wjozjik_2ac87786_Rx: ComTransferProperty=TRIGGERED, ComSystemTemplateSignalGroupRef=VSS_TP_Auth_ST3_6j4id7sghlvlbroli4wjozjik
          8 x ComGroupSignal, all with ComBitSize=8, ComSignalEndianness=LITTLE_ENDIAN, ComSignalInitValue=255, ComSignalType=UINT8:
            VSS_TP_Auth_0_ST3_8d2bd1cf_Rx: ComBitPosition=0, ComSystemTemplateSystemSignalRef=VSS_TP_Auth_0_ST3
            VSS_TP_Auth_1_ST3_b04bf87f_Rx: ComBitPosition=8, ComSystemTemplateSystemSignalRef=VSS_TP_Auth_1_ST3
            VSS_TP_Auth_2_ST3_f7eb82af_Rx: ComBitPosition=16, ComSystemTemplateSystemSignalRef=VSS_TP_Auth_2_ST3
            VSS_TP_Auth_3_ST3_ca8bab1f_Rx: ComBitPosition=24, ComSystemTemplateSystemSignalRef=VSS_TP_Auth_3_ST3
            VSS_TP_Auth_4_ST3_78ab770f_Rx: ComBitPosition=32, ComSystemTemplateSystemSignalRef=VSS_TP_Auth_4_ST3
            VSS_TP_Auth_5_ST3_45cb5ebf_Rx: ComBitPosition=40, ComSystemTemplateSystemSignalRef=VSS_TP_Auth_5_ST3
            VSS_TP_Auth_6_ST3_026b246f_Rx: ComBitPosition=48, ComSystemTemplateSystemSignalRef=VSS_TP_Auth_6_ST3
            VSS_TP_Auth_7_ST3_3f0b0ddf_Rx: ComBitPosition=56, ComSystemTemplateSystemSignalRef=VSS_TP_Auth_7_ST3
        VSS_TP_RealTmOffset_ST3_1t7vc44gftc0wv35k5kgc2in9_d3385ce4_Rx: ComTransferProperty=TRIGGERED, ComSystemTemplateSignalGroupRef=VSS_TP_RealTmOffset_ST3_1t7vc44gftc0wv35k5kgc2in9
          8 x ComGroupSignal, all with ComBitSize=8, ComSignalEndianness=LITTLE_ENDIAN, ComSignalInitValue=255, ComSignalType=UINT8:
            VSS_TP_RealTmOffset_0_ST3_a2539a58_Rx: ComBitPosition=0, ComSystemTemplateSystemSignalRef=VSS_TP_RealTmOffset_0_ST3
            VSS_TP_RealTmOffset_1_ST3_9f33b3e8_Rx: ComBitPosition=8, ComSystemTemplateSystemSignalRef=VSS_TP_RealTmOffset_1_ST3
            VSS_TP_RealTmOffset_2_ST3_d893c938_Rx: ComBitPosition=16, ComSystemTemplateSystemSignalRef=VSS_TP_RealTmOffset_2_ST3
            VSS_TP_RealTmOffset_3_ST3_e5f3e088_Rx: ComBitPosition=24, ComSystemTemplateSystemSignalRef=VSS_TP_RealTmOffset_3_ST3
            VSS_TP_RealTmOffset_4_ST3_57d33c98_Rx: ComBitPosition=32, ComSystemTemplateSystemSignalRef=VSS_TP_RealTmOffset_4_ST3
            VSS_TP_RealTmOffset_5_ST3_6ab31528_Rx: ComBitPosition=40, ComSystemTemplateSystemSignalRef=VSS_TP_RealTmOffset_5_ST3
            VSS_TP_RealTmOffset_6_ST3_2d136ff8_Rx: ComBitPosition=48, ComSystemTemplateSystemSignalRef=VSS_TP_RealTmOffset_6_ST3
            VSS_TP_RealTmOffset_7_ST3_10734648_Rx: ComBitPosition=56, ComSystemTemplateSystemSignalRef=VSS_TP_RealTmOffset_7_ST3
        VSS_TP_SecTickCount_Lvl2_ST3_9eubq13iosat764o0lqh5xb6r_01efe31e_Rx: ComTransferProperty=TRIGGERED, ComSystemTemplateSignalGroupRef=VSS_TP_SecTickCount_Lvl2_ST3_9eubq13iosat764o0lqh5xb6r
          8 x ComGroupSignal, all with ComBitSize=8, ComSignalEndianness=LITTLE_ENDIAN, ComSignalInitValue=255, ComSignalType=UINT8:
            VSS_TP_SecTickCount_Lvl2_0_ST3_dac5ba08_Rx: ComBitPosition=0, ComSystemTemplateSystemSignalRef=VSS_TP_SecTickCount_Lvl2_0_ST3
            VSS_TP_SecTickCount_Lvl2_1_ST3_e7a593b8_Rx: ComBitPosition=8, ComSystemTemplateSystemSignalRef=VSS_TP_SecTickCount_Lvl2_1_ST3
            VSS_TP_SecTickCount_Lvl2_2_ST3_a005e968_Rx: ComBitPosition=16, ComSystemTemplateSystemSignalRef=VSS_TP_SecTickCount_Lvl2_2_ST3
            VSS_TP_SecTickCount_Lvl2_3_ST3_9d65c0d8_Rx: ComBitPosition=24, ComSystemTemplateSystemSignalRef=VSS_TP_SecTickCount_Lvl2_3_ST3
            VSS_TP_SecTickCount_Lvl2_4_ST3_2f451cc8_Rx: ComBitPosition=32, ComSystemTemplateSystemSignalRef=VSS_TP_SecTickCount_Lvl2_4_ST3
            VSS_TP_SecTickCount_Lvl2_5_ST3_12253578_Rx: ComBitPosition=40, ComSystemTemplateSystemSignalRef=VSS_TP_SecTickCount_Lvl2_5_ST3
            VSS_TP_SecTickCount_Lvl2_6_ST3_55854fa8_Rx: ComBitPosition=48, ComSystemTemplateSystemSignalRef=VSS_TP_SecTickCount_Lvl2_6_ST3
            VSS_TP_SecTickCount_Lvl2_7_ST3_68e56618_Rx: ComBitPosition=56, ComSystemTemplateSystemSignalRef=VSS_TP_SecTickCount_Lvl2_7_ST3
        VSS_TP_SharedSecret_ST3_8pj4t8t4rm3tw3pk5hj7vonti_d9a21e4b_Rx: ComTransferProperty=TRIGGERED, ComSystemTemplateSignalGroupRef=VSS_TP_SharedSecret_ST3_8pj4t8t4rm3tw3pk5hj7vonti
          8 x ComGroupSignal, all with ComBitSize=8, ComSignalEndianness=LITTLE_ENDIAN, ComSignalInitValue=255, ComSignalType=UINT8:
            VSS_TP_SharedSecret_0_ST3_74e3db3b_Rx: ComBitPosition=0, ComSystemTemplateSystemSignalRef=VSS_TP_SharedSecret_0_ST3
            VSS_TP_SharedSecret_1_ST3_4983f28b_Rx: ComBitPosition=8, ComSystemTemplateSystemSignalRef=VSS_TP_SharedSecret_1_ST3
            VSS_TP_SharedSecret_2_ST3_0e23885b_Rx: ComBitPosition=16, ComSystemTemplateSystemSignalRef=VSS_TP_SharedSecret_2_ST3
            VSS_TP_SharedSecret_3_ST3_3343a1eb_Rx: ComBitPosition=24, ComSystemTemplateSystemSignalRef=VSS_TP_SharedSecret_3_ST3
            VSS_TP_SharedSecret_4_ST3_81637dfb_Rx: ComBitPosition=32, ComSystemTemplateSystemSignalRef=VSS_TP_SharedSecret_4_ST3
            VSS_TP_SharedSecret_5_ST3_bc03544b_Rx: ComBitPosition=40, ComSystemTemplateSystemSignalRef=VSS_TP_SharedSecret_5_ST3
            VSS_TP_SharedSecret_6_ST3_fba32e9b_Rx: ComBitPosition=48, ComSystemTemplateSystemSignalRef=VSS_TP_SharedSecret_6_ST3
            VSS_TP_SharedSecret_7_ST3_c6c3072b_Rx: ComBitPosition=56, ComSystemTemplateSystemSignalRef=VSS_TP_SharedSecret_7_ST3
        VSS_TP_VIN_ST3_bz1xsv84cxzl09j028gn39p69_f31ab3e3_Rx: ComTransferProperty=TRIGGERED, ComSystemTemplateSignalGroupRef=VSS_TP_VIN_ST3_bz1xsv84cxzl09j028gn39p69
          8 x ComGroupSignal, all with ComBitSize=8, ComSignalEndianness=LITTLE_ENDIAN, ComSignalInitValue=63, ComSignalType=UINT8:
            VSS_TP_VIN_0_ST3_fc3604d4_Rx: ComBitPosition=0, ComSystemTemplateSystemSignalRef=VSS_TP_VIN_0_ST3
            VSS_TP_VIN_1_ST3_c1562d64_Rx: ComBitPosition=8, ComSystemTemplateSystemSignalRef=VSS_TP_VIN_1_ST3
            VSS_TP_VIN_2_ST3_86f657b4_Rx: ComBitPosition=16, ComSystemTemplateSystemSignalRef=VSS_TP_VIN_2_ST3
            VSS_TP_VIN_3_ST3_bb967e04_Rx: ComBitPosition=24, ComSystemTemplateSystemSignalRef=VSS_TP_VIN_3_ST3
            VSS_TP_VIN_4_ST3_09b6a214_Rx: ComBitPosition=32, ComSystemTemplateSystemSignalRef=VSS_TP_VIN_4_ST3
            VSS_TP_VIN_5_ST3_34d68ba4_Rx: ComBitPosition=40, ComSystemTemplateSystemSignalRef=VSS_TP_VIN_5_ST3
            VSS_TP_VIN_6_ST3_7376f174_Rx: ComBitPosition=48, ComSystemTemplateSystemSignalRef=VSS_TP_VIN_6_ST3
            VSS_TP_VIN_7_ST3_4e16d8c4_Rx: ComBitPosition=56, ComSystemTemplateSystemSignalRef=VSS_TP_VIN_7_ST3
      ComTimeBase: ComGwTimeBase=0.005, ComRxTimeBase=0.005, ComTxTimeBase=0.005
      12 x ComIPdu, all with ComIPduType=NORMAL, variation-point=post-build-variant-condition{matching-criterion=Side, value=1}:
        BeltAdj_FL_Stat_ST3_d2ce0dbb_Rx: ComIPduDirection=RECEIVE, ComIPduGroupRef=RBTM_FR_BODY3_Rx_PNC_20_02b0f03d, ComIPduGroupRef=RBTM_FR_BODY3_Rx_PNC_All_Active_592f1bcd, ComIPduSignalRef=RevBltTns_FL_ComCyc_Actv_ST3_4c5f745f_Rx, ComPduIdRef=EcucPduCollection/BeltAdj_FL_Stat_ST3_d2ce0dbb_Rx
        BeltAdj_FR_Stat_ST3_eba9bce0_Tx: ComIPduDirection=SEND, ComIPduGroupRef=RBTM_FR_BODY3_Tx_PNC_20_71aa89b7, ComIPduGroupRef=RBTM_FR_BODY3_Tx_PNC_All_Active_fe1bacc5, ComIPduSignalRef=BltSlckDec_Md_FR_Stat_ST3_8538ecdf_Tx, ComIPduSignalRef=RevBltTns_FR_ComCyc_Actv_ST3_4c00d29e_Tx, ComPduIdRef=EcucPduCollection/BeltAdj_FR_Stat_ST3_eba9bce0_Tx
          ComTxIPdu: ComMinimumDelayTime=0.04, ComTxIPduUnusedAreasDefault=255
            ComTxModeTrue
              ComTxMode: ComTxModeMode=MIXED, ComTxModeNumberOfRepetitions=0, ComTxModeTimeOffset=0.02, ComTxModeTimePeriod=1
        BeltHdOvr_FR_State_ST3_c8a18c7a_Rx: ComIPduDirection=RECEIVE, ComIPduGroupRef=RBTM_FR_BODY3_Rx_PNC_20_02b0f03d, ComIPduGroupRef=RBTM_FR_BODY3_Rx_PNC_All_Active_592f1bcd, ComIPduSignalRef=BeltHdOvr_FR_Stat_ST3_0eefd507_Rx, ComPduIdRef=EcucPduCollection/BeltHdOvr_FR_State_ST3_c8a18c7a_Rx
        Develop8_Rq_RBTM_FR_ST3_25b7d179_Rx: ComIPduDirection=RECEIVE, ComIPduGroupRef=RBTM_FR_BODY3_Rx_PNC_20_02b0f03d, ComIPduGroupRef=RBTM_FR_BODY3_Rx_PNC_All_Active_592f1bcd, ComIPduSignalGroupRef=Develop8_Rq_RBTM_FR_ST3_bcqj2sqez8u9spf5qxmu4a35u_86f26259_Rx, ComPduIdRef=EcucPduCollection/Develop8_Rq_RBTM_FR_ST3_25b7d179_Rx
        Develop8_Rs_RBTM_FR_ST3_45eb6432_Tx: ComIPduDirection=SEND, ComIPduGroupRef=TxMess_RBTM_FR_BODY3_dfe5c3c9, ComIPduSignalGroupRef=Develop8_Rs_RBTM_FR_ST3_5t18pq0a13t698v0vsj7yvmmm_aab2c7df_Tx, ComPduIdRef=EcucPduCollection/Develop8_Rs_RBTM_FR_ST3_45eb6432_Tx
          ComTxIPdu: ComMinimumDelayTime=0.02, ComTxIPduUnusedAreasDefault=0
            ComTxModeTrue
              ComTxMode: ComTxModeMode=DIRECT, ComTxModeNumberOfRepetitions=0
        ECU_Stat_RBTM_FR_ST3_28d39f08_Tx: ComIPduDirection=SEND, ComIPduGroupRef=RBTM_FR_BODY3_Tx_PNC_20_71aa89b7, ComIPduGroupRef=RBTM_FR_BODY3_Tx_PNC_All_Active_fe1bacc5, ComIPduSignalRef=Awake_Diag_Actv_RBTM_FR_ST3_822fa87a_Tx, ComIPduSignalRef=Awake_Ignition_On_RBTM_FR_ST3_df6a9d63_Tx, ComIPduSignalRef=Awake_NwStart_RBTM_FR_ST3_59fd792e_Tx, ComIPduSignalRef=ECU_Id_RBTM_FR_ST3_765534d2_Tx, ComIPduSignalRef=WakeupRsn_RBTM_FR_ST3_6ec4195b_Tx, ComPduIdRef=EcucPduCollection/ECU_Stat_RBTM_FR_ST3_28d39f08_Tx
          ComTxIPdu: ComTxIPduUnusedAreasDefault=0
            ComTxModeTrue
              ComTxMode: ComTxModeMode=PERIODIC, ComTxModeTimeOffset=0, ComTxModeTimePeriod=1
        Meas8_RBTM_FR_ST3_76ff3d39_Tx: ComIPduDirection=SEND, ComIPduGroupRef=TxMess_RBTM_FR_BODY3_dfe5c3c9, ComIPduSignalGroupRef=Meas8_RBTM_FR_ST3_7ba3lhjy9fnhufd3n9dyw0p9p_19ed5f9c_Tx, ComPduIdRef=EcucPduCollection/Meas8_RBTM_FR_ST3_76ff3d39_Tx
          ComTxIPdu: ComMinimumDelayTime=0.02, ComTxIPduUnusedAreasDefault=0
            ComTxModeTrue
              ComTxMode: ComTxModeMode=DIRECT, ComTxModeNumberOfRepetitions=0
        NM_RBTM_FR_ST3_d30f04ec_Tx: ComIPduDirection=SEND, ComIPduSignalRef=NM_RBTM_FR_ST3_PNC_0103a546_Tx, ComPduIdRef=EcucPduCollection/NM_RBTM_FR_ST3_d30f04ec_Tx
          ComTxIPdu: ComTxIPduUnusedAreasDefault=0  # NM_RBTM_FR_ST3
        RBTM_FL_Stat_ST3_dd2436a1_Rx: ComIPduDirection=RECEIVE, ComIPduGroupRef=RBTM_FR_BODY3_Rx_PNC_20_02b0f03d, ComIPduGroupRef=RBTM_FR_BODY3_Rx_PNC_All_Active_592f1bcd, ComIPduSignalRef=RevBltTns_FL_SafeCyc_Actv_ST3_b0efc754_Rx, ComPduIdRef=EcucPduCollection/RBTM_FL_Stat_ST3_dd2436a1_Rx
        RBTM_FR_Stat_ST3_e44387fa_Tx: ComIPduDirection=SEND, ComIPduGroupRef=RBTM_FR_BODY3_Tx_PNC_20_71aa89b7, ComIPduGroupRef=RBTM_FR_BODY3_Tx_PNC_All_Active_fe1bacc5, ComIPduSignalRef=PS_Curve_FR_Stat_ST3_36a2193c_Tx, ComIPduSignalRef=RBTM_FR_Disp_Rq_ST3_4c4b9655_Tx, ComIPduSignalRef=RBTM_FR_Tgl_ST3_bb42027b_Tx, ComIPduSignalRef=RevBltTns_FR_SafeCyc_Actv_ST3_5c8c6ad4_Tx, ComPduIdRef=EcucPduCollection/RBTM_FR_Stat_ST3_e44387fa_Tx
          ComTxIPdu: ComMinimumDelayTime=0.04, ComTxIPduUnusedAreasDefault=255
            ComTxModeTrue
              ComTxMode: ComTxModeMode=MIXED, ComTxModeNumberOfRepetitions=0, ComTxModeTimeOffset=0.01, ComTxModeTimePeriod=1
        RBTM_FR_Tens_ST3_6c59775c_Tx: ComIPduDirection=SEND, ComIPduGroupRef=RBTM_FR_BODY3_Tx_PNC_20_71aa89b7, ComIPduGroupRef=RBTM_FR_BODY3_Tx_PNC_All_Active_fe1bacc5, ComIPduSignalRef=RBTMFR_Actv_Lvl_ST35_77991ccb_Tx, ComIPduSignalRef=RBTMFR_SP_ActvClient_ST35_1fd8ade4_Tx, ComIPduSignalRef=RBTMFR_SP_FctPrecond_Stat_ST35_ce5639ee_Tx, ComPduIdRef=EcucPduCollection/RBTM_FR_Tens_ST3_6c59775c_Tx
          ComTxIPdu: ComMinimumDelayTime=0.02, ComTxIPduUnusedAreasDefault=255
            ComTxModeTrue
              ComTxMode: ComTxModeMode=MIXED, ComTxModeNumberOfRepetitions=0, ComTxModeTimeOffset=0.005, ComTxModeTimePeriod=0.5
        ROE_RBTM_FR_ST3_79bce2bc_Tx: ComIPduDirection=SEND, ComIPduGroupRef=RBTM_FR_BODY3_Tx_PNC_20_71aa89b7, ComIPduGroupRef=RBTM_FR_BODY3_Tx_PNC_All_Active_fe1bacc5, ComIPduSignalGroupRef=ROE_RBTM_FR_ST3_3f1btonh6ivdn6ytgyuu9rtt1_5c720902_Tx, ComPduIdRef=EcucPduCollection/ROE_RBTM_FR_ST3_79bce2bc_Tx
          ComTxIPdu: ComMinimumDelayTime=0.2, ComTxIPduUnusedAreasDefault=0
            ComTxModeTrue
              ComTxMode: ComTxModeMode=DIRECT, ComTxModeNumberOfRepetitions=0
      5 x ComIPduGroup, all with variation-point=post-build-variant-condition{matching-criterion=Side, value=1}:
        RBTM_FR_BODY3_Rx_PNC_20_02b0f03d
        RBTM_FR_BODY3_Rx_PNC_All_Active_592f1bcd
        RBTM_FR_BODY3_Tx_PNC_20_71aa89b7
        RBTM_FR_BODY3_Tx_PNC_All_Active_fe1bacc5
        TxMess_RBTM_FR_BODY3_dfe5c3c9
      19 x ComSignal, all with variation-point=post-build-variant-condition{matching-criterion=Side, value=1}:
        Awake_Diag_Actv_RBTM_FR_ST3_822fa87a_Tx: ComBitPosition=30, ComBitSize=1, ComSignalEndianness=LITTLE_ENDIAN, ComSignalInitValue=0, ComSignalType=BOOLEAN, ComTransferProperty=PENDING, ComSystemTemplateSystemSignalRef=Awake_Diag_Actv_RBTM_FR_ST3
        Awake_Ignition_On_RBTM_FR_ST3_df6a9d63_Tx: ComBitPosition=32, ComBitSize=1, ComSignalEndianness=LITTLE_ENDIAN, ComSignalInitValue=0, ComSignalType=BOOLEAN, ComTransferProperty=PENDING, ComSystemTemplateSystemSignalRef=Awake_Ignition_On_RBTM_FR_ST3
        Awake_NwStart_RBTM_FR_ST3_59fd792e_Tx: ComBitPosition=31, ComBitSize=1, ComSignalEndianness=LITTLE_ENDIAN, ComSignalInitValue=0, ComSignalType=BOOLEAN, ComTransferProperty=PENDING, ComSystemTemplateSystemSignalRef=Awake_NwStart_RBTM_FR_ST3
        BeltHdOvr_FR_Stat_ST3_0eefd507_Rx: ComBitPosition=0, ComBitSize=2, ComSignalDataInvalidValue=3, ComSignalEndianness=LITTLE_ENDIAN, ComSignalInitValue=3, ComSignalType=UINT8, ComTimeout=5.25, ComSystemTemplateSystemSignalRef=BeltHdOvr_FR_Stat_ST3
        BltSlckDec_Md_FR_Stat_ST3_8538ecdf_Tx: ComBitPosition=0, ComBitSize=2, ComSignalDataInvalidValue=3, ComSignalEndianness=LITTLE_ENDIAN, ComSignalInitValue=3, ComSignalType=UINT8, ComTransferProperty=TRIGGERED_ON_CHANGE, ComSystemTemplateSystemSignalRef=BltSlckDec_Md_FR_Stat_ST3
        ECU_Id_RBTM_FR_ST3_765534d2_Tx: ComBitPosition=0, ComBitSize=12, ComSignalDataInvalidValue=4095, ComSignalEndianness=LITTLE_ENDIAN, ComSignalInitValue=421, ComSignalType=UINT16, ComTransferProperty=PENDING, ComSystemTemplateSystemSignalRef=ECU_Id_RBTM_FR_ST3
        NM_RBTM_FR_ST3_PNC_0103a546_Tx: ComBitPosition=0, ComSignalEndianness=opaque, ComSignalInitValue=0 0 0 0 0 0 0, ComSignalLength=7, ComSignalType=UINT8_N, ComTransferProperty=PENDING, ComSystemTemplateSystemSignalRef=NM_RBTM_FR_ST3_PNC
        PS_Curve_FR_Rq_HU_ST3_90527677_Rx: ComBitPosition=4, ComBitSize=2, ComSignalDataInvalidValue=3, ComSignalEndianness=LITTLE_ENDIAN, ComSignalInitValue=3, ComSignalType=UINT8, ComTimeout=10.1, ComSystemTemplateSystemSignalRef=PS_Curve_FR_Rq_HU_ST3
        PS_Curve_FR_Stat_ST3_36a2193c_Tx: ComBitPosition=2, ComBitSize=2, ComSignalDataInvalidValue=3, ComSignalEndianness=LITTLE_ENDIAN, ComSignalInitValue=3, ComSignalType=UINT8, ComTransferProperty=TRIGGERED_ON_CHANGE, ComSystemTemplateSystemSignalRef=PS_Curve_FR_Stat_ST3
        RBTMFR_Actv_Lvl_ST35_77991ccb_Tx: ComBitPosition=10, ComBitSize=6, ComSignalDataInvalidValue=63, ComSignalEndianness=LITTLE_ENDIAN, ComSignalInitValue=0, ComSignalType=UINT8, ComTransferProperty=TRIGGERED_ON_CHANGE, ComSystemTemplateSystemSignalRef=RBTMFR_Actv_Lvl_ST35
        RBTMFR_SP_ActvClient_ST35_1fd8ade4_Tx: ComBitPosition=16, ComBitSize=4, ComSignalDataInvalidValue=15, ComSignalEndianness=LITTLE_ENDIAN, ComSignalInitValue=0, ComSignalType=UINT8, ComTransferProperty=TRIGGERED_ON_CHANGE, ComSystemTemplateSystemSignalRef=RBTMFR_SP_ActvClient_ST35
        RBTMFR_SP_FctPrecond_Stat_ST35_ce5639ee_Tx: ComBitPosition=0, ComBitSize=10, ComSignalEndianness=LITTLE_ENDIAN, ComSignalInitValue=0, ComSignalType=UINT16, ComTransferProperty=TRIGGERED_ON_CHANGE, ComSystemTemplateSystemSignalRef=RBTMFR_SP_FctPrecond_Stat_ST35
        RBTM_FR_Disp_Rq_ST3_4c4b9655_Tx: ComBitPosition=24, ComBitSize=2, ComSignalEndianness=LITTLE_ENDIAN, ComSignalInitValue=0, ComSignalType=UINT8, ComTransferProperty=TRIGGERED_ON_CHANGE, ComSystemTemplateSystemSignalRef=RBTM_FR_Disp_Rq_ST3
        RBTM_FR_Tgl_ST3_bb42027b_Tx: ComBitPosition=26, ComBitSize=1, ComSignalEndianness=LITTLE_ENDIAN, ComSignalInitValue=0, ComSignalType=BOOLEAN, ComTransferProperty=PENDING, ComSystemTemplateSystemSignalRef=RBTM_FR_Tgl_ST3
        RevBltTns_FL_ComCyc_Actv_ST3_4c5f745f_Rx: ComBitPosition=2, ComBitSize=2, ComSignalDataInvalidValue=3, ComSignalEndianness=LITTLE_ENDIAN, ComSignalInitValue=3, ComSignalType=UINT8, ComSystemTemplateSystemSignalRef=RevBltTns_FL_ComCyc_Actv_ST3
        RevBltTns_FL_SafeCyc_Actv_ST3_b0efc754_Rx: ComBitPosition=0, ComBitSize=2, ComSignalDataInvalidValue=3, ComSignalEndianness=LITTLE_ENDIAN, ComSignalInitValue=3, ComSignalType=UINT8, ComSystemTemplateSystemSignalRef=RevBltTns_FL_SafeCyc_Actv_ST3
        RevBltTns_FR_ComCyc_Actv_ST3_4c00d29e_Tx: ComBitPosition=2, ComBitSize=2, ComSignalDataInvalidValue=3, ComSignalEndianness=LITTLE_ENDIAN, ComSignalInitValue=3, ComSignalType=UINT8, ComTransferProperty=TRIGGERED_ON_CHANGE, ComSystemTemplateSystemSignalRef=RevBltTns_FR_ComCyc_Actv_ST3
        RevBltTns_FR_SafeCyc_Actv_ST3_5c8c6ad4_Tx: ComBitPosition=0, ComBitSize=2, ComSignalDataInvalidValue=3, ComSignalEndianness=LITTLE_ENDIAN, ComSignalInitValue=3, ComSignalType=UINT8, ComTransferProperty=TRIGGERED_ON_CHANGE, ComSystemTemplateSystemSignalRef=RevBltTns_FR_SafeCyc_Actv_ST3
        WakeupRsn_RBTM_FR_ST3_6ec4195b_Tx: ComBitPosition=20, ComBitSize=10, ComSignalDataInvalidValue=1023, ComSignalEndianness=LITTLE_ENDIAN, ComSignalInitValue=1023, ComSignalType=UINT16, ComTransferProperty=PENDING, ComSystemTemplateSystemSignalRef=WakeupRsn_RBTM_FR_ST3
      4 x ComSignalGroup, all with ComTransferProperty=TRIGGERED, variation-point=post-build-variant-condition{matching-criterion=Side, value=1}:
        Develop8_Rq_RBTM_FR_ST3_bcqj2sqez8u9spf5qxmu4a35u_86f26259_Rx: ComSystemTemplateSignalGroupRef=Develop8_Rq_RBTM_FR_ST3_bcqj2sqez8u9spf5qxmu4a35u
          8 x ComGroupSignal, all with ComBitSize=8, ComSignalEndianness=LITTLE_ENDIAN, ComSignalInitValue=0, ComSignalType=UINT8:
            Develop_Rq_RBTM_FR_01_ST3_b6e465c6_Rx: ComBitPosition=0, ComSystemTemplateSystemSignalRef=Develop_Rq_RBTM_FR_01_ST3
            Develop_Rq_RBTM_FR_02_ST3_f1441f16_Rx: ComBitPosition=8, ComSystemTemplateSystemSignalRef=Develop_Rq_RBTM_FR_02_ST3
            Develop_Rq_RBTM_FR_03_ST3_cc2436a6_Rx: ComBitPosition=16, ComSystemTemplateSystemSignalRef=Develop_Rq_RBTM_FR_03_ST3
            Develop_Rq_RBTM_FR_04_ST3_7e04eab6_Rx: ComBitPosition=24, ComSystemTemplateSystemSignalRef=Develop_Rq_RBTM_FR_04_ST3
            Develop_Rq_RBTM_FR_05_ST3_4364c306_Rx: ComBitPosition=32, ComSystemTemplateSystemSignalRef=Develop_Rq_RBTM_FR_05_ST3
            Develop_Rq_RBTM_FR_06_ST3_04c4b9d6_Rx: ComBitPosition=40, ComSystemTemplateSystemSignalRef=Develop_Rq_RBTM_FR_06_ST3
            Develop_Rq_RBTM_FR_07_ST3_39a49066_Rx: ComBitPosition=48, ComSystemTemplateSystemSignalRef=Develop_Rq_RBTM_FR_07_ST3
            Develop_Rq_RBTM_FR_08_ST3_bbf407b7_Rx: ComBitPosition=56, ComSystemTemplateSystemSignalRef=Develop_Rq_RBTM_FR_08_ST3
        Develop8_Rs_RBTM_FR_ST3_5t18pq0a13t698v0vsj7yvmmm_aab2c7df_Tx: ComSystemTemplateSignalGroupRef=Develop8_Rs_RBTM_FR_ST3_5t18pq0a13t698v0vsj7yvmmm
          8 x ComGroupSignal, all with ComBitSize=8, ComSignalEndianness=LITTLE_ENDIAN, ComSignalInitValue=0, ComSignalType=UINT8:
            Develop_Rs_RBTM_FR_01_ST3_ac5657f7_Tx: ComBitPosition=0, ComSystemTemplateSystemSignalRef=Develop_Rs_RBTM_FR_01_ST3
            Develop_Rs_RBTM_FR_02_ST3_ebf62d27_Tx: ComBitPosition=8, ComSystemTemplateSystemSignalRef=Develop_Rs_RBTM_FR_02_ST3
            Develop_Rs_RBTM_FR_03_ST3_d6960497_Tx: ComBitPosition=16, ComSystemTemplateSystemSignalRef=Develop_Rs_RBTM_FR_03_ST3
            Develop_Rs_RBTM_FR_04_ST3_64b6d887_Tx: ComBitPosition=24, ComSystemTemplateSystemSignalRef=Develop_Rs_RBTM_FR_04_ST3
            Develop_Rs_RBTM_FR_05_ST3_59d6f137_Tx: ComBitPosition=32, ComSystemTemplateSystemSignalRef=Develop_Rs_RBTM_FR_05_ST3
            Develop_Rs_RBTM_FR_06_ST3_1e768be7_Tx: ComBitPosition=40, ComSystemTemplateSystemSignalRef=Develop_Rs_RBTM_FR_06_ST3
            Develop_Rs_RBTM_FR_07_ST3_2316a257_Tx: ComBitPosition=48, ComSystemTemplateSystemSignalRef=Develop_Rs_RBTM_FR_07_ST3
            Develop_Rs_RBTM_FR_08_ST3_a1463586_Tx: ComBitPosition=56, ComSystemTemplateSystemSignalRef=Develop_Rs_RBTM_FR_08_ST3
        Meas8_RBTM_FR_ST3_7ba3lhjy9fnhufd3n9dyw0p9p_19ed5f9c_Tx: ComSystemTemplateSignalGroupRef=Meas8_RBTM_FR_ST3_7ba3lhjy9fnhufd3n9dyw0p9p
          8 x ComGroupSignal, all with ComBitSize=8, ComSignalEndianness=LITTLE_ENDIAN, ComSignalInitValue=0, ComSignalType=UINT8:
            Meas_RBTM_FR_01_ST3_6f6f342d_Tx: ComBitPosition=0, ComSystemTemplateSystemSignalRef=Meas_RBTM_FR_01_ST3
            Meas_RBTM_FR_02_ST3_28cf4efd_Tx: ComBitPosition=8, ComSystemTemplateSystemSignalRef=Meas_RBTM_FR_02_ST3
            Meas_RBTM_FR_03_ST3_15af674d_Tx: ComBitPosition=16, ComSystemTemplateSystemSignalRef=Meas_RBTM_FR_03_ST3
            Meas_RBTM_FR_04_ST3_a78fbb5d_Tx: ComBitPosition=24, ComSystemTemplateSystemSignalRef=Meas_RBTM_FR_04_ST3
            Meas_RBTM_FR_05_ST3_9aef92ed_Tx: ComBitPosition=32, ComSystemTemplateSystemSignalRef=Meas_RBTM_FR_05_ST3
            Meas_RBTM_FR_06_ST3_dd4fe83d_Tx: ComBitPosition=40, ComSystemTemplateSystemSignalRef=Meas_RBTM_FR_06_ST3
            Meas_RBTM_FR_07_ST3_e02fc18d_Tx: ComBitPosition=48, ComSystemTemplateSystemSignalRef=Meas_RBTM_FR_07_ST3
            Meas_RBTM_FR_08_ST3_627f565c_Tx: ComBitPosition=56, ComSystemTemplateSystemSignalRef=Meas_RBTM_FR_08_ST3
        ROE_RBTM_FR_ST3_3f1btonh6ivdn6ytgyuu9rtt1_5c720902_Tx: ComSystemTemplateSignalGroupRef=ROE_RBTM_FR_ST3_3f1btonh6ivdn6ytgyuu9rtt1
          8 x ComGroupSignal, all with ComBitSize=8, ComSignalEndianness=LITTLE_ENDIAN, ComSignalInitValue=0, ComSignalType=UINT8:
            ROE_0_RBTM_FR_ST3_418450d2_Tx: ComBitPosition=0, ComSystemTemplateSystemSignalRef=ROE_0_RBTM_FR_ST3
            ROE_1_RBTM_FR_ST3_9c128957_Tx: ComBitPosition=8, ComSystemTemplateSystemSignalRef=ROE_1_RBTM_FR_ST3
            ROE_2_RBTM_FR_ST3_21d8e599_Tx: ComBitPosition=16, ComSystemTemplateSystemSignalRef=ROE_2_RBTM_FR_ST3
            ROE_3_RBTM_FR_ST3_fc4e3c1c_Tx: ComBitPosition=24, ComSystemTemplateSystemSignalRef=ROE_3_RBTM_FR_ST3
            ROE_4_RBTM_FR_ST3_813d3a44_Tx: ComBitPosition=32, ComSystemTemplateSystemSignalRef=ROE_4_RBTM_FR_ST3
            ROE_5_RBTM_FR_ST3_5cabe3c1_Tx: ComBitPosition=40, ComSystemTemplateSystemSignalRef=ROE_5_RBTM_FR_ST3
            ROE_6_RBTM_FR_ST3_e1618f0f_Tx: ComBitPosition=48, ComSystemTemplateSystemSignalRef=ROE_6_RBTM_FR_ST3
            ROE_7_RBTM_FR_ST3_3cf7568a_Tx: ComBitPosition=56, ComSystemTemplateSystemSignalRef=ROE_7_RBTM_FR_ST3
    ComGeneral
