AUTOSAR XML (schema 4-3-0)
package /ActiveEcuC
  module config FblBm: implementation-config-variant=VARIANT-PRE-COMPILE, module-description=FblBm_Impl
    FblBmGeneral:
      FblBmFailsafeUpdater = false
      FblBmIncludeHardwareConfiguration = false
      FblBmInitializeKeys = false
      FblBmSecureBoot = false
      FblBmStandaloneMode = true
      FblBmInitializeMacOfBootloader = false
      FblBmIncludeOemConfiguration = false
      FblBmExecutionInstance = FlashBootloader
      FblBmHeaderAddress = 2684568320
