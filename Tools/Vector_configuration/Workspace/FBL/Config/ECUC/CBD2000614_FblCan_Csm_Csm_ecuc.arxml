AUTOSAR XML (schema 4-3-0)
package /ActiveEcuC
  module config Csm: implementation-config-variant=VARIANT-PRE-COMPILE, module-description=Csm_Impl
    CsmGeneral:
      CsmAsymPrivateKeyMaxLength = 32
      CsmAsymPublicKeyMaxLength = 1024
      CsmDevErrorDetect = true
      CsmMainFunctionPeriod = 0.005
      CsmSymKeyMaxLength = 16
      CsmUseDeprecated = false
      CsmVersionInfoApi = false
      CsmCallbackStartNotification = false
      CsmCancelationDuringProcessing = false
      CsmSafeBswChecks = false
      CsmCustomIncludeFiles = Crypto_30_vHsm_Custom.h
      CsmCustomIncludeFiles = Crypto_30_LibCv_Custom.h
      CsmJobTypeLayout:
        CsmJobTypeLayoutAsr430Compatibility = true
        CsmJobTypeLayoutVarMembers = true
        CsmJobTypeLayoutInput64 = false
        CsmJobTypeLayoutOutput64Ptr = false
        CsmJobTypeLayoutRedirectionInfoRef = false
    CsmJobs
      7 x CsmJob, all with CsmJobPriority=0, CsmJobUsePort=false, CsmProcessingMode=CRYPTO_PROCESSING_SYNC, CsmJobInterfaceUsePort=CRYPTO_USE_FNC:
        CsmJob_RandomGenerate: CsmJobId=2, CsmJobQueueRef=CsmQueue_Rng, CsmJobPrimitiveRef=Csm/CsmPrimitives_RandomGenerate, CsmJobKeyRef=CsmKey_Fbl_Rng_Fips186
        CsmJob_SigAsymVer_Ed25519Sha512: CsmJobId=5, CsmJobQueueRef=CsmQueue_vHsm_Hwa, CsmJobPrimitiveRef=Csm/CsmPrimitives_SigAsymVer_EdDsa25519Sha512, CsmJobKeyRef=CsmKey_Fbl_Signature_Ed25519_01
        CsmJob_DecryptionAes128NoneCbc: CsmJobId=0, CsmJobQueueRef=CsmQueue_vHsm_Hwa, CsmJobPrimitiveRef=Csm/CsmPrimitives_Dec_Aes128NoneCbc, CsmJobKeyRef=CsmKey_Fbl_Decrypt_Aes128_01
        CsmJob_Sha512: CsmJobId=4, CsmJobKeyRef=CsmKey_Fbl_HashDummy_01, CsmJobPrimitiveRef=Csm/CsmPrimitives_Sha512, CsmJobQueueRef=CsmQueue_Standard
        CsmJob_DecryptionAes128PkcsCbc: CsmJobId=1, CsmJobQueueRef=CsmQueue_vHsm_Hwa, CsmJobPrimitiveRef=Csm/CsmPrimitives_Dec_Aes128PkcsCbc, CsmJobKeyRef=CsmKey_Fbl_Decrypt_Aes128_01
        CsmJob_vHsm_Fw_Update: CsmJobId=6, CsmJobKeyRef=CsmKey_vHsm_FirmwareUpdate_Signature, CsmJobPrimitiveRef=Csm/CsmPrimitives_vHsm_Fw_Update, CsmJobQueueRef=CsmQueue_vHsm_Fw_Update
        CsmJob_SecurityAccess_Ed25519Sha512: CsmJobId=3, CsmJobQueueRef=CsmQueue_vHsm_Hwa, CsmJobPrimitiveRef=Csm/CsmPrimitives_SigAsymVer_EdDsa25519Sha512, CsmJobKeyRef=CsmKey_Fbl_SecurityAccess_Ed25519
    CsmQueues
      6 x CsmQueue, all with CsmQueueSize=1, CsmTriggerAsynchJobsInCallback=false:
        CsmQueue_Standard: CsmJobSharing=true, CsmChannelRef=CryIfChannel_CryptoCv_Fbl_Signature
        CsmQueue_Aes: CsmJobSharing=true, CsmChannelRef=CryIfChannel_CryptoCv_Fbl_Aes
        CsmQueue_Rng: CsmJobSharing=true, CsmChannelRef=CryIfChannel_CryptoCv_Fbl_Rng
        CsmQueue_vHsm_Core: CsmJobSharing=true, CsmChannelRef=CryIfChannel_vHsm_Core
        CsmQueue_vHsm_Fw_Update: CsmJobSharing=false, CsmChannelRef=CryIfChannel_vHsm_Fw_Update
        CsmQueue_vHsm_Hwa: CsmJobSharing=true, CsmChannelRef=CryIfChannel_vHsm_Hwa
    CsmKeys
      63 x CsmKey, all with CsmKeyUsePort=false:
        CsmKey_Fbl_Decrypt_Aes128: CsmKeyId=0, CsmKeyRef=CryIfKey_Fbl_Decrypt_Aes128
        CsmKey_Fbl_Signature_Ed25519: CsmKeyId=7, CsmKeyRef=CryIfKey_Fbl_Signature_Ed25519
        CsmKey_Fbl_Rng_Fips186: CsmKeyId=4, CsmKeyRef=CryIfKey_Fbl_Rng_Fips186
        CsmKey_Fbl_HashDummy: CsmKeyId=2, CsmKeyRef=CryIfKey_Fbl_HashDummy
        CsmKey_vHsm_Custom: CsmKeyId=55, CsmKeyRef=CryIfKey_vHsm_Custom
        CsmKey_vHsm_FirmwareUpdate_Signature: CsmKeyId=56, CsmKeyRef=CryIfKey_vHsm_FirmwareUpdate_Signature
        CsmKey_vHsm_Hardware: CsmKeyId=57, CsmKeyRef=CryIfKey_vHsm_Hardware
        CsmKey_vHsm_Info: CsmKeyId=58, CsmKeyRef=CryIfKey_vHsm_Info
        CsmKey_vHsm_RomKey0: CsmKeyId=61, CsmKeyRef=CryIfKey_vHsm_RomKey0
        CsmKey_vHsm_Log: CsmKeyId=60, CsmKeyRef=CryIfKey_vHsm_Log
        CsmKey_vHsm_TRNG: CsmKeyId=62, CsmKeyRef=CryIfKey_vHsm_TRNG
        CsmKey_vHsm_Info_01: CsmKeyId=59, CsmKeyRef=CryIfKey_CryIfKey_vHsm_Info
        CsmKey_Fbl_Signature_Ed25519_01: CsmKeyId=8, CsmKeyRef=CryIfKey_CryIfKey_Fbl_Signature_Ed25519
        CsmKey_Fbl_Rng_Fips186_01: CsmKeyId=5, CsmKeyRef=CryIfKey_CryIfKey_Fbl_Rng_Fips186
        CsmKey_Fbl_HashDummy_01: CsmKeyId=3, CsmKeyRef=CryIfKey_CryIfKey_Fbl_HashDummy
        CsmKey_Fbl_Decrypt_Aes128_01: CsmKeyId=1, CsmKeyRef=CryIfKey_CryIfKey_Fbl_Decrypt_Aes128
        CsmKey_Fbl_SecurityAccess_Ed25519: CsmKeyId=6, CsmKeyRef=CryIfKey_CryIfKey_Fbl_SecurityAccess_Ed25519
        CsmKey_Ssa_SharedSecretExchangeKey: CsmKeyId=38, CsmKeyRef=CryIfKey_Ssa_SharedSecretExchangeKey
        CsmKey_SSA_SecOC_Int_MacVerify_COM_C0X_Pdu20_secured_3ef6961f_Rx: CsmKeyId=23, CsmKeyRef=CryIfKey_SSA_SecOC_Int_MacVerify_COM_C0X_Pdu20_secured_3ef6961f_Rx
        CsmKey_KeyM_SigVerifyKey_TrustModelBackend: CsmKeyId=14, CsmKeyRef=CryIfKey_KeyM_SigVerifyKey_TrustModelBackend
        CsmKey_SSA_SecOC_Int_MacVerify_PT4_PTCoor4: CsmKeyId=28, CsmKeyRef=CryIfKey_SSA_SecOC_Int_MacVerify_PT4_PTCoor4
        CsmKey_KeyM_SigVerifyKey_TrustModelEcuPeer: CsmKeyId=16, CsmKeyRef=CryIfKey_KeyM_SigVerifyKey_TrustModelEcuPeer
        CsmKey_KeyM_SigVerifyKey_TrustModelBackendPeer: CsmKeyId=15, CsmKeyRef=CryIfKey_KeyM_SigVerifyKey_TrustModelBackendPeer
        CsmKey_Ssa_Authentication: CsmKeyId=31, CsmKeyRef=CryIfKey_Ssa_Authentication
        CsmKey_Ssa_SharedSecretHash: CsmKeyId=39, CsmKeyRef=CryIfKey_Ssa_SharedSecretHash
        CsmKey_Ssa_TrustModelBackendCert_inHSM: CsmKeyId=43, CsmKeyRef=CryIfKey_CryIfKey_Ssa_TrustModelBackendCert_inHSM
        CsmKey_Ssa_RandomSeed: CsmKeyId=34, CsmKeyRef=CryIfKey_Ssa_RandomSeed
        CsmKey_SSA_SecOC_Int_MacVerify_PN14_Master_Stat1: CsmKeyId=27, CsmKeyRef=CryIfKey_SSA_SecOC_Int_MacVerify_PN14_Master_Stat1
        CsmKey_SSA_SecOC_Int_MacGen_COM_C04_Pdu20_secured_393d7a18_Tx: CsmKeyId=21, CsmKeyRef=CryIfKey_SSA_SecOC_Int_MacGen_COM_C04_Pdu20_secured_393d7a18_Tx
        CsmKey_KeyM_ECC_Root: CsmKeyId=13, CsmKeyRef=CryIfKey_KeyM_ECC_Root
        CsmKey_Ssa_TrustModelPrivateEcuUnique_StagingKey: CsmKeyId=48, CsmKeyRef=CryIfKey_CryIfKey_Ssa_TrustModelPrivateEcuUnique_StagingKey
        CsmKey_Ssa_RealTime: CsmKeyId=35, CsmKeyRef=CryIfKey_Ssa_RealTime
        CsmKey_Ssa_PduKeysMac: CsmKeyId=33, CsmKeyRef=CryIfKey_Ssa_PduKeysMac
        CsmKey_Ssa_TrustModelIntermediateCert_inHSM: CsmKeyId=47, CsmKeyRef=CryIfKey_CryIfKey_Ssa_TrustModelIntermediateCert_inHSM
        CsmKey_Ssa_TrustModelEcuPublic_LiveKey: CsmKeyId=46, CsmKeyRef=CryIfKey_Ssa_TrustModelEcuPublic_LiveKey
        CsmKey_Ssa_SignatureRamKey: CsmKeyId=40, CsmKeyRef=CryIfKey_Ssa_SignatureRamKey
        CsmKey_Ssa_TrustModel_Ecu_CsrPublicKey: CsmKeyId=52, CsmKeyRef=CryIfKey_CryIfKey_Ssa_TrustModel_Ecu_CsrPublicKey
        CsmKey_Ssa_TrustModelEcuCert_inHSM: CsmKeyId=44, CsmKeyRef=CryIfKey_CryIfKey_Ssa_TrustModelEcuCert_inHSM
        CsmKey_Ssa_SignatureRamKey_replacementAuthority: CsmKeyId=41, CsmKeyRef=CryIfKey_CryIfKey_Ssa_SignatureRamKey_replacementAuthority
        CsmKey_Ssa_BackendCert: CsmKeyId=32, CsmKeyRef=CryIfKey_Ssa_BackendCert
        CsmKey_Ssa_AesRamKey: CsmKeyId=30, CsmKeyRef=CryIfKey_Ssa_AesRamKey
        CsmKey_SSA_SecOC_Int_MacVerify_Ign_Stat: CsmKeyId=26, CsmKeyRef=CryIfKey_SSA_SecOC_Int_MacVerify_Ign_Stat
        CsmKey_KeyM_SigVerifyKey_TrustModelIntermediatePeer: CsmKeyId=18, CsmKeyRef=CryIfKey_KeyM_SigVerifyKey_TrustModelIntermediatePeer
        CsmKey_Ssa_SecurityAccessPublicKey: CsmKeyId=37, CsmKeyRef=CryIfKey_Ssa_SecurityAccessPublicKey
        CsmKey_SSA_SecOC_Int_MacVerify_DI_OdoSpeedometer: CsmKeyId=25, CsmKeyRef=CryIfKey_SSA_SecOC_Int_MacVerify_DI_OdoSpeedometer
        CsmKey_KeyM_Cert_Root: CsmKeyId=11, CsmKeyRef=CryIfKey_KeyM_Cert_Root
        CsmKey_SSA_SecOC_Int_MacVerify_COM_C0X_Pdu21_secured_298d825c_Rx: CsmKeyId=24, CsmKeyRef=CryIfKey_SSA_SecOC_Int_MacVerify_COM_C0X_Pdu21_secured_298d825c_Rx
        CsmKey_KeyMCertificate_OSSL_X509_ECDSA_P384_IA: CsmKeyId=10, CsmKeyRef=CryIfKey_CryIfKey_KeyMCertificate_OSSL_X509_ECDSA_P384_IA
        CsmKey_SSA_SecOC_Int_MacVerify_VehSpd_8: CsmKeyId=29, CsmKeyRef=CryIfKey_SSA_SecOC_Int_MacVerify_VehSpd_8
        CsmKey_SSA_SecOC_Int_MacGen_COM_C04_Pdu03_secured_044596e0_Tx: CsmKeyId=20, CsmKeyRef=CryIfKey_SSA_SecOC_Int_MacGen_COM_C04_Pdu03_secured_044596e0_Tx
        CsmKey_Ssa_TickCount: CsmKeyId=42, CsmKeyRef=CryIfKey_Ssa_TickCount
        CsmKey_vHSM_Custom_HSM_Version: CsmKeyId=54, CsmKeyRef=CryIfKey_vHSM_Custom_HSM_Version
        CsmKey_Ssa_TrustModel_Ecu_CsrPrivateKey: CsmKeyId=51, CsmKeyRef=CryIfKey_CryIfKey_Ssa_TrustModel_Ecu_CsrPrivateKey
        CsmKey_KeyM_ECC_Intermediate: CsmKeyId=12, CsmKeyRef=CryIfKey_KeyM_ECC_Intermediate
        CsmKey_KeyM_SigVerifyKey_TrustModelIntermediate: CsmKeyId=17, CsmKeyRef=CryIfKey_KeyM_SigVerifyKey_TrustModelIntermediate
        CsmKey_Ssa_RootCert: CsmKeyId=36, CsmKeyRef=CryIfKey_Ssa_RootCert
        CsmKey_SSA_SecOC_Int_MacGen_COM_C04_Pdu21_secured_2e466e5b_Tx: CsmKeyId=22, CsmKeyRef=CryIfKey_SSA_SecOC_Int_MacGen_COM_C04_Pdu21_secured_2e466e5b_Tx
        CsmKey_Ssa_TrustModelRootCert_inHSM: CsmKeyId=50, CsmKeyRef=CryIfKey_CryIfKey_Ssa_TrustModelRootCert_inHSM
        CsmKey_Ssa_TrustModelPrivateEcu_LiveKey: CsmKeyId=49, CsmKeyRef=CryIfKey_Ssa_TrustModelPrivateEcu_LiveKey
        CsmKey_KeyM_SigVerifyKey_TrustModelRoot: CsmKeyId=19, CsmKeyRef=CryIfKey_KeyM_SigVerifyKey_TrustModelRoot
        CsmKey_Ssa_VIN: CsmKeyId=53, CsmKeyRef=CryIfKey_Ssa_VIN
        CsmKey_Ssa_TrustModelEcuPublicCsr_StagingKey: CsmKeyId=45, CsmKeyRef=CryIfKey_Ssa_TrustModelEcuPublicCsr_StagingKey
        CsmKey_KeyMCertificate_OSSL_X509_ECDSA_P384_CA: CsmKeyId=9, CsmKeyRef=CryIfKey_CryIfKey_KeyMCertificate_OSSL_X509_ECDSA_P384_CA
    6 x CsmPrimitives:
      CsmPrimitives_RandomGenerate
        CsmRandomGenerate
          CsmPrimitives_RandomGenerate (CsmRandomGenerateConfig):
            CsmRandomGenerateAlgorithmFamiliy = CRYPTO_ALGOFAM_RNG
            CsmRandomGenerateAlgorithmMode = CRYPTO_ALGOMODE_NOT_SET
            CsmRandomGenerateAlgorithmSecondaryFamily = CRYPTO_ALGOFAM_NOT_SET
            CsmRandomGenerateProcessing = CSM_SYNCHRONOUS
            CsmRandomGenerateAlgorithmFamily = CRYPTO_ALGOFAM_RNG
            CsmRandomGenerateResultLength = 4
      CsmPrimitives_Dec_Aes128NoneCbc
        CsmDecrypt
          CsmPrimitives_Dec_Aes128NoneCbc (CsmDecryptConfig):
            CsmDecryptAlgorithmFamiliy = CRYPTO_ALGOFAM_AES
            CsmDecryptAlgorithmFamily = CRYPTO_ALGOFAM_AES
            CsmDecryptAlgorithmKeyLength = 16
            CsmDecryptAlgorithmMode = CRYPTO_ALGOMODE_CBC
            CsmDecryptAlgorithmSecondaryFamily = CRYPTO_ALGOFAM_NOT_SET
            CsmDecryptProcessing = CSM_SYNCHRONOUS
      CsmPrimitives_Sha512
        CsmHash
          CsmPrimitives_Sha512 (CsmHashConfig):
            CsmHashProcessing = CSM_SYNCHRONOUS
            CsmHashResultLength = 64
            CsmHashAlgorithmFamily = CRYPTO_ALGOFAM_SHA2_512
            CsmHashAlgorithmFamiliy = CRYPTO_ALGOFAM_SHA2_512
            CsmHashAlgorithmMode = CRYPTO_ALGOMODE_NOT_SET
            CsmHashAlgorithmSecondaryFamily = CRYPTO_ALGOFAM_NOT_SET
      CsmPrimitives_SigAsymVer_EdDsa25519Sha512
        CsmSignatureVerify
          CsmPrimitives_SigAsymVer_EdDsa25519Sha512 (CsmSignatureVerifyConfig):
            CsmSignatureVerifyAlgorithmFamily = CRYPTO_ALGOFAM_ED25519
            CsmSignatureVerifyAlgorithmMode = CRYPTO_ALGOMODE_CUSTOM
            CsmSignatureVerifyAlgorithmSecondaryFamily = CRYPTO_ALGOFAM_SHA2_512
            CsmSignatureVerifyProcessing = CSM_SYNCHRONOUS
            CsmSignatureVerifyCompareLength = 64
            CsmSignatureVerifyKeyLength = 32
            CsmSignatureVerifyAlgorithmFamiliy = CRYPTO_ALGOFAM_ED25519
            CsmSignatureVerifyAlgorithmModeCustomRef = Crypto_30_vHsm_Hwa_Ed25519Ph
      CsmPrimitives_Dec_Aes128PkcsCbc
        CsmDecrypt
          CsmPrimitives_Dec_Aes128PkcsCbc (CsmDecryptConfig):
            CsmDecryptAlgorithmFamiliy = CRYPTO_ALGOFAM_AES
            CsmDecryptAlgorithmFamily = CRYPTO_ALGOFAM_AES
            CsmDecryptAlgorithmKeyLength = 16
            CsmDecryptAlgorithmMode = CRYPTO_ALGOMODE_CBC
            CsmDecryptAlgorithmSecondaryFamily = CRYPTO_ALGOFAM_CUSTOM
            CsmDecryptProcessing = CSM_SYNCHRONOUS
            CsmDecryptAlgorithmSecondaryFamilyCustomRef = Crypto_30_vHsm_Hwa_PaddingPKCS7
      CsmPrimitives_vHsm_Fw_Update
        CsmAEADEncrypt
          CsmPrimitives_vHsm_Fw_Update (CsmAEADEncryptConfig):
            CsmAEADEncryptAlgorithmFamiliy = CRYPTO_ALGOFAM_CUSTOM
            CsmAEADEncryptAlgorithmFamily = CRYPTO_ALGOFAM_CUSTOM
            CsmAEADEncryptAlgorithmKeyLength = 16
            CsmAEADEncryptAlgorithmMode = CRYPTO_ALGOMODE_GCM
            CsmAEADEncryptProcessing = CSM_SYNCHRONOUS
            CsmAEADEncryptTagLength = 1
            CsmAEADEncryptAlgorithmSecondaryFamily = CRYPTO_ALGOFAM_NOT_SET
            CsmAEADEncryptAlgorithmFamilyCustom = CRYPTO_ALGOFAM_CUSTOM_VHSM_FIRMWARE_UPDATE
            CsmAEADEncryptKeyRef = CsmKey_vHsm_FirmwareUpdate_Signature
