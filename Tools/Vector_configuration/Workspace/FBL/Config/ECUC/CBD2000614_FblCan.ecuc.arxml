AUTOSAR XML (schema 4-3-0)
package /ActiveEcuC
  ecuc value collection ActiveEcuC: ecu-extract=SYSTEM
    ecuc-values:
      CanSM
      CanTp
      EcuC
      vSet
      PduR
      Dcm
      Can
      CanIf
      Det
      ComM
      Os
      CryIf
      Crypto
      Csm
      vSecPrim
      vBaseEnv
      FblBmHdr
      FblBm
      FblHal
      Fbl
      Smh
      vLinkGen
      Crypto_vHsm
      vMemAccM
      vMem
      vBRS
      WrapNv
      ResourceM
      Port
      McalLib
      Dio
      Mcu
      Fls
      MemMap
      NvM_Stub
      Dma
      Spi
      Fee
