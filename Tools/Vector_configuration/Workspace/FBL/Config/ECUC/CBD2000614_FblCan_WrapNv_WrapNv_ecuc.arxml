AUTOSAR XML (schema 4-3-0)
package /ActiveEcuC
  module config WrapNv: implementation-config-variant=VARIANT-PRE-COMPILE, module-description=WrapNv_Impl
    WrapNvMemoryLayout
      6 x WrapNvDataBlock, all with WrapNvDbAccessMacro=false:
        SecAccessDelayFlag: WrapNvDbCount=1, WrapNvDbDescription=Security access delay flag, WrapNvDbIndex=4, WrapNvDbType=SINGLE
          SecAccessDelayFlag (WrapNvDataElement):
            WrapNvDeDescription = Security access delay flag
            WrapNvDeLength = 1
            WrapNvDeIndex = 0
            WrapNvDeDefaultValue = 0xFF
            WrapNvDeNVMBlockRef = NvMBlockDescriptor_SecAccessDelayFlag
        FblMetaData: WrapNvDbDescription=FBL meta data - 2 needed per logical block, WrapNvDbCount=3, WrapNvDbIndex=7, WrapNvDbType=TABLE
          13 x WrapNvDataElement, all with WrapNvDeNVMBlockRef=NvMBlockDescriptor_FblMetaData:
            FpStatusInfo: WrapNvDeDescription=Fingerprint status information, WrapNvDeLength=1, WrapNvDeIndex=0, WrapNvDeDefaultValue=0xFF
            Fingerprint: WrapNvDeDescription=Diagnostic Authentication Certificate ID, programming date, WrapNvDeLength=19, WrapNvDeIndex=1, WrapNvDeDefaultValue=0xFF 0xFF 0xFF 0xFF 0xFF 0xFF 0xFF 0xFF 0xFF 0xFF 0xFF 0xFF 0xFF 0xFF 0xFF 0xFF 0xFF 0xFF 0xFF
            ProgAttempts: WrapNvDeDescription=Programming attempt counter, WrapNvDeLength=2, WrapNvDeIndex=2, WrapNvDeDefaultValue=0xFF 0xFF
            SwVersion: WrapNvDeDescription=Software version, WrapNvDeLength=3, WrapNvDeIndex=4, WrapNvDeDefaultValue=0xFF 0xFF 0xFF
            SwPartNumber: WrapNvDeDescription=Software part number, WrapNvDeLength=10, WrapNvDeIndex=5, WrapNvDeDefaultValue=0xFF 0xFF 0xFF 0xFF 0xFF 0xFF 0xFF 0xFF 0xFF 0xFF
            SwSupplierInformation: WrapNvDeDescription=Software supplier information, WrapNvDeLength=2, WrapNvDeIndex=6, WrapNvDeDefaultValue=0xFF 0xFF
            SegmentCount: WrapNvDeDescription=Number of entries in segment list, WrapNvDeLength=1, WrapNvDeIndex=10, WrapNvDeDefaultValue=0xFF
            SegmentAddrList: WrapNvDeDescription=List of segment start addresses, WrapNvDeLength=40, WrapNvDeIndex=11, WrapNvDeDefaultValue=0xFF 0xFF 0xFF 0xFF 0xFF 0xFF 0xFF 0xFF 0xFF 0xFF 0xFF 0xFF 0xFF 0xFF 0xFF 0xFF 0xFF 0xFF 0xFF 0xFF 0xFF 0xFF 0xFF 0xFF 0xFF 0xFF 0xFF 0xFF 0xFF 0xFF 0xFF 0xFF 0xFF 0xFF 0xFF 0xFF 0xFF 0xFF 0xFF 0xFF
            SegmentLengthList: WrapNvDeDescription=List of segment lengths, WrapNvDeLength=40, WrapNvDeIndex=12, WrapNvDeDefaultValue=0xFF 0xFF 0xFF 0xFF 0xFF 0xFF 0xFF 0xFF 0xFF 0xFF 0xFF 0xFF 0xFF 0xFF 0xFF 0xFF 0xFF 0xFF 0xFF 0xFF 0xFF 0xFF 0xFF 0xFF 0xFF 0xFF 0xFF 0xFF 0xFF 0xFF 0xFF 0xFF 0xFF 0xFF 0xFF 0xFF 0xFF 0xFF 0xFF 0xFF
            MinimumSoftwareVersion: WrapNvDeIndex=7, WrapNvDeDescription=The minimum software version is used to prevent the downgrade to an older version, WrapNvDeLength=3, WrapNvDeDefaultValue=0xFF 0xFF 0xFF
            CRCTotal: WrapNvDeDescription=CRC total of logical block, WrapNvDeLength=4, WrapNvDeIndex=3, WrapNvDeDefaultValue=0xFF 0xFF 0xFF 0xFF
            CRCWritten: WrapNvDeIndex=9, WrapNvDeLength=4, WrapNvDeDescription=CRC32 value over written data in current logical block, WrapNvDeDefaultValue=0xFF 0xFF 0xFF 0xFF
            Cmac: WrapNvDeIndex=8, WrapNvDeLength=16, WrapNvDeDescription=Avoid manipulation of download software in case of OFR-Light, WrapNvDeDefaultValue=0xFF 0xFF 0xFF 0xFF 0xFF 0xFF 0xFF 0xFF 0xFF 0xFF 0xFF 0xFF 0xFF 0xFF 0xFF 0xFF
        VerificationKey: WrapNvDbCount=1, WrapNvDbIndex=6, WrapNvDbDescription=Key for signature verification, WrapNvDbType=STRUCT
          VerificationKeyState (WrapNvDataElement):
            WrapNvDeDescription = Memory status of verification key value
            WrapNvDeLength = 1
            WrapNvDeDefaultValue = 0xFF
            WrapNvDeIndex = 0
            WrapNvDeNVMBlockRef = NvMBlockDescriptor_VerificationKey
          VerificationKeyValue (WrapNvDataElement):
            WrapNvDeLength = 32
            WrapNvDeDescription = Key value for signature verification
            WrapNvDeIndex = 1
            WrapNvDeDefaultValue = 0xFF 0xFF 0xFF 0xFF 0xFF 0xFF 0xFF 0xFF 0xFF 0xFF 0xFF 0xFF 0xFF 0xFF 0xFF 0xFF 0xFF 0xFF 0xFF 0xFF 0xFF 0xFF 0xFF 0xFF 0xFF 0xFF 0xFF 0xFF 0xFF 0xFF 0xFF 0xFF
            WrapNvDeNVMBlockRef = NvMBlockDescriptor_VerificationKey
        IdEcuLocation: WrapNvDbType=SINGLE, WrapNvDbIndex=8, WrapNvDbCount=1, WrapNvDbDescription=
          IdEcuLocation (WrapNvDataElement): WrapNvDeIndex=0, WrapNvDeLength=3, WrapNvDeDescription=, WrapNvDeDefaultValue=0x9C 0xFF 0xFF, WrapNvDeNVMBlockRef=NvMBlockDescriptor_IDEcuLocation
        NVP_BLOCK_ID_HW_VERSION: WrapNvDbType=SINGLE, WrapNvDbIndex=10, WrapNvDbCount=1, WrapNvDbDescription=
          NVP_BLOCK_ID_HW_VERSION (WrapNvDataElement): WrapNvDeIndex=0, WrapNvDeLength=3, WrapNvDeDescription=, WrapNvDeDefaultValue=0x17 0x11 0x00, WrapNvDeNVMBlockRef=NVP_BLOCK_ID_HW_VERSION
        NVP_BLOCK_ID_HW_PARTNUMBER: WrapNvDbType=SINGLE, WrapNvDbIndex=0, WrapNvDbCount=1, WrapNvDbDescription=
          NVP_BLOCK_ID_HW_PARTNUMBER (WrapNvDataElement):
            WrapNvDeIndex = 0
            WrapNvDeLength = 20
            WrapNvDeDescription = 
            WrapNvDeDefaultValue = 0x30 0x30 0x30 0x30 0x30 0x30 0x30 0x30 0x30 0x30 0x30 0x30 0x30 0x30 0x30 0x30 0x30 0x30 0x30 0x30
            WrapNvDeNVMBlockRef = NVP_BLOCK_ID_HW_PARTNUMBER
    WrapNvGeneral:
      WrapNvEEPROMBaseAddress = 0
      WrapNvFirstHandle = 1
      WrapNvNVMDataHandling = FEE
      WrapNvMainFunctionPolling = true
      WrapNvUserConfigFile = $(DpaProjectFolder)\config\wrapnv_user.cfg
      WrapNvDevErrorDetect = true
      MainFunctionCycle_Fee (WrapNvMainFunctionCycle): WrapNvMainFunctionCycleValue=5, WrapNvMainFunctionCycleModuleRef=Fee
      MainFunctionCycle_Fls (WrapNvMainFunctionCycle): WrapNvMainFunctionCycleValue=5, WrapNvMainFunctionCycleModuleRef=Fls
