AUTOSAR XML (schema 4-3-0)
package /ActiveEcuC
  module config EcuC: implementation-config-variant=VARIANT-POST-BUILD-SELECTABLE, module-description=EcuC_Impl
    EcucPduCollection: PduIdTypeEnum=UINT8, PduLengthTypeEnum=UINT16
      48 x Pdu, all with J1939Requestable=false:
        SDU_DIAG_GLOBAL_ExtEth_RQ_BODY3_ST3_38ac71dd_Rx: DynamicLength=true, PduLength=7
        DIAG_RBTM_FL_03_ExtEth_RS_ST3_0b692d29_Tx: DynamicLength=false, PduLength=8, SysTPduToFrameMappingRef=DIAG_RBTM_FL_03_ExtEth_RS_ST3, variation-point=post-build-variant-condition{matching-criterion=Side, value=0}
        SDU_DIAG_RBTM_FL_03_IntEth_RS_BODY3_ST3_e1d59ed3_Tx: DynamicLength=true, PduLength=4095, variation-point=post-build-variant-condition{matching-criterion=Side, value=0}
        DIAG_RQ_GLOBAL_ExtCAN_ST3_320b5155_Rx: DynamicLength=false, PduLength=8, SysTPduToFrameMappingRef=DIAG_RQ_GLOBAL_ExtCAN_ST3
        DIAG_RBTM_FL_03_ExtEth_RQ_ST3_8e910fe6_Rx: DynamicLength=false, PduLength=8, SysTPduToFrameMappingRef=DIAG_RBTM_FL_03_ExtEth_RQ_ST3, variation-point=post-build-variant-condition{matching-criterion=Side, value=0}
        DIAG_RBTM_FL_03_IntEth_RS_ST3_46126af2_Tx: DynamicLength=false, PduLength=8, SysTPduToFrameMappingRef=DIAG_RBTM_FL_03_IntEth_RS_ST3, variation-point=post-build-variant-condition{matching-criterion=Side, value=0}
        SDU_DIAG_GLOBAL_ExtCAN_RQ_BODY3_ST3_18e7f235_Rx: DynamicLength=true, PduLength=7
        SDU_DIAG_RBTM_FL_03_ExtCAN_RQ_BODY3_ST3_6d2a29a5_Rx: DynamicLength=true, PduLength=4095, variation-point=post-build-variant-condition{matching-criterion=Side, value=0}
        SDU_DIAG_RBTM_FL_03_ExtCAN_RS_BODY3_ST3_b462d7d3_Tx: DynamicLength=true, PduLength=4095, variation-point=post-build-variant-condition{matching-criterion=Side, value=0}
        SDU_DIAG_RBTM_FL_03_ExtEth_RS_BODY3_ST3_b783cf68_Tx: DynamicLength=true, PduLength=4095, variation-point=post-build-variant-condition{matching-criterion=Side, value=0}
        SDU_DIAG_RBTM_FL_03_ExtEth_RQ_BODY3_ST3_4810f84e_Rx: DynamicLength=true, PduLength=4095, variation-point=post-build-variant-condition{matching-criterion=Side, value=0}
        DIAG_RBTM_FL_03_IntEth_RQ_ST3_c3ea483d_Rx: DynamicLength=false, PduLength=8, SysTPduToFrameMappingRef=DIAG_RBTM_FL_03_IntEth_RQ_ST3, variation-point=post-build-variant-condition{matching-criterion=Side, value=0}
        DIAG_RBTM_FL_03_ExtCAN_RS_ST3_ba6d58fb_Tx: DynamicLength=false, PduLength=8, SysTPduToFrameMappingRef=DIAG_RBTM_FL_03_ExtCAN_RS_ST3, variation-point=post-build-variant-condition{matching-criterion=Side, value=0}
        SDU_DIAG_RBTM_FL_03_ExtCAN_RS_BODY3_ST3_92b91e83_Tx: DynamicLength=true, PduLength=4095, variation-point=post-build-variant-condition{matching-criterion=Side, value=0}
        DIAG_RQ_GLOBAL_IntEth_ST3_f8cf566a_Rx: DynamicLength=false, PduLength=8, SysTPduToFrameMappingRef=DIAG_RQ_GLOBAL_IntEth_ST3
        SDU_DIAG_GLOBAL_ExtCAN_RQ_BODY3_ST3_1d96a036_Rx: DynamicLength=true, PduLength=7
        SDU_DIAG_GLOBAL_IntEth_RQ_BODY3_ST3_6efa2066_Rx: DynamicLength=true, PduLength=7
        DIAG_RQ_GLOBAL_ExtEth_ST3_3402b191_Rx: DynamicLength=false, PduLength=8, SysTPduToFrameMappingRef=DIAG_RQ_GLOBAL_ExtEth_ST3
        SDU_DIAG_RBTM_FL_03_ExtCAN_RQ_BODY3_ST3_ec0e6e12_Rx: DynamicLength=true, PduLength=4095, variation-point=post-build-variant-condition{matching-criterion=Side, value=0}
        DIAG_RBTM_FL_03_ExtCAN_RQ_ST3_3f957a34_Rx: DynamicLength=false, PduLength=8, SysTPduToFrameMappingRef=DIAG_RBTM_FL_03_ExtCAN_RQ_ST3, variation-point=post-build-variant-condition{matching-criterion=Side, value=0}
        SDU_DIAG_RBTM_FL_03_IntEth_RQ_BODY3_ST3_1e46a9f5_Rx: DynamicLength=true, PduLength=4095, variation-point=post-build-variant-condition{matching-criterion=Side, value=0}
        SDU_DIAG_GLOBAL_ExtEth_RQ_BODY3_ST3_81f0b7e5_Rx: DynamicLength=true, PduLength=7
        SDU_DIAG_GLOBAL_IntEth_RQ_BODY3_ST3_41e6471f_Rx: DynamicLength=true, PduLength=7
        SDU_DIAG_RBTM_FL_03_ExtEth_RQ_BODY3_ST3_75192bc2_Rx: DynamicLength=true, PduLength=4095, variation-point=post-build-variant-condition{matching-criterion=Side, value=0}
        SDU_DIAG_RBTM_FL_03_ExtEth_RS_BODY3_ST3_2d759203_Tx: DynamicLength=true, PduLength=4095, variation-point=post-build-variant-condition{matching-criterion=Side, value=0}
        SDU_DIAG_RBTM_FL_03_IntEth_RQ_BODY3_ST3_b50fdb38_Rx: DynamicLength=true, PduLength=4095, variation-point=post-build-variant-condition{matching-criterion=Side, value=0}
        SDU_DIAG_RBTM_FL_03_IntEth_RS_BODY3_ST3_ed6362f9_Tx: DynamicLength=true, PduLength=4095, variation-point=post-build-variant-condition{matching-criterion=Side, value=0}
        RBTM_FL_Tens_ST3_553ec607_Tx: DynamicLength=false, PduLength=8, variation-point=post-build-variant-condition{matching-criterion=Side, value=0}
        SBeltTens_SP_Lvl_ST3_46421e11_Rx: DynamicLength=false, PduLength=8
        DIAG_RBTM_FR_03_ExtEth_RQ_ST3_935b3bbf_Rx: DynamicLength=false, PduLength=8, SysTPduToFrameMappingRef=DIAG_RBTM_FR_03_ExtEth_RQ_ST3, variation-point=post-build-variant-condition{matching-criterion=Side, value=1}
        DIAG_RBTM_FR_03_ExtCAN_RQ_ST3_225f4e6d_Rx: DynamicLength=false, PduLength=8, SysTPduToFrameMappingRef=DIAG_RBTM_FR_03_ExtCAN_RQ_ST3, variation-point=post-build-variant-condition{matching-criterion=Side, value=1}
        SDU_DIAG_RBTM_FR_03_ExtCAN_RS_BODY3_ST3_e09767bb_Tx: DynamicLength=true, PduLength=4095, variation-point=post-build-variant-condition{matching-criterion=Side, value=1}
        DIAG_RBTM_FR_03_ExtCAN_RS_ST3_a7a76ca2_Tx: DynamicLength=false, PduLength=8, SysTPduToFrameMappingRef=DIAG_RBTM_FR_03_ExtCAN_RS_ST3, variation-point=post-build-variant-condition{matching-criterion=Side, value=1}
        DIAG_RBTM_FR_03_ExtEth_RS_ST3_16a31970_Tx: DynamicLength=false, PduLength=8, SysTPduToFrameMappingRef=DIAG_RBTM_FR_03_ExtEth_RS_ST3, variation-point=post-build-variant-condition{matching-criterion=Side, value=1}
        SDU_DIAG_RBTM_FR_03_IntEth_RS_BODY3_ST3_93fbe7eb_Tx: DynamicLength=true, PduLength=4095, variation-point=post-build-variant-condition{matching-criterion=Side, value=1}
        SDU_DIAG_RBTM_FR_03_ExtEth_RQ_BODY3_ST3_3a3e8176_Rx: DynamicLength=true, PduLength=4095, variation-point=post-build-variant-condition{matching-criterion=Side, value=1}
        SDU_DIAG_RBTM_FR_03_ExtCAN_RS_BODY3_ST3_a939c600_Tx: DynamicLength=true, PduLength=4095, variation-point=post-build-variant-condition{matching-criterion=Side, value=1}
        SDU_DIAG_RBTM_FR_03_ExtCAN_RQ_BODY3_ST3_1f04509d_Rx: DynamicLength=true, PduLength=4095, variation-point=post-build-variant-condition{matching-criterion=Side, value=1}
        SDU_DIAG_RBTM_FR_03_ExtEth_RQ_BODY3_ST3_68423a11_Rx: DynamicLength=true, PduLength=4095, variation-point=post-build-variant-condition{matching-criterion=Side, value=1}
        SDU_DIAG_RBTM_FR_03_IntEth_RQ_BODY3_ST3_a854caeb_Rx: DynamicLength=true, PduLength=4095, variation-point=post-build-variant-condition{matching-criterion=Side, value=1}
        DIAG_RBTM_FR_03_IntEth_RS_ST3_5bd85eab_Tx: DynamicLength=false, PduLength=8, SysTPduToFrameMappingRef=DIAG_RBTM_FR_03_IntEth_RS_ST3, variation-point=post-build-variant-condition{matching-criterion=Side, value=1}
        DIAG_RBTM_FR_03_IntEth_RQ_ST3_de207c64_Rx: DynamicLength=false, PduLength=8, SysTPduToFrameMappingRef=DIAG_RBTM_FR_03_IntEth_RQ_ST3, variation-point=post-build-variant-condition{matching-criterion=Side, value=1}
        SDU_DIAG_RBTM_FR_03_IntEth_RS_BODY3_ST3_f038732a_Tx: DynamicLength=true, PduLength=4095, variation-point=post-build-variant-condition{matching-criterion=Side, value=1}
        SDU_DIAG_RBTM_FR_03_IntEth_RQ_BODY3_ST3_6c68d0cd_Rx: DynamicLength=true, PduLength=4095, variation-point=post-build-variant-condition{matching-criterion=Side, value=1}
        SDU_DIAG_RBTM_FR_03_ExtEth_RS_BODY3_ST3_c5adb650_Tx: DynamicLength=true, PduLength=4095, variation-point=post-build-variant-condition{matching-criterion=Side, value=1}
        SDU_DIAG_RBTM_FR_03_ExtCAN_RQ_BODY3_ST3_f1557fc1_Rx: DynamicLength=true, PduLength=4095, variation-point=post-build-variant-condition{matching-criterion=Side, value=1}
        SDU_DIAG_RBTM_FR_03_ExtEth_RS_BODY3_ST3_302e83d0_Tx: DynamicLength=true, PduLength=4095, variation-point=post-build-variant-condition{matching-criterion=Side, value=1}
        RBTM_FR_Tens_ST3_6c59775c_Tx: DynamicLength=false, PduLength=8, variation-point=post-build-variant-condition{matching-criterion=Side, value=1}
    EcucGeneral:
      CPUType = CPU32Bit
      SizeOfInt = Size32Bit
      ByteOrder = LITTLE_ENDIAN
      BitOrder = LSB_to_MSB
      AtomicBitAccessInBitfield = false
      AtomicVariableAccess = Atomic32BitAccess
      SizeOfEnum = Size32Bit
      SizeOfROMPointer = Size32Bit
      SizeOfRAMPointer = Size32Bit
      BitFieldDataType = INT
      StructAlignment = Auto
      ArrayAlignment = Align8Bit
      StructInArrayAlignment = Auto
      DummyFunction = false
      DummyStatement = true
      DummyStatementKind = None
      ConditionalGenerating = true
      EcucBswImplementationCodeType = EcuCSourceCode
      EcuCUseStdReturnTypeForRte = false
      PostbuildLoadable: AlignmentFillPattern=255, PBROMStartAddress=0, PBRAMStartAddress=0, PBROMEndAddress=0, PBRAMEndAddress=0
      BswInitialization
        44 x InitFunction:
          Can_Init: Header=Can.h, InitPhase=INIT_TWO_DRV, ConfigType=Can_ConfigType, ConfigPtrName=Can_Config_RBTM_FL_Ptr if post-build-variant-condition{matching-criterion=Side, value=0}, ConfigPtrClass=CAN_INIT_DATA, ConfigPtrName=Can_Config_RBTM_FR_Ptr if post-build-variant-condition{matching-criterion=Side, value=1}, ModuleRef=Can  # /ActiveEcuC/Can PLAIN_TEXT Init function description of Can in PostBuildPredefinedVariantView (RBTM_FL) .
          Can_InitMemory: Header=Can.h, InitPhase=INIT_MEMORY, ModuleRef=Can  # /ActiveEcuC/Can PLAIN_TEXT InitMemory function description of Can in UnfilteredViewInInvariantProject (UnfilteredInvariantProjectModelView) .
          CanIf_Init: Header=CanIf.h, InitPhase=INIT_TWO_IF, ConfigType=CanIf_ConfigType, ConfigPtrName=CanIf_Config_RBTM_FL_Ptr if post-build-variant-condition{matching-criterion=Side, value=0}, ConfigPtrClass=CANIF_INIT_DATA, ConfigPtrName=CanIf_Config_RBTM_FR_Ptr if post-build-variant-condition{matching-criterion=Side, value=1}, ModuleRef=CanIf  # /ActiveEcuC/CanIf PLAIN_TEXT Init function description of CanIf in PostBuildPredefinedVariantView (RBTM_FL) .
          CanIf_InitMemory: Header=CanIf.h, InitPhase=INIT_MEMORY, ModuleRef=CanIf  # /ActiveEcuC/CanIf PLAIN_TEXT InitMemory function description of CanIf in UnfilteredViewInInvariantProject (UnfilteredInvariantProjectModelView) .
          CanSM_Init: Header=CanSM_EcuM.h, InitPhase=INIT_TWO_SM, ConfigType=CanSM_ConfigType, ConfigPtrName=CanSM_Config_RBTM_FL_Ptr if post-build-variant-condition{matching-criterion=Side, value=0}, ConfigPtrClass=CANSM_INIT_DATA, ConfigPtrName=CanSM_Config_RBTM_FR_Ptr if post-build-variant-condition{matching-criterion=Side, value=1}, ModuleRef=CanSM  # /ActiveEcuC/CanSM PLAIN_TEXT Init function description of CanSM in PostBuildPredefinedVariantView (RBTM_FL) .
          CanSM_InitMemory: Header=CanSM_EcuM.h, InitPhase=INIT_MEMORY, ModuleRef=CanSM  # /ActiveEcuC/CanSM PLAIN_TEXT InitMemory function description of CanSM in UnfilteredViewInInvariantProject (UnfilteredInvariantProjectModelView) .
          CanTp_Init: Header=CanTp.h, InitPhase=INIT_TWO_TP, ConfigType=CanTp_ConfigType, ConfigPtrName=CanTp_Config_RBTM_FL_Ptr if post-build-variant-condition{matching-criterion=Side, value=0}, ConfigPtrClass=CANTP_INIT_DATA, ConfigPtrName=CanTp_Config_RBTM_FR_Ptr if post-build-variant-condition{matching-criterion=Side, value=1}, ModuleRef=CanTp  # /ActiveEcuC/CanTp PLAIN_TEXT Init function description of CanTp in PostBuildPredefinedVariantView (RBTM_FL) .
          CanTp_InitMemory: Header=CanTp.h, InitPhase=INIT_MEMORY, ModuleRef=CanTp  # /ActiveEcuC/CanTp PLAIN_TEXT InitMemory function description of CanTp in UnfilteredViewInInvariantProject (UnfilteredInvariantProjectModelView) .
          ComM_InitMemory: Header=ComM.h, InitPhase=INIT_MEMORY, ModuleRef=ComM  # /ActiveEcuC/ComM PLAIN_TEXT Initializes variables of Communication Manager
          ComM_Init: Header=ComM.h, InitPhase=INIT_TWO_POST_NVMREADALL, ConfigType=ComM_ConfigType, ConfigPtrName=ComM_Config_RBTM_FL_Ptr if post-build-variant-condition{matching-criterion=Side, value=0}, ConfigPtrClass=COMM_INIT_DATA, ConfigPtrName=ComM_Config_RBTM_FR_Ptr if post-build-variant-condition{matching-criterion=Side, value=1}, ModuleRef=ComM  # /ActiveEcuC/ComM PLAIN_TEXT Init function description of ComM in PostBuildPredefinedVariantView (RBTM_FL) .
          CryIf_Init: Header=CryIf.h, InitPhase=INIT_TWO_IF, ModuleRef=CryIf  # /ActiveEcuC/CryIf PLAIN_TEXT Initializes the Crypto Interface
          CryIf_InitMemory: Header=CryIf.h, InitPhase=INIT_MEMORY, ModuleRef=CryIf  # /ActiveEcuC/CryIf PLAIN_TEXT Initializes variables of the Crypto Interface
          Csm_InitMemory: Header=Csm.h, InitPhase=INIT_MEMORY, ModuleRef=Csm  # /ActiveEcuC/Csm PLAIN_TEXT Initializes variables of the Crypto Service Manager
          Csm_Init: Header=Csm.h, InitPhase=INIT_TWO_SYS, ModuleRef=Csm  # /ActiveEcuC/Csm PLAIN_TEXT Initializes the Crypto Service Manager
          FblCw_Init: Header=fbl_inc.h, InitPhase=INIT_THREE, ConfigType=FblCw_ConfigType, ConfigPtrName=FblCw_Config_RBTM_FL_Ptr if post-build-variant-condition{matching-criterion=Side, value=0}, ConfigPtrClass=FBLCW_INIT_DATA, ConfigPtrName=FblCw_Config_RBTM_FR_Ptr if post-build-variant-condition{matching-criterion=Side, value=1}, ModuleRef=Dcm  # /ActiveEcuC/Dcm PLAIN_TEXT Init function description of FblCw in PostBuildPredefinedVariantView (RBTM_FL) .
          FblCw_InitMemory: Header=fbl_inc.h, InitPhase=INIT_MEMORY, ModuleRef=Dcm  # /ActiveEcuC/Dcm PLAIN_TEXT InitMemory function description of FblCw in UnfilteredViewInInvariantProject (UnfilteredInvariantProjectModelView) .
          Det_Init: Header=Det.h, InitPhase=INIT_ZERO, ConfigType=Det_ConfigType, ConfigPtrName=Det_Config_Ptr, ConfigPtrClass=DET_INIT_DATA, ModuleRef=Det  # /ActiveEcuC/Det PLAIN_TEXT Init function description of Det in UnfilteredViewInInvariantProject (UnfilteredInvariantProjectModelView) .
          Det_InitMemory: Header=Det.h, InitPhase=INIT_MEMORY, ModuleRef=Det  # /ActiveEcuC/Det PLAIN_TEXT InitMemory function description of Det in UnfilteredViewInInvariantProject (UnfilteredInvariantProjectModelView) .
          PduR_InitMemory: Header=PduR.h, InitPhase=INIT_MEMORY, ModuleRef=PduR  # /ActiveEcuC/PduR PLAIN_TEXT InitMemory function description of PduR in UnfilteredViewInInvariantProject (UnfilteredInvariantProjectModelView) .
          PduR_Init: Header=PduR.h, InitPhase=INIT_TWO_COM, ConfigType=PduR_PBConfigType, ConfigPtrName=PduR_Config_RBTM_FL_Ptr if post-build-variant-condition{matching-criterion=Side, value=0}, ConfigPtrClass=PDUR_INIT_DATA, ConfigPtrName=PduR_Config_RBTM_FR_Ptr if post-build-variant-condition{matching-criterion=Side, value=1}, ModuleRef=PduR  # /ActiveEcuC/PduR PLAIN_TEXT Init function description of PduR in PostBuildPredefinedVariantView (RBTM_FL) .
          PduR_PreInit: Header=PduR.h, InitPhase=INIT_ONE, ConfigType=PduR_PBConfigType, ConfigPtrName=PduR_Config_RBTM_FL_Ptr if post-build-variant-condition{matching-criterion=Side, value=0}, ConfigPtrClass=PDUR_INIT_DATA, ConfigPtrName=PduR_Config_RBTM_FR_Ptr if post-build-variant-condition{matching-criterion=Side, value=1}, ModuleRef=PduR  # /ActiveEcuC/PduR PLAIN_TEXT PreInit function description of PduR in PostBuildPredefinedVariantView (RBTM_FL) .
          Mcu_Init: Header=Mcu.h, InitPhase=INIT_ONE_EARLY, ConfigType=Mcu_ConfigType, ConfigPtrName=&Mcu_Config, ConfigPtrClass=AUTOMATIC, AdditionalInitCode=Mcu_InitClock(0);while (MCU_PLL_LOCKED != Mcu_GetPllStatus());Mcu_DistributePllClock();, ModuleRef=Mcu  # /Mcu/Mcu PLAIN_TEXT Created Mcu_Init by Extended Init XML Service
          Crypto_30_LibCv_InitMemory: Header=Crypto_30_LibCv.h, InitPhase=INIT_MEMORY, ModuleRef=Crypto  # /ActiveEcuC/Crypto PLAIN_TEXT Initializes variables of the Crypto Driver
          Crypto_30_LibCv_Init: Header=Crypto_30_LibCv.h, InitPhase=INIT_TWO_DRV, ModuleRef=Crypto  # /ActiveEcuC/Crypto PLAIN_TEXT Initializes the Crypto Driver
          vBaseEnv_Init: Header=, InitPhase=NO_INIT, ModuleRef=vBaseEnv  # /ActiveEcuC/vBaseEnv PLAIN_TEXT Created vBaseEnv_Init by Extended Init XML Service
          vLinkGen_Init: Header=vLinkGen_Lcfg.h, InitPhase=NO_INIT, ModuleRef=vLinkGen  # /ActiveEcuC/vLinkGen PLAIN_TEXT Dummy initialization of the vLinkGen
          McalLib_Init: Header=McalLib.h, InitPhase=NO_INIT, ModuleRef=McalLib  # /McalLib/McalLib PLAIN_TEXT Created McalLib_Init by Extended Init XML Service
          Port_Init: Header=Port.h, InitPhase=INIT_ONE_EARLY, ConfigType=Port_ConfigType, ConfigPtrName=&Port_Config, ConfigPtrClass=AUTOMATIC, ModuleRef=Port  # /Port/Port PLAIN_TEXT Created Port_Init by Extended Init XML Service
          Dio_Init: Header=Dio.h, InitPhase=NO_INIT, ModuleRef=Dio  # /Dio/Dio PLAIN_TEXT Created Dio_Init by Extended Init XML Service
          Crypto_30_vHsm_Init: Header=Crypto_30_vHsm.h, InitPhase=INIT_TWO_DRV, ModuleRef=Crypto_vHsm  # /ActiveEcuC/Crypto_vHsm PLAIN_TEXT Initializes the Crypto Driver
          Crypto_30_vHsm_InitMemory: Header=Crypto_30_vHsm.h, InitPhase=INIT_MEMORY, ModuleRef=Crypto_vHsm  # /ActiveEcuC/Crypto_vHsm PLAIN_TEXT Initializes variables of the Crypto Interface
          vMemAccM_InitMemory: Header=vMemAccM.h, InitPhase=INIT_MEMORY, ModuleRef=vMemAccM  # /ActiveEcuC/vMemAccM PLAIN_TEXT Initializes all *_INIT_* section variables within the vMemAccM.
          vMemAccM_Init: Header=vMemAccM.h, InitPhase=INIT_TWO_DRV, ModuleRef=vMemAccM  # /ActiveEcuC/vMemAccM PLAIN_TEXT Initializes the vMemAccM.
          Brs_Init: Header=, InitPhase=NO_INIT, ModuleRef=vBRS  # /ActiveEcuC/vBRS PLAIN_TEXT Automatically generated by EcuCBswInitFctConfigurationService.
          WrapNv_Init: Header=WrapNv.h, InitPhase=INIT_TWO_SYS, ModuleRef=WrapNv  # /ActiveEcuC/WrapNv PLAIN_TEXT WrapNv_Init function description
          Fls_17_Dmu_Init: Header=Fls_17_Dmu.h, InitPhase=INIT_ONE, ConfigType=Fls_17_Dmu_ConfigType, ConfigPtrName=&Fls_17_Dmu_Config, ConfigPtrClass=AUTOMATIC, ModuleRef=Fls  # /Fls/Fls PLAIN_TEXT Created Fls_17_Dmu_Init by Extended Init XML Service
          ComM_PreInit: Header=ComM.h, ConfigType=ComM_ConfigType, ConfigPtrClass=COMM_INIT_DATA, ConfigPtrName=ComM_Config_RBTM_FL_Ptr if post-build-variant-condition{matching-criterion=Side, value=0}, InitPhase=INIT_ONE, ConfigPtrName=ComM_Config_RBTM_FR_Ptr if post-build-variant-condition{matching-criterion=Side, value=1}, ModuleRef=ComM  # /ActiveEcuC/ComM PLAIN_TEXT PreInit function description of ComM in PostBuildPredefinedVariantView (RBTM_FL) .
          ComM_PostInit: Header=ComM.h, InitPhase=INIT_THREE, ModuleRef=ComM  # /ActiveEcuC/ComM PLAIN_TEXT Post-Initialization of the ComM and its internal state machine
          Dma_Init: Header=Dma.h, InitPhase=INIT_ONE, ConfigType=Dma_ConfigType, ConfigPtrName=&Dma_Config, ConfigPtrClass=AUTOMATIC, ModuleRef=Dma  # /ActiveEcuC/Dma PLAIN_TEXT Created Dma_Init by Extended Init XML Service
          Spi_Init: Header=Spi.h, ConfigType=Spi_ConfigType, ConfigPtrClass=AUTOMATIC, ConfigPtrName=&Spi_Config, InitPhase=INIT_ONE, ModuleRef=Spi  # /ActiveEcuC/Spi PLAIN_TEXT Created Spi_Init by Extended Init XML Service
          ResourceM_Init: Header=ResourceM.h, InitPhase=NO_INIT, ModuleRef=ResourceM  # /ResourceM/ResourceM PLAIN_TEXT Created ResourceM_Init by Extended Init XML Service
          SecM_Init: Header=Sec.h, InitPhase=INIT_TWO_SYS, ModuleRef=Smh  # /ActiveEcuC/Smh PLAIN_TEXT SecM_Init function description
          Fee_Init: Header=Fee.h, InitPhase=INIT_ONE_LATE, ConfigType=Fee_ConfigType, ConfigPtrClass=AUTOMATIC, ConfigPtrName=&Fee_Config, ModuleRef=Fee, variation-point=post-build-variant-condition{matching-criterion=Side, value=0}  # /ActiveEcuC/Fee PLAIN_TEXT Created Fee_Init by Extended Init XML Service
          Fee_Init: Header=Fee.h, ConfigType=Fee_ConfigType, ConfigPtrClass=AUTOMATIC, InitPhase=INIT_ONE_LATE, ConfigPtrName=&Fee_Config, ModuleRef=Fee, variation-point=post-build-variant-condition{matching-criterion=Side, value=1}  # /ActiveEcuC/Fee PLAIN_TEXT Created Fee_Init by Extended Init XML Service
    EcucHardware
      EcucCoreDefinition: EcucCoreId=0
