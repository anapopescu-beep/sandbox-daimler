AUTOSAR XML (schema 00048)
package /MICROSAR
  5 x bsw implementation, all with programming-language=C, vendor-id=30:
    CanIf_Impl: sw-version=8.04.00, used-code-generator=cMSR, ar-release-version=4.00.03, behavior=CanIf_Behavior
    CanSM_Impl: sw-version=4.00.00, used-code-generator=DaVinci Configurator, ar-release-version=4.00.03, behavior=CanSMBehavior
    CanTp_Impl: sw-version=5.00.00, used-code-generator=DaVinci Configurator, ar-release-version=4.00.03, behavior=CanTpBehavior
    ComM_Impl: sw-version=15.00.01, used-code-generator=DaVinci Configurator, ar-release-version=4.00.03, behavior=ComMBehavior
    PduR_Impl: sw-version=17.02.00, used-code-generator=DaVinci Configurator, ar-release-version=4.01.02, behavior=PduRBehavior
package /MICROSAR/CanIf_ib_bswmd/BswModuleDescriptions
  bsw module description CanIf
    bsw internal behavior CanIf_Behavior
      8 x exclusive area:
        CANIF_EXCLUSIVE_AREA_{0..7}
package /MICROSAR/CanSM_ib_bswmd/BswModuleDescriptions
  bsw module description CanSM
    bsw internal behavior CanSMBehavior
      6 x exclusive area:
        CANSM_EXCLUSIVE_AREA_{1..6}
      bsw schedulable entity CanSM_MainFunction: implemented-entry=CanSM_MainFunction
      bsw timing event CanSM_MainFunctionTimingEvent0: starts-on-event=CanSM_MainFunction, period=0.005
  bsw module entry CanSM_MainFunction: call-type=SCHEDULED, execution-context=TASK
package /MICROSAR/CanTp_ib_bswmd/BswModuleDescriptions
  bsw module description CanTp
    bsw internal behavior CanTpBehavior
      exclusive area CANTP_EXCLUSIVE_AREA_0
      bsw schedulable entity CanTp_MainFunction: implemented-entry=CanTp_MainFunction
      bsw timing event CanTp_MainFunctionTimingEvent0: starts-on-event=CanTp_MainFunction, period=0.005
  bsw module entry CanTp_MainFunction: call-type=SCHEDULED, execution-context=TASK
package /MICROSAR/ComM_ib_bswmd/BswModuleDescriptions
  bsw module description ComM
    bsw internal behavior ComMBehavior
      8 x exclusive area:
        COMM_EXCLUSIVE_AREA_0
        COMM_EXCLUSIVE_AREA_1
        COMM_EXCLUSIVE_AREA_{2..7}  # This exclusive area is only used in case of multi-partition. It must be configured as a spinlock to allow access to some variables simultaneously from multiple cores.
      bsw schedulable entity ComM_MainFunction_0: implemented-entry=ComM_MainFunction_0
      bsw schedulable entity ComM_MainFunction_1: implemented-entry=ComM_MainFunction_1
      bsw timing event ComM_MainFunction_0TimingEvent0: starts-on-event=ComM_MainFunction_0, period=0.005
      bsw timing event ComM_MainFunction_1TimingEvent0: starts-on-event=ComM_MainFunction_1, period=0.005
  bsw module entry ComM_MainFunction_1: call-type=SCHEDULED, execution-context=TASK
  bsw module entry ComM_MainFunction_0: call-type=SCHEDULED, execution-context=TASK
package /MICROSAR/PduR_ib_bswmd/BswModuleDescriptions
  bsw module description PduR
    bsw internal behavior PduRBehavior
      exclusive area PDUR_EXCLUSIVE_AREA_0
package /MICROSARFBL
  bsw implementation Dcm_Impl: programming-language=C, sw-version=8.03.00, used-code-generator=DaVinci Configurator, vendor-id=30, ar-release-version=4.00.03, behavior=DcmBehavior
package /MICROSARFBL/Dcm_ib_bswmd/BswModuleDescriptions
  bsw module description Dcm
    bsw internal behavior DcmBehavior
