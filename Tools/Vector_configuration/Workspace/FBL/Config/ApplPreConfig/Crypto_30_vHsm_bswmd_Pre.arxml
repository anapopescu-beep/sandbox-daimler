AUTOSAR XML (schema 4-0-3)
package /MICROSAR/Crypto_30_vHsm
  module config Crypto_Pre: definition=Crypto  # Software Crypto Driver pre-configuration
    CryptoKeys
      64 x CryptoKey, all with CryptoKeyDeriveIterations=1:
        vHsm_Hardware: CryptoKeyId=59, CryptoKeyTypeRef=vHsm_Hal_Hardware
        vHsm_SecureBoot_Signature: CryptoKeyId=67, CryptoKeyTypeRef=Crypto_30_LibCv_Signature_SecureBootUpdate
        vHsm_LazyPersistKey: CryptoKeyId=62, CryptoKeyTypeRef=Crypto_30_LibCv_LazyPersistKey
        vHsm_FirmwareUpdate_Signature: CryptoKeyId=58, CryptoKeyTypeRef=Crypto_30_LibCv_Signature
        vHsm_Custom: CryptoKeyId=54, CryptoKeyTypeRef=Crypto_30_LibCv_Cipher
        vHsm_Info_SecureBoot: CryptoKeyId=61, CryptoKeyTypeRef=vHsm_Core_vHsmSecureBootGroupInfo_Type
        KeyM_Cert_Root: CryptoKeyId=5, CryptoKeyTypeRef=Crypto_30_LibCv_KeyType_KeyM_CertificateData
        KeyM_Cert_Intermediate: CryptoKeyId=4, CryptoKeyTypeRef=Crypto_30_LibCv_KeyType_KeyM_CertificateData
        KeyM_ECC_Root: CryptoKeyId=7, CryptoKeyTypeRef=Crypto_30_LibCv_Signature
        KeyM_ECC_Intermediate: CryptoKeyId=6, CryptoKeyTypeRef=Crypto_30_LibCv_Signature
        vHsm_RomKey0: CryptoKeyId=64, CryptoKeyTypeRef=vHsm_Hal_RomKeyType
        vHsm_Aggregated_RomKey0: CryptoKeyId=52, CryptoKeyTypeRef=Crypto_30_LibCv_Cipher_OnlyIV
        vHsm_Aggregated_RomKey1: CryptoKeyId=53, CryptoKeyTypeRef=Crypto_30_LibCv_Cipher_OnlyIV
        KeyMCertificate_OSSL_X509_ECDSA_P384_IA: CryptoKeyId=3, CryptoKeyTypeRef=Crypto_30_KeyM_KeyType_KeyM_Certificate
        vHsm_Log: CryptoKeyId=63, CryptoKeyTypeRef=vHsm_Core_vHsmLog_Type
        vHsm_RomKey1: CryptoKeyId=65, CryptoKeyTypeRef=vHsm_Hal_RomKeyType
        KeyMCertificate_OSSL_X509_ECDSA_P384_CA: CryptoKeyId=2, CryptoKeyTypeRef=Crypto_30_KeyM_KeyType_KeyM_Certificate
        Ssa_RandomSeed: CryptoKeyId=43, CryptoKeyTypeRef=Crypto_30_LibCv_Ssa_Random_Nist_800_90A_DRBG_AES_DF
        Ssa_SecurityAccessPublicKey: CryptoKeyId=46, CryptoKeyTypeRef=Crypto_30_LibCv_Ssa_SecurityAccessPublicKey
        Ssa_EcuCert: CryptoKeyId=37, CryptoKeyTypeRef=Crypto_30_LibCv_Ssa_EcuCert
        Ssa_SharedSecretExchangeKey: CryptoKeyId=47, CryptoKeyTypeRef=Crypto_30_LibCv_KeyExchange_X25519
        Ssa_SharedSecretHash: CryptoKeyId=48, CryptoKeyTypeRef=Crypto_30_LibCv_Ssa_SharedSecretHash
        Ssa_BackendCert: CryptoKeyId=36, CryptoKeyTypeRef=Crypto_30_LibCv_Ssa_BackEndCert
        Ssa_AesRamKey: CryptoKeyId=34, CryptoKeyTypeRef=Crypto_30_LibCv_Ssa_Cipher
        Ssa_RootCert: CryptoKeyId=45, CryptoKeyTypeRef=Crypto_30_LibCv_Ssa_RootCert
        KeyM_SigVerifyKey_TrustModelEcu: CryptoKeyId=10, CryptoKeyTypeRef=Crypto_30_LibCv_Signature_TrustModelEcu
        Ssa_RealTime: CryptoKeyId=44, CryptoKeyTypeRef=Crypto_30_LibCv_Ssa_Mac
        SSA_SecOC_Int_MacVerify_Ign_Stat: CryptoKeyId=21, CryptoKeyTypeRef=Crypto_30_LibCv_Ssa_Mac
        Ssa_SignatureRamKey: CryptoKeyId=49, CryptoKeyTypeRef=Crypto_30_LibCv_Signature
        SSA_SecOC_Int_MacVerify_VehSpd_8: CryptoKeyId=24, CryptoKeyTypeRef=Crypto_30_LibCv_Ssa_Mac
        SSA_SecOC_Int_MacVerify_PN14_Master_Stat1: CryptoKeyId=22, CryptoKeyTypeRef=Crypto_30_LibCv_Ssa_Mac
        KeyM_SigVerifyKey_TrustModelRoot: CryptoKeyId=14, CryptoKeyTypeRef=Crypto_30_LibCv_Signature
        SSA_SecOC_Int_MacVerify_DI_OdoSpeedometer: CryptoKeyId=20, CryptoKeyTypeRef=Crypto_30_LibCv_Ssa_Mac
        KeyM_SigVerifyKey_TrustModelIntermediate: CryptoKeyId=12, CryptoKeyTypeRef=Crypto_30_LibCv_Signature
        Ssa_VIN: CryptoKeyId=51, CryptoKeyTypeRef=Crypto_30_LibCv_Ssa_Mac
        Ssa_Authentication: CryptoKeyId=35, CryptoKeyTypeRef=Crypto_30_LibCv_Ssa_Mac
        KeyM_SigVerifyKey_TrustModelBackend: CryptoKeyId=8, CryptoKeyTypeRef=Crypto_30_LibCv_Signature
        Ssa_TickCount: CryptoKeyId=50, CryptoKeyTypeRef=Crypto_30_LibCv_Ssa_Mac
        SSA_SecOC_Int_MacVerify_PT4_PTCoor4: CryptoKeyId=23, CryptoKeyTypeRef=Crypto_30_LibCv_Ssa_Mac
        vHsm_Info: CryptoKeyId=60, CryptoKeyTypeRef=vHsm_Core_vHsmInfo_Type
        Diagnostic_Root_Cert_Test: CryptoKeyId=1, CryptoKeyTypeRef=Crypto_30_LibCv_Diagnostic_Root_Cert_Test
        Diagnostic_Backend_Cert_Test: CryptoKeyId=0, CryptoKeyTypeRef=Crypto_30_LibCv_Diagnostic_Backend_Cert_Test
        SecureBoot_Group_Appl_2: CryptoKeyId=27, CryptoKeyTypeRef=Crypto_30_LibCv_vHsm_SecureBootGroupDummy
        SecureBoot_Group_Appl_3: CryptoKeyId=28, CryptoKeyTypeRef=Crypto_30_LibCv_vHsm_SecureBootGroupDummy
        SecureBoot_Group_Fbl: CryptoKeyId=30, CryptoKeyTypeRef=Crypto_30_LibCv_vHsm_SecureBootGroup
        SecureBoot_WriteOnceKey: CryptoKeyId=33, CryptoKeyTypeRef=Crypto_30_LibCv_SecureBoot_WriteOnceKey
        SecureBoot_Group_Appl_0: CryptoKeyId=25, CryptoKeyTypeRef=Crypto_30_LibCv_vHsm_SecureBootGroupDummy
        SecureBoot_Group_Appl_4: CryptoKeyId=29, CryptoKeyTypeRef=Crypto_30_LibCv_vHsm_SecureBootGroupDummy
        SecureBoot_Group_Appl_1: CryptoKeyId=26, CryptoKeyTypeRef=Crypto_30_LibCv_vHsm_SecureBootGroupDummy
        SecureBoot_VerifyKey: CryptoKeyId=32, CryptoKeyTypeRef=Crypto_30_LibCv_Signature
        Ssa_PduKeysMac: CryptoKeyId=38, CryptoKeyTypeRef=Crypto_30_LibCv_Ssa_MacKey
        Ssa_PrivateEcuKey: CryptoKeyId=39, CryptoKeyTypeRef=Crypto_30_LibCv_Ssa_TrustModelEcuPrivateKey
        SSA_SecOC_Int_MacGen_COM_C04_Pdu03_secured_044596e0_Tx: CryptoKeyId=15, CryptoKeyTypeRef=Crypto_30_LibCv_Ssa_Mac
        SSA_SecOC_Int_MacGen_COM_C04_Pdu20_secured_393d7a18_Tx: CryptoKeyId=16, CryptoKeyTypeRef=Crypto_30_LibCv_Ssa_Mac
        SSA_SecOC_Int_MacGen_COM_C04_Pdu21_secured_2e466e5b_Tx: CryptoKeyId=17, CryptoKeyTypeRef=Crypto_30_LibCv_Ssa_Mac
        SSA_SecOC_Int_MacVerify_COM_C0X_Pdu20_secured_3ef6961f_Rx: CryptoKeyId=18, CryptoKeyTypeRef=Crypto_30_LibCv_Ssa_Mac
        SSA_SecOC_Int_MacVerify_COM_C0X_Pdu21_secured_298d825c_Rx: CryptoKeyId=19, CryptoKeyTypeRef=Crypto_30_LibCv_Ssa_Mac
        KeyM_SigVerifyKey_TrustModelBackendPeer: CryptoKeyId=9, CryptoKeyTypeRef=Crypto_30_LibCv_Signature
        KeyM_SigVerifyKey_TrustModelEcuPeer: CryptoKeyId=11, CryptoKeyTypeRef=Crypto_30_LibCv_Signature
        KeyM_SigVerifyKey_TrustModelIntermediatePeer: CryptoKeyId=13, CryptoKeyTypeRef=Crypto_30_LibCv_Signature
        vHsm_TRNG: CryptoKeyId=68, CryptoKeyTypeRef=Crypto_30_LibCv_Random_Nist_800_90A_DRBG_AES_NoDF
        Ssa_PublicEcuKey: CryptoKeyId=41, CryptoKeyTypeRef=Crypto_30_LibCv_Ssa_TrustModelEcuPublicKey
        Ssa_PrivateEcuUniqueKey: CryptoKeyId=40, CryptoKeyTypeRef=Crypto_30_LibCv_Ssa_TrustModelEcuPrivateUniqueKey
        Ssa_PublicEcuKeyCsr: CryptoKeyId=42, CryptoKeyTypeRef=Crypto_30_LibCv_Ssa_TrustModelEcuPublicKeyCsr
    CryptoKeyTypes
      33 x CryptoKeyType:
        vHsm_Hal_Hardware: CryptoKeyElementRef=vHsm_Hal_FlashOperation_Sync
        Crypto_30_LibCv_Signature_SecureBootUpdate: CryptoKeyElementRef=Crypto_30_LibCv_Signature_Key_SecureBootUpdate_Sync
        Crypto_30_LibCv_LazyPersistKey: CryptoKeyElementRef=Crypto_30_LibCv_vHsm_LazyPersistKey_Sync
        Crypto_30_LibCv_Signature: CryptoKeyElementRef=Crypto_30_LibCv_Signature_Key_Sync
        Crypto_30_LibCv_Cipher: CryptoKeyElementRef=Crypto_30_LibCv_Cipher_Key_Sync, CryptoKeyElementRef=Crypto_30_LibCv_Cipher_IV_Sync, CryptoKeyElementRef=Crypto_30_LibCv_Cipher_Proof_Sync
        vHsm_Core_vHsmSecureBootGroupInfo_Type: CryptoKeyElementRef=vHsm_Core_vHsmSecureBootInfo_GroupState_Sync
        Crypto_30_LibCv_KeyType_KeyM_CertificateData: CryptoKeyElementRef=Crypto_30_LibCv_KeyM_CertificateData_Sync
        vHsm_Hal_RomKeyType: CryptoKeyElementRef=vHsm_Hal_RomKey_Sync
        Crypto_30_LibCv_Cipher_OnlyIV: CryptoKeyElementRef=Crypto_30_LibCv_Cipher_ConstIV_Sync
        Crypto_30_KeyM_KeyType_KeyM_Certificate: CryptoKeyElementRef=Crypto_30_KeyM_KeyM_Certificate_Sync, CryptoKeyElementRef=Crypto_30_KeyM_KeyM_GetStatus_Sync, CryptoKeyElementRef=Crypto_30_KeyM_KeyM_VerifyCertificate_Sync, CryptoKeyElementRef=Crypto_30_KeyM_KeyM_VerifyCertificates_Sync
        vHsm_Core_vHsmLog_Type: CryptoKeyElementRef=vHsm_Core_vHsmLog_EventId_Sync
        Crypto_30_LibCv_Ssa_Random_Nist_800_90A_DRBG_AES_DF: CryptoKeyElementRef=Crypto_30_LibCv_Random_Algorithm_Nist_800_90A_DRBG_AES128_DF_Sync, CryptoKeyElementRef=Crypto_30_LibCv_Random_Reseed_Counter_Sync, CryptoKeyElementRef=Crypto_30_LibCv_Random_Seed_Sync, CryptoKeyElementRef=Crypto_30_LibCv_Ssa_Random_Nonce_Sync, CryptoKeyElementRef=Crypto_30_LibCv_CryptoKeyElement_DummyWorkaround_RandomSeedSize_Sync
        Crypto_30_LibCv_Ssa_SecurityAccessPublicKey: CryptoKeyElementRef=Crypto_30_LibCv_Ssa_SecurityAccesPublicKey_Sync
        Crypto_30_LibCv_Ssa_EcuCert: CryptoKeyElementRef=Crypto_30_LibCv_Ssa_EcuCert_Sync
        Crypto_30_LibCv_KeyExchange_X25519: CryptoKeyElementRef=Crypto_30_LibCv_KeyExchange_Algorithm_X25519_Sync, CryptoKeyElementRef=Crypto_30_LibCv_KeyExchange_OwnPubKey_Sync, CryptoKeyElementRef=Crypto_30_LibCv_KeyExchange_Base_Sync, CryptoKeyElementRef=Crypto_30_LibCv_KeyExchange_PrivKey_Sync, CryptoKeyElementRef=Crypto_30_LibCv_KeyExchange_SharedValue_Sync
        Crypto_30_LibCv_Ssa_SharedSecretHash: CryptoKeyElementRef=Crypto_30_LibCv_Ssa_SharedSecretHash_Sync
        Crypto_30_LibCv_Ssa_BackEndCert: CryptoKeyElementRef=Crypto_30_LibCv_Ssa_BackendCert_Sync
        Crypto_30_LibCv_Ssa_Cipher: CryptoKeyElementRef=Crypto_30_LibCv_Ssa_Cipher_IV_Sync, CryptoKeyElementRef=Crypto_30_LibCv_Ssa_Cipher_Key_Sync
        Crypto_30_LibCv_Ssa_RootCert: CryptoKeyElementRef=Crypto_30_LibCv_Ssa_RootCert_Sync
        Crypto_30_LibCv_Signature_TrustModelEcu: CryptoKeyElementRef=Crypto_30_LibCv_Ssa_Signature_Key_TrustModelEcu_Sync
        Crypto_30_LibCv_Ssa_Mac: CryptoKeyElementRef=Crypto_30_LibCv_Ssa_Mac_Key_Sync, CryptoKeyElementRef=Crypto_30_LibCv_Ssa_Mac_Proof_Sync
        vHsm_Core_vHsmInfo_Type: CryptoKeyElementRef=vHsm_Core_vHsmInfo_Version_Sync, CryptoKeyElementRef=vHsm_Core_vHsmInfo_PerformPersist_Sync, CryptoKeyElementRef=vHsm_Core_vHsmInfo_PerformRepersist_Sync, CryptoKeyElementRef=vHsm_Core_vHsmInfo_StartFirmwareUpdater_Sync, CryptoKeyElementRef=vHsm_Core_vHsmInfo_SecureBootEnd_Sync, CryptoKeyElementRef=vHsm_Core_vHsmInfo_SecureBootResult_Sync
        Crypto_30_LibCv_Diagnostic_Root_Cert_Test: CryptoKeyElementRef=Crypto_30_LibCv_Diagnostic_Root_Cert_Test_Sync
        Crypto_30_LibCv_Diagnostic_Backend_Cert_Test: CryptoKeyElementRef=Crypto_30_LibCv_Diagnostic_Backend_Cert_Test_Sync
        Crypto_30_LibCv_vHsm_SecureBootGroupDummy: CryptoKeyElementRef=Crypto_30_LibCv_vHsm_SecureBoot_GroupDummy_Sync
        Crypto_30_LibCv_vHsm_SecureBootGroup: CryptoKeyElementRef=Crypto_30_LibCv_vHsm_SecureBoot_Key_Sync
        Crypto_30_LibCv_SecureBoot_WriteOnceKey: CryptoKeyElementRef=Crypto_30_LibCv_SecureBoot_WriteOnce_Sync
        Crypto_30_LibCv_Ssa_MacKey: CryptoKeyElementRef=Crypto_30_LibCv_Ssa_MacKey_Sync, CryptoKeyElementRef=Crypto_30_LibCv_Ssa_MacKey_Hash_Sync
        Crypto_30_LibCv_Ssa_TrustModelEcuPrivateKey: CryptoKeyElementRef=Crypto_30_LibCv_Ssa_TrustModelEcuPrivateKey_Sync
        Crypto_30_LibCv_Random_Nist_800_90A_DRBG_AES_NoDF: CryptoKeyElementRef=Crypto_30_LibCv_Random_Algorithm_Nist_800_90A_DRBG_AES128_Sync, CryptoKeyElementRef=Crypto_30_LibCv_Random_PrivateString_Sync, CryptoKeyElementRef=Crypto_30_LibCv_Random_Reseed_Counter_Sync, CryptoKeyElementRef=Crypto_30_LibCv_Random_Seed_Nist_800_90A_DRBG_AES128_Sync, CryptoKeyElementRef=Crypto_30_LibCv_Random_AdditionalInput_Sync
        Crypto_30_LibCv_Ssa_TrustModelEcuPublicKey: CryptoKeyElementRef=Crypto_30_LibCv_Ssa_TrustModelEcuPublicKey_Sync
        Crypto_30_LibCv_Ssa_TrustModelEcuPrivateUniqueKey: CryptoKeyElementRef=Crypto_30_LibCv_Ssa_TrustModelEcuPrivateUniqueKey_Sync
        Crypto_30_LibCv_Ssa_TrustModelEcuPublicKeyCsr: CryptoKeyElementRef=Crypto_30_LibCv_Ssa_TrustModelEcuPublicKeyCsr_Sync
    CryptoKeyElements
      57 x CryptoKeyElement:
        vHsm_Hal_FlashOperation_Sync: CryptoKeyElementAllowPartialAccess=FALSE, CryptoKeyElementPersist=FALSE, CryptoKeyElementId=3032, CryptoKeyElementSize=1, CryptoKeyElementReadAccess=RA_DENIED, CryptoKeyElementWriteAccess=WA_ALLOWED
        Crypto_30_LibCv_Signature_Key_SecureBootUpdate_Sync: CryptoKeyElementAllowPartialAccess=FALSE, CryptoKeyElementPersist=FALSE, CryptoKeyElementId=1, CryptoKeyElementSize=32, CryptoKeyElementReadAccess=RA_ALLOWED, CryptoKeyElementWriteAccess=WA_ALLOWED
        Crypto_30_LibCv_vHsm_LazyPersistKey_Sync: CryptoKeyElementAllowPartialAccess=FALSE, CryptoKeyElementPersist=TRUE, CryptoKeyElementId=1, CryptoKeyElementSize=16, CryptoKeyElementReadAccess=RA_ALLOWED, CryptoKeyElementWriteAccess=WA_ALLOWED
        Crypto_30_LibCv_Signature_Key_Sync: CryptoKeyElementAllowPartialAccess=FALSE, CryptoKeyElementPersist=FALSE, CryptoKeyElementId=1, CryptoKeyElementSize=32, CryptoKeyElementReadAccess=RA_ALLOWED, CryptoKeyElementWriteAccess=WA_ALLOWED
        Crypto_30_LibCv_Cipher_Key_Sync: CryptoKeyElementAllowPartialAccess=FALSE, CryptoKeyElementPersist=FALSE, CryptoKeyElementId=1, CryptoKeyElementSize=16, CryptoKeyElementReadAccess=RA_ALLOWED, CryptoKeyElementWriteAccess=WA_ALLOWED
        Crypto_30_LibCv_Cipher_IV_Sync: CryptoKeyElementAllowPartialAccess=FALSE, CryptoKeyElementPersist=FALSE, CryptoKeyElementId=5, CryptoKeyElementSize=16, CryptoKeyElementReadAccess=RA_ALLOWED, CryptoKeyElementWriteAccess=WA_ALLOWED
        Crypto_30_LibCv_Cipher_Proof_Sync: CryptoKeyElementAllowPartialAccess=FALSE, CryptoKeyElementPersist=FALSE, CryptoKeyElementId=6, CryptoKeyElementSize=48, CryptoKeyElementReadAccess=RA_ALLOWED, CryptoKeyElementWriteAccess=WA_ALLOWED
        vHsm_Core_vHsmSecureBootInfo_GroupState_Sync: CryptoKeyElementAllowPartialAccess=FALSE, CryptoKeyElementPersist=FALSE, CryptoKeyElementId=0, CryptoKeyElementSize=2, CryptoKeyElementReadAccess=RA_ALLOWED, CryptoKeyElementWriteAccess=WA_DENIED
        Crypto_30_LibCv_KeyM_CertificateData_Sync: CryptoKeyElementAllowPartialAccess=FALSE, CryptoKeyElementPersist=FALSE, CryptoKeyElementId=0, CryptoKeyElementSize=1500, CryptoKeyElementReadAccess=RA_ALLOWED, CryptoKeyElementWriteAccess=WA_ALLOWED
        vHsm_Hal_RomKey_Sync: CryptoKeyElementAllowPartialAccess=FALSE, CryptoKeyElementPersist=FALSE, CryptoKeyElementId=1, CryptoKeyElementSize=16, CryptoKeyElementReadAccess=RA_DENIED, CryptoKeyElementWriteAccess=WA_DENIED
        Crypto_30_LibCv_Cipher_ConstIV_Sync: CryptoKeyElementAllowPartialAccess=FALSE, CryptoKeyElementPersist=FALSE, CryptoKeyElementId=5, CryptoKeyElementSize=16, CryptoKeyElementReadAccess=RA_DENIED, CryptoKeyElementWriteAccess=WA_DENIED
        Crypto_30_KeyM_KeyM_Certificate_Sync: CryptoKeyElementAllowPartialAccess=TRUE, CryptoKeyElementPersist=FALSE, CryptoKeyElementId=3080, CryptoKeyElementSize=600, CryptoKeyElementReadAccess=RA_ALLOWED, CryptoKeyElementWriteAccess=WA_ALLOWED
        Crypto_30_KeyM_KeyM_GetStatus_Sync: CryptoKeyElementAllowPartialAccess=FALSE, CryptoKeyElementPersist=FALSE, CryptoKeyElementId=3081, CryptoKeyElementSize=1, CryptoKeyElementReadAccess=RA_ALLOWED, CryptoKeyElementWriteAccess=WA_DENIED
        Crypto_30_KeyM_KeyM_VerifyCertificate_Sync: CryptoKeyElementAllowPartialAccess=TRUE, CryptoKeyElementPersist=FALSE, CryptoKeyElementId=3082, CryptoKeyElementSize=1, CryptoKeyElementReadAccess=RA_DENIED, CryptoKeyElementWriteAccess=WA_ALLOWED
        Crypto_30_KeyM_KeyM_VerifyCertificates_Sync: CryptoKeyElementAllowPartialAccess=FALSE, CryptoKeyElementPersist=FALSE, CryptoKeyElementId=3083, CryptoKeyElementSize=2, CryptoKeyElementReadAccess=RA_DENIED, CryptoKeyElementWriteAccess=WA_ALLOWED
        vHsm_Core_vHsmLog_EventId_Sync: CryptoKeyElementAllowPartialAccess=FALSE, CryptoKeyElementPersist=FALSE, CryptoKeyElementId=0, CryptoKeyElementSize=1, CryptoKeyElementReadAccess=RA_ALLOWED, CryptoKeyElementWriteAccess=WA_DENIED
        Crypto_30_LibCv_Random_Algorithm_Nist_800_90A_DRBG_AES128_DF_Sync: CryptoKeyElementAllowPartialAccess=FALSE, CryptoKeyElementPersist=FALSE, CryptoKeyElementId=4, CryptoKeyElementSize=1, CryptoKeyElementReadAccess=RA_ALLOWED, CryptoKeyElementWriteAccess=WA_ALLOWED
        Crypto_30_LibCv_Random_Reseed_Counter_Sync: CryptoKeyElementAllowPartialAccess=FALSE, CryptoKeyElementPersist=TRUE, CryptoKeyElementId=3018, CryptoKeyElementSize=4, CryptoKeyElementReadAccess=RA_ALLOWED, CryptoKeyElementWriteAccess=WA_DENIED
        Crypto_30_LibCv_Random_Seed_Sync: CryptoKeyElementAllowPartialAccess=FALSE, CryptoKeyElementPersist=FALSE, CryptoKeyElementId=3, CryptoKeyElementSize=20, CryptoKeyElementReadAccess=RA_ALLOWED, CryptoKeyElementWriteAccess=WA_ALLOWED
        Crypto_30_LibCv_Ssa_Random_Nonce_Sync: CryptoKeyElementAllowPartialAccess=FALSE, CryptoKeyElementPersist=FALSE, CryptoKeyElementId=3017, CryptoKeyElementSize=16, CryptoKeyElementReadAccess=RA_ALLOWED, CryptoKeyElementWriteAccess=WA_ALLOWED
        Crypto_30_LibCv_CryptoKeyElement_DummyWorkaround_RandomSeedSize_Sync: CryptoKeyElementAllowPartialAccess=FALSE, CryptoKeyElementPersist=FALSE, CryptoKeyElementId=999, CryptoKeyElementSize=209, CryptoKeyElementReadAccess=RA_ALLOWED, CryptoKeyElementWriteAccess=WA_ALLOWED
        Crypto_30_LibCv_Ssa_SecurityAccesPublicKey_Sync: CryptoKeyElementAllowPartialAccess=FALSE, CryptoKeyElementPersist=TRUE, CryptoKeyElementId=1, CryptoKeyElementSize=32, CryptoKeyElementReadAccess=RA_ALLOWED, CryptoKeyElementWriteAccess=WA_ALLOWED
        Crypto_30_LibCv_Ssa_EcuCert_Sync: CryptoKeyElementAllowPartialAccess=TRUE, CryptoKeyElementPersist=TRUE, CryptoKeyElementId=0, CryptoKeyElementSize=600, CryptoKeyElementReadAccess=RA_ALLOWED, CryptoKeyElementWriteAccess=WA_ALLOWED
        Crypto_30_LibCv_KeyExchange_Algorithm_X25519_Sync: CryptoKeyElementAllowPartialAccess=FALSE, CryptoKeyElementPersist=FALSE, CryptoKeyElementId=12, CryptoKeyElementSize=1, CryptoKeyElementReadAccess=RA_ALLOWED, CryptoKeyElementWriteAccess=WA_ALLOWED
        Crypto_30_LibCv_KeyExchange_OwnPubKey_Sync: CryptoKeyElementAllowPartialAccess=FALSE, CryptoKeyElementPersist=FALSE, CryptoKeyElementId=10, CryptoKeyElementSize=32, CryptoKeyElementReadAccess=RA_ALLOWED, CryptoKeyElementWriteAccess=WA_ALLOWED
        Crypto_30_LibCv_KeyExchange_Base_Sync: CryptoKeyElementAllowPartialAccess=FALSE, CryptoKeyElementPersist=FALSE, CryptoKeyElementId=8, CryptoKeyElementSize=16, CryptoKeyElementReadAccess=RA_ALLOWED, CryptoKeyElementWriteAccess=WA_ALLOWED
        Crypto_30_LibCv_KeyExchange_PrivKey_Sync: CryptoKeyElementAllowPartialAccess=FALSE, CryptoKeyElementPersist=FALSE, CryptoKeyElementId=9, CryptoKeyElementSize=32, CryptoKeyElementReadAccess=RA_ALLOWED, CryptoKeyElementWriteAccess=WA_ALLOWED
        Crypto_30_LibCv_KeyExchange_SharedValue_Sync: CryptoKeyElementAllowPartialAccess=FALSE, CryptoKeyElementPersist=FALSE, CryptoKeyElementId=1, CryptoKeyElementSize=32, CryptoKeyElementReadAccess=RA_ALLOWED, CryptoKeyElementWriteAccess=WA_ALLOWED
        Crypto_30_LibCv_Ssa_SharedSecretHash_Sync: CryptoKeyElementAllowPartialAccess=FALSE, CryptoKeyElementPersist=TRUE, CryptoKeyElementId=2, CryptoKeyElementSize=4, CryptoKeyElementReadAccess=RA_ALLOWED, CryptoKeyElementWriteAccess=WA_ALLOWED
        Crypto_30_LibCv_Ssa_BackendCert_Sync: CryptoKeyElementAllowPartialAccess=TRUE, CryptoKeyElementPersist=TRUE, CryptoKeyElementId=0, CryptoKeyElementSize=600, CryptoKeyElementReadAccess=RA_ALLOWED, CryptoKeyElementWriteAccess=WA_ALLOWED
        Crypto_30_LibCv_Ssa_Cipher_IV_Sync: CryptoKeyElementAllowPartialAccess=FALSE, CryptoKeyElementPersist=FALSE, CryptoKeyElementId=5, CryptoKeyElementSize=16, CryptoKeyElementReadAccess=RA_ALLOWED, CryptoKeyElementWriteAccess=WA_ALLOWED
        Crypto_30_LibCv_Ssa_Cipher_Key_Sync: CryptoKeyElementAllowPartialAccess=FALSE, CryptoKeyElementPersist=FALSE, CryptoKeyElementId=1, CryptoKeyElementSize=16, CryptoKeyElementReadAccess=RA_ALLOWED, CryptoKeyElementWriteAccess=WA_ALLOWED
        Crypto_30_LibCv_Ssa_RootCert_Sync: CryptoKeyElementAllowPartialAccess=TRUE, CryptoKeyElementPersist=TRUE, CryptoKeyElementId=0, CryptoKeyElementSize=600, CryptoKeyElementReadAccess=RA_ALLOWED, CryptoKeyElementWriteAccess=WA_ALLOWED
        Crypto_30_LibCv_Ssa_Signature_Key_TrustModelEcu_Sync: CryptoKeyElementAllowPartialAccess=FALSE, CryptoKeyElementPersist=FALSE, CryptoKeyElementId=1, CryptoKeyElementSize=32, CryptoKeyElementReadAccess=RA_ALLOWED, CryptoKeyElementWriteAccess=WA_ALLOWED
        Crypto_30_LibCv_Ssa_Mac_Key_Sync: CryptoKeyElementAllowPartialAccess=FALSE, CryptoKeyElementPersist=TRUE, CryptoKeyElementId=1, CryptoKeyElementSize=16, CryptoKeyElementReadAccess=RA_ALLOWED, CryptoKeyElementWriteAccess=WA_ALLOWED
        Crypto_30_LibCv_Ssa_Mac_Proof_Sync: CryptoKeyElementAllowPartialAccess=FALSE, CryptoKeyElementPersist=TRUE, CryptoKeyElementId=2, CryptoKeyElementSize=4, CryptoKeyElementReadAccess=RA_ALLOWED, CryptoKeyElementWriteAccess=WA_ALLOWED
        vHsm_Core_vHsmInfo_Version_Sync: CryptoKeyElementAllowPartialAccess=FALSE, CryptoKeyElementPersist=FALSE, CryptoKeyElementId=3020, CryptoKeyElementSize=3, CryptoKeyElementReadAccess=RA_ALLOWED, CryptoKeyElementWriteAccess=WA_DENIED
        vHsm_Core_vHsmInfo_PerformPersist_Sync: CryptoKeyElementAllowPartialAccess=FALSE, CryptoKeyElementPersist=FALSE, CryptoKeyElementId=3022, CryptoKeyElementSize=1, CryptoKeyElementReadAccess=RA_ALLOWED, CryptoKeyElementWriteAccess=WA_DENIED
        vHsm_Core_vHsmInfo_PerformRepersist_Sync: CryptoKeyElementAllowPartialAccess=FALSE, CryptoKeyElementPersist=FALSE, CryptoKeyElementId=3036, CryptoKeyElementSize=1, CryptoKeyElementReadAccess=RA_DENIED, CryptoKeyElementWriteAccess=WA_ALLOWED
        vHsm_Core_vHsmInfo_StartFirmwareUpdater_Sync: CryptoKeyElementAllowPartialAccess=FALSE, CryptoKeyElementPersist=FALSE, CryptoKeyElementId=3038, CryptoKeyElementSize=1, CryptoKeyElementReadAccess=RA_DENIED, CryptoKeyElementWriteAccess=WA_ALLOWED
        vHsm_Core_vHsmInfo_SecureBootEnd_Sync: CryptoKeyElementAllowPartialAccess=FALSE, CryptoKeyElementPersist=FALSE, CryptoKeyElementId=3028, CryptoKeyElementSize=1, CryptoKeyElementReadAccess=RA_ALLOWED, CryptoKeyElementWriteAccess=WA_ALLOWED
        vHsm_Core_vHsmInfo_SecureBootResult_Sync: CryptoKeyElementAllowPartialAccess=FALSE, CryptoKeyElementPersist=FALSE, CryptoKeyElementId=3037, CryptoKeyElementSize=1, CryptoKeyElementReadAccess=RA_ALLOWED, CryptoKeyElementWriteAccess=WA_DENIED
        Crypto_30_LibCv_Diagnostic_Root_Cert_Test_Sync: CryptoKeyElementAllowPartialAccess=FALSE, CryptoKeyElementPersist=FALSE, CryptoKeyElementId=1, CryptoKeyElementSize=370, CryptoKeyElementReadAccess=RA_ALLOWED, CryptoKeyElementWriteAccess=WA_ALLOWED
        Crypto_30_LibCv_Diagnostic_Backend_Cert_Test_Sync: CryptoKeyElementAllowPartialAccess=FALSE, CryptoKeyElementPersist=FALSE, CryptoKeyElementId=1, CryptoKeyElementSize=409, CryptoKeyElementReadAccess=RA_ALLOWED, CryptoKeyElementWriteAccess=WA_ALLOWED
        Crypto_30_LibCv_vHsm_SecureBoot_GroupDummy_Sync: CryptoKeyElementAllowPartialAccess=FALSE, CryptoKeyElementPersist=FALSE, CryptoKeyElementId=1, CryptoKeyElementSize=1, CryptoKeyElementReadAccess=RA_DENIED, CryptoKeyElementWriteAccess=WA_DENIED
        Crypto_30_LibCv_vHsm_SecureBoot_Key_Sync: CryptoKeyElementAllowPartialAccess=FALSE, CryptoKeyElementPersist=TRUE, CryptoKeyElementId=1, CryptoKeyElementSize=16, CryptoKeyElementReadAccess=RA_DENIED, CryptoKeyElementWriteAccess=WA_DENIED
        Crypto_30_LibCv_SecureBoot_WriteOnce_Sync: CryptoKeyElementAllowPartialAccess=FALSE, CryptoKeyElementPersist=TRUE, CryptoKeyElementId=1, CryptoKeyElementSize=1, CryptoKeyElementReadAccess=RA_ALLOWED, CryptoKeyElementWriteAccess=WA_ALLOWED
        Crypto_30_LibCv_Ssa_MacKey_Sync: CryptoKeyElementAllowPartialAccess=FALSE, CryptoKeyElementPersist=TRUE, CryptoKeyElementId=1, CryptoKeyElementSize=16, CryptoKeyElementReadAccess=RA_ALLOWED, CryptoKeyElementWriteAccess=WA_ALLOWED
        Crypto_30_LibCv_Ssa_MacKey_Hash_Sync: CryptoKeyElementAllowPartialAccess=FALSE, CryptoKeyElementPersist=TRUE, CryptoKeyElementId=2, CryptoKeyElementSize=4, CryptoKeyElementReadAccess=RA_ALLOWED, CryptoKeyElementWriteAccess=WA_ALLOWED
        Crypto_30_LibCv_Ssa_TrustModelEcuPrivateKey_Sync: CryptoKeyElementAllowPartialAccess=FALSE, CryptoKeyElementPersist=TRUE, CryptoKeyElementId=1, CryptoKeyElementSize=32, CryptoKeyElementReadAccess=RA_DENIED, CryptoKeyElementWriteAccess=WA_ALLOWED
        Crypto_30_LibCv_Random_Algorithm_Nist_800_90A_DRBG_AES128_Sync: CryptoKeyElementAllowPartialAccess=FALSE, CryptoKeyElementPersist=FALSE, CryptoKeyElementId=4, CryptoKeyElementSize=1, CryptoKeyElementReadAccess=RA_ALLOWED, CryptoKeyElementWriteAccess=WA_ALLOWED
        Crypto_30_LibCv_Random_PrivateString_Sync: CryptoKeyElementAllowPartialAccess=FALSE, CryptoKeyElementPersist=FALSE, CryptoKeyElementId=3015, CryptoKeyElementSize=16, CryptoKeyElementReadAccess=RA_ALLOWED, CryptoKeyElementWriteAccess=WA_ALLOWED
        Crypto_30_LibCv_Random_Seed_Nist_800_90A_DRBG_AES128_Sync: CryptoKeyElementAllowPartialAccess=FALSE, CryptoKeyElementPersist=TRUE, CryptoKeyElementId=3, CryptoKeyElementSize=32, CryptoKeyElementReadAccess=RA_DENIED, CryptoKeyElementWriteAccess=WA_ALLOWED
        Crypto_30_LibCv_Random_AdditionalInput_Sync: CryptoKeyElementAllowPartialAccess=FALSE, CryptoKeyElementPersist=FALSE, CryptoKeyElementId=3016, CryptoKeyElementSize=16, CryptoKeyElementReadAccess=RA_ALLOWED, CryptoKeyElementWriteAccess=WA_ALLOWED
        Crypto_30_LibCv_Ssa_TrustModelEcuPublicKey_Sync: CryptoKeyElementAllowPartialAccess=FALSE, CryptoKeyElementPersist=TRUE, CryptoKeyElementId=1, CryptoKeyElementSize=32, CryptoKeyElementReadAccess=RA_ALLOWED, CryptoKeyElementWriteAccess=WA_ALLOWED
        Crypto_30_LibCv_Ssa_TrustModelEcuPrivateUniqueKey_Sync: CryptoKeyElementAllowPartialAccess=FALSE, CryptoKeyElementPersist=TRUE, CryptoKeyElementId=1, CryptoKeyElementSize=32, CryptoKeyElementReadAccess=RA_ALLOWED, CryptoKeyElementWriteAccess=WA_ALLOWED
        Crypto_30_LibCv_Ssa_TrustModelEcuPublicKeyCsr_Sync: CryptoKeyElementAllowPartialAccess=TRUE, CryptoKeyElementPersist=TRUE, CryptoKeyElementId=1, CryptoKeyElementSize=33, CryptoKeyElementReadAccess=RA_ALLOWED, CryptoKeyElementWriteAccess=WA_ALLOWED
    CryptoDriverObjects
      7 x CryptoDriverObject, all with CryptoDriverObjectQueueSize=1:
        Crypto_30_vHsm_Core: CryptoDriverObjectId=1, CryptoPrimitiveRef=vHsm_Core_vHsmSecureBoot, CryptoPrimitiveRef=vHsm_Core_vHsmFirmwareUpdate, CryptoPrimitiveRef=vHsm_Core_vHsmSecureBootUpdate, CryptoPrimitiveRef=vHsm_Core_vHsmSecureSoftwareDownload
        Crypto_30_vHsm_Hal: CryptoDriverObjectId=2, CryptoPrimitiveRef=vHsm_Hal_Trng, CryptoPrimitiveRef=vHsm_Hal_AesDecrypt, CryptoPrimitiveRef=vHsm_Hal_AesEncrypt, CryptoPrimitiveRef=vHsm_Hal_AesCmacVerify, CryptoPrimitiveRef=vHsm_Hal_AesCmacGenerate
        Crypto_30_vHsm_LibCv: CryptoDriverObjectId=6, CryptoPrimitiveRef=Crypto_30_LibCv_SHA256, CryptoPrimitiveRef=Crypto_30_LibCv_AesDecrypt, CryptoPrimitiveRef=Crypto_30_LibCv_AesEncrypt, CryptoPrimitiveRef=Crypto_30_LibCv_AesCmacGenerate, CryptoPrimitiveRef=Crypto_30_LibCv_AesCmacVerify, CryptoPrimitiveRef=Crypto_30_LibCv_RngDrbgAes128, CryptoPrimitiveRef=Crypto_30_LibCv_EccNistP256R1VerifySha256, CryptoPrimitiveRef=Crypto_30_LibCv_EcDsaEd25519Generate, CryptoPrimitiveRef=Crypto_30_LibCv_EcDsaEd25519Verify, CryptoPrimitiveRef=Crypto_30_LibCv_SHA512
        Crypto_30_vHsm_KeyManagement: CryptoDriverObjectId=0, CryptoPrimitiveRef=vHsmUsageForbidden
        Crypto_30_vHsm_LibCv_HighPrio: CryptoDriverObjectId=7, CryptoPrimitiveRef=Crypto_30_LibCv_SHA256, CryptoPrimitiveRef=Crypto_30_LibCv_AesDecrypt, CryptoPrimitiveRef=Crypto_30_LibCv_AesEncrypt, CryptoPrimitiveRef=Crypto_30_LibCv_AesCmacGenerate, CryptoPrimitiveRef=Crypto_30_LibCv_AesCmacVerify, CryptoPrimitiveRef=Crypto_30_LibCv_RngDrbgAes128, CryptoPrimitiveRef=Crypto_30_LibCv_SHA512
        Crypto_30_vHsm_Hal_HighPrio: CryptoDriverObjectId=3, CryptoPrimitiveRef=vHsm_Hal_AesCmacVerify, CryptoPrimitiveRef=vHsm_Hal_AesCmacGenerate
        Crypto_30_vHsm_KeyM_LibCv: CryptoDriverObjectId=5, CryptoPrimitiveRef=Crypto_30_LibCv_EccNistP256R1VerifySha256
    CryptoPrimitives
      20 x CryptoPrimitive:
        vHsm_Core_vHsmSecureBoot: CryptoPrimitiveService=CRYPTO_MAC_VERIFY, CryptoPrimitiveAlgorithmFamily=CRYPTO_ALGOFAM_CUSTOM_VHSM_SECURE_BOOT, CryptoPrimitiveAlgorithmMode=CRYPTO_ALGOMODE_CMAC, CryptoPrimitiveAlgorithmMode=CRYPTO_ALGOMODE_NOT_SET, CryptoPrimitiveAlgorithmMode=CRYPTO_ALGOMODE_CUSTOM, CryptoPrimitiveAlgorithmSecondaryFamily=CRYPTO_ALGOFAM_NOT_SET
        vHsm_Core_vHsmFirmwareUpdate: CryptoPrimitiveService=CRYPTO_AEADENCRYPT, CryptoPrimitiveAlgorithmFamily=CRYPTO_ALGOFAM_CUSTOM_VHSM_FIRMWARE_UPDATE, CryptoPrimitiveAlgorithmMode=CRYPTO_ALGOMODE_GCM, CryptoPrimitiveAlgorithmMode=CRYPTO_ALGOMODE_NOT_SET, CryptoPrimitiveAlgorithmSecondaryFamily=CRYPTO_ALGOFAM_NOT_SET
        vHsm_Core_vHsmSecureBootUpdate: CryptoPrimitiveService=CRYPTO_SIGNATURE_VERIFY, CryptoPrimitiveAlgorithmFamily=CRYPTO_ALGOFAM_CUSTOM, CryptoPrimitiveAlgorithmMode=CRYPTO_ALGOMODE_NOT_SET, CryptoPrimitiveAlgorithmSecondaryFamily=CRYPTO_ALGOFAM_NOT_SET
        vHsm_Core_vHsmSecureSoftwareDownload: CryptoPrimitiveService=CRYPTO_SIGNATURE_VERIFY, CryptoPrimitiveAlgorithmFamily=CRYPTO_ALGOFAM_CUSTOM_VHSM_SOFTWARE_DOWNLOAD, CryptoPrimitiveAlgorithmMode=CRYPTO_ALGOMODE_NOT_SET, CryptoPrimitiveAlgorithmSecondaryFamily=CRYPTO_ALGOFAM_NOT_SET
        vHsm_Hal_Trng: CryptoPrimitiveService=CRYPTO_RANDOM, CryptoPrimitiveAlgorithmFamily=CRYPTO_ALGOFAM_RNG, CryptoPrimitiveAlgorithmMode=CRYPTO_ALGOMODE_NOT_SET, CryptoPrimitiveAlgorithmSecondaryFamily=CRYPTO_ALGOFAM_NOT_SET
        vHsm_Hal_AesDecrypt: CryptoPrimitiveService=CRYPTO_DECRYPT, CryptoPrimitiveAlgorithmFamily=CRYPTO_ALGOFAM_AES, CryptoPrimitiveAlgorithmMode=CRYPTO_ALGOMODE_ECB, CryptoPrimitiveAlgorithmMode=CRYPTO_ALGOMODE_CBC, CryptoPrimitiveAlgorithmMode=CRYPTO_ALGOMODE_CTR, CryptoPrimitiveAlgorithmSecondaryFamily=CRYPTO_ALGOFAM_NOT_SET, CryptoPrimitiveAlgorithmSecondaryFamily=CRYPTO_ALGOFAM_CUSTOM_PADDING_PKCS7
        vHsm_Hal_AesEncrypt: CryptoPrimitiveService=CRYPTO_ENCRYPT, CryptoPrimitiveAlgorithmFamily=CRYPTO_ALGOFAM_AES, CryptoPrimitiveAlgorithmMode=CRYPTO_ALGOMODE_ECB, CryptoPrimitiveAlgorithmMode=CRYPTO_ALGOMODE_CBC, CryptoPrimitiveAlgorithmMode=CRYPTO_ALGOMODE_CTR, CryptoPrimitiveAlgorithmSecondaryFamily=CRYPTO_ALGOFAM_NOT_SET, CryptoPrimitiveAlgorithmSecondaryFamily=CRYPTO_ALGOFAM_CUSTOM_PADDING_PKCS7
        vHsm_Hal_AesCmacVerify: CryptoPrimitiveService=CRYPTO_MAC_VERIFY, CryptoPrimitiveAlgorithmFamily=CRYPTO_ALGOFAM_AES, CryptoPrimitiveAlgorithmMode=CRYPTO_ALGOMODE_CMAC, CryptoPrimitiveAlgorithmSecondaryFamily=CRYPTO_ALGOFAM_NOT_SET
        vHsm_Hal_AesCmacGenerate: CryptoPrimitiveService=CRYPTO_MAC_GENERATE, CryptoPrimitiveAlgorithmFamily=CRYPTO_ALGOFAM_AES, CryptoPrimitiveAlgorithmMode=CRYPTO_ALGOMODE_CMAC, CryptoPrimitiveAlgorithmSecondaryFamily=CRYPTO_ALGOFAM_NOT_SET
        Crypto_30_LibCv_SHA256: CryptoPrimitiveService=CRYPTO_HASH, CryptoPrimitiveAlgorithmFamily=CRYPTO_ALGOFAM_SHA2_256, CryptoPrimitiveAlgorithmMode=CRYPTO_ALGOMODE_NOT_SET, CryptoPrimitiveAlgorithmSecondaryFamily=CRYPTO_ALGOFAM_NOT_SET
        Crypto_30_LibCv_AesDecrypt: CryptoPrimitiveService=CRYPTO_DECRYPT, CryptoPrimitiveAlgorithmFamily=CRYPTO_ALGOFAM_AES, CryptoPrimitiveAlgorithmMode=CRYPTO_ALGOMODE_ECB, CryptoPrimitiveAlgorithmMode=CRYPTO_ALGOMODE_CBC, CryptoPrimitiveAlgorithmMode=CRYPTO_ALGOMODE_CTR, CryptoPrimitiveAlgorithmSecondaryFamily=CRYPTO_ALGOFAM_NOT_SET, CryptoPrimitiveAlgorithmSecondaryFamily=CRYPTO_ALGOFAM_CUSTOM_PADDING_PKCS7, CryptoPrimitiveAlgorithmSecondaryFamily=CRYPTO_ALGOFAM_CUSTOM
        Crypto_30_LibCv_AesEncrypt: CryptoPrimitiveService=CRYPTO_ENCRYPT, CryptoPrimitiveAlgorithmFamily=CRYPTO_ALGOFAM_AES, CryptoPrimitiveAlgorithmMode=CRYPTO_ALGOMODE_ECB, CryptoPrimitiveAlgorithmMode=CRYPTO_ALGOMODE_CBC, CryptoPrimitiveAlgorithmMode=CRYPTO_ALGOMODE_CTR, CryptoPrimitiveAlgorithmSecondaryFamily=CRYPTO_ALGOFAM_NOT_SET, CryptoPrimitiveAlgorithmSecondaryFamily=CRYPTO_ALGOFAM_CUSTOM_PADDING_PKCS7, CryptoPrimitiveAlgorithmSecondaryFamily=CRYPTO_ALGOFAM_CUSTOM
        Crypto_30_LibCv_AesCmacGenerate: CryptoPrimitiveService=CRYPTO_MAC_GENERATE, CryptoPrimitiveAlgorithmFamily=CRYPTO_ALGOFAM_AES, CryptoPrimitiveAlgorithmMode=CRYPTO_ALGOMODE_CMAC, CryptoPrimitiveAlgorithmSecondaryFamily=CRYPTO_ALGOFAM_NOT_SET
        Crypto_30_LibCv_AesCmacVerify: CryptoPrimitiveService=CRYPTO_MAC_VERIFY, CryptoPrimitiveAlgorithmFamily=CRYPTO_ALGOFAM_AES, CryptoPrimitiveAlgorithmMode=CRYPTO_ALGOMODE_CMAC, CryptoPrimitiveAlgorithmSecondaryFamily=CRYPTO_ALGOFAM_NOT_SET
        Crypto_30_LibCv_RngDrbgAes128: CryptoPrimitiveService=CRYPTO_RANDOM, CryptoPrimitiveAlgorithmFamily=CRYPTO_ALGOFAM_CUSTOM_DRBG, CryptoPrimitiveAlgorithmMode=CRYPTO_ALGOMODE_NOT_SET, CryptoPrimitiveAlgorithmSecondaryFamily=CRYPTO_ALGOFAM_AES
        Crypto_30_LibCv_EccNistP256R1VerifySha256: CryptoPrimitiveService=CRYPTO_SIGNATURE_VERIFY, CryptoPrimitiveAlgorithmFamily=CRYPTO_ALGOFAM_ECCNIST, CryptoPrimitiveAlgorithmMode=CRYPTO_ALGOMODE_CUSTOM_P256R1, CryptoPrimitiveAlgorithmSecondaryFamily=CRYPTO_ALGOFAM_SHA2_256
        Crypto_30_LibCv_EcDsaEd25519Generate: CryptoPrimitiveService=CRYPTO_SIGNATURE_GENERATE, CryptoPrimitiveAlgorithmFamily=CRYPTO_ALGOFAM_ED25519, CryptoPrimitiveAlgorithmMode=CRYPTO_ALGOMODE_NOT_SET, CryptoPrimitiveAlgorithmSecondaryFamily=CRYPTO_ALGOFAM_NOT_SET, CryptoPrimitiveAlgorithmSecondaryFamily=CRYPTO_ALGOFAM_SHA2_512
        Crypto_30_LibCv_EcDsaEd25519Verify: CryptoPrimitiveService=CRYPTO_SIGNATURE_VERIFY, CryptoPrimitiveAlgorithmFamily=CRYPTO_ALGOFAM_ED25519, CryptoPrimitiveAlgorithmMode=CRYPTO_ALGOMODE_NOT_SET, CryptoPrimitiveAlgorithmSecondaryFamily=CRYPTO_ALGOFAM_NOT_SET, CryptoPrimitiveAlgorithmSecondaryFamily=CRYPTO_ALGOFAM_SHA2_512
        Crypto_30_LibCv_SHA512: CryptoPrimitiveService=CRYPTO_HASH, CryptoPrimitiveAlgorithmFamily=CRYPTO_ALGOFAM_SHA2_512, CryptoPrimitiveAlgorithmMode=CRYPTO_ALGOMODE_NOT_SET, CryptoPrimitiveAlgorithmSecondaryFamily=CRYPTO_ALGOFAM_NOT_SET
        vHsmUsageForbidden: CryptoPrimitiveService=CRYPTO_RANDOM, CryptoPrimitiveAlgorithmFamily=CRYPTO_ALGOFAM_NOT_SET, CryptoPrimitiveAlgorithmMode=CRYPTO_ALGOMODE_NOT_SET, CryptoPrimitiveAlgorithmSecondaryFamily=CRYPTO_ALGOFAM_NOT_SET
    CryptovHsm: CryptoIpcChannels=2, CryptoIpcProtocolVersion=2, CryptoManagementDriverObject=Crypto_30_vHsm_KeyManagement
