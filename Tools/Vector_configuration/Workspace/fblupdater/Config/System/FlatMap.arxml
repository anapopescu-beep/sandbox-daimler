AUTOSAR XML (schema 00046)
package /COM/VECTOR/CFG/WORKFLOW/SYSDESC/SYNC
  flat map FLATMAP
    174 x flat instance descriptor:
      P_ROE: upstream-reference=ECU_COMP_ECU4_MB_Base_Layer.P_ROE, ecu-extract-reference=COMPOSITIONTYPE.P_ROE
      DI_Odo_Pr5_ST3_e68xmtlkywxgxsdwekdjjhw3t: upstream-reference=ECU_COMP_ECU4_MB_Base_Layer.R_DI_Odo_Pr5_ST3.DI_Odo_Pr5_ST3, ecu-extract-reference=COMPOSITIONTYPE.R_DI_Odo_Pr5_ST3.DI_Odo_Pr5_ST3
      R_DI_Odo_Pr5_ST3: upstream-reference=ECU_COMP_ECU4_MB_Base_Layer.R_DI_Odo_Pr5_ST3, ecu-extract-reference=COMPOSITIONTYPE.R_DI_Odo_Pr5_ST3
      DidA_ExtTest_Pres_ST3: upstream-reference=ECU_COMP_ECU4_MB_Base_Layer.R_DidA_ExtTest_Pres_ST3.DidA_ExtTest_Pres_ST3, ecu-extract-reference=COMPOSITIONTYPE.R_DidA_ExtTest_Pres_ST3.DidA_ExtTest_Pres_ST3
      R_DidA_ExtTest_Pres_ST3: upstream-reference=ECU_COMP_ECU4_MB_Base_Layer.R_DidA_ExtTest_Pres_ST3, ecu-extract-reference=COMPOSITIONTYPE.R_DidA_ExtTest_Pres_ST3
      Ign_Stat_Pr5_ST3_csgs1dv6drms80o1i9p49677w: upstream-reference=ECU_COMP_ECU4_MB_Base_Layer.R_Ign_Stat_Pr5_ST3.Ign_Stat_Pr5_ST3, ecu-extract-reference=COMPOSITIONTYPE.R_Ign_Stat_Pr5_ST3.Ign_Stat_Pr5_ST3
      R_Ign_Stat_Pr5_ST3: upstream-reference=ECU_COMP_ECU4_MB_Base_Layer.R_Ign_Stat_Pr5_ST3, ecu-extract-reference=COMPOSITIONTYPE.R_Ign_Stat_Pr5_ST3
      PN14_ProdMd_Stat_ST3: upstream-reference=ECU_COMP_ECU4_MB_Base_Layer.R_PN14_ProdMd_Stat_ST3.PN14_ProdMd_Stat_ST3, ecu-extract-reference=COMPOSITIONTYPE.R_PN14_ProdMd_Stat_ST3.PN14_ProdMd_Stat_ST3
      R_PN14_ProdMd_Stat_ST3: upstream-reference=ECU_COMP_ECU4_MB_Base_Layer.R_PN14_ProdMd_Stat_ST3, ecu-extract-reference=COMPOSITIONTYPE.R_PN14_ProdMd_Stat_ST3
      PN14_SupBat_Volt_ST3: upstream-reference=ECU_COMP_ECU4_MB_Base_Layer.R_PN14_SupBat_Volt_ST3.PN14_SupBat_Volt_ST3, ecu-extract-reference=COMPOSITIONTYPE.R_PN14_SupBat_Volt_ST3.PN14_SupBat_Volt_ST3
      R_PN14_SupBat_Volt_ST3: upstream-reference=ECU_COMP_ECU4_MB_Base_Layer.R_PN14_SupBat_Volt_ST3, ecu-extract-reference=COMPOSITIONTYPE.R_PN14_SupBat_Volt_ST3
      PN14_TransMd_Stat_ST3: upstream-reference=ECU_COMP_ECU4_MB_Base_Layer.R_PN14_TransMd_Stat_ST3.PN14_TransMd_Stat_ST3, ecu-extract-reference=COMPOSITIONTYPE.R_PN14_TransMd_Stat_ST3.PN14_TransMd_Stat_ST3
      R_PN14_TransMd_Stat_ST3: upstream-reference=ECU_COMP_ECU4_MB_Base_Layer.R_PN14_TransMd_Stat_ST3, ecu-extract-reference=COMPOSITIONTYPE.R_PN14_TransMd_Stat_ST3
      PT4_PTCoor4_Pr5_ST3_af4fxb1ykieox3itqdfzs0kpb: upstream-reference=ECU_COMP_ECU4_MB_Base_Layer.R_PT4_PTCoor4_Pr5_ST3.PT4_PTCoor4_Pr5_ST3, ecu-extract-reference=COMPOSITIONTYPE.R_PT4_PTCoor4_Pr5_ST3.PT4_PTCoor4_Pr5_ST3
      R_PT4_PTCoor4_Pr5_ST3: upstream-reference=ECU_COMP_ECU4_MB_Base_Layer.R_PT4_PTCoor4_Pr5_ST3, ecu-extract-reference=COMPOSITIONTYPE.R_PT4_PTCoor4_Pr5_ST3
      VSS_TP_Auth_ST3_6j4id7sghlvlbroli4wjozjik: upstream-reference=ECU_COMP_ECU4_MB_Base_Layer.R_VSS_TP_Auth_ST3.VSS_TP_Auth_ST3, ecu-extract-reference=COMPOSITIONTYPE.R_VSS_TP_Auth_ST3.VSS_TP_Auth_ST3
      R_VSS_TP_Auth_ST3: upstream-reference=ECU_COMP_ECU4_MB_Base_Layer.R_VSS_TP_Auth_ST3, ecu-extract-reference=COMPOSITIONTYPE.R_VSS_TP_Auth_ST3
      VSS_TP_RealTmOffset_ST3_1t7vc44gftc0wv35k5kgc2in9: upstream-reference=ECU_COMP_ECU4_MB_Base_Layer.R_VSS_TP_RealTmOffset_ST3.VSS_TP_RealTmOffset_ST3, ecu-extract-reference=COMPOSITIONTYPE.R_VSS_TP_RealTmOffset_ST3.VSS_TP_RealTmOffset_ST3
      R_VSS_TP_RealTmOffset_ST3: upstream-reference=ECU_COMP_ECU4_MB_Base_Layer.R_VSS_TP_RealTmOffset_ST3, ecu-extract-reference=COMPOSITIONTYPE.R_VSS_TP_RealTmOffset_ST3
      VSS_TP_SecTickCount_Lvl2_ST3_9eubq13iosat764o0lqh5xb6r: upstream-reference=ECU_COMP_ECU4_MB_Base_Layer.P_VSS_TP_SecTickCount_ST3.VSS_TP_SecTickCount_ST3, ecu-extract-reference=COMPOSITIONTYPE.P_VSS_TP_SecTickCount_ST3.VSS_TP_SecTickCount_ST3
      R_VSS_TP_SecTickCount_ST3: upstream-reference=ECU_COMP_ECU4_MB_Base_Layer.R_VSS_TP_SecTickCount_ST3, ecu-extract-reference=COMPOSITIONTYPE.R_VSS_TP_SecTickCount_ST3
      VSS_TP_SharedSecret_ST3_8pj4t8t4rm3tw3pk5hj7vonti: upstream-reference=ECU_COMP_ECU4_MB_Base_Layer.R_VSS_TP_SharedSecret_ST3.VSS_TP_SharedSecret_ST3, ecu-extract-reference=COMPOSITIONTYPE.R_VSS_TP_SharedSecret_ST3.VSS_TP_SharedSecret_ST3
      R_VSS_TP_SharedSecret_ST3: upstream-reference=ECU_COMP_ECU4_MB_Base_Layer.R_VSS_TP_SharedSecret_ST3, ecu-extract-reference=COMPOSITIONTYPE.R_VSS_TP_SharedSecret_ST3
      VSS_TP_VIN_ST3_bz1xsv84cxzl09j028gn39p69: upstream-reference=ECU_COMP_ECU4_MB_Base_Layer.R_VSS_TP_VIN_ST3.VSS_TP_VIN_ST3, ecu-extract-reference=COMPOSITIONTYPE.R_VSS_TP_VIN_ST3.VSS_TP_VIN_ST3
      R_VSS_TP_VIN_ST3: upstream-reference=ECU_COMP_ECU4_MB_Base_Layer.R_VSS_TP_VIN_ST3, ecu-extract-reference=COMPOSITIONTYPE.R_VSS_TP_VIN_ST3
      Awake_Diag_Actv_ECU4: upstream-reference=ECU_COMP_ECU4_MB_Base_Layer.P_Awake_Diag_Actv_ECU4.Awake_Diag_Actv_ECU4, ecu-extract-reference=COMPOSITIONTYPE.P_Awake_Diag_Actv_ECU4.Awake_Diag_Actv_ECU4
      P_Awake_Diag_Actv_ECU4: upstream-reference=ECU_COMP_ECU4_MB_Base_Layer.P_Awake_Diag_Actv_ECU4, ecu-extract-reference=COMPOSITIONTYPE.P_Awake_Diag_Actv_ECU4
      Awake_Ignition_On_C04: upstream-reference=ECU_COMP_ECU4_MB_Base_Layer.P_Awake_Ignition_On_C04.Awake_Ignition_On_C04, ecu-extract-reference=COMPOSITIONTYPE.P_Awake_Ignition_On_C04.Awake_Ignition_On_C04
      P_Awake_Ignition_On_C04: upstream-reference=ECU_COMP_ECU4_MB_Base_Layer.P_Awake_Ignition_On_C04, ecu-extract-reference=COMPOSITIONTYPE.P_Awake_Ignition_On_C04
      Awake_NwStart_Cluster_ECU4: upstream-reference=ECU_COMP_ECU4_MB_Base_Layer.P_Awake_NwStart_Cluster_ECU4.Awake_NwStart_Cluster_ECU4, ecu-extract-reference=COMPOSITIONTYPE.P_Awake_NwStart_Cluster_ECU4.Awake_NwStart_Cluster_ECU4
      P_Awake_NwStart_Cluster_ECU4: upstream-reference=ECU_COMP_ECU4_MB_Base_Layer.P_Awake_NwStart_Cluster_ECU4, ecu-extract-reference=COMPOSITIONTYPE.P_Awake_NwStart_Cluster_ECU4
      COM_C04_SGR01_P05_5t2743h81pbparal6h2spw309: upstream-reference=ECU_COMP_ECU4_MB_Base_Layer.P_COM_C04_SGR01_P05.COM_C04_SGR01_P05, ecu-extract-reference=COMPOSITIONTYPE.P_COM_C04_SGR01_P05.COM_C04_SGR01_P05
      P_COM_C04_SGR01_P05: upstream-reference=ECU_COMP_ECU4_MB_Base_Layer.P_COM_C04_SGR01_P05, ecu-extract-reference=COMPOSITIONTYPE.P_COM_C04_SGR01_P05
      COM_C04_Sig002: upstream-reference=ECU_COMP_ECU4_MB_Base_Layer.P_COM_C04_Sig002.CS_Operation_C04_Sig002, ecu-extract-reference=COMPOSITIONTYPE.P_COM_C04_Sig002.CS_Operation_C04_Sig002
      P_COM_C04_Sig002: upstream-reference=ECU_COMP_ECU4_MB_Base_Layer.P_COM_C04_Sig002, ecu-extract-reference=COMPOSITIONTYPE.P_COM_C04_Sig002
      COM_C04_Sig003: upstream-reference=ECU_COMP_ECU4_MB_Base_Layer.P_COM_C04_Sig003.COM_C04_Sig003, ecu-extract-reference=COMPOSITIONTYPE.P_COM_C04_Sig003.COM_C04_Sig003
      P_COM_C04_Sig003: upstream-reference=ECU_COMP_ECU4_MB_Base_Layer.P_COM_C04_Sig003, ecu-extract-reference=COMPOSITIONTYPE.P_COM_C04_Sig003
      COM_C04_Sig005: upstream-reference=ECU_COMP_ECU4_MB_Base_Layer.P_COM_C04_Sig005.COM_C04_Sig005, ecu-extract-reference=COMPOSITIONTYPE.P_COM_C04_Sig005.COM_C04_Sig005
      P_COM_C04_Sig005: upstream-reference=ECU_COMP_ECU4_MB_Base_Layer.P_COM_C04_Sig005, ecu-extract-reference=COMPOSITIONTYPE.P_COM_C04_Sig005
      COM_C04_Sig006: upstream-reference=ECU_COMP_ECU4_MB_Base_Layer.P_COM_C04_Sig006.COM_C04_Sig006, ecu-extract-reference=COMPOSITIONTYPE.P_COM_C04_Sig006.COM_C04_Sig006
      P_COM_C04_Sig006: upstream-reference=ECU_COMP_ECU4_MB_Base_Layer.P_COM_C04_Sig006, ecu-extract-reference=COMPOSITIONTYPE.P_COM_C04_Sig006
      COM_C04_Sig007: upstream-reference=ECU_COMP_ECU4_MB_Base_Layer.P_COM_C04_Sig007.COM_C04_Sig007, ecu-extract-reference=COMPOSITIONTYPE.P_COM_C04_Sig007.COM_C04_Sig007
      P_COM_C04_Sig007: upstream-reference=ECU_COMP_ECU4_MB_Base_Layer.P_COM_C04_Sig007, ecu-extract-reference=COMPOSITIONTYPE.P_COM_C04_Sig007
      COM_C04_Sig008: upstream-reference=ECU_COMP_ECU4_MB_Base_Layer.P_COM_C04_Sig008.COM_C04_Sig008, ecu-extract-reference=COMPOSITIONTYPE.P_COM_C04_Sig008.COM_C04_Sig008
      P_COM_C04_Sig008: upstream-reference=ECU_COMP_ECU4_MB_Base_Layer.P_COM_C04_Sig008, ecu-extract-reference=COMPOSITIONTYPE.P_COM_C04_Sig008
      COM_C04_Sig01_PN08: upstream-reference=ECU_COMP_ECU4_MB_Base_Layer.P_COM_C04_Sig01_PN08.COM_C04_Sig01_PN08, ecu-extract-reference=COMPOSITIONTYPE.P_COM_C04_Sig01_PN08.COM_C04_Sig01_PN08
      P_COM_C04_Sig01_PN08: upstream-reference=ECU_COMP_ECU4_MB_Base_Layer.P_COM_C04_Sig01_PN08, ecu-extract-reference=COMPOSITIONTYPE.P_COM_C04_Sig01_PN08
      COM_C04_Sig01_PN17: upstream-reference=ECU_COMP_ECU4_MB_Base_Layer.P_COM_C04_Sig01_PN17.COM_C04_Sig01_PN17, ecu-extract-reference=COMPOSITIONTYPE.P_COM_C04_Sig01_PN17.COM_C04_Sig01_PN17
      P_COM_C04_Sig01_PN17: upstream-reference=ECU_COMP_ECU4_MB_Base_Layer.P_COM_C04_Sig01_PN17, ecu-extract-reference=COMPOSITIONTYPE.P_COM_C04_Sig01_PN17
      COM_C04_Sig01_PN44: upstream-reference=ECU_COMP_ECU4_MB_Base_Layer.P_COM_C04_Sig01_PN44.COM_C04_Sig01_PN44, ecu-extract-reference=COMPOSITIONTYPE.P_COM_C04_Sig01_PN44.COM_C04_Sig01_PN44
      P_COM_C04_Sig01_PN44: upstream-reference=ECU_COMP_ECU4_MB_Base_Layer.P_COM_C04_Sig01_PN44, ecu-extract-reference=COMPOSITIONTYPE.P_COM_C04_Sig01_PN44
      COM_C04_Sig01_PN53: upstream-reference=ECU_COMP_ECU4_MB_Base_Layer.P_COM_C04_Sig01_PN53.COM_C04_Sig01_PN53, ecu-extract-reference=COMPOSITIONTYPE.P_COM_C04_Sig01_PN53.COM_C04_Sig01_PN53
      P_COM_C04_Sig01_PN53: upstream-reference=ECU_COMP_ECU4_MB_Base_Layer.P_COM_C04_Sig01_PN53, ecu-extract-reference=COMPOSITIONTYPE.P_COM_C04_Sig01_PN53
      COM_C04_Sig01_PN62: upstream-reference=ECU_COMP_ECU4_MB_Base_Layer.P_COM_C04_Sig01_PN62.COM_C04_Sig01_PN62, ecu-extract-reference=COMPOSITIONTYPE.P_COM_C04_Sig01_PN62.COM_C04_Sig01_PN62
      P_COM_C04_Sig01_PN62: upstream-reference=ECU_COMP_ECU4_MB_Base_Layer.P_COM_C04_Sig01_PN62, ecu-extract-reference=COMPOSITIONTYPE.P_COM_C04_Sig01_PN62
      COM_C04_Sig110: upstream-reference=ECU_COMP_ECU4_MB_Base_Layer.P_COM_C04_Sig110.COM_C04_Sig110, ecu-extract-reference=COMPOSITIONTYPE.P_COM_C04_Sig110.COM_C04_Sig110
      P_COM_C04_Sig110: upstream-reference=ECU_COMP_ECU4_MB_Base_Layer.P_COM_C04_Sig110, ecu-extract-reference=COMPOSITIONTYPE.P_COM_C04_Sig110
      COM_C04_Sig111: upstream-reference=ECU_COMP_ECU4_MB_Base_Layer.P_COM_C04_Sig111.COM_C04_Sig111, ecu-extract-reference=COMPOSITIONTYPE.P_COM_C04_Sig111.COM_C04_Sig111
      P_COM_C04_Sig111: upstream-reference=ECU_COMP_ECU4_MB_Base_Layer.P_COM_C04_Sig111, ecu-extract-reference=COMPOSITIONTYPE.P_COM_C04_Sig111
      COM_C04_Sig112: upstream-reference=ECU_COMP_ECU4_MB_Base_Layer.P_COM_C04_Sig112.COM_C04_Sig112, ecu-extract-reference=COMPOSITIONTYPE.P_COM_C04_Sig112.COM_C04_Sig112
      P_COM_C04_Sig112: upstream-reference=ECU_COMP_ECU4_MB_Base_Layer.P_COM_C04_Sig112, ecu-extract-reference=COMPOSITIONTYPE.P_COM_C04_Sig112
      COM_C04_Sig113: upstream-reference=ECU_COMP_ECU4_MB_Base_Layer.P_COM_C04_Sig113.COM_C04_Sig113, ecu-extract-reference=COMPOSITIONTYPE.P_COM_C04_Sig113.COM_C04_Sig113
      P_COM_C04_Sig113: upstream-reference=ECU_COMP_ECU4_MB_Base_Layer.P_COM_C04_Sig113, ecu-extract-reference=COMPOSITIONTYPE.P_COM_C04_Sig113
      COM_C04_Sig114: upstream-reference=ECU_COMP_ECU4_MB_Base_Layer.P_COM_C04_Sig114.COM_C04_Sig114, ecu-extract-reference=COMPOSITIONTYPE.P_COM_C04_Sig114.COM_C04_Sig114
      P_COM_C04_Sig114: upstream-reference=ECU_COMP_ECU4_MB_Base_Layer.P_COM_C04_Sig114, ecu-extract-reference=COMPOSITIONTYPE.P_COM_C04_Sig114
      COM_C04_Sig115: upstream-reference=ECU_COMP_ECU4_MB_Base_Layer.P_COM_C04_Sig115.COM_C04_Sig115, ecu-extract-reference=COMPOSITIONTYPE.P_COM_C04_Sig115.COM_C04_Sig115
      P_COM_C04_Sig115: upstream-reference=ECU_COMP_ECU4_MB_Base_Layer.P_COM_C04_Sig115, ecu-extract-reference=COMPOSITIONTYPE.P_COM_C04_Sig115
      COM_C04_Sig116: upstream-reference=ECU_COMP_ECU4_MB_Base_Layer.P_COM_C04_Sig116.COM_C04_Sig116, ecu-extract-reference=COMPOSITIONTYPE.P_COM_C04_Sig116.COM_C04_Sig116
      P_COM_C04_Sig116: upstream-reference=ECU_COMP_ECU4_MB_Base_Layer.P_COM_C04_Sig116, ecu-extract-reference=COMPOSITIONTYPE.P_COM_C04_Sig116
      COM_C04_Sig117: upstream-reference=ECU_COMP_ECU4_MB_Base_Layer.P_COM_C04_Sig117.COM_C04_Sig117, ecu-extract-reference=COMPOSITIONTYPE.P_COM_C04_Sig117.COM_C04_Sig117
      P_COM_C04_Sig117: upstream-reference=ECU_COMP_ECU4_MB_Base_Layer.P_COM_C04_Sig117, ecu-extract-reference=COMPOSITIONTYPE.P_COM_C04_Sig117
      COM_C04_Sig118: upstream-reference=ECU_COMP_ECU4_MB_Base_Layer.P_COM_C04_Sig118.COM_C04_Sig118, ecu-extract-reference=COMPOSITIONTYPE.P_COM_C04_Sig118.COM_C04_Sig118
      P_COM_C04_Sig118: upstream-reference=ECU_COMP_ECU4_MB_Base_Layer.P_COM_C04_Sig118, ecu-extract-reference=COMPOSITIONTYPE.P_COM_C04_Sig118
      COM_C04_Sig119: upstream-reference=ECU_COMP_ECU4_MB_Base_Layer.P_COM_C04_Sig119.COM_C04_Sig119, ecu-extract-reference=COMPOSITIONTYPE.P_COM_C04_Sig119.COM_C04_Sig119
      P_COM_C04_Sig119: upstream-reference=ECU_COMP_ECU4_MB_Base_Layer.P_COM_C04_Sig119, ecu-extract-reference=COMPOSITIONTYPE.P_COM_C04_Sig119
      COM_C04_Sig120: upstream-reference=ECU_COMP_ECU4_MB_Base_Layer.P_COM_C04_Sig120.COM_C04_Sig120, ecu-extract-reference=COMPOSITIONTYPE.P_COM_C04_Sig120.COM_C04_Sig120
      P_COM_C04_Sig120: upstream-reference=ECU_COMP_ECU4_MB_Base_Layer.P_COM_C04_Sig120, ecu-extract-reference=COMPOSITIONTYPE.P_COM_C04_Sig120
      COM_C04_Sig121: upstream-reference=ECU_COMP_ECU4_MB_Base_Layer.P_COM_C04_Sig121.COM_C04_Sig121, ecu-extract-reference=COMPOSITIONTYPE.P_COM_C04_Sig121.COM_C04_Sig121
      P_COM_C04_Sig121: upstream-reference=ECU_COMP_ECU4_MB_Base_Layer.P_COM_C04_Sig121, ecu-extract-reference=COMPOSITIONTYPE.P_COM_C04_Sig121
      COM_C04_Sig1Cyc_1: upstream-reference=ECU_COMP_ECU4_MB_Base_Layer.P_COM_C04_Sig1Cyc_1.COM_C04_Sig1Cyc_1, ecu-extract-reference=COMPOSITIONTYPE.P_COM_C04_Sig1Cyc_1.COM_C04_Sig1Cyc_1
      P_COM_C04_Sig1Cyc_1: upstream-reference=ECU_COMP_ECU4_MB_Base_Layer.P_COM_C04_Sig1Cyc_1, ecu-extract-reference=COMPOSITIONTYPE.P_COM_C04_Sig1Cyc_1
      COM_C04_Sig221: upstream-reference=ECU_COMP_ECU4_MB_Base_Layer.P_COM_C04_Sig221.COM_C04_Sig221, ecu-extract-reference=COMPOSITIONTYPE.P_COM_C04_Sig221.COM_C04_Sig221
      P_COM_C04_Sig221: upstream-reference=ECU_COMP_ECU4_MB_Base_Layer.P_COM_C04_Sig221, ecu-extract-reference=COMPOSITIONTYPE.P_COM_C04_Sig221
      COM_C04_Sig2Cyc_7: upstream-reference=ECU_COMP_ECU4_MB_Base_Layer.P_COM_C04_Sig2Cyc_7.COM_C04_Sig2Cyc_7, ecu-extract-reference=COMPOSITIONTYPE.P_COM_C04_Sig2Cyc_7.COM_C04_Sig2Cyc_7
      P_COM_C04_Sig2Cyc_7: upstream-reference=ECU_COMP_ECU4_MB_Base_Layer.P_COM_C04_Sig2Cyc_7, ecu-extract-reference=COMPOSITIONTYPE.P_COM_C04_Sig2Cyc_7
      COM_C04_Sig3Cyc_9: upstream-reference=ECU_COMP_ECU4_MB_Base_Layer.P_COM_C04_Sig3Cyc_9.COM_C04_Sig3Cyc_9, ecu-extract-reference=COMPOSITIONTYPE.P_COM_C04_Sig3Cyc_9.COM_C04_Sig3Cyc_9
      P_COM_C04_Sig3Cyc_9: upstream-reference=ECU_COMP_ECU4_MB_Base_Layer.P_COM_C04_Sig3Cyc_9, ecu-extract-reference=COMPOSITIONTYPE.P_COM_C04_Sig3Cyc_9
      COM_C04_Sig4Cyc_24: upstream-reference=ECU_COMP_ECU4_MB_Base_Layer.P_COM_C04_Sig4Cyc_24.COM_C04_Sig4Cyc_24, ecu-extract-reference=COMPOSITIONTYPE.P_COM_C04_Sig4Cyc_24.COM_C04_Sig4Cyc_24
      P_COM_C04_Sig4Cyc_24: upstream-reference=ECU_COMP_ECU4_MB_Base_Layer.P_COM_C04_Sig4Cyc_24, ecu-extract-reference=COMPOSITIONTYPE.P_COM_C04_Sig4Cyc_24
      ECU_ID_C04: upstream-reference=ECU_COMP_ECU4_MB_Base_Layer.P_ECU_ID_C04.ECU_ID_C04, ecu-extract-reference=COMPOSITIONTYPE.P_ECU_ID_C04.ECU_ID_C04
      P_ECU_ID_C04: upstream-reference=ECU_COMP_ECU4_MB_Base_Layer.P_ECU_ID_C04, ecu-extract-reference=COMPOSITIONTYPE.P_ECU_ID_C04
      P_ICS_VIN_Ctrl_ST3: upstream-reference=ECU_COMP_ECU4_MB_Base_Layer.P_ICS_VIN_Ctrl_ST3, ecu-extract-reference=COMPOSITIONTYPE.P_ICS_VIN_Ctrl_ST3
      P_ICS_VIN_ST3: upstream-reference=ECU_COMP_ECU4_MB_Base_Layer.P_ICS_VIN_ST3, ecu-extract-reference=COMPOSITIONTYPE.P_ICS_VIN_ST3
      NwId_C04_CAN1: upstream-reference=ECU_COMP_ECU4_MB_Base_Layer.P_NwId_C04_CAN1.NwId_C04_CAN1, ecu-extract-reference=COMPOSITIONTYPE.P_NwId_C04_CAN1.NwId_C04_CAN1
      P_NwId_C04_CAN1: upstream-reference=ECU_COMP_ECU4_MB_Base_Layer.P_NwId_C04_CAN1, ecu-extract-reference=COMPOSITIONTYPE.P_NwId_C04_CAN1
      NwId_C04_CANFD1: upstream-reference=ECU_COMP_ECU4_MB_Base_Layer.P_NwId_C04_CANFD1.NwId_C04_CANFD1, ecu-extract-reference=COMPOSITIONTYPE.P_NwId_C04_CANFD1.NwId_C04_CANFD1
      P_NwId_C04_CANFD1: upstream-reference=ECU_COMP_ECU4_MB_Base_Layer.P_NwId_C04_CANFD1, ecu-extract-reference=COMPOSITIONTYPE.P_NwId_C04_CANFD1
      NwId_C04_ETH_ECU4: upstream-reference=ECU_COMP_ECU4_MB_Base_Layer.P_NwId_C04_ETH_ECU4.NwId_C04_ETH_ECU4, ecu-extract-reference=COMPOSITIONTYPE.P_NwId_C04_ETH_ECU4.NwId_C04_ETH_ECU4
      P_NwId_C04_ETH_ECU4: upstream-reference=ECU_COMP_ECU4_MB_Base_Layer.P_NwId_C04_ETH_ECU4, ecu-extract-reference=COMPOSITIONTYPE.P_NwId_C04_ETH_ECU4
      Diag_RoE_C04_SigGrp01_2ksq5hjijyze6lf3nboiafq6k: upstream-reference=ECU_COMP_ECU4_MB_Base_Layer.P_ROE.ROE_XX_ST3, ecu-extract-reference=COMPOSITIONTYPE.P_ROE.ROE_XX_ST3
      P_VSS_TP_SecTickCount_ST3: upstream-reference=ECU_COMP_ECU4_MB_Base_Layer.P_VSS_TP_SecTickCount_ST3, ecu-extract-reference=COMPOSITIONTYPE.P_VSS_TP_SecTickCount_ST3
      WakeupRsn_C04_ECU04: upstream-reference=ECU_COMP_ECU4_MB_Base_Layer.P_WakeupRsn_C04_ECU04.WakeupRsn_C04_ECU04, ecu-extract-reference=COMPOSITIONTYPE.P_WakeupRsn_C04_ECU04.WakeupRsn_C04_ECU04
      P_WakeupRsn_C04_ECU04: upstream-reference=ECU_COMP_ECU4_MB_Base_Layer.P_WakeupRsn_C04_ECU04, ecu-extract-reference=COMPOSITIONTYPE.P_WakeupRsn_C04_ECU04
      COM_C01_Sig01_PN08: upstream-reference=ECU_COMP_ECU4_MB_Base_Layer.R_COM_C01_Sig01_PN08.COM_C01_Sig01_PN08, ecu-extract-reference=COMPOSITIONTYPE.R_COM_C01_Sig01_PN08.COM_C01_Sig01_PN08
      R_COM_C01_Sig01_PN08: upstream-reference=ECU_COMP_ECU4_MB_Base_Layer.R_COM_C01_Sig01_PN08, ecu-extract-reference=COMPOSITIONTYPE.R_COM_C01_Sig01_PN08
      COM_C01_Sig01_PN17: upstream-reference=ECU_COMP_ECU4_MB_Base_Layer.R_COM_C01_Sig01_PN17.COM_C01_Sig01_PN17, ecu-extract-reference=COMPOSITIONTYPE.R_COM_C01_Sig01_PN17.COM_C01_Sig01_PN17
      R_COM_C01_Sig01_PN17: upstream-reference=ECU_COMP_ECU4_MB_Base_Layer.R_COM_C01_Sig01_PN17, ecu-extract-reference=COMPOSITIONTYPE.R_COM_C01_Sig01_PN17
      COM_C01_Sig01_PN44: upstream-reference=ECU_COMP_ECU4_MB_Base_Layer.R_COM_C01_Sig01_PN44.COM_C01_Sig01_PN44, ecu-extract-reference=COMPOSITIONTYPE.R_COM_C01_Sig01_PN44.COM_C01_Sig01_PN44
      R_COM_C01_Sig01_PN44: upstream-reference=ECU_COMP_ECU4_MB_Base_Layer.R_COM_C01_Sig01_PN44, ecu-extract-reference=COMPOSITIONTYPE.R_COM_C01_Sig01_PN44
      COM_C01_Sig01_PN53: upstream-reference=ECU_COMP_ECU4_MB_Base_Layer.R_COM_C01_Sig01_PN53.COM_C01_Sig01_PN53, ecu-extract-reference=COMPOSITIONTYPE.R_COM_C01_Sig01_PN53.COM_C01_Sig01_PN53
      R_COM_C01_Sig01_PN53: upstream-reference=ECU_COMP_ECU4_MB_Base_Layer.R_COM_C01_Sig01_PN53, ecu-extract-reference=COMPOSITIONTYPE.R_COM_C01_Sig01_PN53
      COM_C01_Sig01_PN62: upstream-reference=ECU_COMP_ECU4_MB_Base_Layer.R_COM_C01_Sig01_PN62.COM_C01_Sig01_PN62, ecu-extract-reference=COMPOSITIONTYPE.R_COM_C01_Sig01_PN62.COM_C01_Sig01_PN62
      R_COM_C01_Sig01_PN62: upstream-reference=ECU_COMP_ECU4_MB_Base_Layer.R_COM_C01_Sig01_PN62, ecu-extract-reference=COMPOSITIONTYPE.R_COM_C01_Sig01_PN62
      COM_C07_Sig01_PN08: upstream-reference=ECU_COMP_ECU4_MB_Base_Layer.R_COM_C07_Sig01_PN08.COM_C07_Sig01_PN08, ecu-extract-reference=COMPOSITIONTYPE.R_COM_C07_Sig01_PN08.COM_C07_Sig01_PN08
      R_COM_C07_Sig01_PN08: upstream-reference=ECU_COMP_ECU4_MB_Base_Layer.R_COM_C07_Sig01_PN08, ecu-extract-reference=COMPOSITIONTYPE.R_COM_C07_Sig01_PN08
      COM_C07_Sig01_PN44: upstream-reference=ECU_COMP_ECU4_MB_Base_Layer.R_COM_C07_Sig01_PN44.COM_C07_Sig01_PN44, ecu-extract-reference=COMPOSITIONTYPE.R_COM_C07_Sig01_PN44.COM_C07_Sig01_PN44
      R_COM_C07_Sig01_PN44: upstream-reference=ECU_COMP_ECU4_MB_Base_Layer.R_COM_C07_Sig01_PN44, ecu-extract-reference=COMPOSITIONTYPE.R_COM_C07_Sig01_PN44
      COM_C07_Sig01_PN53: upstream-reference=ECU_COMP_ECU4_MB_Base_Layer.R_COM_C07_Sig01_PN53.COM_C07_Sig01_PN53, ecu-extract-reference=COMPOSITIONTYPE.R_COM_C07_Sig01_PN53.COM_C07_Sig01_PN53
      R_COM_C07_Sig01_PN53: upstream-reference=ECU_COMP_ECU4_MB_Base_Layer.R_COM_C07_Sig01_PN53, ecu-extract-reference=COMPOSITIONTYPE.R_COM_C07_Sig01_PN53
      COM_C0X_Sig110: upstream-reference=ECU_COMP_ECU4_MB_Base_Layer.R_COM_C0X_Sig110.COM_C0X_Sig110, ecu-extract-reference=COMPOSITIONTYPE.R_COM_C0X_Sig110.COM_C0X_Sig110
      R_COM_C0X_Sig110: upstream-reference=ECU_COMP_ECU4_MB_Base_Layer.R_COM_C0X_Sig110, ecu-extract-reference=COMPOSITIONTYPE.R_COM_C0X_Sig110
      COM_C0X_Sig111: upstream-reference=ECU_COMP_ECU4_MB_Base_Layer.R_COM_C0X_Sig111.COM_C0X_Sig111, ecu-extract-reference=COMPOSITIONTYPE.R_COM_C0X_Sig111.COM_C0X_Sig111
      R_COM_C0X_Sig111: upstream-reference=ECU_COMP_ECU4_MB_Base_Layer.R_COM_C0X_Sig111, ecu-extract-reference=COMPOSITIONTYPE.R_COM_C0X_Sig111
      COM_C0X_Sig112: upstream-reference=ECU_COMP_ECU4_MB_Base_Layer.R_COM_C0X_Sig112.COM_C0X_Sig112, ecu-extract-reference=COMPOSITIONTYPE.R_COM_C0X_Sig112.COM_C0X_Sig112
      R_COM_C0X_Sig112: upstream-reference=ECU_COMP_ECU4_MB_Base_Layer.R_COM_C0X_Sig112, ecu-extract-reference=COMPOSITIONTYPE.R_COM_C0X_Sig112
      COM_C0X_Sig113: upstream-reference=ECU_COMP_ECU4_MB_Base_Layer.R_COM_C0X_Sig113.COM_C0X_Sig113, ecu-extract-reference=COMPOSITIONTYPE.R_COM_C0X_Sig113.COM_C0X_Sig113
      R_COM_C0X_Sig113: upstream-reference=ECU_COMP_ECU4_MB_Base_Layer.R_COM_C0X_Sig113, ecu-extract-reference=COMPOSITIONTYPE.R_COM_C0X_Sig113
      COM_C0X_Sig114: upstream-reference=ECU_COMP_ECU4_MB_Base_Layer.R_COM_C0X_Sig114.COM_C0X_Sig114, ecu-extract-reference=COMPOSITIONTYPE.R_COM_C0X_Sig114.COM_C0X_Sig114
      R_COM_C0X_Sig114: upstream-reference=ECU_COMP_ECU4_MB_Base_Layer.R_COM_C0X_Sig114, ecu-extract-reference=COMPOSITIONTYPE.R_COM_C0X_Sig114
      COM_C0X_Sig115: upstream-reference=ECU_COMP_ECU4_MB_Base_Layer.R_COM_C0X_Sig115.COM_C0X_Sig115, ecu-extract-reference=COMPOSITIONTYPE.R_COM_C0X_Sig115.COM_C0X_Sig115
      R_COM_C0X_Sig115: upstream-reference=ECU_COMP_ECU4_MB_Base_Layer.R_COM_C0X_Sig115, ecu-extract-reference=COMPOSITIONTYPE.R_COM_C0X_Sig115
      COM_C0X_Sig116: upstream-reference=ECU_COMP_ECU4_MB_Base_Layer.R_COM_C0X_Sig116.COM_C0X_Sig116, ecu-extract-reference=COMPOSITIONTYPE.R_COM_C0X_Sig116.COM_C0X_Sig116
      R_COM_C0X_Sig116: upstream-reference=ECU_COMP_ECU4_MB_Base_Layer.R_COM_C0X_Sig116, ecu-extract-reference=COMPOSITIONTYPE.R_COM_C0X_Sig116
      COM_C0X_Sig117: upstream-reference=ECU_COMP_ECU4_MB_Base_Layer.R_COM_C0X_Sig117.COM_C0X_Sig117, ecu-extract-reference=COMPOSITIONTYPE.R_COM_C0X_Sig117.COM_C0X_Sig117
      R_COM_C0X_Sig117: upstream-reference=ECU_COMP_ECU4_MB_Base_Layer.R_COM_C0X_Sig117, ecu-extract-reference=COMPOSITIONTYPE.R_COM_C0X_Sig117
      COM_C0X_Sig118: upstream-reference=ECU_COMP_ECU4_MB_Base_Layer.R_COM_C0X_Sig118.COM_C0X_Sig118, ecu-extract-reference=COMPOSITIONTYPE.R_COM_C0X_Sig118.COM_C0X_Sig118
      R_COM_C0X_Sig118: upstream-reference=ECU_COMP_ECU4_MB_Base_Layer.R_COM_C0X_Sig118, ecu-extract-reference=COMPOSITIONTYPE.R_COM_C0X_Sig118
      COM_C0X_Sig119: upstream-reference=ECU_COMP_ECU4_MB_Base_Layer.R_COM_C0X_Sig119.COM_C0X_Sig119, ecu-extract-reference=COMPOSITIONTYPE.R_COM_C0X_Sig119.COM_C0X_Sig119
      R_COM_C0X_Sig119: upstream-reference=ECU_COMP_ECU4_MB_Base_Layer.R_COM_C0X_Sig119, ecu-extract-reference=COMPOSITIONTYPE.R_COM_C0X_Sig119
      COM_C0X_Sig120: upstream-reference=ECU_COMP_ECU4_MB_Base_Layer.R_COM_C0X_Sig120.COM_C0X_Sig120, ecu-extract-reference=COMPOSITIONTYPE.R_COM_C0X_Sig120.COM_C0X_Sig120
      R_COM_C0X_Sig120: upstream-reference=ECU_COMP_ECU4_MB_Base_Layer.R_COM_C0X_Sig120, ecu-extract-reference=COMPOSITIONTYPE.R_COM_C0X_Sig120
      COM_C0X_Sig121: upstream-reference=ECU_COMP_ECU4_MB_Base_Layer.R_COM_C0X_Sig121.COM_C0X_Sig121, ecu-extract-reference=COMPOSITIONTYPE.R_COM_C0X_Sig121.COM_C0X_Sig121
      R_COM_C0X_Sig121: upstream-reference=ECU_COMP_ECU4_MB_Base_Layer.R_COM_C0X_Sig121, ecu-extract-reference=COMPOSITIONTYPE.R_COM_C0X_Sig121
      COM_C0X_Sig221: upstream-reference=ECU_COMP_ECU4_MB_Base_Layer.R_COM_C0X_Sig221.COM_C0X_Sig221, ecu-extract-reference=COMPOSITIONTYPE.R_COM_C0X_Sig221.COM_C0X_Sig221
      R_COM_C0X_Sig221: upstream-reference=ECU_COMP_ECU4_MB_Base_Layer.R_COM_C0X_Sig221, ecu-extract-reference=COMPOSITIONTYPE.R_COM_C0X_Sig221
      COM_C10_Sig01_PN08: upstream-reference=ECU_COMP_ECU4_MB_Base_Layer.R_COM_C10_Sig01_PN08.COM_C10_Sig01_PN08, ecu-extract-reference=COMPOSITIONTYPE.R_COM_C10_Sig01_PN08.COM_C10_Sig01_PN08
      R_COM_C10_Sig01_PN08: upstream-reference=ECU_COMP_ECU4_MB_Base_Layer.R_COM_C10_Sig01_PN08, ecu-extract-reference=COMPOSITIONTYPE.R_COM_C10_Sig01_PN08
      COM_C10_Sig01_PN17: upstream-reference=ECU_COMP_ECU4_MB_Base_Layer.R_COM_C10_Sig01_PN17.COM_C10_Sig01_PN17, ecu-extract-reference=COMPOSITIONTYPE.R_COM_C10_Sig01_PN17.COM_C10_Sig01_PN17
      R_COM_C10_Sig01_PN17: upstream-reference=ECU_COMP_ECU4_MB_Base_Layer.R_COM_C10_Sig01_PN17, ecu-extract-reference=COMPOSITIONTYPE.R_COM_C10_Sig01_PN17
      COM_C19_Sig002: upstream-reference=ECU_COMP_ECU4_MB_Base_Layer.R_COM_C19_Sig002.COM_C19_Sig002, ecu-extract-reference=COMPOSITIONTYPE.R_COM_C19_Sig002.COM_C19_Sig002
      R_COM_C19_Sig002: upstream-reference=ECU_COMP_ECU4_MB_Base_Layer.R_COM_C19_Sig002, ecu-extract-reference=COMPOSITIONTYPE.R_COM_C19_Sig002
      COM_C19_Sig003: upstream-reference=ECU_COMP_ECU4_MB_Base_Layer.R_COM_C19_Sig003.COM_C19_Sig003, ecu-extract-reference=COMPOSITIONTYPE.R_COM_C19_Sig003.COM_C19_Sig003
      R_COM_C19_Sig003: upstream-reference=ECU_COMP_ECU4_MB_Base_Layer.R_COM_C19_Sig003, ecu-extract-reference=COMPOSITIONTYPE.R_COM_C19_Sig003
      COM_C19_Sig004: upstream-reference=ECU_COMP_ECU4_MB_Base_Layer.R_COM_C19_Sig004.COM_C19_Sig004, ecu-extract-reference=COMPOSITIONTYPE.R_COM_C19_Sig004.COM_C19_Sig004
      R_COM_C19_Sig004: upstream-reference=ECU_COMP_ECU4_MB_Base_Layer.R_COM_C19_Sig004, ecu-extract-reference=COMPOSITIONTYPE.R_COM_C19_Sig004
      COM_C19_Sig005: upstream-reference=ECU_COMP_ECU4_MB_Base_Layer.R_COM_C19_Sig005.COM_C19_Sig005, ecu-extract-reference=COMPOSITIONTYPE.R_COM_C19_Sig005.COM_C19_Sig005
      R_COM_C19_Sig005: upstream-reference=ECU_COMP_ECU4_MB_Base_Layer.R_COM_C19_Sig005, ecu-extract-reference=COMPOSITIONTYPE.R_COM_C19_Sig005
      COM_C19_Sig006: upstream-reference=ECU_COMP_ECU4_MB_Base_Layer.R_COM_C19_Sig006.COM_C19_Sig006, ecu-extract-reference=COMPOSITIONTYPE.R_COM_C19_Sig006.COM_C19_Sig006
      R_COM_C19_Sig006: upstream-reference=ECU_COMP_ECU4_MB_Base_Layer.R_COM_C19_Sig006, ecu-extract-reference=COMPOSITIONTYPE.R_COM_C19_Sig006
      COM_C19_Sig01_PN08: upstream-reference=ECU_COMP_ECU4_MB_Base_Layer.R_COM_C19_Sig01_PN08.COM_C19_Sig01_PN08, ecu-extract-reference=COMPOSITIONTYPE.R_COM_C19_Sig01_PN08.COM_C19_Sig01_PN08
      R_COM_C19_Sig01_PN08: upstream-reference=ECU_COMP_ECU4_MB_Base_Layer.R_COM_C19_Sig01_PN08, ecu-extract-reference=COMPOSITIONTYPE.R_COM_C19_Sig01_PN08
      COM_C19_Sig01_PN44: upstream-reference=ECU_COMP_ECU4_MB_Base_Layer.R_COM_C19_Sig01_PN44.COM_C19_Sig01_PN44, ecu-extract-reference=COMPOSITIONTYPE.R_COM_C19_Sig01_PN44.COM_C19_Sig01_PN44
      R_COM_C19_Sig01_PN44: upstream-reference=ECU_COMP_ECU4_MB_Base_Layer.R_COM_C19_Sig01_PN44, ecu-extract-reference=COMPOSITIONTYPE.R_COM_C19_Sig01_PN44
      COM_SL05_Sig001: upstream-reference=ECU_COMP_ECU4_MB_Base_Layer.R_COM_SL05_Sig001.COM_SL05_Sig001, ecu-extract-reference=COMPOSITIONTYPE.R_COM_SL05_Sig001.COM_SL05_Sig001
      R_COM_SL05_Sig001: upstream-reference=ECU_COMP_ECU4_MB_Base_Layer.R_COM_SL05_Sig001, ecu-extract-reference=COMPOSITIONTYPE.R_COM_SL05_Sig001
      RsErr_LIN5_SL05: upstream-reference=ECU_COMP_ECU4_MB_Base_Layer.R_RsErr_LIN5_SL05.RsErr_LIN5_SL05, ecu-extract-reference=COMPOSITIONTYPE.R_RsErr_LIN5_SL05.RsErr_LIN5_SL05
      R_RsErr_LIN5_SL05: upstream-reference=ECU_COMP_ECU4_MB_Base_Layer.R_RsErr_LIN5_SL05, ecu-extract-reference=COMPOSITIONTYPE.R_RsErr_LIN5_SL05
      VehSpd8_Pr5_ST3_168m1ogyookfwuxfakr38tbmv: upstream-reference=ECU_COMP_ECU4_MB_Base_Layer.R_VehSpd8_Pr5_ST3.VehSpd8_Pr5_ST3, ecu-extract-reference=COMPOSITIONTYPE.R_VehSpd8_Pr5_ST3.VehSpd8_Pr5_ST3
      R_VehSpd8_Pr5_ST3: upstream-reference=ECU_COMP_ECU4_MB_Base_Layer.R_VehSpd8_Pr5_ST3, ecu-extract-reference=COMPOSITIONTYPE.R_VehSpd8_Pr5_ST3
      VSS_TP_SecTickCount_Lvl1_ST3_mzmfdqtqz5kvv1kfpvg0kql3: upstream-reference=ECU_COMP_ECU4_MB_Base_Layer.R_VSS_TP_SecTickCount_ST3.VSS_TP_SecTickCount_ST3, ecu-extract-reference=COMPOSITIONTYPE.R_VSS_TP_SecTickCount_ST3.VSS_TP_SecTickCount_ST3
      Actv_Line_Stat_ST3: upstream-reference=ECU_COMP_ECU4_MB_Base_Layer.R_Actv_Line_Stat_ST3.Actv_Line_Stat_ST3, ecu-extract-reference=COMPOSITIONTYPE.R_Actv_Line_Stat_ST3.Actv_Line_Stat_ST3
      R_Actv_Line_Stat_ST3: upstream-reference=ECU_COMP_ECU4_MB_Base_Layer.R_Actv_Line_Stat_ST3, ecu-extract-reference=COMPOSITIONTYPE.R_Actv_Line_Stat_ST3
      WakeupStat_Cluster4_LIN_S5: upstream-reference=ECU_COMP_ECU4_MB_Base_Layer.R_WakeupStat_Cluster4_LIN_S5.WakeupStat_Cluster4_LIN_S5, ecu-extract-reference=COMPOSITIONTYPE.R_WakeupStat_Cluster4_LIN_S5.WakeupStat_Cluster4_LIN_S5
      R_WakeupStat_Cluster4_LIN_S5: upstream-reference=ECU_COMP_ECU4_MB_Base_Layer.R_WakeupStat_Cluster4_LIN_S5, ecu-extract-reference=COMPOSITIONTYPE.R_WakeupStat_Cluster4_LIN_S5
