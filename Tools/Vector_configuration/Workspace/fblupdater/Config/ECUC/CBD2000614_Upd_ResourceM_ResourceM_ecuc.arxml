AUTOSAR XML (schema 00046)
package /ActiveEcuC
  module config ResourceM: implementation-config-variant=VARIANT-PRE-COMPILE
    ResourceMMcalConfig: ResourceMMasterCore=CORE0
      ResourceMMcalCore: ResourceMCoreID=CORE0
