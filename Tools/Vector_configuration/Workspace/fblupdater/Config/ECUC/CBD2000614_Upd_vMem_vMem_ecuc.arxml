AUTOSAR XML (schema 00046)
package /ActiveEcuC
  module config vMem: implementation-config-variant=VARIANT-PRE-COMPILE, module-description=vMem_Impl
    vMemInstance: vMemInstanceId=0
      vMemSectorList
        16 x vMemSector, all with vMemPageSize=32, vMemSectorSize=16384:
          PF2_PF0_PS0_S36_S63: vMemNumberOfSectors=9, vMemStartAddress=2690908160
          PF2_PF0_PS0_S0_S35: vMemNumberOfSectors=36, vMemStartAddress=2690646016
          PF0_PF2_PS0_S36_S63: vMemNumberOfSectors=9, vMemStartAddress=2684649472
          PF0_PF2_PS0_S0_S35: vMemNumberOfSectors=17, vMemStartAddress=2684354560
          PF0_PF2_PS1_S64_S127: vMemNumberOfSectors=37, vMemStartAddress=2684796928
          PF0_PF2_PS2_S128_S191: vMemNumberOfSectors=64, vMemStartAddress=2686451712
          PF1_PF3_PS0_S0_S63: vMemNumberOfSectors=64, vMemStartAddress=2687500288
          PF1_PF3_PS1_S64_S127: vMemNumberOfSectors=64, vMemStartAddress=2688548864
          PF1_PF3_PS2_S128_S191: vMemNumberOfSectors=64, vMemStartAddress=2689597440
          PF2_PF0_PS1_S64_S127: vMemNumberOfSectors=320, vMemStartAddress=2691055616
          PF2_PF0_PS2_S128_S191: vMemNumberOfSectors=64, vMemStartAddress=2692743168
          PF3_PF1_PS0_S0_S63: vMemNumberOfSectors=64, vMemStartAddress=2693791744
          PF3_PF1_PS1_S64_S127: vMemNumberOfSectors=64, vMemStartAddress=2694840320
          PF3_PF1_PS2_S128_S191: vMemNumberOfSectors=64, vMemStartAddress=2695888896
          PF4_PF5_PS0_S0_S63: vMemNumberOfSectors=64, vMemStartAddress=2696937472
          PF5_PF4_PS0_S0_S63: vMemNumberOfSectors=64, vMemStartAddress=2700083200
    vMemInstanceMapping: vMemvMemInstanceRef=vMemInstance, vMemFblMemoryDeviceRef=Flash
    vMemGeneral:
      vMemInitialize = false
      vMemUseIsBlank = false
      vMemUserMainFunction = false
      vMemUserInitFunction = false
      vMemCompareAfterWrite = true
      vMemInitHandling = ALL_DRIVERS_MANDATORY
