AUTOSAR XML (schema 00046)
package /ActiveEcuC
  module config FblBmHdr: implementation-config-variant=VARIANT-PRE-COMPILE, module-description=FblBmHdr_Impl
    FblBmHdrGeneral: FblBmHdrMaxVerificationEntries=1, FblBmHdrSbVerificationList=false
    Appl (FblBmHdrTarget): FblBmHdrTargetId=2
    Data (FblBmHdrTarget): FblBmHdrTargetId=3
    FblBmHdrHeader: FblBmHdrBlockLength=606208, FblBmHdrBlockStartAddress=2684796928, FblBmHdrEntryAddress=brsStartupEntry, FblBmHdrTargetRef=FblUpdater
      FblBmHdrVariant
        FblBmHdrAuthenticationHeader: FblBmHdrAuthenticationHeaderAddress=0xA00D2E00
    Fbl (FblBmHdrTarget): FblBmHdrTargetId=0
    FblUpdater (FblBmHdrTarget): FblBmHdrTargetId=1
