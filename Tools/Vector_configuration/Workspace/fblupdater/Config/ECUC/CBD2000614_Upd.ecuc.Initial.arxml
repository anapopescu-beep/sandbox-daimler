[part 1 of 2: package /InitialEcuC]
AUTOSAR XML (schema 00046)
package /InitialEcuC
  ecuc value collection InitialEcuC
    ecuc-values:
      Can
      CanIf
      CanNm
      CanSM
      CanTSyn
      CanTp
      Com
      ComM
      Dcm
      DoIP
      EcuC
      EcuM
      Eth
      EthIf
      EthSM
      EthSwt
      EthTSyn
      IpduM
      Lin
      LinIf
      LinSM
      LinTp
      Nm
      PduR
      Sd
      SecOC
      SoAd
      StbM
      TcpIp
      UdpNm
  module config Can
    CanConfigSet
      ECU4_CRN_CAN1_Cluster4_ff587629 (CanController):
        CanControllerActivation = true
        CanControllerDefaultBaudrate = ECU4_CRN_CAN1_Cluster4_ff587629/CanControllerBaudrateConfig
        CanControllerSystemRef = ECU4_CRN_CAN1_Cluster4
        CanWakeupSourceRef = EcuMCommonConfiguration/ECU4_CRN_CAN1_Cluster4_6it1ke922hxi7y4c8scsqzzry_25bd0b69
        CanControllerBaudrateConfig: CanControllerBaudRate=500
      ECU4_CRN_CANFD1_Cluster4_069cd7c3 (CanController):
        CanControllerActivation = true
        CanControllerDefaultBaudrate = ECU4_CRN_CANFD1_Cluster4_069cd7c3/CanControllerBaudrateConfig
        CanControllerSystemRef = ECU4_CRN_CANFD1_Cluster4
        CanWakeupSourceRef = EcuMCommonConfiguration/ECU4_CRN_CANFD1_Cluster4_bx4qzxpu7xp7napnh6bsrtlzq_d98d74ac
        CanControllerBaudrateConfig: CanControllerBaudRate=500
          CanControllerFdBaudrateConfig: CanControllerFdBaudRate=1000
      5 x CanHardwareObject, all with CanHandleType=BASIC, CanIdValue=0:
        ECU4_CRN_CAN1_Cluster4_6it1ke922hxi7y4c8scsqzzry_25bd0b69_Tx: CanObjectType=TRANSMIT, CanControllerRef=CanConfigSet/ECU4_CRN_CAN1_Cluster4_ff587629
        ECU4_CRN_CAN1_Cluster4_6it1ke922hxi7y4c8scsqzzry_7627c91f_Rx: CanIdType=EXTENDED, CanObjectType=RECEIVE, CanControllerRef=CanConfigSet/ECU4_CRN_CAN1_Cluster4_ff587629
        ECU4_CRN_CANFD1_Cluster4_bx4qzxpu7xp7napnh6bsrtlzq_0e7e26ec_Rx: CanIdType=STANDARD, CanObjectType=RECEIVE, CanControllerRef=CanConfigSet/ECU4_CRN_CANFD1_Cluster4_069cd7c3
        ECU4_CRN_CANFD1_Cluster4_bx4qzxpu7xp7napnh6bsrtlzq_3b347014_Rx: CanIdType=EXTENDED, CanObjectType=RECEIVE, CanControllerRef=CanConfigSet/ECU4_CRN_CANFD1_Cluster4_069cd7c3
        ECU4_CRN_CANFD1_Cluster4_bx4qzxpu7xp7napnh6bsrtlzq_d98d74ac_Tx: CanObjectType=TRANSMIT, CanControllerRef=CanConfigSet/ECU4_CRN_CANFD1_Cluster4_069cd7c3
    CanGeneral: CanIndex=0
  module config CanIf
    CanIfCtrlDrvCfg_7d254554 (CanIfCtrlDrvCfg): CanIfCtrlDrvInitHohConfigRef=CanIfInitHohCfg, CanIfCtrlDrvNameRef=CanGeneral
      ECU4_CRN_CAN1_Cluster4_ff587629 (CanIfCtrlCfg): CanIfCtrlCanCtrlRef=CanConfigSet/ECU4_CRN_CAN1_Cluster4_ff587629
      ECU4_CRN_CANFD1_Cluster4_069cd7c3 (CanIfCtrlCfg): CanIfCtrlCanCtrlRef=CanConfigSet/ECU4_CRN_CANFD1_Cluster4_069cd7c3
    CanIfInitCfg
      CAN1_Cluster4_ec1fd655 (CanIfBufferCfg): CanIfBufferSize=0, CanIfBufferHthRef=CanIfInitHohCfg/ECU4_CRN_CAN1_Cluster4_6it1ke922hxi7y4c8scsqzzry_25bd0b69_Tx
      CANFD1_Cluster4_2d5c8a9f (CanIfBufferCfg): CanIfBufferSize=0, CanIfBufferHthRef=CanIfInitHohCfg/ECU4_CRN_CANFD1_Cluster4_bx4qzxpu7xp7napnh6bsrtlzq_d98d74ac_Tx
      CanIfInitHohCfg: CanIfInitRefCfgSet=CanConfigSet
        3 x CanIfHrhCfg:
          ECU4_CRN_CAN1_Cluster4_6it1ke922hxi7y4c8scsqzzry_7627c91f_Rx: CanIfHrhCanCtrlIdRef=CanIfCtrlDrvCfg_7d254554/ECU4_CRN_CAN1_Cluster4_ff587629, CanIfHrhIdSymRef=CanConfigSet/ECU4_CRN_CAN1_Cluster4_6it1ke922hxi7y4c8scsqzzry_7627c91f_Rx
          ECU4_CRN_CANFD1_Cluster4_bx4qzxpu7xp7napnh6bsrtlzq_0e7e26ec_Rx: CanIfHrhCanCtrlIdRef=CanIfCtrlDrvCfg_7d254554/ECU4_CRN_CANFD1_Cluster4_069cd7c3, CanIfHrhIdSymRef=CanConfigSet/ECU4_CRN_CANFD1_Cluster4_bx4qzxpu7xp7napnh6bsrtlzq_0e7e26ec_Rx
          ECU4_CRN_CANFD1_Cluster4_bx4qzxpu7xp7napnh6bsrtlzq_3b347014_Rx: CanIfHrhCanCtrlIdRef=CanIfCtrlDrvCfg_7d254554/ECU4_CRN_CANFD1_Cluster4_069cd7c3, CanIfHrhIdSymRef=CanConfigSet/ECU4_CRN_CANFD1_Cluster4_bx4qzxpu7xp7napnh6bsrtlzq_3b347014_Rx
        ECU4_CRN_CAN1_Cluster4_6it1ke922hxi7y4c8scsqzzry_25bd0b69_Tx (CanIfHthCfg):
          CanIfHthCanCtrlIdRef = CanIfCtrlDrvCfg_7d254554/ECU4_CRN_CAN1_Cluster4_ff587629
          CanIfHthIdSymRef = CanConfigSet/ECU4_CRN_CAN1_Cluster4_6it1ke922hxi7y4c8scsqzzry_25bd0b69_Tx
        ECU4_CRN_CANFD1_Cluster4_bx4qzxpu7xp7napnh6bsrtlzq_d98d74ac_Tx (CanIfHthCfg):
          CanIfHthCanCtrlIdRef = CanIfCtrlDrvCfg_7d254554/ECU4_CRN_CANFD1_Cluster4_069cd7c3
          CanIfHthIdSymRef = CanConfigSet/ECU4_CRN_CANFD1_Cluster4_bx4qzxpu7xp7napnh6bsrtlzq_d98d74ac_Tx
      15 x CanIfRxPduCfg:
        COM_C10_Pdu01_PN08_8b282ab6_Rx: CanIfRxPduCanId=267452424, CanIfRxPduCanIdType=EXTENDED_CAN, CanIfRxPduDlc=8, CanIfRxPduUserRxIndicationName=PduR_CanIfRxIndication, CanIfRxPduUserRxIndicationUL=PDUR, CanIfRxPduHrhIdRef=CanIfInitHohCfg/ECU4_CRN_CAN1_Cluster4_6it1ke922hxi7y4c8scsqzzry_7627c91f_Rx, CanIfRxPduRef=EcucPduCollection/COM_C10_Pdu01_PN08_0cb26b5d_Rx
        COM_C10_Pdu01_PN17_9dc5a793_Rx: CanIfRxPduCanId=267452439, CanIfRxPduCanIdType=EXTENDED_CAN, CanIfRxPduDlc=8, CanIfRxPduUserRxIndicationName=PduR_CanIfRxIndication, CanIfRxPduUserRxIndicationUL=PDUR, CanIfRxPduHrhIdRef=CanIfInitHohCfg/ECU4_CRN_CAN1_Cluster4_6it1ke922hxi7y4c8scsqzzry_7627c91f_Rx, CanIfRxPduRef=EcucPduCollection/COM_C10_Pdu01_PN17_4cf8c594_Rx
        COM_C19_Frm02_ContainerIPdu_271a3db8_Rx: CanIfRxPduCanId=267489282, CanIfRxPduCanIdType=EXTENDED_FD_CAN, CanIfRxPduDlc=64, CanIfRxPduUserRxIndicationName=PduR_CanIfRxIndication, CanIfRxPduUserRxIndicationUL=PDUR, CanIfRxPduHrhIdRef=CanIfInitHohCfg/ECU4_CRN_CANFD1_Cluster4_bx4qzxpu7xp7napnh6bsrtlzq_3b347014_Rx, CanIfRxPduRef=EcucPduCollection/COM_C19_Frm02_ContainerIPdu_dfac1312_Rx
        COM_C19_Pdu01_PN08_337592cd_Rx: CanIfRxPduCanId=267489288, CanIfRxPduCanIdType=EXTENDED_FD_CAN, CanIfRxPduDlc=8, CanIfRxPduUserRxIndicationName=PduR_CanIfRxIndication, CanIfRxPduUserRxIndicationUL=PDUR, CanIfRxPduHrhIdRef=CanIfInitHohCfg/ECU4_CRN_CANFD1_Cluster4_bx4qzxpu7xp7napnh6bsrtlzq_3b347014_Rx, CanIfRxPduRef=EcucPduCollection/COM_C19_Pdu01_PN08_f0eb1e95_Rx
        COM_C19_Pdu01_PN44_9e3ab93e_Rx: CanIfRxPduCanId=267489348, CanIfRxPduCanIdType=EXTENDED_FD_CAN, CanIfRxPduDlc=8, CanIfRxPduUserRxIndicationName=PduR_CanIfRxIndication, CanIfRxPduUserRxIndicationUL=PDUR, CanIfRxPduHrhIdRef=CanIfInitHohCfg/ECU4_CRN_CANFD1_Cluster4_bx4qzxpu7xp7napnh6bsrtlzq_3b347014_Rx, CanIfRxPduRef=EcucPduCollection/COM_C19_Pdu01_PN44_08bc86e1_Rx
        DIAG_C10_ExtEth_RS_CAN1_CTP_8992fb4b_Rx: CanIfRxPduCanId=417337472, CanIfRxPduCanIdType=EXTENDED_CAN, CanIfRxPduDlc=8, CanIfRxPduUserRxIndicationName=CanTp_RxIndication, CanIfRxPduUserRxIndicationType=PDUID_PDUINFOPTR, CanIfRxPduUserRxIndicationUL=CAN_TP, CanIfRxPduHrhIdRef=CanIfInitHohCfg/ECU4_CRN_CAN1_Cluster4_6it1ke922hxi7y4c8scsqzzry_7627c91f_Rx, CanIfRxPduRef=DIAG_C10_ExtEth_RS_CAN1_CTP_c02ed27d_Rx
        DIAG_C10_IntEth_RS_CAN1_CTP_7ce29e8d_Rx: CanIfRxPduCanId=417337477, CanIfRxPduCanIdType=EXTENDED_CAN, CanIfRxPduDlc=8, CanIfRxPduUserRxIndicationName=CanTp_RxIndication, CanIfRxPduUserRxIndicationType=PDUID_PDUINFOPTR, CanIfRxPduUserRxIndicationUL=CAN_TP, CanIfRxPduHrhIdRef=CanIfInitHohCfg/ECU4_CRN_CAN1_Cluster4_6it1ke922hxi7y4c8scsqzzry_7627c91f_Rx, CanIfRxPduRef=DIAG_C10_IntEth_RS_CAN1_CTP_5cd71842_Rx
        DIAG_C19_ExtEth_RS_CANFD1_CTP_b33323d2_Rx: CanIfRxPduCanId=417339776, CanIfRxPduCanIdType=EXTENDED_CAN, CanIfRxPduDlc=64, CanIfRxPduUserRxIndicationName=CanTp_RxIndication, CanIfRxPduUserRxIndicationType=PDUID_PDUINFOPTR, CanIfRxPduUserRxIndicationUL=CAN_TP, CanIfRxPduHrhIdRef=CanIfInitHohCfg/ECU4_CRN_CANFD1_Cluster4_bx4qzxpu7xp7napnh6bsrtlzq_3b347014_Rx, CanIfRxPduRef=DIAG_C19_ExtEth_RS_CANFD1_CTP_497d5586_Rx
        DIAG_C19_IntEth_RS_CANFD1_CTP_a66e9a6a_Rx: CanIfRxPduCanId=417339781, CanIfRxPduCanIdType=EXTENDED_FD_CAN, CanIfRxPduDlc=64, CanIfRxPduUserRxIndicationName=CanTp_RxIndication, CanIfRxPduUserRxIndicationType=PDUID_PDUINFOPTR, CanIfRxPduUserRxIndicationUL=CAN_TP, CanIfRxPduHrhIdRef=CanIfInitHohCfg/ECU4_CRN_CANFD1_Cluster4_bx4qzxpu7xp7napnh6bsrtlzq_3b347014_Rx, CanIfRxPduRef=DIAG_C19_IntEth_RS_CANFD1_CTP_1093083d_Rx
        DIAG_ECU4_CTP_03_ExtCAN_RQ_FD_ST3_1c5f385a_Rx: CanIfRxPduCanId=417334409, CanIfRxPduCanIdType=EXTENDED_FD_CAN, CanIfRxPduDlc=64, CanIfRxPduUserRxIndicationName=CanTp_RxIndication, CanIfRxPduUserRxIndicationType=PDUID_PDUINFOPTR, CanIfRxPduUserRxIndicationUL=CAN_TP, CanIfRxPduHrhIdRef=CanIfInitHohCfg/ECU4_CRN_CANFD1_Cluster4_bx4qzxpu7xp7napnh6bsrtlzq_3b347014_Rx, CanIfRxPduRef=DIAG_ECU4_CTP_03_ExtCAN_RQ_FD_ST3_ce3f6aac_Rx
        DIAG_RQ_GLOBAL_ExtCAN_FD_ST3_eb577d88_Rx: CanIfRxPduCanId=418314633, CanIfRxPduCanIdType=EXTENDED_FD_CAN, CanIfRxPduDlc=64, CanIfRxPduUserRxIndicationName=CanTp_RxIndication, CanIfRxPduUserRxIndicationType=PDUID_PDUINFOPTR, CanIfRxPduUserRxIndicationUL=CAN_TP, CanIfRxPduHrhIdRef=CanIfInitHohCfg/ECU4_CRN_CANFD1_Cluster4_bx4qzxpu7xp7napnh6bsrtlzq_3b347014_Rx, CanIfRxPduRef=DIAG_RQ_GLOBAL_ExtCAN_FD_ST3_078ee7f5_Rx
        ECU4_CRN_CAN1_Cluster4NMNODE_2c912a8d_Rx: CanIfRxPduCanIdType=EXTENDED_CAN, CanIfRxPduDlc=8, CanIfRxPduUserRxIndicationName=CanNm_RxIndication, CanIfRxPduUserRxIndicationUL=CAN_NM, CanIfRxPduHrhIdRef=CanIfInitHohCfg/ECU4_CRN_CAN1_Cluster4_6it1ke922hxi7y4c8scsqzzry_7627c91f_Rx, CanIfRxPduRef=ECU4_CRN_CAN1_Cluster4NMNODE_0f1af05c_Rx
          CAN1_Cluster4_910c118c (CanIfRxPduCanIdRange): CanIfRxPduCanIdRangeLowerCanId=339869696, CanIfRxPduCanIdRangeUpperCanId=339873791
        ECU4_CRN_CANFD1_Cluster4NMNODE_a1f80c40_Rx: CanIfRxPduCanIdType=EXTENDED_NO_FD_CAN, CanIfRxPduDlc=8, CanIfRxPduUserRxIndicationName=CanNm_RxIndication, CanIfRxPduUserRxIndicationUL=CAN_NM, CanIfRxPduHrhIdRef=CanIfInitHohCfg/ECU4_CRN_CANFD1_Cluster4_bx4qzxpu7xp7napnh6bsrtlzq_3b347014_Rx, CanIfRxPduRef=ECU4_CRN_CANFD1_Cluster4NMNODE_9a3f72ab_Rx
          CANFD1_Cluster4_f6335e1c (CanIfRxPduCanIdRange): CanIfRxPduCanIdRangeLowerCanId=339869696, CanIfRxPduCanIdRangeUpperCanId=339873791
        FBL_Cfg_Star3_ST3_1e0c3ae2_Rx: CanIfRxPduCanId=104, CanIfRxPduCanIdType=STANDARD_NO_FD_CAN, CanIfRxPduDlc=1, CanIfRxPduUserRxIndicationName=PduR_CanIfRxIndication, CanIfRxPduUserRxIndicationUL=PDUR, CanIfRxPduHrhIdRef=CanIfInitHohCfg/ECU4_CRN_CANFD1_Cluster4_bx4qzxpu7xp7napnh6bsrtlzq_0e7e26ec_Rx, CanIfRxPduRef=EcucPduCollection/FBL_Cfg_Star3_ST3_bdf2a476_Rx
        TPA_CANFD_Eth_ST3_cdb993dc_Rx: CanIfRxPduCanId=1337, CanIfRxPduCanIdType=STANDARD_FD_CAN, CanIfRxPduDlc=64, CanIfRxPduUserRxIndicationName=CanTp_RxIndication, CanIfRxPduUserRxIndicationType=PDUID_PDUINFOPTR, CanIfRxPduUserRxIndicationUL=CAN_TP, CanIfRxPduHrhIdRef=CanIfInitHohCfg/ECU4_CRN_CANFD1_Cluster4_bx4qzxpu7xp7napnh6bsrtlzq_0e7e26ec_Rx, CanIfRxPduRef=TPA_CANFD_Eth_ST3_0c07352b_Rx
      28 x CanIfTxPduCfg:
        C04_CANFD_1_Container_ST3_ContainerIPdu_10761bd4_Tx: CanIfTxPduCanId=263, CanIfTxPduCanIdType=STANDARD_FD_CAN, CanIfTxPduDlc=64, CanIfTxPduUserTxConfirmationName=PduR_CanIfTxConfirmation, CanIfTxPduUserTxConfirmationUL=PDUR, CanIfTxPduBufferRef=CanIfInitCfg/CANFD1_Cluster4_2d5c8a9f, CanIfTxPduRef=EcucPduCollection/C04_CANFD_1_Container_ST3_ContainerIPdu_7bdf0645_Tx
        COM_C04_Frm05_ContainerIPdu_f090ef89_Tx: CanIfTxPduCanId=267403269, CanIfTxPduCanIdType=EXTENDED_FD_CAN, CanIfTxPduDlc=64, CanIfTxPduUserTxConfirmationName=PduR_CanIfTxConfirmation, CanIfTxPduUserTxConfirmationUL=PDUR, CanIfTxPduBufferRef=CanIfInitCfg/CANFD1_Cluster4_2d5c8a9f, CanIfTxPduRef=EcucPduCollection/COM_C04_Frm05_ContainerIPdu_09ce4b60_Tx
        COM_C04_Pdu01_PN08_519f3835_Tx: CanIfTxPduCanId=267403272, CanIfTxPduCanIdType=EXTENDED_CAN, CanIfTxPduDlc=8, CanIfTxPduUserTxConfirmationName=PduR_CanIfTxConfirmation, CanIfTxPduUserTxConfirmationUL=PDUR, CanIfTxPduBufferRef=CanIfInitCfg/CAN1_Cluster4_ec1fd655, CanIfTxPduRef=EcucPduCollection/COM_C04_Pdu01_PN08_1a3bebf9_Tx
        COM_C04_Pdu01_PN08_a17dad9f_Tx: CanIfTxPduCanId=267403272, CanIfTxPduCanIdType=EXTENDED_FD_CAN, CanIfTxPduDlc=8, CanIfTxPduUserTxConfirmationName=PduR_CanIfTxConfirmation, CanIfTxPduUserTxConfirmationUL=PDUR, CanIfTxPduBufferRef=CanIfInitCfg/CANFD1_Cluster4_2d5c8a9f, CanIfTxPduRef=EcucPduCollection/COM_C04_Pdu01_PN08_f12ace0a_Tx
        COM_C04_Pdu01_PN17_f8c14a03_Tx: CanIfTxPduCanId=267403287, CanIfTxPduCanIdType=EXTENDED_CAN, CanIfTxPduDlc=8, CanIfTxPduUserTxConfirmationName=PduR_CanIfTxConfirmation, CanIfTxPduUserTxConfirmationUL=PDUR, CanIfTxPduBufferRef=CanIfInitCfg/CAN1_Cluster4_ec1fd655, CanIfTxPduRef=EcucPduCollection/COM_C04_Pdu01_PN17_5a714530_Tx
        COM_C04_Pdu01_PN44_1b7ee01c_Tx: CanIfTxPduCanId=267403332, CanIfTxPduCanIdType=EXTENDED_FD_CAN, CanIfTxPduDlc=8, CanIfTxPduUserTxConfirmationName=PduR_CanIfTxConfirmation, CanIfTxPduUserTxConfirmationUL=PDUR, CanIfTxPduBufferRef=CanIfInitCfg/CANFD1_Cluster4_2d5c8a9f, CanIfTxPduRef=EcucPduCollection/COM_C04_Pdu01_PN44_097d567e_Tx
        DIAG_C10_ExtEth_RQ_CAN1_CTP_23324b52_Tx: CanIfTxPduCanId=417337480, CanIfTxPduCanIdType=EXTENDED_CAN, CanIfTxPduDlc=8, CanIfTxPduUserTxConfirmationName=CanTp_TxConfirmation, CanIfTxPduUserTxConfirmationUL=CAN_TP, CanIfTxPduBufferRef=CanIfInitCfg/CAN1_Cluster4_ec1fd655, CanIfTxPduRef=DIAG_C10_ExtEth_RQ_CAN1_CTP_3bb44803_Tx
        DIAG_C10_IntEth_RQ_CAN1_CTP_65ef24cb_Tx: CanIfTxPduCanId=417337485, CanIfTxPduCanIdType=EXTENDED_CAN, CanIfTxPduDlc=8, CanIfTxPduUserTxConfirmationName=CanTp_TxConfirmation, CanIfTxPduUserTxConfirmationUL=CAN_TP, CanIfTxPduBufferRef=CanIfInitCfg/CAN1_Cluster4_ec1fd655, CanIfTxPduRef=DIAG_C10_IntEth_RQ_CAN1_CTP_a74d823c_Tx
        DIAG_C19_ExtEth_RQ_CANFD1_CTP_5f8dcd93_Tx: CanIfTxPduCanId=417339784, CanIfTxPduCanIdType=EXTENDED_FD_CAN, CanIfTxPduDlc=64, CanIfTxPduUserTxConfirmationName=CanTp_TxConfirmation, CanIfTxPduUserTxConfirmationUL=CAN_TP, CanIfTxPduBufferRef=CanIfInitCfg/CANFD1_Cluster4_2d5c8a9f, CanIfTxPduRef=DIAG_C19_ExtEth_RQ_CANFD1_CTP_888f9b77_Tx
        DIAG_C19_IntEth_RQ_CANFD1_CTP_19186262_Tx: CanIfTxPduCanId=417339789, CanIfTxPduCanIdType=EXTENDED_FD_CAN, CanIfTxPduDlc=64, CanIfTxPduUserTxConfirmationName=CanTp_TxConfirmation, CanIfTxPduUserTxConfirmationUL=CAN_TP, CanIfTxPduBufferRef=CanIfInitCfg/CANFD1_Cluster4_2d5c8a9f, CanIfTxPduRef=DIAG_C19_IntEth_RQ_CANFD1_CTP_d161c6cc_Tx
        DIAG_ECU4_CTP_03_ExtCAN_RS_FD_ST3_0e9da60b_Tx: CanIfTxPduCanId=417334401, CanIfTxPduCanIdType=EXTENDED_FD_CAN, CanIfTxPduDlc=64, CanIfTxPduUserTxConfirmationName=CanTp_TxConfirmation, CanIfTxPduUserTxConfirmationUL=CAN_TP, CanIfTxPduBufferRef=CanIfInitCfg/CANFD1_Cluster4_2d5c8a9f, CanIfTxPduRef=DIAG_ECU4_CTP_03_ExtCAN_RS_FD_ST3_6f59bf14_Tx
        DIAG_RQ_GLOBAL_ExtEth_FD_ST3_d116cefc_Tx: CanIfTxPduCanId=418314376, CanIfTxPduCanIdType=EXTENDED_FD_CAN, CanIfTxPduDlc=64, CanIfTxPduUserTxConfirmationName=CanTp_TxConfirmation, CanIfTxPduUserTxConfirmationUL=CAN_TP, CanIfTxPduBufferRef=CanIfInitCfg/CANFD1_Cluster4_2d5c8a9f, CanIfTxPduRef=DIAG_RQ_GLOBAL_ExtEth_FD_ST3_3abb8ac0_Tx
        DIAG_RQ_GLOBAL_ExtEth_ST3_99a5e2c6_Tx: CanIfTxPduCanId=418314376, CanIfTxPduCanIdType=EXTENDED_CAN, CanIfTxPduDlc=8, CanIfTxPduUserTxConfirmationName=CanTp_TxConfirmation, CanIfTxPduUserTxConfirmationUL=CAN_TP, CanIfTxPduBufferRef=CanIfInitCfg/CAN1_Cluster4_ec1fd655, CanIfTxPduRef=DIAG_RQ_GLOBAL_ExtEth_ST3_45b46da7_Tx
        DIAG_RQ_GLOBAL_IntEth_FD_ST3_7fd2964b_Tx: CanIfTxPduCanId=418319757, CanIfTxPduCanIdType=EXTENDED_FD_CAN, CanIfTxPduDlc=64, CanIfTxPduUserTxConfirmationName=CanTp_TxConfirmation, CanIfTxPduUserTxConfirmationUL=CAN_TP, CanIfTxPduBufferRef=CanIfInitCfg/CANFD1_Cluster4_2d5c8a9f, CanIfTxPduRef=DIAG_RQ_GLOBAL_IntEth_FD_ST3_ca771c04_Tx
        DIAG_RQ_GLOBAL_IntEth_ST3_c658be97_Tx: CanIfTxPduCanId=418319757, CanIfTxPduCanIdType=EXTENDED_CAN, CanIfTxPduDlc=8, CanIfTxPduUserTxConfirmationName=CanTp_TxConfirmation, CanIfTxPduUserTxConfirmationUL=CAN_TP, CanIfTxPduBufferRef=CanIfInitCfg/CAN1_Cluster4_ec1fd655, CanIfTxPduRef=DIAG_RQ_GLOBAL_IntEth_ST3_f921c7ba_Tx
        ECU_Stat_C04_CAN1_efffb85a_Tx: CanIfTxPduCanId=373424132, CanIfTxPduCanIdType=EXTENDED_CAN, CanIfTxPduDlc=8, CanIfTxPduUserTxConfirmationName=PduR_CanIfTxConfirmation, CanIfTxPduUserTxConfirmationUL=PDUR, CanIfTxPduBufferRef=CanIfInitCfg/CAN1_Cluster4_ec1fd655, CanIfTxPduRef=EcucPduCollection/ECU_Stat_C04_CAN1_d3b8616c_Tx
        ECU_Stat_C04_CANFD1_45632381_Tx: CanIfTxPduCanId=373424132, CanIfTxPduCanIdType=EXTENDED_FD_CAN, CanIfTxPduDlc=8, CanIfTxPduUserTxConfirmationName=PduR_CanIfTxConfirmation, CanIfTxPduUserTxConfirmationUL=PDUR, CanIfTxPduBufferRef=CanIfInitCfg/CANFD1_Cluster4_2d5c8a9f, CanIfTxPduRef=EcucPduCollection/ECU_Stat_C04_CANFD1_ca9d12b7_Tx
        GTS_Main_CAN_CTP_012deb8f_Tx: CanIfTxPduCanId=121, CanIfTxPduCanIdType=STANDARD_CAN, CanIfTxPduDlc=8, CanIfTxPduUserTxConfirmationName=CanTSyn_CanIfTxConfirmation, CanIfTxPduUserTxConfirmationUL=CAN_TSYN, CanIfTxPduBufferRef=CanIfInitCfg/CAN1_Cluster4_ec1fd655, CanIfTxPduRef=EcucPduCollection/GTS_Main_CAN_CTP_e86d90c4_Tx
        GTS_Main_CAN_CTP_f95842d1_Tx: CanIfTxPduCanId=121, CanIfTxPduCanIdType=STANDARD_FD_CAN, CanIfTxPduDlc=8, CanIfTxPduUserTxConfirmationName=CanTSyn_CanIfTxConfirmation, CanIfTxPduUserTxConfirmationUL=CAN_TSYN, CanIfTxPduBufferRef=CanIfInitCfg/CANFD1_Cluster4_2d5c8a9f, CanIfTxPduRef=EcucPduCollection/GTS_Main_CAN_CTP_57e9dba0_Tx
        Ign_Stat_ST3_secured_19a4aa34_Tx: CanIfTxPduCanId=128, CanIfTxPduCanIdType=STANDARD_CAN, CanIfTxPduDlc=8, CanIfTxPduUserTxConfirmationName=PduR_CanIfTxConfirmation, CanIfTxPduUserTxConfirmationUL=PDUR, CanIfTxPduBufferRef=CanIfInitCfg/CAN1_Cluster4_ec1fd655, CanIfTxPduRef=Ign_Stat_ST3_secured_e8d6e35b_Tx
        NM_C04_2e00473e_Tx: CanIfTxPduCanId=339869700, CanIfTxPduCanIdType=EXTENDED_CAN, CanIfTxPduDlc=8, CanIfTxPduUserTxConfirmationName=CanNm_TxConfirmation, CanIfTxPduUserTxConfirmationUL=CAN_NM, CanIfTxPduBufferRef=CanIfInitCfg/CANFD1_Cluster4_2d5c8a9f, CanIfTxPduRef=EcucPduCollection/NM_C04_80f31308_Tx
        NM_C04_878b32ea_Tx: CanIfTxPduCanId=339869700, CanIfTxPduCanIdType=EXTENDED_CAN, CanIfTxPduDlc=8, CanIfTxPduUserTxConfirmationName=CanNm_TxConfirmation, CanIfTxPduUserTxConfirmationUL=CAN_NM, CanIfTxPduBufferRef=CanIfInitCfg/CAN1_Cluster4_ec1fd655, CanIfTxPduRef=EcucPduCollection/NM_C04_4fc72dfa_Tx
        TPA_Eth_CANFD_ST3_6d7b903d_Tx: CanIfTxPduCanId=1336, CanIfTxPduCanIdType=STANDARD_FD_CAN, CanIfTxPduDlc=64, CanIfTxPduUserTxConfirmationName=CanTp_TxConfirmation, CanIfTxPduUserTxConfirmationUL=CAN_TP, CanIfTxPduBufferRef=CanIfInitCfg/CANFD1_Cluster4_2d5c8a9f, CanIfTxPduRef=TPA_Eth_CANFD_ST3_5e564e5d_Tx
        VSS_TP_Auth_ST3_c278970d_Tx: CanIfTxPduCanId=749, CanIfTxPduCanIdType=STANDARD_CAN, CanIfTxPduDlc=8, CanIfTxPduUserTxConfirmationName=PduR_CanIfTxConfirmation, CanIfTxPduUserTxConfirmationUL=PDUR, CanIfTxPduBufferRef=CanIfInitCfg/CAN1_Cluster4_ec1fd655, CanIfTxPduRef=VSS_TP_Auth_ST3_72bf77fe_Tx
        VSS_TP_RealTmOffset_ST3_a8862772_Tx: CanIfTxPduCanId=741, CanIfTxPduCanIdType=STANDARD_CAN, CanIfTxPduDlc=8, CanIfTxPduUserTxConfirmationName=PduR_CanIfTxConfirmation, CanIfTxPduUserTxConfirmationUL=PDUR, CanIfTxPduBufferRef=CanIfInitCfg/CAN1_Cluster4_ec1fd655, CanIfTxPduRef=VSS_TP_RealTmOffset_ST3_e30a3a18_Tx
        VSS_TP_SecTickCount_Lvl2_ST3_68c01d6e_Tx: CanIfTxPduCanId=745, CanIfTxPduCanIdType=STANDARD_CAN, CanIfTxPduDlc=8, CanIfTxPduUserTxConfirmationName=PduR_CanIfTxConfirmation, CanIfTxPduUserTxConfirmationUL=PDUR, CanIfTxPduBufferRef=CanIfInitCfg/CAN1_Cluster4_ec1fd655, CanIfTxPduRef=EcucPduCollection/VSS_TP_SecTickCount_Lvl2_ST3_97652edb_Tx
        VSS_TP_SharedSecret_ST3_1edb02e1_Tx: CanIfTxPduCanId=751, CanIfTxPduCanIdType=STANDARD_CAN, CanIfTxPduDlc=8, CanIfTxPduUserTxConfirmationName=PduR_CanIfTxConfirmation, CanIfTxPduUserTxConfirmationUL=PDUR, CanIfTxPduBufferRef=CanIfInitCfg/CAN1_Cluster4_ec1fd655, CanIfTxPduRef=VSS_TP_SharedSecret_ST3_06868470_Tx
        VSS_TP_VIN_ST3_c5d6162e_Tx: CanIfTxPduCanId=747, CanIfTxPduCanIdType=STANDARD_CAN, CanIfTxPduDlc=8, CanIfTxPduUserTxConfirmationName=PduR_CanIfTxConfirmation, CanIfTxPduUserTxConfirmationUL=PDUR, CanIfTxPduBufferRef=CanIfInitCfg/CAN1_Cluster4_ec1fd655, CanIfTxPduRef=VSS_TP_VIN_ST3_938749e1_Tx
    CanIfPrivateCfg: CanIfPrivateSoftwareFilterType=LINEAR
    CanIfPublicCfg: CanIfPublicPnSupport=true
  module config CanNm
    CanNmGlobalConfig:
      CanNmBusLoadReductionEnabled = false
      CanNmComControlEnabled = true
      CanNmComUserDataSupport = true
      CanNmImmediateRestartEnabled = false
      CanNmPnEiraCalcEnabled = true
      CanNmPnResetTime = 1.1
      CanNmRemoteSleepIndEnabled = false
      CanNmRepeatMsgIndEnabled = false
      CanNmUserDataEnabled = false
      CanNmPnEiraRxNSduRef = PduPnc_EIRA_CAN_Rx
      CAN1_Cluster4_940f0938 (CanNmChannelConfig):
        CanNmBusLoadReductionActive = false
        CanNmImmediateNmCycleTime = 0.02
        CanNmImmediateNmTransmissions = 6
        CanNmMsgCycleOffset = 0
        CanNmMsgCycleTime = 1
        CanNmMsgReducedTime = 1.3
        CanNmMsgTimeoutTime = 0.5
        CanNmPduCbvPosition = CANNM_PDU_BYTE_0
        CanNmPnEnabled = true
        CanNmPnEraCalcEnabled = true
        CanNmRepeatMessageTime = 3
        CanNmTimeoutTime = 2.5
        CanNmUserDataLength = 7
        CanNmWaitBusSleepTime = 1.5
        CanNmComMNetworkHandleRef = ComMConfigSet/ECU4_CRN_CAN1_Cluster4_6it1ke922hxi7y4c8scsqzzry_25bd0b69
        CanNmPnEraRxNSduRef = PduPnc_ERA_CAN_CAN1_Cluster4_53b2b17a_Rx
        CAN1_Cluster4_940f0938_Rx (CanNmRxPdu): CanNmRxPduRef=ECU4_CRN_CAN1_Cluster4NMNODE_0f1af05c_Rx
        NM_C04_4fc72dfa_Tx (CanNmTxPdu): CanNmTxPduRef=EcucPduCollection/NM_C04_4fc72dfa_Tx
        NM_C04_a05e1db8 (CanNmUserDataTxPdu): CanNmTxUserDataPduRef=EcucPduCollection/NM_C04_04d2ea88_Tx
      CANFD1_Cluster4_95fff329 (CanNmChannelConfig):
        CanNmBusLoadReductionActive = false
        CanNmImmediateNmCycleTime = 0.02
        CanNmImmediateNmTransmissions = 6
        CanNmMsgCycleOffset = 0
        CanNmMsgCycleTime = 1
        CanNmMsgReducedTime = 1.3
        CanNmMsgTimeoutTime = 0.5
        CanNmPduCbvPosition = CANNM_PDU_BYTE_0
        CanNmPnEnabled = true
        CanNmPnEraCalcEnabled = true
        CanNmRepeatMessageTime = 3
        CanNmTimeoutTime = 2.5
        CanNmUserDataLength = 7
        CanNmWaitBusSleepTime = 1.5
        CanNmComMNetworkHandleRef = ComMConfigSet/ECU4_CRN_CANFD1_Cluster4_bx4qzxpu7xp7napnh6bsrtlzq_d98d74ac
        CanNmPnEraRxNSduRef = PduPnc_ERA_CAN_CANFD1_Cluster4_0f365fd3_Rx
        CANFD1_Cluster4_95fff329_Rx (CanNmRxPdu): CanNmRxPduRef=ECU4_CRN_CANFD1_Cluster4NMNODE_9a3f72ab_Rx
        NM_C04_80f31308_Tx (CanNmTxPdu): CanNmTxPduRef=EcucPduCollection/NM_C04_80f31308_Tx
        NM_C04_3d143193 (CanNmUserDataTxPdu): CanNmTxUserDataPduRef=EcucPduCollection/NM_C04_0b5d1bc3_Tx
      CanNmPnInfo: CanNmPnInfoLength=7, CanNmPnInfoOffset=1
        7 x CanNmPnFilterMaskByte:
          CanNmPnFilterMaskByte_0: CanNmPnFilterMaskByteIndex=0, CanNmPnFilterMaskByteValue=1
          CanNmPnFilterMaskByte_1: CanNmPnFilterMaskByteIndex=1, CanNmPnFilterMaskByteValue=2
          CanNmPnFilterMaskByte_2: CanNmPnFilterMaskByteIndex=2, CanNmPnFilterMaskByteValue=0
          CanNmPnFilterMaskByte_3: CanNmPnFilterMaskByteIndex=3, CanNmPnFilterMaskByteValue=0
          CanNmPnFilterMaskByte_4: CanNmPnFilterMaskByteIndex=4, CanNmPnFilterMaskByteValue=16
          CanNmPnFilterMaskByte_5: CanNmPnFilterMaskByteIndex=5, CanNmPnFilterMaskByteValue=0
          CanNmPnFilterMaskByte_6: CanNmPnFilterMaskByteIndex=6, CanNmPnFilterMaskByteValue=0
  module config CanSM
    CanSMConfiguration
      CAN1_Cluster4_ec1fd655 (CanSMManagerNetwork): CanSMComMNetworkHandleRef=ComMConfigSet/ECU4_CRN_CAN1_Cluster4_6it1ke922hxi7y4c8scsqzzry_25bd0b69
        ECU4_CRN_CAN1_Cluster4_b095f090 (CanSMController): CanSMControllerId=CanIfCtrlDrvCfg_7d254554/ECU4_CRN_CAN1_Cluster4_ff587629
      CANFD1_Cluster4_2d5c8a9f (CanSMManagerNetwork): CanSMComMNetworkHandleRef=ComMConfigSet/ECU4_CRN_CANFD1_Cluster4_bx4qzxpu7xp7napnh6bsrtlzq_d98d74ac
        ECU4_CRN_CANFD1_Cluster4_4c0e791c (CanSMController): CanSMControllerId=CanIfCtrlDrvCfg_7d254554/ECU4_CRN_CANFD1_Cluster4_069cd7c3
  module config CanTSyn
    GTD_Eth_Cluster4_0_127_5e02ab5e (CanTSynGlobalTimeDomain): CanTSynGlobalTimeDomainId=0, CanTSynSynchronizedTimeBaseRef=StbM/GTD_Eth_Cluster4_0_127_5e02ab5e
      GTM_ECU4_CRN_0_4f3c140b (CanTSynGlobalTimeMaster): CanTSynGlobalTimeTxCrcSecured=CRC_SUPPORTED, CanTSynGlobalTimeTxPeriod=0.5, CanTSynMasterConfirmationTimeout=0.2
        GTS_Main_CAN_CTP_e86d90c4_Tx (CanTSynGlobalTimeMasterPdu): CanTSynGlobalTimePduRef=EcucPduCollection/GTS_Main_CAN_CTP_e86d90c4_Tx
      GTM_ECU4_CRN_0_c0557bbd (CanTSynGlobalTimeMaster): CanTSynGlobalTimeTxCrcSecured=CRC_SUPPORTED, CanTSynGlobalTimeTxPeriod=0.5, CanTSynMasterConfirmationTimeout=0.2
        GTS_Main_CAN_CTP_57e9dba0_Tx (CanTSynGlobalTimeMasterPdu): CanTSynGlobalTimePduRef=EcucPduCollection/GTS_Main_CAN_CTP_57e9dba0_Tx
  module config CanTp
    CanTpConfig
      11 x CanTpChannel:
        CAN1_Cluster4_DIAG_C10_ExtEth_RQ_CAN1_CTP_DIAG_C10_ExtEth_RS_CAN1_CTP_f3a48c5c: CanTpChannelMode=CANTP_MODE_FULL_DUPLEX
          CanTpRxNSdu_c2b79320 (CanTpRxNSdu):
            CanTpBs = 8
            CanTpRxAddressingFormat = CANTP_STANDARD
            CanTpRxDl = 8
            CanTpRxPaddingActivation = CANTP_ON
            CanTpRxTaType = CANTP_PHYSICAL
            CanTpSTmin = 0.01
            CanTpRxNSduRef = SDU_DIAG_C10_ExtEth_RS_CAN1_CTP_b0b3ae04_Rx
            CanTpRxNPdu_1ad7d312 (CanTpRxNPdu): CanTpRxNPduRef=DIAG_C10_ExtEth_RS_CAN1_CTP_c02ed27d_Rx
            CanTpTxFcNPdu_1ad7d312 (CanTpTxFcNPdu): CanTpTxFcNPduRef=DIAG_C10_ExtEth_RQ_CAN1_CTP_3bb44803_Tx
          CanTpTxNSdu_c2b79320 (CanTpTxNSdu):
            CanTpTxAddressingFormat = CANTP_STANDARD
            CanTpTxDl = 8
            CanTpTxPaddingActivation = CANTP_ON
            CanTpTxTaType = CANTP_PHYSICAL
            CanTpTxNSduRef = SDU_DIAG_C10_ExtEth_RQ_CAN1_CTP_4b29347a_Tx
            CanTpRxFcNPdu_382d07e0 (CanTpRxFcNPdu): CanTpRxFcNPduRef=DIAG_C10_ExtEth_RS_CAN1_CTP_c02ed27d_Rx
            CanTpTxNPdu_382d07e0 (CanTpTxNPdu): CanTpTxNPduRef=DIAG_C10_ExtEth_RQ_CAN1_CTP_3bb44803_Tx
        CAN1_Cluster4_DIAG_C10_IntEth_RQ_CAN1_CTP_DIAG_C10_IntEth_RS_CAN1_CTP_64db1682: CanTpChannelMode=CANTP_MODE_FULL_DUPLEX
          CanTpRxNSdu_61bf4e1d (CanTpRxNSdu):
            CanTpBs = 8
            CanTpRxAddressingFormat = CANTP_STANDARD
            CanTpRxDl = 8
            CanTpRxPaddingActivation = CANTP_ON
            CanTpRxTaType = CANTP_PHYSICAL
            CanTpSTmin = 0.01
            CanTpRxNSduRef = SDU_DIAG_C10_IntEth_RS_CAN1_CTP_2c4a643b_Rx
            CanTpRxNPdu_8293f424 (CanTpRxNPdu): CanTpRxNPduRef=DIAG_C10_IntEth_RS_CAN1_CTP_5cd71842_Rx
            CanTpTxFcNPdu_8293f424 (CanTpTxFcNPdu): CanTpTxFcNPduRef=DIAG_C10_IntEth_RQ_CAN1_CTP_a74d823c_Tx
          CanTpTxNSdu_61bf4e1d (CanTpTxNSdu):
            CanTpTxAddressingFormat = CANTP_STANDARD
            CanTpTxDl = 8
            CanTpTxPaddingActivation = CANTP_ON
            CanTpTxTaType = CANTP_PHYSICAL
            CanTpTxNSduRef = SDU_DIAG_C10_IntEth_RQ_CAN1_CTP_d7d0fe45_Tx
            CanTpRxFcNPdu_a06920d6 (CanTpRxFcNPdu): CanTpRxFcNPduRef=DIAG_C10_IntEth_RS_CAN1_CTP_5cd71842_Rx
            CanTpTxNPdu_a06920d6 (CanTpTxNPdu): CanTpTxNPduRef=DIAG_C10_IntEth_RQ_CAN1_CTP_a74d823c_Tx
        CAN1_Cluster4_DIAG_GLOBAL_ExtEth_RQ_CAN1_ST3_11a5601d: CanTpChannelMode=CANTP_MODE_HALF_DUPLEX
          CanTpTxNSdu_0d9ecb95 (CanTpTxNSdu):
            CanTpTxAddressingFormat = CANTP_STANDARD
            CanTpTxDl = 8
            CanTpTxPaddingActivation = CANTP_ON
            CanTpTxTaType = CANTP_FUNCTIONAL
            CanTpTxNSduRef = SDU_DIAG_GLOBAL_ExtEth_RQ_CAN1_ST3_35cde3a1_Tx
            CanTpTxNPdu_ec4ce4a1 (CanTpTxNPdu): CanTpTxNPduRef=DIAG_RQ_GLOBAL_ExtEth_ST3_45b46da7_Tx
        CAN1_Cluster4_DIAG_GLOBAL_IntEth_RQ_CAN1_ST3_78309f4d: CanTpChannelMode=CANTP_MODE_HALF_DUPLEX
          CanTpTxNSdu_aca52c5a (CanTpTxNSdu):
            CanTpTxAddressingFormat = CANTP_STANDARD
            CanTpTxDl = 8
            CanTpTxPaddingActivation = CANTP_ON
            CanTpTxTaType = CANTP_FUNCTIONAL
            CanTpTxNSduRef = SDU_DIAG_GLOBAL_IntEth_RQ_CAN1_ST3_a934299e_Tx
            CanTpTxNPdu_76d1c38b (CanTpTxNPdu): CanTpTxNPduRef=DIAG_RQ_GLOBAL_IntEth_ST3_f921c7ba_Tx
        CANFD1_Cluster4_DIAG_C19_ExtEth_RQ_CANFD1_CTP_DIAG_C19_ExtEth_RS_CANFD1_CTP_1cfd587a: CanTpChannelMode=CANTP_MODE_FULL_DUPLEX
          CanTpRxNSdu_e3a7438f (CanTpRxNSdu):
            CanTpBs = 8
            CanTpRxAddressingFormat = CANTP_STANDARD
            CanTpRxDl = 64
            CanTpRxPaddingActivation = CANTP_ON
            CanTpRxTaType = CANTP_CANFD_PHYSICAL
            CanTpSTmin = 0.01
            CanTpRxNSduRef = SDU_DIAG_C19_ExtEth_RS_CANFD1_CTP_4244edec_Rx
            CanTpRxNPdu_80212e88 (CanTpRxNPdu): CanTpRxNPduRef=DIAG_C19_ExtEth_RS_CANFD1_CTP_497d5586_Rx
            CanTpTxFcNPdu_80212e88 (CanTpTxFcNPdu): CanTpTxFcNPduRef=DIAG_C19_ExtEth_RQ_CANFD1_CTP_888f9b77_Tx
          CanTpTxNSdu_e3a7438f (CanTpTxNSdu):
            CanTpTxAddressingFormat = CANTP_STANDARD
            CanTpTxDl = 8
            CanTpTxPaddingActivation = CANTP_ON
            CanTpTxTaType = CANTP_CANFD_PHYSICAL
            CanTpTxNSduRef = SDU_DIAG_C19_ExtEth_RQ_CANFD1_CTP_83b6231d_Tx
            CanTpRxFcNPdu_a2dbfa7a (CanTpRxFcNPdu): CanTpRxFcNPduRef=DIAG_C19_ExtEth_RS_CANFD1_CTP_497d5586_Rx
            CanTpTxNPdu_a2dbfa7a (CanTpTxNPdu): CanTpTxNPduRef=DIAG_C19_ExtEth_RQ_CANFD1_CTP_888f9b77_Tx
        CANFD1_Cluster4_DIAG_C19_IntEth_RQ_CANFD1_CTP_DIAG_C19_IntEth_RS_CANFD1_CTP_a091ada2: CanTpChannelMode=CANTP_MODE_FULL_DUPLEX
          CanTpRxNSdu_e1fa8db8 (CanTpRxNSdu):
            CanTpBs = 8
            CanTpRxAddressingFormat = CANTP_STANDARD
            CanTpRxDl = 64
            CanTpRxPaddingActivation = CANTP_ON
            CanTpRxTaType = CANTP_CANFD_PHYSICAL
            CanTpSTmin = 0.01
            CanTpRxNSduRef = SDU_DIAG_C19_IntEth_RS_CANFD1_CTP_1baab057_Rx
            CanTpRxNPdu_ccc54d7d (CanTpRxNPdu): CanTpRxNPduRef=DIAG_C19_IntEth_RS_CANFD1_CTP_1093083d_Rx
            CanTpTxFcNPdu_ccc54d7d (CanTpTxFcNPdu): CanTpTxFcNPduRef=DIAG_C19_IntEth_RQ_CANFD1_CTP_d161c6cc_Tx
          CanTpTxNSdu_e1fa8db8 (CanTpTxNSdu):
            CanTpTxAddressingFormat = CANTP_STANDARD
            CanTpTxDl = 8
            CanTpTxPaddingActivation = CANTP_ON
            CanTpTxTaType = CANTP_CANFD_PHYSICAL
            CanTpTxNSduRef = SDU_DIAG_C19_IntEth_RQ_CANFD1_CTP_da587ea6_Tx
            CanTpRxFcNPdu_ee3f998f (CanTpRxFcNPdu): CanTpRxFcNPduRef=DIAG_C19_IntEth_RS_CANFD1_CTP_1093083d_Rx
            CanTpTxNPdu_ee3f998f (CanTpTxNPdu): CanTpTxNPduRef=DIAG_C19_IntEth_RQ_CANFD1_CTP_d161c6cc_Tx
        CANFD1_Cluster4_DIAG_ECU4_CTP_03_ExtCAN_RQ_FD1_ST3_DIAG_ECU4_CTP_03_ExtCAN_RS_FD1_ST3_4aa10a75: CanTpChannelMode=CANTP_MODE_FULL_DUPLEX
          CanTpRxNSdu_843125f8 (CanTpRxNSdu):
            CanTpBs = 0
            CanTpRxAddressingFormat = CANTP_STANDARD
            CanTpRxDl = 64
            CanTpRxPaddingActivation = CANTP_ON
            CanTpRxTaType = CANTP_CANFD_PHYSICAL
            CanTpSTmin = 0.01
            CanTpRxNSduRef = EcucPduCollection/SDU_DIAG_ECU4_CTP_03_ExtCAN_RQ_FD1_ST3_8b6dc0cd_Rx
            CanTpRxNPdu_34c93e22 (CanTpRxNPdu): CanTpRxNPduRef=DIAG_ECU4_CTP_03_ExtCAN_RQ_FD_ST3_ce3f6aac_Rx
            CanTpTxFcNPdu_34c93e22 (CanTpTxFcNPdu): CanTpTxFcNPduRef=DIAG_ECU4_CTP_03_ExtCAN_RS_FD_ST3_6f59bf14_Tx
          CanTpTxNSdu_843125f8 (CanTpTxNSdu):
            CanTpTxAddressingFormat = CANTP_STANDARD
            CanTpTxDl = 8
            CanTpTxPaddingActivation = CANTP_ON
            CanTpTxTaType = CANTP_CANFD_PHYSICAL
            CanTpTxNSduRef = EcucPduCollection/SDU_DIAG_ECU4_CTP_03_ExtCAN_RS_FD1_ST3_4e769da6_Tx
            CanTpRxFcNPdu_1633ead0 (CanTpRxFcNPdu): CanTpRxFcNPduRef=DIAG_ECU4_CTP_03_ExtCAN_RQ_FD_ST3_ce3f6aac_Rx
            CanTpTxNPdu_1633ead0 (CanTpTxNPdu): CanTpTxNPduRef=DIAG_ECU4_CTP_03_ExtCAN_RS_FD_ST3_6f59bf14_Tx
        CANFD1_Cluster4_DIAG_GLOBAL_ExtCAN_RQ_CANFD1_ST3_7442f8b1: CanTpChannelMode=CANTP_MODE_HALF_DUPLEX
          CanTpRxNSdu_173798d5 (CanTpRxNSdu):
            CanTpBs = 0
            CanTpRxAddressingFormat = CANTP_STANDARD
            CanTpRxDl = 64
            CanTpRxPaddingActivation = CANTP_ON
            CanTpRxTaType = CANTP_CANFD_FUNCTIONAL
            CanTpRxNSduRef = EcucPduCollection/SDU_DIAG_GLOBAL_ExtCAN_RQ_CANFD1_ST3_35fdc983_Rx
            CanTpRxNPdu_e961ba95 (CanTpRxNPdu): CanTpRxNPduRef=DIAG_RQ_GLOBAL_ExtCAN_FD_ST3_078ee7f5_Rx
        CANFD1_Cluster4_DIAG_GLOBAL_ExtEth_RQ_CANFD1_ST3_9c02399f: CanTpChannelMode=CANTP_MODE_HALF_DUPLEX
          CanTpTxNSdu_e935087b (CanTpTxNSdu):
            CanTpTxAddressingFormat = CANTP_STANDARD
            CanTpTxDl = 8
            CanTpTxPaddingActivation = CANTP_ON
            CanTpTxTaType = CANTP_CANFD_FUNCTIONAL
            CanTpTxNSduRef = SDU_DIAG_GLOBAL_ExtEth_RQ_CANFD1_ST3_104c4878_Tx
            CanTpTxNPdu_de80075f (CanTpTxNPdu): CanTpTxNPduRef=DIAG_RQ_GLOBAL_ExtEth_FD_ST3_3abb8ac0_Tx
        CANFD1_Cluster4_DIAG_GLOBAL_IntEth_RQ_CANFD1_ST3_096a5899: CanTpChannelMode=CANTP_MODE_HALF_DUPLEX
          CanTpTxNSdu_e019f2cc (CanTpTxNSdu):
            CanTpTxAddressingFormat = CANTP_STANDARD
            CanTpTxDl = 8
            CanTpTxPaddingActivation = CANTP_ON
            CanTpTxTaType = CANTP_CANFD_FUNCTIONAL
            CanTpTxNSduRef = SDU_DIAG_GLOBAL_IntEth_RQ_CANFD1_ST3_49a215c3_Tx
            CanTpTxNPdu_c3119a93 (CanTpTxNPdu): CanTpTxNPduRef=DIAG_RQ_GLOBAL_IntEth_FD_ST3_ca771c04_Tx
        CANFD1_Cluster4_TPA_CANFD_Eth_ST3_TPA_Eth_CANFD_ST3_c1e2e452: CanTpChannelMode=CANTP_MODE_FULL_DUPLEX
          CanTpRxNSdu_904cf457 (CanTpRxNSdu):
            CanTpBs = 64
            CanTpRxAddressingFormat = CANTP_STANDARD
            CanTpRxDl = 64
            CanTpRxPaddingActivation = CANTP_OFF
            CanTpRxTaType = CANTP_CANFD_PHYSICAL
            CanTpSTmin = 0.04
            CanTpRxNSduRef = SDU_TPA_CANFD_Eth_ST3_e66fe46e_Rx
            CanTpRxNPdu_4f56aa63 (CanTpRxNPdu): CanTpRxNPduRef=TPA_CANFD_Eth_ST3_0c07352b_Rx
            CanTpTxFcNPdu_4f56aa63 (CanTpTxFcNPdu): CanTpTxFcNPduRef=TPA_Eth_CANFD_ST3_5e564e5d_Tx
          CanTpTxNSdu_904cf457 (CanTpTxNSdu):
            CanTpTxAddressingFormat = CANTP_STANDARD
            CanTpTxDl = 64
            CanTpTxPaddingActivation = CANTP_OFF
            CanTpTxTaType = CANTP_CANFD_PHYSICAL
            CanTpTxNSduRef = SDU_TPA_Eth_CANFD_ST3_b43e9f18_Tx
            CanTpRxFcNPdu_6dac7e91 (CanTpRxFcNPdu): CanTpRxFcNPduRef=TPA_CANFD_Eth_ST3_0c07352b_Rx
            CanTpTxNPdu_6dac7e91 (CanTpTxNPdu): CanTpTxNPduRef=TPA_Eth_CANFD_ST3_5e564e5d_Tx
  module config Com
    ComConfig
      86 x ComIPdu:
        C04_CANFD_1_Container_ST3_VSS_TP_SecTickCount_Lvl2_ST3_2da56e8b_Tx: ComIPduDirection=SEND, ComIPduType=NORMAL, ComIPduGroupRef=ECU4_CRN_CANFD1_Cluster4_Tx_PNC_All_Active_bbd973d2, ComIPduSignalGroupRef=VSS_TP_SecTickCount_Lvl2_ST3_9eubq13iosat764o0lqh5xb6r_945278bd_Tx, ComPduIdRef=EcucPduCollection/C04_CANFD_1_Container_ST3_VSS_TP_SecTickCount_Lvl2_ST3_2da56e8b_Tx
          ComTxIPdu: ComMinimumDelayTime=0.02, ComTxIPduUnusedAreasDefault=255
            ComTxModeTrue
              ComTxMode: ComTxModeMode=DIRECT, ComTxModeNumberOfRepetitions=0
        COM_C01_Pdu01_PN08_4daf151f_Rx: ComIPduDirection=RECEIVE, ComIPduType=NORMAL, ComIPduGroupRef=ECU4_CRN_Eth_Cluster4_Rx_PNC_00_c9ae9249, ComIPduGroupRef=ECU4_CRN_Eth_Cluster4_Rx_PNC_All_Active_cef0b377, ComIPduSignalRef=COM_C01_Sig01_PN08_eff292cd_Rx, ComPduIdRef=EcucPduCollection/COM_C01_Pdu01_PN08_4daf151f_Rx
        COM_C01_Pdu01_PN17_c40b39cf_Rx: ComIPduDirection=RECEIVE, ComIPduType=NORMAL, ComIPduGroupRef=ECU4_CRN_Eth_Cluster4_Rx_PNC_00_c9ae9249, ComIPduGroupRef=ECU4_CRN_Eth_Cluster4_Rx_PNC_09_b0722aed, ComIPduGroupRef=ECU4_CRN_Eth_Cluster4_Rx_PNC_All_Active_cef0b377, ComIPduSignalRef=COM_C01_Sig01_PN17_85134da2_Rx, ComPduIdRef=EcucPduCollection/COM_C01_Pdu01_PN17_c40b39cf_Rx
        COM_C01_Pdu01_PN44_20759c30_Rx: ComIPduDirection=RECEIVE, ComIPduType=NORMAL, ComIPduGroupRef=ECU4_CRN_Eth_Cluster4_Rx_PNC_00_c9ae9249, ComIPduGroupRef=ECU4_CRN_Eth_Cluster4_Rx_PNC_36_0be064bf, ComIPduGroupRef=ECU4_CRN_Eth_Cluster4_Rx_PNC_All_Active_cef0b377, ComIPduSignalRef=COM_C01_Sig01_PN44_43e722b2_Rx, ComPduIdRef=EcucPduCollection/COM_C01_Pdu01_PN44_20759c30_Rx
        COM_C01_Pdu01_PN53_a70a38d2_Rx: ComIPduDirection=RECEIVE, ComIPduType=NORMAL, ComIPduGroupRef=ECU4_CRN_Eth_Cluster4_Rx_PNC_00_c9ae9249, ComIPduGroupRef=ECU4_CRN_Eth_Cluster4_Rx_PNC_45_dda8a3c2, ComIPduGroupRef=ECU4_CRN_Eth_Cluster4_Rx_PNC_All_Active_cef0b377, ComIPduSignalRef=COM_C01_Sig01_PN53_ba06a35d_Rx, ComPduIdRef=EcucPduCollection/COM_C01_Pdu01_PN53_a70a38d2_Rx
        COM_C01_Pdu01_PN62_fb205b87_Rx: ComIPduDirection=RECEIVE, ComIPduType=NORMAL, ComIPduGroupRef=ECU4_CRN_Eth_Cluster4_Rx_PNC_00_c9ae9249, ComIPduGroupRef=ECU4_CRN_Eth_Cluster4_Rx_PNC_54_b3b4a215, ComIPduGroupRef=ECU4_CRN_Eth_Cluster4_Rx_PNC_All_Active_cef0b377, ComIPduSignalRef=COM_C01_Sig01_PN62_f85579ad_Rx, ComPduIdRef=EcucPduCollection/COM_C01_Pdu01_PN62_fb205b87_Rx
        COM_C04_C08_Pdu02_TpConnection_07a51284_Tx: ComIPduDirection=SEND, ComIPduType=TP, ComIPduSignalRef=COM_C04_C08_Pdu02_TpConnection_ISignal_05c6e382_Tx, ComPduIdRef=EcucPduCollection/COM_C04_C08_Pdu02_TpConnection_07a51284_Tx
          ComTxIPdu: ComMinimumDelayTime=0.04
            ComTxModeTrue
              ComTxMode: ComTxModeMode=DIRECT, ComTxModeNumberOfRepetitions=0
        COM_C04_C14_Pdu01_TpConnection_3728892a_Tx: ComIPduDirection=SEND, ComIPduType=TP, ComIPduSignalRef=COM_C04_C14_Pdu01_TpConnection_ISignal_9fb8e7b9_Tx, ComPduIdRef=EcucPduCollection/COM_C04_C14_Pdu01_TpConnection_3728892a_Tx
          ComTxIPdu: ComMinimumDelayTime=0.04
            ComTxModeTrue
              ComTxMode: ComTxModeMode=DIRECT, ComTxModeNumberOfRepetitions=0
        COM_C04_Frm05_COM_C04_Pdu05_afb7aab9_Tx: ComIPduDirection=SEND, ComIPduType=NORMAL, ComIPduGroupRef=ECU4_CRN_CANFD1_Cluster4_Tx_PNC_00_0ec53514, ComIPduGroupRef=ECU4_CRN_CANFD1_Cluster4_Tx_PNC_All_Active_bbd973d2, ComIPduSignalGroupRef=COM_C04_SGR01_P05_5t2743h81pbparal6h2spw309_86aa289f_Tx, ComIPduSignalRef=COM_C04_Sig005_dbae26a4_Tx, ComPduIdRef=EcucPduCollection/COM_C04_Frm05_COM_C04_Pdu05_afb7aab9_Tx
          ComTxIPdu: ComMinimumDelayTime=0.1, ComTxIPduUnusedAreasDefault=255
            ComTxModeTrue
              ComTxMode: ComTxModeMode=DIRECT, ComTxModeNumberOfRepetitions=0
        COM_C04_Frm05_COM_C04_Pdu06_36befb03_Tx: ComIPduDirection=SEND, ComIPduType=NORMAL, ComIPduGroupRef=ECU4_CRN_CANFD1_Cluster4_Tx_PNC_00_0ec53514, ComIPduGroupRef=ECU4_CRN_CANFD1_Cluster4_Tx_PNC_All_Active_bbd973d2, ComIPduSignalRef=COM_C04_Sig006_6b6fc3ec_Tx, ComIPduSignalRef=COM_C04_Sig007_1c68f37a_Tx, ComPduIdRef=EcucPduCollection/COM_C04_Frm05_COM_C04_Pdu06_36befb03_Tx
          ComTxIPdu: ComMinimumDelayTime=0.005, ComTxIPduUnusedAreasDefault=0
            ComTxModeTrue
              ComTxMode: ComTxModeMode=DIRECT, ComTxModeNumberOfRepetitions=100, ComTxModeRepetitionPeriod=0.1
        COM_C04_Frm05_COM_C04_Pdu07_41b9cb95_Tx: ComIPduDirection=SEND, ComIPduType=NORMAL, ComIPduGroupRef=ECU4_CRN_CANFD1_Cluster4_Tx_PNC_00_0ec53514, ComIPduGroupRef=ECU4_CRN_CANFD1_Cluster4_Tx_PNC_All_Active_bbd973d2, ComIPduSignalRef=COM_C04_Sig008_22bf7f7a_Tx, ComPduIdRef=EcucPduCollection/COM_C04_Frm05_COM_C04_Pdu07_41b9cb95_Tx
          ComTxIPdu: ComMinimumDelayTime=0.1, ComTxIPduUnusedAreasDefault=255
            ComTxModeTrue
              ComTxMode: ComTxModeMode=MIXED, ComTxModeNumberOfRepetitions=0, ComTxModeTimeOffset=0, ComTxModeTimePeriod=0.5
        COM_C04_Pdu01_PN08_35be779f_Tx: ComIPduDirection=SEND, ComIPduType=NORMAL, ComIPduGroupRef=ECU4_CRN_CANFD1_Cluster4_Tx_PNC_00_0ec53514, ComIPduGroupRef=ECU4_CRN_CANFD1_Cluster4_Tx_PNC_All_Active_bbd973d2, ComIPduSignalRef=COM_C04_Sig01_PN08_4bdc1bc3_Tx, ComPduIdRef=EcucPduCollection/COM_C04_Pdu01_PN08_35be779f_Tx
          ComTxIPdu: ComTxIPduUnusedAreasDefault=0
            ComTxModeTrue
              ComTxMode: ComTxModeMode=PERIODIC, ComTxModeTimeOffset=0.005, ComTxModeTimePeriod=1
        COM_C04_Pdu01_PN08_d50c620f_Tx: ComIPduDirection=SEND, ComIPduType=NORMAL, ComIPduGroupRef=ECU4_CRN_Eth_Cluster4_Tx_PNC_00_bab4ebc3, ComIPduGroupRef=ECU4_CRN_Eth_Cluster4_Tx_PNC_All_Active_69c4047f, ComIPduSignalRef=COM_C04_Sig01_PN08_4229ae48_Tx, ComPduIdRef=EcucPduCollection/COM_C04_Pdu01_PN08_d50c620f_Tx
          ComTxIPdu: ComTxIPduUnusedAreasDefault=0
            ComTxModeTrue
              ComTxMode: ComTxModeMode=PERIODIC, ComTxModeTimeOffset=0, ComTxModeTimePeriod=1
        COM_C04_Pdu01_PN08_f4b54190_Tx: ComIPduDirection=SEND, ComIPduType=NORMAL, ComIPduGroupRef=ECU4_CRN_CAN1_Cluster4_Tx_PNC_00_d3c5ef8c, ComIPduGroupRef=ECU4_CRN_CAN1_Cluster4_Tx_PNC_All_Active_396a3b75, ComIPduSignalRef=COM_C04_Sig01_PN08_c562616e_Tx, ComPduIdRef=EcucPduCollection/COM_C04_Pdu01_PN08_f4b54190_Tx
          ComTxIPdu: ComTxIPduUnusedAreasDefault=0
            ComTxModeTrue
              ComTxMode: ComTxModeMode=PERIODIC, ComTxModeTimeOffset=0, ComTxModeTimePeriod=1
        COM_C04_Pdu01_PN17_5ca84edf_Tx: ComIPduDirection=SEND, ComIPduType=NORMAL, ComIPduGroupRef=ECU4_CRN_Eth_Cluster4_Tx_PNC_00_bab4ebc3, ComIPduGroupRef=ECU4_CRN_Eth_Cluster4_Tx_PNC_09_c3685367, ComIPduGroupRef=ECU4_CRN_Eth_Cluster4_Tx_PNC_All_Active_69c4047f, ComIPduSignalRef=COM_C04_Sig01_PN17_28c87127_Tx, ComPduIdRef=EcucPduCollection/COM_C04_Pdu01_PN17_5ca84edf_Tx
          ComTxIPdu: ComTxIPduUnusedAreasDefault=0
            ComTxModeTrue
              ComTxMode: ComTxModeMode=PERIODIC, ComTxModeTimeOffset=0.005, ComTxModeTimePeriod=1
        COM_C04_Pdu01_PN17_7d116d40_Tx: ComIPduDirection=SEND, ComIPduType=NORMAL, ComIPduGroupRef=ECU4_CRN_CAN1_Cluster4_Tx_PNC_00_d3c5ef8c, ComIPduGroupRef=ECU4_CRN_CAN1_Cluster4_Tx_PNC_09_aa195728, ComIPduGroupRef=ECU4_CRN_CAN1_Cluster4_Tx_PNC_All_Active_396a3b75, ComIPduSignalRef=COM_C04_Sig01_PN17_af83be01_Tx, ComPduIdRef=EcucPduCollection/COM_C04_Pdu01_PN17_7d116d40_Tx
          ComTxIPdu: ComTxIPduUnusedAreasDefault=0
            ComTxModeTrue
              ComTxMode: ComTxModeMode=PERIODIC, ComTxModeTimeOffset=0.005, ComTxModeTimePeriod=1
        COM_C04_Pdu01_PN44_5864feb0_Tx: ComIPduDirection=SEND, ComIPduType=NORMAL, ComIPduGroupRef=ECU4_CRN_CANFD1_Cluster4_Tx_PNC_00_0ec53514, ComIPduGroupRef=ECU4_CRN_CANFD1_Cluster4_Tx_PNC_36_cc8bc3e2, ComIPduGroupRef=ECU4_CRN_CANFD1_Cluster4_Tx_PNC_All_Active_bbd973d2, ComIPduSignalRef=COM_C04_Sig01_PN44_e7c9abbc_Tx, ComPduIdRef=EcucPduCollection/COM_C04_Pdu01_PN44_5864feb0_Tx
          ComTxIPdu: ComTxIPduUnusedAreasDefault=0
            ComTxModeTrue
              ComTxMode: ComTxModeMode=PERIODIC, ComTxModeTimeOffset=0.005, ComTxModeTimePeriod=1
        COM_C04_Pdu01_PN44_b8d6eb20_Tx: ComIPduDirection=SEND, ComIPduType=NORMAL, ComIPduGroupRef=ECU4_CRN_Eth_Cluster4_Tx_PNC_00_bab4ebc3, ComIPduGroupRef=ECU4_CRN_Eth_Cluster4_Tx_PNC_36_78fa1d35, ComIPduGroupRef=ECU4_CRN_Eth_Cluster4_Tx_PNC_All_Active_69c4047f, ComIPduSignalRef=COM_C04_Sig01_PN44_ee3c1e37_Tx, ComPduIdRef=EcucPduCollection/COM_C04_Pdu01_PN44_b8d6eb20_Tx
          ComTxIPdu: ComTxIPduUnusedAreasDefault=0
            ComTxModeTrue
              ComTxMode: ComTxModeMode=PERIODIC, ComTxModeTimeOffset=0.01, ComTxModeTimePeriod=1
        COM_C04_Pdu01_PN53_3fa94fc2_Tx: ComIPduDirection=SEND, ComIPduType=NORMAL, ComIPduGroupRef=ECU4_CRN_Eth_Cluster4_Tx_PNC_00_bab4ebc3, ComIPduGroupRef=ECU4_CRN_Eth_Cluster4_Tx_PNC_45_aeb2da48, ComIPduGroupRef=ECU4_CRN_Eth_Cluster4_Tx_PNC_All_Active_69c4047f, ComIPduSignalRef=COM_C04_Sig01_PN53_17dd9fd8_Tx, ComPduIdRef=EcucPduCollection/COM_C04_Pdu01_PN53_3fa94fc2_Tx
          ComTxIPdu: ComTxIPduUnusedAreasDefault=0
            ComTxModeTrue
              ComTxMode: ComTxModeMode=PERIODIC, ComTxModeTimeOffset=0.015, ComTxModeTimePeriod=1
        COM_C04_Pdu01_PN62_63832c97_Tx: ComIPduDirection=SEND, ComIPduType=NORMAL, ComIPduGroupRef=ECU4_CRN_Eth_Cluster4_Tx_PNC_00_bab4ebc3, ComIPduGroupRef=ECU4_CRN_Eth_Cluster4_Tx_PNC_54_c0aedb9f, ComIPduGroupRef=ECU4_CRN_Eth_Cluster4_Tx_PNC_All_Active_69c4047f, ComIPduSignalRef=COM_C04_Sig01_PN62_558e4528_Tx, ComPduIdRef=EcucPduCollection/COM_C04_Pdu01_PN62_63832c97_Tx
          ComTxIPdu: ComTxIPduUnusedAreasDefault=0
            ComTxModeTrue
              ComTxMode: ComTxModeMode=PERIODIC, ComTxModeTimeOffset=0.02, ComTxModeTimePeriod=1
        COM_C04_Pdu02_Call_582d6eb8_Rx: ComIPduDirection=RECEIVE, ComIPduType=NORMAL, ComIPduSignalRef=COM_C04_Sig002_Call_b5adcdc4_Rx, ComPduIdRef=EcucPduCollection/COM_C04_Pdu02_Call_582d6eb8_Rx
        COM_C04_Pdu02_e98e7a25_Tx: ComIPduDirection=SEND, ComIPduType=NORMAL, ComIPduSignalRef=COM_C04_Sig002_ed549298_Tx, ComPduIdRef=EcucPduCollection/COM_C04_Pdu02_e98e7a25_Tx
          ComTxIPdu
            ComTxModeTrue
              ComTxMode: ComTxModeMode=DIRECT, ComTxModeNumberOfRepetitions=0
        COM_C04_Pdu03_9e894ab3_Tx: ComIPduDirection=SEND, ComIPduType=NORMAL, ComIPduSignalRef=COM_C04_Sig003_343b339f_Tx, ComPduIdRef=EcucPduCollection/COM_C04_Pdu03_9e894ab3_Tx
          ComTxIPdu
            ComTxModeTrue
              ComTxMode: ComTxModeMode=DIRECT, ComTxModeNumberOfRepetitions=0
        COM_C04_Pdu04_ced66c03_Tx: ComIPduDirection=SEND, ComIPduType=NORMAL, ComIPduGroupRef=TxNorm_ECU4_CRN_LIN5_Cluster4_afd7b2bf, ComIPduSignalRef=COM_C04_Sig1Cyc_1_191673fa_Tx, ComIPduSignalRef=COM_C04_Sig2Cyc_7_76e1a461_Tx, ComIPduSignalRef=COM_C04_Sig3Cyc_9_5a055ac3_Tx, ComIPduSignalRef=COM_C04_Sig4Cyc_24_d7d26a2d_Tx, ComPduIdRef=EcucPduCollection/COM_C04_Pdu04_ced66c03_Tx
          ComTxIPdu: ComTxIPduUnusedAreasDefault=255
        COM_C04_Pdu10_1e9b2a48_Tx: ComIPduDirection=SEND, ComIPduType=NORMAL, ComIPduSignalRef=COM_C04_Sig110_1b8546e2_Tx, ComPduIdRef=EcucPduCollection/COM_C04_Pdu10_1e9b2a48_Tx
          ComTxIPdu
            ComTxModeTrue
              ComTxMode: ComTxModeMode=DIRECT, ComTxModeNumberOfRepetitions=0
        COM_C04_Pdu11_699c1ade_Tx: ComIPduDirection=SEND, ComIPduType=NORMAL, ComIPduSignalRef=COM_C04_Sig111_c2eae7e5_Tx, ComPduIdRef=EcucPduCollection/COM_C04_Pdu11_699c1ade_Tx
          ComTxIPdu
            ComTxModeTrue
              ComTxMode: ComTxModeMode=DIRECT, ComTxModeNumberOfRepetitions=0
        COM_C04_Pdu12_f0954b64_Tx: ComIPduDirection=SEND, ComIPduType=NORMAL, ComIPduSignalRef=COM_C04_Sig112_722b02ad_Tx, ComPduIdRef=EcucPduCollection/COM_C04_Pdu12_f0954b64_Tx
          ComTxIPdu
            ComTxModeTrue
              ComTxMode: ComTxModeMode=DIRECT, ComTxModeNumberOfRepetitions=0
        COM_C04_Pdu13_87927bf2_Tx: ComIPduDirection=SEND, ComIPduType=NORMAL, ComIPduSignalRef=COM_C04_Sig113_ab44a3aa_Tx, ComPduIdRef=EcucPduCollection/COM_C04_Pdu13_87927bf2_Tx
          ComTxIPdu
            ComTxModeTrue
              ComTxMode: ComTxModeMode=DIRECT, ComTxModeNumberOfRepetitions=0
        COM_C04_Pdu14_19f6ee51_Tx: ComIPduDirection=SEND, ComIPduType=NORMAL, ComIPduSignalRef=COM_C04_Sig114_c8d9ce7c_Tx, ComPduIdRef=EcucPduCollection/COM_C04_Pdu14_19f6ee51_Tx
          ComTxIPdu
            ComTxModeTrue
              ComTxMode: ComTxModeMode=DIRECT, ComTxModeNumberOfRepetitions=0
        COM_C04_Pdu15_6ef1dec7_Tx: ComIPduDirection=SEND, ComIPduType=NORMAL, ComIPduSignalRef=COM_C04_Sig115_11b66f7b_Tx, ComPduIdRef=EcucPduCollection/COM_C04_Pdu15_6ef1dec7_Tx
          ComTxIPdu
            ComTxModeTrue
              ComTxMode: ComTxModeMode=DIRECT, ComTxModeNumberOfRepetitions=0
        COM_C04_Pdu16_f7f88f7d_Tx: ComIPduDirection=SEND, ComIPduType=NORMAL, ComIPduSignalRef=COM_C04_Sig116_a1778a33_Tx, ComPduIdRef=EcucPduCollection/COM_C04_Pdu16_f7f88f7d_Tx
          ComTxIPdu
            ComTxModeTrue
              ComTxMode: ComTxModeMode=DIRECT, ComTxModeNumberOfRepetitions=0
        COM_C04_Pdu17_80ffbfeb_Tx: ComIPduDirection=SEND, ComIPduType=NORMAL, ComIPduSignalRef=COM_C04_Sig117_78182b34_Tx, ComPduIdRef=EcucPduCollection/COM_C04_Pdu17_80ffbfeb_Tx
          ComTxIPdu
            ComTxModeTrue
              ComTxMode: ComTxModeMode=DIRECT, ComTxModeNumberOfRepetitions=0
        COM_C04_Pdu18_1040a27a_Tx: ComIPduDirection=SEND, ComIPduType=NORMAL, ComIPduSignalRef=COM_C04_Sig118_664d519f_Tx, ComPduIdRef=EcucPduCollection/COM_C04_Pdu18_1040a27a_Tx
          ComTxIPdu
            ComTxModeTrue
              ComTxMode: ComTxModeMode=DIRECT, ComTxModeNumberOfRepetitions=0
        COM_C04_Pdu19_674792ec_Tx: ComIPduDirection=SEND, ComIPduType=NORMAL, ComIPduSignalRef=COM_C04_Sig119_bf22f098_Tx, ComPduIdRef=EcucPduCollection/COM_C04_Pdu19_674792ec_Tx
          ComTxIPdu
            ComTxModeTrue
              ComTxMode: ComTxModeMode=DIRECT, ComTxModeNumberOfRepetitions=0
        COM_C04_Pdu20_35b6798b_Tx: ComIPduDirection=SEND, ComIPduType=NORMAL, ComIPduSignalRef=COM_C04_Sig120_63324ea5_Tx, ComPduIdRef=EcucPduCollection/COM_C04_Pdu20_35b6798b_Tx
          ComTxIPdu
            ComTxModeTrue
              ComTxMode: ComTxModeMode=DIRECT, ComTxModeNumberOfRepetitions=0
        COM_C04_Pdu21_42b1491d_Tx: ComIPduDirection=SEND, ComIPduType=NORMAL, ComIPduGroupRef=ECU4_CRN_Eth_Cluster4_Tx_PNC_All_Active_69c4047f, ComIPduSignalRef=COM_C04_Sig121_ba5defa2_Tx, ComIPduSignalRef=COM_C04_Sig221_b81b51fb_Tx, ComPduIdRef=EcucPduCollection/COM_C04_Pdu21_42b1491d_Tx
          ComTxIPdu: ComTxIPduUnusedAreasDefault=255
            ComTxModeTrue
              ComTxMode: ComTxModeMode=PERIODIC, ComTxModeTimeOffset=0.01, ComTxModeTimePeriod=0.02
        COM_C07_Pdu01_PN08_a292b0ff_Rx: ComIPduDirection=RECEIVE, ComIPduType=NORMAL, ComIPduGroupRef=ECU4_CRN_Eth_Cluster4_Rx_PNC_00_c9ae9249, ComIPduGroupRef=ECU4_CRN_Eth_Cluster4_Rx_PNC_All_Active_cef0b377, ComIPduSignalRef=COM_C07_Sig01_PN08_269f45cb_Rx, ComPduIdRef=EcucPduCollection/COM_C07_Pdu01_PN08_a292b0ff_Rx
        COM_C07_Pdu01_PN44_cf4839d0_Rx: ComIPduDirection=RECEIVE, ComIPduType=NORMAL, ComIPduGroupRef=ECU4_CRN_Eth_Cluster4_Rx_PNC_00_c9ae9249, ComIPduGroupRef=ECU4_CRN_Eth_Cluster4_Rx_PNC_36_0be064bf, ComIPduGroupRef=ECU4_CRN_Eth_Cluster4_Rx_PNC_All_Active_cef0b377, ComIPduSignalRef=COM_C07_Sig01_PN44_8a8af5b4_Rx, ComPduIdRef=EcucPduCollection/COM_C07_Pdu01_PN44_cf4839d0_Rx
        COM_C07_Pdu01_PN53_48379d32_Rx: ComIPduDirection=RECEIVE, ComIPduType=NORMAL, ComIPduGroupRef=ECU4_CRN_Eth_Cluster4_Rx_PNC_00_c9ae9249, ComIPduGroupRef=ECU4_CRN_Eth_Cluster4_Rx_PNC_45_dda8a3c2, ComIPduGroupRef=ECU4_CRN_Eth_Cluster4_Rx_PNC_All_Active_cef0b377, ComIPduSignalRef=COM_C07_Sig01_PN53_736b745b_Rx, ComPduIdRef=EcucPduCollection/COM_C07_Pdu01_PN53_48379d32_Rx
        COM_C08_C04_Pdu02_TpConnection_6f988d8e_Rx: ComIPduDirection=RECEIVE, ComIPduType=TP, ComIPduSignalRef=COM_C08_C04_Pdu02_TpConnection_ISignal_6f5712fd_Rx, ComPduIdRef=EcucPduCollection/COM_C08_C04_Pdu02_TpConnection_6f988d8e_Rx
        COM_C0X_Pdu10_528d0cd9_Rx: ComIPduDirection=RECEIVE, ComIPduType=NORMAL, ComIPduSignalRef=COM_C0X_Sig110_3bf2f712_Rx, ComPduIdRef=EcucPduCollection/COM_C0X_Pdu10_528d0cd9_Rx
        COM_C0X_Pdu11_258a3c4f_Rx: ComIPduDirection=RECEIVE, ComIPduType=NORMAL, ComIPduSignalRef=COM_C0X_Sig111_e29d5615_Rx, ComPduIdRef=EcucPduCollection/COM_C0X_Pdu11_258a3c4f_Rx
        COM_C0X_Pdu12_bc836df5_Rx: ComIPduDirection=RECEIVE, ComIPduType=NORMAL, ComIPduSignalRef=COM_C0X_Sig112_525cb35d_Rx, ComPduIdRef=EcucPduCollection/COM_C0X_Pdu12_bc836df5_Rx
        COM_C0X_Pdu13_cb845d63_Rx: ComIPduDirection=RECEIVE, ComIPduType=NORMAL, ComIPduSignalRef=COM_C0X_Sig113_8b33125a_Rx, ComPduIdRef=EcucPduCollection/COM_C0X_Pdu13_cb845d63_Rx
        COM_C0X_Pdu14_55e0c8c0_Rx: ComIPduDirection=RECEIVE, ComIPduType=NORMAL, ComIPduSignalRef=COM_C0X_Sig114_e8ae7f8c_Rx, ComPduIdRef=EcucPduCollection/COM_C0X_Pdu14_55e0c8c0_Rx
        COM_C0X_Pdu15_22e7f856_Rx: ComIPduDirection=RECEIVE, ComIPduType=NORMAL, ComIPduSignalRef=COM_C0X_Sig115_31c1de8b_Rx, ComPduIdRef=EcucPduCollection/COM_C0X_Pdu15_22e7f856_Rx
        COM_C0X_Pdu16_bbeea9ec_Rx: ComIPduDirection=RECEIVE, ComIPduType=NORMAL, ComIPduSignalRef=COM_C0X_Sig116_81003bc3_Rx, ComPduIdRef=EcucPduCollection/COM_C0X_Pdu16_bbeea9ec_Rx
        COM_C0X_Pdu17_cce9997a_Rx: ComIPduDirection=RECEIVE, ComIPduType=NORMAL, ComIPduSignalRef=COM_C0X_Sig117_586f9ac4_Rx, ComPduIdRef=EcucPduCollection/COM_C0X_Pdu17_cce9997a_Rx
        COM_C0X_Pdu18_5c5684eb_Rx: ComIPduDirection=RECEIVE, ComIPduType=NORMAL, ComIPduSignalRef=COM_C0X_Sig118_463ae06f_Rx, ComPduIdRef=EcucPduCollection/COM_C0X_Pdu18_5c5684eb_Rx
        COM_C0X_Pdu19_2b51b47d_Rx: ComIPduDirection=RECEIVE, ComIPduType=NORMAL, ComIPduSignalRef=COM_C0X_Sig119_9f554168_Rx, ComPduIdRef=EcucPduCollection/COM_C0X_Pdu19_2b51b47d_Rx
        COM_C0X_Pdu20_79a05f1a_Rx: ComIPduDirection=RECEIVE, ComIPduType=NORMAL, ComIPduSignalRef=COM_C0X_Sig120_4345ff55_Rx, ComPduIdRef=EcucPduCollection/COM_C0X_Pdu20_79a05f1a_Rx
        COM_C0X_Pdu21_0ea76f8c_Rx: ComIPduDirection=RECEIVE, ComIPduType=NORMAL, ComIPduGroupRef=ECU4_CRN_Eth_Cluster4_Rx_PNC_All_Active_cef0b377, ComIPduSignalRef=COM_C0X_Sig121_9a2a5e52_Rx, ComIPduSignalRef=COM_C0X_Sig221_986ce00b_Rx, ComPduIdRef=EcucPduCollection/COM_C0X_Pdu21_0ea76f8c_Rx
        COM_C10_Pdu01_PN08_2a25a36a_Rx: ComIPduDirection=RECEIVE, ComIPduType=NORMAL, ComIPduGroupRef=ECU4_CRN_CAN1_Cluster4_Rx_PNC_00_a0df9606, ComIPduGroupRef=ECU4_CRN_CAN1_Cluster4_Rx_PNC_All_Active_9e5e8c7d, ComIPduSignalRef=COM_C10_Sig01_PN08_d1b7257a_Rx, ComPduIdRef=EcucPduCollection/COM_C10_Pdu01_PN08_2a25a36a_Rx
        COM_C10_Pdu01_PN17_a3818fba_Rx: ComIPduDirection=RECEIVE, ComIPduType=NORMAL, ComIPduGroupRef=ECU4_CRN_CAN1_Cluster4_Rx_PNC_00_a0df9606, ComIPduGroupRef=ECU4_CRN_CAN1_Cluster4_Rx_PNC_09_d9032ea2, ComIPduGroupRef=ECU4_CRN_CAN1_Cluster4_Rx_PNC_All_Active_9e5e8c7d, ComIPduSignalRef=COM_C10_Sig01_PN17_bb56fa15_Rx, ComPduIdRef=EcucPduCollection/COM_C10_Pdu01_PN17_a3818fba_Rx
        COM_C14_C04_Pdu01_TpConnection_0d799aba_Rx: ComIPduDirection=RECEIVE, ComIPduType=TP, ComIPduGroupRef=ECU4_CRN_Eth_Cluster4_Rx_PNC_00_c9ae9249, ComIPduGroupRef=ECU4_CRN_Eth_Cluster4_Rx_PNC_All_Active_cef0b377, ComIPduSignalRef=COM_C14_C04_Pdu01_TpConnection_ISignal_8fab0d74_Rx, ComPduIdRef=EcucPduCollection/COM_C14_C04_Pdu01_TpConnection_0d799aba_Rx
        COM_C19_Frm02_COM_C19_Pdu02_5201838a_Rx: ComIPduDirection=RECEIVE, ComIPduType=NORMAL, ComIPduGroupRef=ECU4_CRN_CANFD1_Cluster4_Rx_PNC_00_7ddf4c9e, ComIPduGroupRef=ECU4_CRN_CANFD1_Cluster4_Rx_PNC_All_Active_1cedc4da, ComIPduSignalRef=COM_C19_Sig002_b5a6f2ff_Rx, ComIPduSignalRef=COM_C19_Sig003_c2a1c269_Rx, ComPduIdRef=EcucPduCollection/COM_C19_Frm02_COM_C19_Pdu02_5201838a_Rx
        COM_C19_Frm02_COM_C19_Pdu03_2506b31c_Rx: ComIPduDirection=RECEIVE, ComIPduType=NORMAL, ComIPduGroupRef=ECU4_CRN_CANFD1_Cluster4_Rx_PNC_00_7ddf4c9e, ComIPduGroupRef=ECU4_CRN_CANFD1_Cluster4_Rx_PNC_All_Active_1cedc4da, ComIPduSignalRef=COM_C19_Sig004_f2adc65b_Rx, ComPduIdRef=EcucPduCollection/COM_C19_Frm02_COM_C19_Pdu03_2506b31c_Rx
        COM_C19_Frm02_COM_C19_Pdu04_bb6226bf_Rx: ComIPduDirection=RECEIVE, ComIPduType=NORMAL, ComIPduGroupRef=ECU4_CRN_CANFD1_Cluster4_Rx_PNC_00_7ddf4c9e, ComIPduGroupRef=ECU4_CRN_CANFD1_Cluster4_Rx_PNC_All_Active_1cedc4da, ComIPduSignalRef=COM_C19_Sig005_78530eb8_Rx, ComIPduSignalRef=COM_C19_Sig006_e15a5f02_Rx, ComPduIdRef=EcucPduCollection/COM_C19_Frm02_COM_C19_Pdu04_bb6226bf_Rx
        COM_C19_Pdu01_PN08_7687aff4_Rx: ComIPduDirection=RECEIVE, ComIPduType=NORMAL, ComIPduGroupRef=ECU4_CRN_CANFD1_Cluster4_Rx_PNC_00_7ddf4c9e, ComIPduGroupRef=ECU4_CRN_CANFD1_Cluster4_Rx_PNC_All_Active_1cedc4da, ComIPduSignalRef=COM_C19_Sig01_PN08_bb78cb1f_Rx, ComPduIdRef=EcucPduCollection/COM_C19_Pdu01_PN08_7687aff4_Rx
        COM_C19_Pdu01_PN44_1b5d26db_Rx: ComIPduDirection=RECEIVE, ComIPduType=NORMAL, ComIPduGroupRef=ECU4_CRN_CANFD1_Cluster4_Rx_PNC_00_7ddf4c9e, ComIPduGroupRef=ECU4_CRN_CANFD1_Cluster4_Rx_PNC_36_bf91ba68, ComIPduGroupRef=ECU4_CRN_CANFD1_Cluster4_Rx_PNC_All_Active_1cedc4da, ComIPduSignalRef=COM_C19_Sig01_PN44_176d7b60_Rx, ComPduIdRef=EcucPduCollection/COM_C19_Pdu01_PN44_1b5d26db_Rx
        COM_SL05_Pdu01_dfc1d25f_Rx: ComIPduDirection=RECEIVE, ComIPduType=NORMAL, ComIPduGroupRef=RxNorm_ECU4_CRN_LIN5_Cluster4_3eb66226, ComIPduSignalRef=COM_SL05_Sig001_089333d4_Rx, ComIPduSignalRef=RsErr_LIN5_SL05_dafd79b3_Rx, ComIPduSignalRef=WakeupStat_Cluster4_LIN_S5_9b9dbcbd_Rx, ComPduIdRef=EcucPduCollection/COM_SL05_Pdu01_dfc1d25f_Rx
        ComIPduPnc_EIRA_CAN_Rx: ComIPduDirection=RECEIVE, ComIPduSignalRef=ComSignalPnc_EIRA_CAN_Rx, ComPduIdRef=PduPnc_EIRA_CAN_Rx
        ComIPduPnc_EIRA_ETH_Rx: ComIPduDirection=RECEIVE, ComIPduSignalRef=ComSignalPnc_EIRA_ETH_Rx, ComPduIdRef=PduPnc_EIRA_ETH_Rx
        ComIPduPnc_ERA_CAN_CAN1_Cluster4_53b2b17a_Rx: ComIPduDirection=RECEIVE, ComIPduSignalRef=ComSignalPnc_ERA_CAN_CAN1_Cluster4_53b2b17a_Rx, ComPduIdRef=PduPnc_ERA_CAN_CAN1_Cluster4_53b2b17a_Rx
        ComIPduPnc_ERA_CAN_CANFD1_Cluster4_0f365fd3_Rx: ComIPduDirection=RECEIVE, ComIPduSignalRef=ComSignalPnc_ERA_CAN_CANFD1_Cluster4_0f365fd3_Rx, ComPduIdRef=PduPnc_ERA_CAN_CANFD1_Cluster4_0f365fd3_Rx
        ComIPduPnc_ERA_ETH_ECU4_CRN_Eth_Cluster4_3g6xoesclytkmkqofl9pi6ol1_481bdd0f_Rx: ComIPduDirection=RECEIVE, ComIPduSignalRef=ComSignalPnc_ERA_ETH_ECU4_CRN_Eth_Cluster4_3g6xoesclytkmkqofl9pi6ol1_481bdd0f_Rx, ComPduIdRef=PduPnc_ERA_ETH_ECU4_CRN_Eth_Cluster4_3g6xoesclytkmkqofl9pi6ol1_481bdd0f_Rx
        DIAG_C01_ONBD_Container_ST3_DIAG_Stat_ST3_1a17e5f9_Rx: ComIPduDirection=RECEIVE, ComIPduType=NORMAL, ComIPduGroupRef=ECU4_CRN_Eth_Cluster4_Rx_PNC_All_Active_d9df5141, ComIPduSignalRef=Actv_Line_Stat_ST3_38ee811f_Rx, ComIPduSignalRef=DidA_ExtTest_Pres_ST3_0ace79d9_Rx, ComPduIdRef=EcucPduCollection/DIAG_C01_ONBD_Container_ST3_DIAG_Stat_ST3_1a17e5f9_Rx
        DIAG_ROE_C04_Container_ST3_ROE_C04_PDU01_f322ff21_Tx: ComIPduDirection=SEND, ComIPduType=NORMAL, ComIPduGroupRef=ECU4_CRN_Eth_Cluster4_Tx_PNC_All_Active_9da251eb, ComIPduSignalGroupRef=Diag_RoE_C04_SigGrp01_2ksq5hjijyze6lf3nboiafq6k_da3d7672_Tx, ComPduIdRef=EcucPduCollection/DIAG_ROE_C04_Container_ST3_ROE_C04_PDU01_f322ff21_Tx
          ComTxIPdu: ComMinimumDelayTime=0.2, ComTxIPduUnusedAreasDefault=255
            ComTxModeTrue
              ComTxMode: ComTxModeMode=DIRECT, ComTxModeNumberOfRepetitions=0
        DI_OdoSpeedometer_ST3_ffe5aaae_Rx: ComIPduDirection=RECEIVE, ComIPduType=NORMAL, ComIPduGroupRef=ECU4_CRN_Eth_Cluster4_Rx_PNC_All_Active_cef0b377, ComIPduSignalGroupRef=DI_Odo_Pr5_ST3_e68xmtlkywxgxsdwekdjjhw3t_fd42724a_Rx, ComPduIdRef=EcucPduCollection/DI_OdoSpeedometer_ST3_ffe5aaae_Rx
        ECU_Stat_C04_CAN1_2bd34198_Tx: ComIPduDirection=SEND, ComIPduType=NORMAL, ComIPduGroupRef=ECU4_CRN_CAN1_Cluster4_Tx_PNC_00_d3c5ef8c, ComIPduGroupRef=ECU4_CRN_CAN1_Cluster4_Tx_PNC_09_aa195728, ComIPduGroupRef=ECU4_CRN_CAN1_Cluster4_Tx_PNC_All_Active_396a3b75, ComIPduSignalRef=Awake_Diag_Actv_ECU4_d39cd365_Tx, ComIPduSignalRef=Awake_Ignition_On_C04_4cfb34fb_Tx, ComIPduSignalRef=Awake_NwStart_Cluster_ECU4_e9d6a996_Tx, ComIPduSignalRef=ECU_ID_C04_c477e499_Tx, ComIPduSignalRef=NwId_C04_CAN1_20d9dbad_Tx, ComIPduSignalRef=WakeupRsn_C04_ECU04_43f9feaf_Tx, ComPduIdRef=EcucPduCollection/ECU_Stat_C04_CAN1_2bd34198_Tx
          ComTxIPdu: ComTxIPduUnusedAreasDefault=255
            ComTxModeTrue
              ComTxMode: ComTxModeMode=PERIODIC, ComTxModeTimeOffset=0.01, ComTxModeTimePeriod=1
        ECU_Stat_C04_CANFD1_fd91aa71_Tx: ComIPduDirection=SEND, ComIPduType=NORMAL, ComIPduGroupRef=ECU4_CRN_CANFD1_Cluster4_Tx_PNC_00_0ec53514, ComIPduGroupRef=ECU4_CRN_CANFD1_Cluster4_Tx_PNC_36_cc8bc3e2, ComIPduGroupRef=ECU4_CRN_CANFD1_Cluster4_Tx_PNC_All_Active_bbd973d2, ComIPduSignalRef=Awake_Diag_Actv_ECU4_086d59bd_Tx, ComIPduSignalRef=Awake_Ignition_On_C04_c4289f97_Tx, ComIPduSignalRef=Awake_NwStart_Cluster_ECU4_53eb34f4_Tx, ComIPduSignalRef=ECU_ID_C04_bbd46a3e_Tx, ComIPduSignalRef=NwId_C04_CANFD1_631c0bbe_Tx, ComIPduSignalRef=WakeupRsn_C04_ECU04_09baf085_Tx, ComPduIdRef=EcucPduCollection/ECU_Stat_C04_CANFD1_fd91aa71_Tx
          ComTxIPdu: ComTxIPduUnusedAreasDefault=255
            ComTxModeTrue
              ComTxMode: ComTxModeMode=PERIODIC, ComTxModeTimeOffset=0.01, ComTxModeTimePeriod=1
        ECU_Stat_C04_ETH_Container_ECU_Stat_C04_ETH_47aafe39_Tx: ComIPduDirection=SEND, ComIPduType=NORMAL, ComIPduGroupRef=ECU4_CRN_Eth_Cluster4_Tx_PNC_00_5800caa3, ComIPduGroupRef=ECU4_CRN_Eth_Cluster4_Tx_PNC_09_21dc7207, ComIPduGroupRef=ECU4_CRN_Eth_Cluster4_Tx_PNC_18_4fc073d0, ComIPduGroupRef=ECU4_CRN_Eth_Cluster4_Tx_PNC_27_f4523d82, ComIPduGroupRef=ECU4_CRN_Eth_Cluster4_Tx_PNC_36_9a4e3c55, ComIPduGroupRef=ECU4_CRN_Eth_Cluster4_Tx_PNC_45_4c06fb28, ComIPduGroupRef=ECU4_CRN_Eth_Cluster4_Tx_PNC_54_221afaff, ComIPduGroupRef=ECU4_CRN_Eth_Cluster4_Tx_PNC_All_Active_03aa5330, ComIPduSignalRef=Awake_Diag_Actv_ECU4_1463dbf3_Tx, ComIPduSignalRef=Awake_Ignition_On_C04_5550fd82_Tx, ComIPduSignalRef=Awake_NwStart_Cluster_ECU4_587c913d_Tx, ComIPduSignalRef=ECU_ID_C04_33a5606d_Tx, ComIPduSignalRef=NwId_C04_ETH_ECU4_b2258645_Tx, ComIPduSignalRef=WakeupRsn_C04_ECU04_6b59dcd4_Tx, ComPduIdRef=EcucPduCollection/ECU_Stat_C04_ETH_Container_ECU_Stat_C04_ETH_47aafe39_Tx
          ComTxIPdu: ComTxIPduUnusedAreasDefault=255
            ComTxModeTrue
              ComTxMode: ComTxModeMode=PERIODIC, ComTxModeTimeOffset=0, ComTxModeTimePeriod=1
        FBL_Cfg_Star3_ST3_b7257cce_Rx: ComIPduDirection=RECEIVE, ComIPduType=NORMAL, ComIPduGroupRef=ECU4_CRN_CANFD1_Cluster4_Rx_PNC_All_Active_1cedc4da, ComIPduSignalRef=Platform_Stat_Star3_f1e85fdc_Rx, ComPduIdRef=EcucPduCollection/FBL_Cfg_Star3_ST3_b7257cce_Rx
        Ign_Stat_ST3_dacb1e38_Rx: ComIPduDirection=RECEIVE, ComIPduType=NORMAL, ComIPduGroupRef=ECU4_CRN_Eth_Cluster4_Rx_PNC_00_c9ae9249, ComIPduGroupRef=ECU4_CRN_Eth_Cluster4_Rx_PNC_09_b0722aed, ComIPduGroupRef=ECU4_CRN_Eth_Cluster4_Rx_PNC_36_0be064bf, ComIPduGroupRef=ECU4_CRN_Eth_Cluster4_Rx_PNC_45_dda8a3c2, ComIPduGroupRef=ECU4_CRN_Eth_Cluster4_Rx_PNC_54_b3b4a215, ComIPduGroupRef=ECU4_CRN_Eth_Cluster4_Rx_PNC_All_Active_cef0b377, ComIPduSignalGroupRef=Ign_Stat_Pr5_ST3_csgs1dv6drms80o1i9p49677w_15450583_Rx, ComPduIdRef=EcucPduCollection/Ign_Stat_ST3_dacb1e38_Rx
        NM_C04_04d2ea88_Tx: ComIPduDirection=SEND, ComIPduType=NORMAL, ComIPduSignalRef=NM_C04_PNC_741720e0_Tx, ComPduIdRef=EcucPduCollection/NM_C04_04d2ea88_Tx
          ComTxIPdu: ComTxIPduUnusedAreasDefault=0  # NM_C04
        NM_C04_0b5d1bc3_Tx: ComIPduDirection=SEND, ComIPduType=NORMAL, ComIPduSignalRef=NM_C04_PNC_d0e8f103_Tx, ComPduIdRef=EcucPduCollection/NM_C04_0b5d1bc3_Tx
          ComTxIPdu: ComTxIPduUnusedAreasDefault=0  # NM_C04
        NM_C04_d7c6e387_Tx: ComIPduDirection=SEND, ComIPduType=NORMAL, ComIPduSignalRef=NM_C04_PNC_8497b6a9_Tx, ComPduIdRef=EcucPduCollection/NM_C04_d7c6e387_Tx
          ComTxIPdu: ComTxIPduUnusedAreasDefault=0  # NM_C04
        PN14_Master_Stat1_ST3_7ba93c2a_Rx: ComIPduDirection=RECEIVE, ComIPduType=NORMAL, ComIPduGroupRef=ECU4_CRN_Eth_Cluster4_Rx_PNC_All_Active_cef0b377, ComIPduSignalRef=PN14_ProdMd_Stat_ST3_80d1b3ff_Rx, ComIPduSignalRef=PN14_SupBat_Volt_ST3_aa9537c7_Rx, ComIPduSignalRef=PN14_TransMd_Stat_ST3_55311051_Rx, ComPduIdRef=EcucPduCollection/PN14_Master_Stat1_ST3_7ba93c2a_Rx
        PT4_PTCoor4_ST3_0379360e_Rx: ComIPduDirection=RECEIVE, ComIPduType=NORMAL, ComIPduGroupRef=ECU4_CRN_Eth_Cluster4_Rx_PNC_All_Active_cef0b377, ComIPduSignalGroupRef=PT4_PTCoor4_Pr5_ST3_af4fxb1ykieox3itqdfzs0kpb_7ac1c48b_Rx, ComPduIdRef=EcucPduCollection/PT4_PTCoor4_ST3_0379360e_Rx
        VSS_TP_Auth_ST3_c0e08494_Rx: ComIPduDirection=RECEIVE, ComIPduType=NORMAL, ComIPduGroupRef=ECU4_CRN_Eth_Cluster4_Rx_PNC_00_c9ae9249, ComIPduGroupRef=ECU4_CRN_Eth_Cluster4_Rx_PNC_09_b0722aed, ComIPduGroupRef=ECU4_CRN_Eth_Cluster4_Rx_PNC_36_0be064bf, ComIPduGroupRef=ECU4_CRN_Eth_Cluster4_Rx_PNC_45_dda8a3c2, ComIPduGroupRef=ECU4_CRN_Eth_Cluster4_Rx_PNC_54_b3b4a215, ComIPduGroupRef=ECU4_CRN_Eth_Cluster4_Rx_PNC_All_Active_cef0b377, ComIPduSignalGroupRef=VSS_TP_Auth_ST3_6j4id7sghlvlbroli4wjozjik_7e4c4bef_Rx, ComPduIdRef=EcucPduCollection/VSS_TP_Auth_ST3_c0e08494_Rx
        VSS_TP_RealTmOffset_ST3_0b3c026b_Rx: ComIPduDirection=RECEIVE, ComIPduType=NORMAL, ComIPduGroupRef=ECU4_CRN_Eth_Cluster4_Rx_PNC_00_c9ae9249, ComIPduGroupRef=ECU4_CRN_Eth_Cluster4_Rx_PNC_09_b0722aed, ComIPduGroupRef=ECU4_CRN_Eth_Cluster4_Rx_PNC_36_0be064bf, ComIPduGroupRef=ECU4_CRN_Eth_Cluster4_Rx_PNC_45_dda8a3c2, ComIPduGroupRef=ECU4_CRN_Eth_Cluster4_Rx_PNC_54_b3b4a215, ComIPduGroupRef=ECU4_CRN_Eth_Cluster4_Rx_PNC_All_Active_cef0b377, ComIPduSignalGroupRef=VSS_TP_RealTmOffset_ST3_1t7vc44gftc0wv35k5kgc2in9_edbcea96_Rx, ComPduIdRef=EcucPduCollection/VSS_TP_RealTmOffset_ST3_0b3c026b_Rx
        VSS_TP_SecTickCount_Lvl1_ST3_c81cbef9_Rx: ComIPduDirection=RECEIVE, ComIPduType=NORMAL, ComIPduGroupRef=ECU4_CRN_Eth_Cluster4_Rx_PNC_00_c9ae9249, ComIPduGroupRef=ECU4_CRN_Eth_Cluster4_Rx_PNC_09_b0722aed, ComIPduGroupRef=ECU4_CRN_Eth_Cluster4_Rx_PNC_36_0be064bf, ComIPduGroupRef=ECU4_CRN_Eth_Cluster4_Rx_PNC_45_dda8a3c2, ComIPduGroupRef=ECU4_CRN_Eth_Cluster4_Rx_PNC_54_b3b4a215, ComIPduGroupRef=ECU4_CRN_Eth_Cluster4_Rx_PNC_All_Active_cef0b377, ComIPduSignalGroupRef=VSS_TP_SecTickCount_Lvl1_ST3_mzmfdqtqz5kvv1kfpvg0kql3_7c2092e6_Rx, ComPduIdRef=EcucPduCollection/VSS_TP_SecTickCount_Lvl1_ST3_c81cbef9_Rx
        VSS_TP_SecTickCount_Lvl2_ST3_a413568f_Tx: ComIPduDirection=SEND, ComIPduType=NORMAL, ComIPduGroupRef=ECU4_CRN_CAN1_Cluster4_Tx_PNC_All_Active_396a3b75, ComIPduSignalGroupRef=VSS_TP_SecTickCount_Lvl2_ST3_9eubq13iosat764o0lqh5xb6r_98a4441d_Tx, ComPduIdRef=EcucPduCollection/VSS_TP_SecTickCount_Lvl2_ST3_a413568f_Tx
          ComTxIPdu: ComMinimumDelayTime=0.02, ComTxIPduUnusedAreasDefault=255
            ComTxModeTrue
              ComTxMode: ComTxModeMode=DIRECT, ComTxModeNumberOfRepetitions=0
        VSS_TP_SharedSecret_ST3_09f25701_Rx: ComIPduDirection=RECEIVE, ComIPduType=NORMAL, ComIPduGroupRef=ECU4_CRN_Eth_Cluster4_Rx_PNC_00_c9ae9249, ComIPduGroupRef=ECU4_CRN_Eth_Cluster4_Rx_PNC_09_b0722aed, ComIPduGroupRef=ECU4_CRN_Eth_Cluster4_Rx_PNC_36_0be064bf, ComIPduGroupRef=ECU4_CRN_Eth_Cluster4_Rx_PNC_45_dda8a3c2, ComIPduGroupRef=ECU4_CRN_Eth_Cluster4_Rx_PNC_54_b3b4a215, ComIPduGroupRef=ECU4_CRN_Eth_Cluster4_Rx_PNC_All_Active_cef0b377, ComIPduSignalGroupRef=VSS_TP_SharedSecret_ST3_8pj4t8t4rm3tw3pk5hj7vonti_e726a839_Rx, ComPduIdRef=EcucPduCollection/VSS_TP_SharedSecret_ST3_09f25701_Rx
        VSS_TP_VIN_ST3_97a3d79b_Rx: ComIPduDirection=RECEIVE, ComIPduType=NORMAL, ComIPduGroupRef=ECU4_CRN_Eth_Cluster4_Rx_PNC_00_c9ae9249, ComIPduGroupRef=ECU4_CRN_Eth_Cluster4_Rx_PNC_09_b0722aed, ComIPduGroupRef=ECU4_CRN_Eth_Cluster4_Rx_PNC_36_0be064bf, ComIPduGroupRef=ECU4_CRN_Eth_Cluster4_Rx_PNC_45_dda8a3c2, ComIPduGroupRef=ECU4_CRN_Eth_Cluster4_Rx_PNC_54_b3b4a215, ComIPduGroupRef=ECU4_CRN_Eth_Cluster4_Rx_PNC_All_Active_cef0b377, ComIPduSignalGroupRef=VSS_TP_VIN_ST3_bz1xsv84cxzl09j028gn39p69_9d855e1d_Rx, ComPduIdRef=EcucPduCollection/VSS_TP_VIN_ST3_97a3d79b_Rx
        VehSpd_8_ST3_a4557cc9_Rx: ComIPduDirection=RECEIVE, ComIPduType=NORMAL, ComIPduGroupRef=ECU4_CRN_Eth_Cluster4_Rx_PNC_All_Active_cef0b377, ComIPduSignalGroupRef=VehSpd8_Pr5_ST3_168m1ogyookfwuxfakr38tbmv_c0deee46_Rx, ComPduIdRef=EcucPduCollection/VehSpd_8_ST3_a4557cc9_Rx
      36 x ComIPduGroup:
        ECU4_CRN_CAN1_Cluster4_Rx_PNC_00_a0df9606
        ECU4_CRN_CAN1_Cluster4_Rx_PNC_09_d9032ea2
        ECU4_CRN_CAN1_Cluster4_Rx_PNC_All_Active_9e5e8c7d
        ECU4_CRN_CAN1_Cluster4_Tx_PNC_00_d3c5ef8c
        ECU4_CRN_CAN1_Cluster4_Tx_PNC_09_aa195728
        ECU4_CRN_CAN1_Cluster4_Tx_PNC_All_Active_396a3b75
        ECU4_CRN_CANFD1_Cluster4_Rx_PNC_00_7ddf4c9e
        ECU4_CRN_CANFD1_Cluster4_Rx_PNC_36_bf91ba68
        ECU4_CRN_CANFD1_Cluster4_Rx_PNC_All_Active_1cedc4da
        ECU4_CRN_CANFD1_Cluster4_Tx_PNC_00_0ec53514
        ECU4_CRN_CANFD1_Cluster4_Tx_PNC_36_cc8bc3e2
        ECU4_CRN_CANFD1_Cluster4_Tx_PNC_All_Active_bbd973d2
        ECU4_CRN_Eth_Cluster4_Rx_PNC_00_c9ae9249
        ECU4_CRN_Eth_Cluster4_Rx_PNC_09_b0722aed
        ECU4_CRN_Eth_Cluster4_Rx_PNC_36_0be064bf
        ECU4_CRN_Eth_Cluster4_Rx_PNC_45_dda8a3c2
        ECU4_CRN_Eth_Cluster4_Rx_PNC_54_b3b4a215
        ECU4_CRN_Eth_Cluster4_Rx_PNC_All_Active_cef0b377
        ECU4_CRN_Eth_Cluster4_Rx_PNC_All_Active_d9df5141
        ECU4_CRN_Eth_Cluster4_Tx_PNC_00_5800caa3
        ECU4_CRN_Eth_Cluster4_Tx_PNC_00_bab4ebc3
        ECU4_CRN_Eth_Cluster4_Tx_PNC_09_21dc7207
        ECU4_CRN_Eth_Cluster4_Tx_PNC_09_c3685367
        ECU4_CRN_Eth_Cluster4_Tx_PNC_18_4fc073d0
        ECU4_CRN_Eth_Cluster4_Tx_PNC_27_f4523d82
        ECU4_CRN_Eth_Cluster4_Tx_PNC_36_78fa1d35
        ECU4_CRN_Eth_Cluster4_Tx_PNC_36_9a4e3c55
        ECU4_CRN_Eth_Cluster4_Tx_PNC_45_4c06fb28
        ECU4_CRN_Eth_Cluster4_Tx_PNC_45_aeb2da48
        ECU4_CRN_Eth_Cluster4_Tx_PNC_54_221afaff
        ECU4_CRN_Eth_Cluster4_Tx_PNC_54_c0aedb9f
        ECU4_CRN_Eth_Cluster4_Tx_PNC_All_Active_03aa5330
        ECU4_CRN_Eth_Cluster4_Tx_PNC_All_Active_69c4047f
        ECU4_CRN_Eth_Cluster4_Tx_PNC_All_Active_9da251eb
        RxNorm_ECU4_CRN_LIN5_Cluster4_3eb66226
        TxNorm_ECU4_CRN_LIN5_Cluster4_afd7b2bf
      102 x ComSignal:
        Actv_Line_Stat_ST3_38ee811f_Rx: ComBitPosition=0, ComBitSize=2, ComSignalDataInvalidValue=3, ComSignalEndianness=LITTLE_ENDIAN, ComSignalInitValue=0, ComSignalType=UINT8, ComSystemTemplateSystemSignalRef=Actv_Line_Stat_ST3
        Awake_Diag_Actv_ECU4_086d59bd_Tx: ComBitPosition=30, ComBitSize=1, ComSignalEndianness=LITTLE_ENDIAN, ComSignalInitValue=1, ComSignalType=BOOLEAN, ComTransferProperty=PENDING, ComSystemTemplateSystemSignalRef=Awake_Diag_Actv_ECU4
        Awake_Diag_Actv_ECU4_1463dbf3_Tx: ComBitPosition=30, ComBitSize=1, ComSignalEndianness=LITTLE_ENDIAN, ComSignalInitValue=1, ComSignalType=BOOLEAN, ComTransferProperty=PENDING, ComSystemTemplateSystemSignalRef=Awake_Diag_Actv_ECU4
        Awake_Diag_Actv_ECU4_d39cd365_Tx: ComBitPosition=30, ComBitSize=1, ComSignalEndianness=LITTLE_ENDIAN, ComSignalInitValue=1, ComSignalType=BOOLEAN, ComTransferProperty=PENDING, ComSystemTemplateSystemSignalRef=Awake_Diag_Actv_ECU4
        Awake_Ignition_On_C04_4cfb34fb_Tx: ComBitPosition=32, ComBitSize=1, ComSignalEndianness=LITTLE_ENDIAN, ComSignalInitValue=1, ComSignalType=BOOLEAN, ComTransferProperty=PENDING, ComSystemTemplateSystemSignalRef=Awake_Ignition_On_C04
        Awake_Ignition_On_C04_5550fd82_Tx: ComBitPosition=32, ComBitSize=1, ComSignalEndianness=LITTLE_ENDIAN, ComSignalInitValue=1, ComSignalType=BOOLEAN, ComTransferProperty=PENDING, ComSystemTemplateSystemSignalRef=Awake_Ignition_On_C04
        Awake_Ignition_On_C04_c4289f97_Tx: ComBitPosition=32, ComBitSize=1, ComSignalEndianness=LITTLE_ENDIAN, ComSignalInitValue=1, ComSignalType=BOOLEAN, ComTransferProperty=PENDING, ComSystemTemplateSystemSignalRef=Awake_Ignition_On_C04
        Awake_NwStart_Cluster_ECU4_53eb34f4_Tx: ComBitPosition=31, ComBitSize=1, ComSignalEndianness=LITTLE_ENDIAN, ComSignalInitValue=0, ComSignalType=BOOLEAN, ComTransferProperty=PENDING, ComSystemTemplateSystemSignalRef=Awake_NwStart_Cluster_ECU4
        Awake_NwStart_Cluster_ECU4_587c913d_Tx: ComBitPosition=31, ComBitSize=1, ComSignalEndianness=LITTLE_ENDIAN, ComSignalInitValue=0, ComSignalType=BOOLEAN, ComTransferProperty=PENDING, ComSystemTemplateSystemSignalRef=Awake_NwStart_Cluster_ECU4
        Awake_NwStart_Cluster_ECU4_e9d6a996_Tx: ComBitPosition=31, ComBitSize=1, ComSignalEndianness=LITTLE_ENDIAN, ComSignalInitValue=0, ComSignalType=BOOLEAN, ComTransferProperty=PENDING, ComSystemTemplateSystemSignalRef=Awake_NwStart_Cluster_ECU4
        COM_C01_Sig01_PN08_eff292cd_Rx: ComBitPosition=0, ComBitSize=8, ComSignalEndianness=LITTLE_ENDIAN, ComSignalInitValue=255, ComSignalType=UINT8, ComTimeout=1.1, ComSystemTemplateSystemSignalRef=COM_C01_Sig01_PN08
        COM_C01_Sig01_PN17_85134da2_Rx: ComBitPosition=0, ComBitSize=8, ComSignalEndianness=LITTLE_ENDIAN, ComSignalInitValue=255, ComSignalType=UINT8, ComTimeout=1.1, ComSystemTemplateSystemSignalRef=COM_C01_Sig01_PN17
        COM_C01_Sig01_PN44_43e722b2_Rx: ComBitPosition=0, ComBitSize=8, ComSignalEndianness=LITTLE_ENDIAN, ComSignalInitValue=255, ComSignalType=UINT8, ComTimeout=1.1, ComSystemTemplateSystemSignalRef=COM_C01_Sig01_PN44
        COM_C01_Sig01_PN53_ba06a35d_Rx: ComBitPosition=0, ComBitSize=8, ComSignalEndianness=LITTLE_ENDIAN, ComSignalInitValue=255, ComSignalType=UINT8, ComTimeout=1.1, ComSystemTemplateSystemSignalRef=COM_C01_Sig01_PN53
        COM_C01_Sig01_PN62_f85579ad_Rx: ComBitPosition=0, ComBitSize=8, ComSignalEndianness=LITTLE_ENDIAN, ComSignalInitValue=255, ComSignalType=UINT8, ComTimeout=1.1, ComSystemTemplateSystemSignalRef=COM_C01_Sig01_PN62
        COM_C04_C08_Pdu02_TpConnection_ISignal_05c6e382_Tx: ComBitPosition=0, ComSignalEndianness=opaque, ComSignalLength=187, ComSignalType=UINT8_DYN, ComTransferProperty=TRIGGERED, ComSystemTemplateSystemSignalRef=COM_C04_C08_Pdu02_TpConnection
        COM_C04_C14_Pdu01_TpConnection_ISignal_9fb8e7b9_Tx: ComBitPosition=0, ComSignalEndianness=opaque, ComSignalLength=187, ComSignalType=UINT8_DYN, ComTransferProperty=TRIGGERED, ComSystemTemplateSystemSignalRef=COM_C04_C14_Pdu01_TpConnection
        COM_C04_Sig002_Call_b5adcdc4_Rx: ComBitPosition=0, ComSignalEndianness=opaque, ComSignalLength=9, ComSignalType=UINT8_N, ComSystemTemplateSystemSignalRef=COM_C04_Sig002_Call
        COM_C04_Sig002_ed549298_Tx: ComBitPosition=0, ComSignalEndianness=opaque, ComSignalLength=10, ComSignalType=UINT8_N, ComTransferProperty=TRIGGERED, ComSystemTemplateSystemSignalRef=COM_C04_Sig002
        COM_C04_Sig003_343b339f_Tx: ComBitPosition=0, ComSignalEndianness=opaque, ComSignalLength=3013, ComSignalType=UINT8_N, ComTransferProperty=TRIGGERED, ComSystemTemplateSystemSignalRef=COM_C04_Sig003
        COM_C04_Sig005_dbae26a4_Tx: ComBitPosition=56, ComBitSize=32, ComSignalEndianness=LITTLE_ENDIAN, ComSignalInitValue=2147483647, ComSignalType=SINT32, ComTransferProperty=TRIGGERED, ComSystemTemplateSystemSignalRef=COM_C04_Sig005
        COM_C04_Sig006_6b6fc3ec_Tx: ComBitPosition=0, ComBitSize=16, ComSignalEndianness=LITTLE_ENDIAN, ComSignalInitValue=65535, ComSignalType=UINT16, ComTransferProperty=TRIGGERED_ON_CHANGE, ComSystemTemplateSystemSignalRef=COM_C04_Sig006
        COM_C04_Sig007_1c68f37a_Tx: ComBitPosition=32, ComBitSize=16, ComSignalEndianness=LITTLE_ENDIAN, ComSignalInitValue=32767, ComSignalType=SINT16, ComTransferProperty=TRIGGERED_ON_CHANGE, ComSystemTemplateSystemSignalRef=COM_C04_Sig007
        COM_C04_Sig008_22bf7f7a_Tx: ComBitPosition=0, ComBitSize=32, ComSignalEndianness=LITTLE_ENDIAN, ComSignalInitValue=-1, ComSignalType=SINT32, ComTransferProperty=TRIGGERED_ON_CHANGE, ComSystemTemplateSystemSignalRef=COM_C04_Sig008
        COM_C04_Sig01_PN08_4229ae48_Tx: ComBitPosition=0, ComBitSize=8, ComSignalEndianness=LITTLE_ENDIAN, ComSignalInitValue=255, ComSignalType=UINT8, ComTransferProperty=PENDING, ComSystemTemplateSystemSignalRef=COM_C04_Sig01_PN08
        COM_C04_Sig01_PN08_4bdc1bc3_Tx: ComBitPosition=0, ComBitSize=8, ComSignalEndianness=LITTLE_ENDIAN, ComSignalInitValue=255, ComSignalType=UINT8, ComTransferProperty=PENDING, ComSystemTemplateSystemSignalRef=COM_C04_Sig01_PN08
        COM_C04_Sig01_PN08_c562616e_Tx: ComBitPosition=0, ComBitSize=8, ComSignalEndianness=LITTLE_ENDIAN, ComSignalInitValue=255, ComSignalType=UINT8, ComTransferProperty=PENDING, ComSystemTemplateSystemSignalRef=COM_C04_Sig01_PN08
        COM_C04_Sig01_PN17_28c87127_Tx: ComBitPosition=0, ComBitSize=8, ComSignalEndianness=LITTLE_ENDIAN, ComSignalInitValue=255, ComSignalType=UINT8, ComTransferProperty=PENDING, ComSystemTemplateSystemSignalRef=COM_C04_Sig01_PN17
        COM_C04_Sig01_PN17_af83be01_Tx: ComBitPosition=0, ComBitSize=8, ComSignalEndianness=LITTLE_ENDIAN, ComSignalInitValue=255, ComSignalType=UINT8, ComTransferProperty=PENDING, ComSystemTemplateSystemSignalRef=COM_C04_Sig01_PN17
        COM_C04_Sig01_PN44_e7c9abbc_Tx: ComBitPosition=0, ComBitSize=8, ComSignalEndianness=LITTLE_ENDIAN, ComSignalInitValue=255, ComSignalType=UINT8, ComTransferProperty=PENDING, ComSystemTemplateSystemSignalRef=COM_C04_Sig01_PN44
        COM_C04_Sig01_PN44_ee3c1e37_Tx: ComBitPosition=0, ComBitSize=8, ComSignalEndianness=LITTLE_ENDIAN, ComSignalInitValue=255, ComSignalType=UINT8, ComTransferProperty=PENDING, ComSystemTemplateSystemSignalRef=COM_C04_Sig01_PN44
        COM_C04_Sig01_PN53_17dd9fd8_Tx: ComBitPosition=0, ComBitSize=8, ComSignalEndianness=LITTLE_ENDIAN, ComSignalInitValue=255, ComSignalType=UINT8, ComTransferProperty=PENDING, ComSystemTemplateSystemSignalRef=COM_C04_Sig01_PN53
        COM_C04_Sig01_PN62_558e4528_Tx: ComBitPosition=0, ComBitSize=8, ComSignalEndianness=LITTLE_ENDIAN, ComSignalInitValue=255, ComSignalType=UINT8, ComTransferProperty=PENDING, ComSystemTemplateSystemSignalRef=COM_C04_Sig01_PN62
        COM_C04_Sig110_1b8546e2_Tx: ComBitPosition=0, ComSignalEndianness=opaque, ComSignalLength=10, ComSignalType=UINT8_N, ComTransferProperty=TRIGGERED, ComSystemTemplateSystemSignalRef=COM_C04_Sig110
        COM_C04_Sig111_c2eae7e5_Tx: ComBitPosition=0, ComSignalEndianness=opaque, ComSignalLength=15, ComSignalType=UINT8_N, ComTransferProperty=TRIGGERED, ComSystemTemplateSystemSignalRef=COM_C04_Sig111
        COM_C04_Sig112_722b02ad_Tx: ComBitPosition=0, ComSignalEndianness=opaque, ComSignalLength=15, ComSignalType=UINT8_N, ComTransferProperty=TRIGGERED, ComSystemTemplateSystemSignalRef=COM_C04_Sig112
        COM_C04_Sig113_ab44a3aa_Tx: ComBitPosition=0, ComSignalEndianness=opaque, ComSignalLength=15, ComSignalType=UINT8_N, ComTransferProperty=TRIGGERED, ComSystemTemplateSystemSignalRef=COM_C04_Sig113
        COM_C04_Sig114_c8d9ce7c_Tx: ComBitPosition=0, ComSignalEndianness=opaque, ComSignalLength=15, ComSignalType=UINT8_N, ComTransferProperty=TRIGGERED, ComSystemTemplateSystemSignalRef=COM_C04_Sig114
        COM_C04_Sig115_11b66f7b_Tx: ComBitPosition=0, ComSignalEndianness=opaque, ComSignalLength=15, ComSignalType=UINT8_N, ComTransferProperty=TRIGGERED, ComSystemTemplateSystemSignalRef=COM_C04_Sig115
        COM_C04_Sig116_a1778a33_Tx: ComBitPosition=0, ComSignalEndianness=opaque, ComSignalLength=15, ComSignalType=UINT8_N, ComTransferProperty=TRIGGERED, ComSystemTemplateSystemSignalRef=COM_C04_Sig116
        COM_C04_Sig117_78182b34_Tx: ComBitPosition=0, ComSignalEndianness=opaque, ComSignalLength=15, ComSignalType=UINT8_N, ComTransferProperty=TRIGGERED, ComSystemTemplateSystemSignalRef=COM_C04_Sig117
        COM_C04_Sig118_664d519f_Tx: ComBitPosition=0, ComSignalEndianness=opaque, ComSignalLength=15, ComSignalType=UINT8_N, ComTransferProperty=TRIGGERED, ComSystemTemplateSystemSignalRef=COM_C04_Sig118
        COM_C04_Sig119_bf22f098_Tx: ComBitPosition=0, ComSignalEndianness=opaque, ComSignalLength=15, ComSignalType=UINT8_N, ComTransferProperty=TRIGGERED, ComSystemTemplateSystemSignalRef=COM_C04_Sig119
        COM_C04_Sig120_63324ea5_Tx: ComBitPosition=0, ComSignalEndianness=opaque, ComSignalLength=15, ComSignalType=UINT8_N, ComTransferProperty=TRIGGERED, ComSystemTemplateSystemSignalRef=COM_C04_Sig120
        COM_C04_Sig121_ba5defa2_Tx: ComBitPosition=0, ComBitSize=4, ComSignalDataInvalidValue=15, ComSignalEndianness=LITTLE_ENDIAN, ComSignalInitValue=15, ComSignalType=UINT8, ComTransferProperty=PENDING, ComSystemTemplateSystemSignalRef=COM_C04_Sig121
        COM_C04_Sig1Cyc_1_191673fa_Tx: ComBitPosition=0, ComBitSize=1, ComSignalEndianness=LITTLE_ENDIAN, ComSignalInitValue=0, ComSignalType=BOOLEAN, ComTransferProperty=PENDING, ComUpdateBitPosition=63, ComSystemTemplateSystemSignalRef=COM_C04_Sig1Cyc_1
        COM_C04_Sig221_b81b51fb_Tx: ComBitPosition=14, ComBitSize=8, ComSignalDataInvalidValue=255, ComSignalEndianness=LITTLE_ENDIAN, ComSignalInitValue=255, ComSignalType=UINT8, ComTransferProperty=PENDING, ComSystemTemplateSystemSignalRef=COM_C04_Sig221
        COM_C04_Sig2Cyc_7_76e1a461_Tx: ComBitPosition=1, ComBitSize=7, ComSignalDataInvalidValue=127, ComSignalEndianness=LITTLE_ENDIAN, ComSignalInitValue=0, ComSignalType=UINT8, ComTransferProperty=PENDING, ComUpdateBitPosition=62, ComSystemTemplateSystemSignalRef=COM_C04_Sig2Cyc_7
        COM_C04_Sig3Cyc_9_5a055ac3_Tx: ComBitPosition=8, ComBitSize=9, ComSignalDataInvalidValue=511, ComSignalEndianness=LITTLE_ENDIAN, ComSignalInitValue=0, ComSignalType=UINT16, ComTransferProperty=PENDING, ComSystemTemplateSystemSignalRef=COM_C04_Sig3Cyc_9
        COM_C04_Sig4Cyc_24_d7d26a2d_Tx: ComBitPosition=24, ComBitSize=24, ComSignalDataInvalidValue=16777215, ComSignalEndianness=LITTLE_ENDIAN, ComSignalInitValue=0, ComSignalType=UINT32, ComTransferProperty=PENDING, ComSystemTemplateSystemSignalRef=COM_C04_Sig4Cyc_24
        COM_C07_Sig01_PN08_269f45cb_Rx: ComBitPosition=0, ComBitSize=8, ComSignalEndianness=LITTLE_ENDIAN, ComSignalInitValue=255, ComSignalType=UINT8, ComTimeout=1.1, ComSystemTemplateSystemSignalRef=COM_C07_Sig01_PN08
        COM_C07_Sig01_PN44_8a8af5b4_Rx: ComBitPosition=0, ComBitSize=8, ComSignalEndianness=LITTLE_ENDIAN, ComSignalInitValue=255, ComSignalType=UINT8, ComTimeout=1.1, ComSystemTemplateSystemSignalRef=COM_C07_Sig01_PN44
        COM_C07_Sig01_PN53_736b745b_Rx: ComBitPosition=0, ComBitSize=8, ComSignalEndianness=LITTLE_ENDIAN, ComSignalInitValue=255, ComSignalType=UINT8, ComTimeout=1.1, ComSystemTemplateSystemSignalRef=COM_C07_Sig01_PN53
        COM_C08_C04_Pdu02_TpConnection_ISignal_6f5712fd_Rx: ComBitPosition=0, ComSignalEndianness=opaque, ComSignalLength=187, ComSignalType=UINT8_DYN, ComSystemTemplateSystemSignalRef=COM_C08_C04_Pdu02_TpConnection
        COM_C0X_Sig110_3bf2f712_Rx: ComBitPosition=0, ComSignalEndianness=opaque, ComSignalLength=10, ComSignalType=UINT8_N, ComSystemTemplateSystemSignalRef=COM_C0X_Sig110
        COM_C0X_Sig111_e29d5615_Rx: ComBitPosition=0, ComSignalEndianness=opaque, ComSignalLength=15, ComSignalType=UINT8_N, ComSystemTemplateSystemSignalRef=COM_C0X_Sig111
        COM_C0X_Sig112_525cb35d_Rx: ComBitPosition=0, ComSignalEndianness=opaque, ComSignalLength=15, ComSignalType=UINT8_N, ComSystemTemplateSystemSignalRef=COM_C0X_Sig112
        COM_C0X_Sig113_8b33125a_Rx: ComBitPosition=0, ComSignalEndianness=opaque, ComSignalLength=15, ComSignalType=UINT8_N, ComSystemTemplateSystemSignalRef=COM_C0X_Sig113
        COM_C0X_Sig114_e8ae7f8c_Rx: ComBitPosition=0, ComSignalEndianness=opaque, ComSignalLength=15, ComSignalType=UINT8_N, ComSystemTemplateSystemSignalRef=COM_C0X_Sig114
        COM_C0X_Sig115_31c1de8b_Rx: ComBitPosition=0, ComSignalEndianness=opaque, ComSignalLength=15, ComSignalType=UINT8_N, ComSystemTemplateSystemSignalRef=COM_C0X_Sig115
        COM_C0X_Sig116_81003bc3_Rx: ComBitPosition=0, ComSignalEndianness=opaque, ComSignalLength=15, ComSignalType=UINT8_N, ComSystemTemplateSystemSignalRef=COM_C0X_Sig116
        COM_C0X_Sig117_586f9ac4_Rx: ComBitPosition=0, ComSignalEndianness=opaque, ComSignalLength=15, ComSignalType=UINT8_N, ComSystemTemplateSystemSignalRef=COM_C0X_Sig117
        COM_C0X_Sig118_463ae06f_Rx: ComBitPosition=0, ComSignalEndianness=opaque, ComSignalLength=15, ComSignalType=UINT8_N, ComSystemTemplateSystemSignalRef=COM_C0X_Sig118
        COM_C0X_Sig119_9f554168_Rx: ComBitPosition=0, ComSignalEndianness=opaque, ComSignalLength=15, ComSignalType=UINT8_N, ComSystemTemplateSystemSignalRef=COM_C0X_Sig119
        COM_C0X_Sig120_4345ff55_Rx: ComBitPosition=0, ComSignalEndianness=opaque, ComSignalLength=15, ComSignalType=UINT8_N, ComSystemTemplateSystemSignalRef=COM_C0X_Sig120
        COM_C0X_Sig121_9a2a5e52_Rx: ComBitPosition=0, ComBitSize=4, ComSignalDataInvalidValue=15, ComSignalEndianness=LITTLE_ENDIAN, ComSignalInitValue=15, ComSignalType=UINT8, ComSystemTemplateSystemSignalRef=COM_C0X_Sig121
        COM_C0X_Sig221_986ce00b_Rx: ComBitPosition=14, ComBitSize=8, ComSignalDataInvalidValue=255, ComSignalEndianness=LITTLE_ENDIAN, ComSignalInitValue=255, ComSignalType=UINT8, ComSystemTemplateSystemSignalRef=COM_C0X_Sig221
        COM_C10_Sig01_PN08_d1b7257a_Rx: ComBitPosition=0, ComBitSize=8, ComSignalEndianness=LITTLE_ENDIAN, ComSignalInitValue=255, ComSignalType=UINT8, ComTimeout=1.1, ComSystemTemplateSystemSignalRef=COM_C10_Sig01_PN08
        COM_C10_Sig01_PN17_bb56fa15_Rx: ComBitPosition=0, ComBitSize=8, ComSignalEndianness=LITTLE_ENDIAN, ComSignalInitValue=255, ComSignalType=UINT8, ComTimeout=1.1, ComSystemTemplateSystemSignalRef=COM_C10_Sig01_PN17
        COM_C14_C04_Pdu01_TpConnection_ISignal_8fab0d74_Rx: ComBitPosition=0, ComSignalEndianness=opaque, ComSignalLength=187, ComSignalType=UINT8_DYN, ComSystemTemplateSystemSignalRef=COM_C14_C04_Pdu01_TpConnection
        COM_C19_Sig002_b5a6f2ff_Rx: ComBitPosition=32, ComBitSize=32, ComSignalEndianness=LITTLE_ENDIAN, ComSignalInitValue=-1, ComSignalType=SINT32, ComSystemTemplateSystemSignalRef=COM_C19_Sig002
        COM_C19_Sig003_c2a1c269_Rx: ComBitPosition=0, ComBitSize=32, ComSignalDataInvalidValue=4294967295, ComSignalEndianness=LITTLE_ENDIAN, ComSignalInitValue=4294967295, ComSignalType=UINT32, ComSystemTemplateSystemSignalRef=COM_C19_Sig003
        COM_C19_Sig004_f2adc65b_Rx: ComBitPosition=0, ComBitSize=32, ComSignalEndianness=LITTLE_ENDIAN, ComSignalInitValue=-1, ComSignalType=SINT32, ComSystemTemplateSystemSignalRef=COM_C19_Sig004
        COM_C19_Sig005_78530eb8_Rx: ComBitPosition=32, ComBitSize=16, ComSignalEndianness=LITTLE_ENDIAN, ComSignalInitValue=32767, ComSignalType=SINT16, ComSystemTemplateSystemSignalRef=COM_C19_Sig005
        COM_C19_Sig006_e15a5f02_Rx: ComBitPosition=0, ComBitSize=16, ComSignalEndianness=LITTLE_ENDIAN, ComSignalInitValue=65535, ComSignalType=UINT16, ComSystemTemplateSystemSignalRef=COM_C19_Sig006
        COM_C19_Sig01_PN08_bb78cb1f_Rx: ComBitPosition=0, ComBitSize=8, ComSignalEndianness=LITTLE_ENDIAN, ComSignalInitValue=255, ComSignalType=UINT8, ComTimeout=1.1, ComSystemTemplateSystemSignalRef=COM_C19_Sig01_PN08
        COM_C19_Sig01_PN44_176d7b60_Rx: ComBitPosition=0, ComBitSize=8, ComSignalEndianness=LITTLE_ENDIAN, ComSignalInitValue=255, ComSignalType=UINT8, ComTimeout=1.1, ComSystemTemplateSystemSignalRef=COM_C19_Sig01_PN44
        COM_SL05_Sig001_089333d4_Rx: ComBitPosition=3, ComBitSize=1, ComSignalDataInvalidValue=1, ComSignalEndianness=LITTLE_ENDIAN, ComSignalInitValue=0, ComSignalType=BOOLEAN, ComSystemTemplateSystemSignalRef=COM_SL05_Sig001
        ComSignalPnc_EIRA_CAN_Rx: ComSignalInitValue=0 0 0 0 0 0 0, ComSignalLength=7, ComSignalType=UINT8_N
        ComSignalPnc_EIRA_ETH_Rx: ComSignalInitValue=0 0 0 0 0 0 0, ComSignalLength=7, ComSignalType=UINT8_N
        ComSignalPnc_ERA_CAN_CAN1_Cluster4_53b2b17a_Rx: ComSignalInitValue=0 0 0 0 0 0 0, ComSignalLength=7, ComSignalType=UINT8_N
        ComSignalPnc_ERA_CAN_CANFD1_Cluster4_0f365fd3_Rx: ComSignalInitValue=0 0 0 0 0 0 0, ComSignalLength=7, ComSignalType=UINT8_N
        ComSignalPnc_ERA_ETH_ECU4_CRN_Eth_Cluster4_3g6xoesclytkmkqofl9pi6ol1_481bdd0f_Rx: ComSignalInitValue=0 0 0 0 0 0 0, ComSignalLength=7, ComSignalType=UINT8_N
        DidA_ExtTest_Pres_ST3_0ace79d9_Rx: ComBitPosition=2, ComBitSize=2, ComSignalDataInvalidValue=3, ComSignalEndianness=LITTLE_ENDIAN, ComSignalInitValue=3, ComSignalType=UINT8, ComSystemTemplateSystemSignalRef=DidA_ExtTest_Pres_ST3
        ECU_ID_C04_33a5606d_Tx: ComBitPosition=0, ComBitSize=12, ComSignalDataInvalidValue=4095, ComSignalEndianness=LITTLE_ENDIAN, ComSignalInitValue=4, ComSignalType=UINT16, ComTransferProperty=PENDING, ComSystemTemplateSystemSignalRef=ECU_ID_C04
        ECU_ID_C04_bbd46a3e_Tx: ComBitPosition=0, ComBitSize=12, ComSignalDataInvalidValue=4095, ComSignalEndianness=LITTLE_ENDIAN, ComSignalInitValue=4, ComSignalType=UINT16, ComTransferProperty=PENDING, ComSystemTemplateSystemSignalRef=ECU_ID_C04
        ECU_ID_C04_c477e499_Tx: ComBitPosition=0, ComBitSize=12, ComSignalDataInvalidValue=4095, ComSignalEndianness=LITTLE_ENDIAN, ComSignalInitValue=4, ComSignalType=UINT16, ComTransferProperty=PENDING, ComSystemTemplateSystemSignalRef=ECU_ID_C04
        NM_C04_PNC_741720e0_Tx: ComBitPosition=0, ComSignalEndianness=opaque, ComSignalInitValue=0 0 0 0 0 0 0, ComSignalLength=7, ComSignalType=UINT8_N, ComTransferProperty=PENDING, ComSystemTemplateSystemSignalRef=NM_C04_PNC
        NM_C04_PNC_8497b6a9_Tx: ComBitPosition=0, ComSignalEndianness=opaque, ComSignalInitValue=0 0 0 0 0 0 0, ComSignalLength=7, ComSignalType=UINT8_N, ComTransferProperty=PENDING, ComSystemTemplateSystemSignalRef=NM_C04_PNC
        NM_C04_PNC_d0e8f103_Tx: ComBitPosition=0, ComSignalEndianness=opaque, ComSignalInitValue=0 0 0 0 0 0 0, ComSignalLength=7, ComSignalType=UINT8_N, ComTransferProperty=PENDING, ComSystemTemplateSystemSignalRef=NM_C04_PNC
        NwId_C04_CAN1_20d9dbad_Tx: ComBitPosition=12, ComBitSize=8, ComSignalDataInvalidValue=255, ComSignalEndianness=LITTLE_ENDIAN, ComSignalInitValue=32, ComSignalType=UINT8, ComTransferProperty=PENDING, ComSystemTemplateSystemSignalRef=NwId_C04_CAN1
        NwId_C04_CANFD1_631c0bbe_Tx: ComBitPosition=12, ComBitSize=8, ComSignalDataInvalidValue=255, ComSignalEndianness=LITTLE_ENDIAN, ComSignalInitValue=3, ComSignalType=UINT8, ComTransferProperty=PENDING, ComSystemTemplateSystemSignalRef=NwId_C04_CANFD1
        NwId_C04_ETH_ECU4_b2258645_Tx: ComBitPosition=12, ComBitSize=8, ComSignalDataInvalidValue=255, ComSignalEndianness=LITTLE_ENDIAN, ComSignalInitValue=4, ComSignalType=UINT8, ComTransferProperty=PENDING, ComSystemTemplateSystemSignalRef=NwId_C04_ETH_ECU4
        PN14_ProdMd_Stat_ST3_80d1b3ff_Rx: ComBitPosition=5, ComBitSize=3, ComSignalDataInvalidValue=7, ComSignalEndianness=LITTLE_ENDIAN, ComSignalInitValue=7, ComSignalType=UINT8, ComSystemTemplateSystemSignalRef=PN14_ProdMd_Stat_ST3
        PN14_SupBat_Volt_ST3_aa9537c7_Rx: ComBitPosition=22, ComBitSize=10, ComSignalDataInvalidValue=1023, ComSignalEndianness=LITTLE_ENDIAN, ComSignalInitValue=1023, ComSignalType=UINT16, ComSystemTemplateSystemSignalRef=PN14_SupBat_Volt_ST3
        PN14_TransMd_Stat_ST3_55311051_Rx: ComBitPosition=0, ComBitSize=2, ComSignalDataInvalidValue=3, ComSignalEndianness=LITTLE_ENDIAN, ComSignalInitValue=3, ComSignalType=UINT8, ComSystemTemplateSystemSignalRef=PN14_TransMd_Stat_ST3
        Platform_Stat_Star3_f1e85fdc_Rx: ComBitPosition=0, ComBitSize=8, ComSignalDataInvalidValue=255, ComSignalEndianness=LITTLE_ENDIAN, ComSignalInitValue=4, ComSignalType=UINT8, ComSystemTemplateSystemSignalRef=Platform_Stat_Star3
        RsErr_LIN5_SL05_dafd79b3_Rx: ComBitPosition=0, ComBitSize=1, ComSignalEndianness=LITTLE_ENDIAN, ComSignalInitValue=0, ComSignalType=BOOLEAN, ComSystemTemplateSystemSignalRef=RsErr_LIN5_SL05
        WakeupRsn_C04_ECU04_09baf085_Tx: ComBitPosition=20, ComBitSize=10, ComSignalDataInvalidValue=1023, ComSignalEndianness=LITTLE_ENDIAN, ComSignalInitValue=1023, ComSignalType=UINT16, ComTransferProperty=PENDING, ComSystemTemplateSystemSignalRef=WakeupRsn_C04_ECU04
        WakeupRsn_C04_ECU04_43f9feaf_Tx: ComBitPosition=20, ComBitSize=10, ComSignalDataInvalidValue=1023, ComSignalEndianness=LITTLE_ENDIAN, ComSignalInitValue=1023, ComSignalType=UINT16, ComTransferProperty=PENDING, ComSystemTemplateSystemSignalRef=WakeupRsn_C04_ECU04
        WakeupRsn_C04_ECU04_6b59dcd4_Tx: ComBitPosition=20, ComBitSize=10, ComSignalDataInvalidValue=1023, ComSignalEndianness=LITTLE_ENDIAN, ComSignalInitValue=1023, ComSignalType=UINT16, ComTransferProperty=PENDING, ComSystemTemplateSystemSignalRef=WakeupRsn_C04_ECU04
        WakeupStat_Cluster4_LIN_S5_9b9dbcbd_Rx: ComBitPosition=6, ComBitSize=2, ComSignalDataInvalidValue=3, ComSignalEndianness=LITTLE_ENDIAN, ComSignalInitValue=3, ComSignalType=UINT8, ComSystemTemplateSystemSignalRef=WakeupStat_Cluster4_LIN_S5
      13 x ComSignalGroup:
        COM_C04_SGR01_P05_5t2743h81pbparal6h2spw309_86aa289f_Tx: ComTransferProperty=TRIGGERED, ComSystemTemplateSignalGroupRef=COM_C04_SGR01_P05_5t2743h81pbparal6h2spw309
          3 x ComGroupSignal, all with ComSignalEndianness=LITTLE_ENDIAN:
            COM_C04_Sig004_aca91632_Tx: ComBitPosition=24, ComBitSize=32, ComSignalDataInvalidValue=4294967295, ComSignalInitValue=4294967295, ComSignalType=UINT32, ComSystemTemplateSystemSignalRef=COM_C04_Sig004
            CRC_COM_C04_SGR01_P05_27dfd73b_Tx: ComBitPosition=0, ComBitSize=16, ComSignalInitValue=13866, ComSignalType=UINT16, ComSystemTemplateSystemSignalRef=CRC_COM_C04_SGR01_P05
            SQC_COM_C04_SGR01_P05_c392881d_Tx: ComBitPosition=16, ComBitSize=8, ComSignalInitValue=0, ComSignalType=UINT8, ComSystemTemplateSystemSignalRef=SQC_COM_C04_SGR01_P05
        DI_Odo_Pr5_ST3_e68xmtlkywxgxsdwekdjjhw3t_fd42724a_Rx: ComTransferProperty=TRIGGERED_ON_CHANGE, ComUpdateBitPosition=63, ComSystemTemplateSignalGroupRef=DI_Odo_Pr5_ST3_e68xmtlkywxgxsdwekdjjhw3t
          3 x ComGroupSignal, all with ComSignalEndianness=LITTLE_ENDIAN:
            CRC_DI_Odo_Pr5_ST3_37772215_Rx: ComBitPosition=0, ComBitSize=16, ComSignalInitValue=8633, ComSignalType=UINT16, ComSystemTemplateSystemSignalRef=CRC_DI_Odo_Pr5_ST3
            Odo_ST3_885558ae_Rx: ComBitPosition=24, ComBitSize=24, ComSignalDataInvalidValue=16777215, ComSignalInitValue=16777215, ComSignalType=UINT32, ComSystemTemplateSystemSignalRef=Odo_ST3
            SQC_DI_Odo_Pr5_ST3_4a4e2589_Rx: ComBitPosition=16, ComBitSize=8, ComSignalInitValue=0, ComSignalType=UINT8, ComSystemTemplateSystemSignalRef=SQC_DI_Odo_Pr5_ST3
        Diag_RoE_C04_SigGrp01_2ksq5hjijyze6lf3nboiafq6k_da3d7672_Tx: ComTransferProperty=TRIGGERED, ComSystemTemplateSignalGroupRef=Diag_RoE_C04_SigGrp01_2ksq5hjijyze6lf3nboiafq6k
          8 x ComGroupSignal, all with ComBitSize=8, ComSignalEndianness=LITTLE_ENDIAN, ComSignalType=UINT8:
            Diag_RoE_C04_Sig00_895ff146_Tx: ComBitPosition=0, ComSignalInitValue=0, ComSystemTemplateSystemSignalRef=Diag_RoE_C04_Sig00
            Diag_RoE_C04_Sig01_fe58c1d0_Tx: ComBitPosition=8, ComSignalInitValue=255, ComSystemTemplateSystemSignalRef=Diag_RoE_C04_Sig01
            Diag_RoE_C04_Sig02_6751906a_Tx: ComBitPosition=16, ComSignalInitValue=255, ComSystemTemplateSystemSignalRef=Diag_RoE_C04_Sig02
            Diag_RoE_C04_Sig03_1056a0fc_Tx: ComBitPosition=24, ComSignalInitValue=255, ComSystemTemplateSystemSignalRef=Diag_RoE_C04_Sig03
            Diag_RoE_C04_Sig04_8e32355f_Tx: ComBitPosition=32, ComSignalInitValue=255, ComSystemTemplateSystemSignalRef=Diag_RoE_C04_Sig04
            Diag_RoE_C04_Sig05_f93505c9_Tx: ComBitPosition=40, ComSignalInitValue=255, ComSystemTemplateSystemSignalRef=Diag_RoE_C04_Sig05
            Diag_RoE_C04_Sig06_603c5473_Tx: ComBitPosition=48, ComSignalInitValue=255, ComSystemTemplateSystemSignalRef=Diag_RoE_C04_Sig06
            Diag_RoE_C04_Sig07_173b64e5_Tx: ComBitPosition=56, ComSignalInitValue=255, ComSystemTemplateSystemSignalRef=Diag_RoE_C04_Sig07
        Ign_Stat_Pr5_ST3_csgs1dv6drms80o1i9p49677w_15450583_Rx: ComTransferProperty=TRIGGERED_ON_CHANGE, ComSystemTemplateSignalGroupRef=Ign_Stat_Pr5_ST3_csgs1dv6drms80o1i9p49677w
          5 x ComGroupSignal, all with ComSignalEndianness=LITTLE_ENDIAN:
            CRC_Ign_Stat_Pr5_ST3_5a6d484c_Rx: ComBitPosition=0, ComBitSize=16, ComSignalInitValue=20886, ComSignalType=UINT16, ComSystemTemplateSystemSignalRef=CRC_Ign_Stat_Pr5_ST3
            ISw_Stat_ST3_420cdaef_Rx: ComBitPosition=24, ComBitSize=3, ComSignalDataInvalidValue=7, ComSignalInitValue=7, ComSignalType=UINT8, ComSystemTemplateSystemSignalRef=ISw_Stat_ST3
            KG_StartSw_Psd_ST3_c98c4896_Rx: ComBitPosition=31, ComBitSize=1, ComSignalInitValue=0, ComSignalType=BOOLEAN, ComSystemTemplateSystemSignalRef=KG_StartSw_Psd_ST3
            SQC_Ign_Stat_Pr5_ST3_19fd65c0_Rx: ComBitPosition=16, ComBitSize=8, ComSignalInitValue=0, ComSignalType=UINT8, ComSystemTemplateSystemSignalRef=SQC_Ign_Stat_Pr5_ST3
            Veh_Op_Mode_ST3_7d318849_Rx: ComBitPosition=27, ComBitSize=4, ComSignalDataInvalidValue=15, ComSignalInitValue=0, ComSignalType=UINT8, ComSystemTemplateSystemSignalRef=Veh_Op_Mode_ST3
        PT4_PTCoor4_Pr5_ST3_af4fxb1ykieox3itqdfzs0kpb_7ac1c48b_Rx: ComTimeout=1, ComTransferProperty=TRIGGERED_ON_CHANGE, ComSystemTemplateSignalGroupRef=PT4_PTCoor4_Pr5_ST3_af4fxb1ykieox3itqdfzs0kpb
          6 x ComGroupSignal, all with ComSignalEndianness=LITTLE_ENDIAN:
            CRC_PT4_PTCoor4_Pr5_ST3_fea93842_Rx: ComBitPosition=0, ComBitSize=16, ComSignalInitValue=4203, ComSignalType=UINT16, ComSystemTemplateSystemSignalRef=CRC_PT4_PTCoor4_Pr5_ST3
            PT4_PTCoor_EngStartPN14_Stat_ST3_28d5ff96_Rx: ComBitPosition=28, ComBitSize=3, ComSignalDataInvalidValue=7, ComSignalInitValue=0, ComSignalType=UINT8, ComSystemTemplateSystemSignalRef=PT4_PTCoor_EngStartPN14_Stat_ST3
            PT4_PTCoor_PT_Rdy_ST3_2fa39504_Rx: ComBitPosition=24, ComBitSize=2, ComSignalDataInvalidValue=3, ComSignalInitValue=0, ComSignalType=UINT8, ComSystemTemplateSystemSignalRef=PT4_PTCoor_PT_Rdy_ST3
            PT4_PTCoor_SSA_EngSp_ST3_49b9f1e7_Rx: ComBitPosition=26, ComBitSize=2, ComSignalDataInvalidValue=3, ComSignalInitValue=3, ComSignalType=UINT8, ComSystemTemplateSystemSignalRef=PT4_PTCoor_SSA_EngSp_ST3
            Rsrv1_PT4_PTCoor_PT_Rdy_Pr5_ST3_15a5d52b_Rx: ComBitPosition=31, ComBitSize=1, ComSignalInitValue=1, ComSignalType=UINT8, ComSystemTemplateSystemSignalRef=Rsrv1_PT4_PTCoor_PT_Rdy_Pr5_ST3
            SQC_PT4_PTCoor4_Pr5_ST3_c6a3134e_Rx: ComBitPosition=16, ComBitSize=8, ComSignalInitValue=0, ComSignalType=UINT8, ComSystemTemplateSystemSignalRef=SQC_PT4_PTCoor4_Pr5_ST3
        VSS_TP_Auth_ST3_6j4id7sghlvlbroli4wjozjik_7e4c4bef_Rx: ComTransferProperty=TRIGGERED, ComSystemTemplateSignalGroupRef=VSS_TP_Auth_ST3_6j4id7sghlvlbroli4wjozjik
          8 x ComGroupSignal, all with ComBitSize=8, ComSignalEndianness=LITTLE_ENDIAN, ComSignalInitValue=255, ComSignalType=UINT8:
            VSS_TP_Auth_0_ST3_38766ee7_Rx: ComBitPosition=0, ComSystemTemplateSystemSignalRef=VSS_TP_Auth_0_ST3
            VSS_TP_Auth_1_ST3_05164757_Rx: ComBitPosition=8, ComSystemTemplateSystemSignalRef=VSS_TP_Auth_1_ST3
            VSS_TP_Auth_2_ST3_42b63d87_Rx: ComBitPosition=16, ComSystemTemplateSystemSignalRef=VSS_TP_Auth_2_ST3
            VSS_TP_Auth_3_ST3_7fd61437_Rx: ComBitPosition=24, ComSystemTemplateSystemSignalRef=VSS_TP_Auth_3_ST3
            VSS_TP_Auth_4_ST3_cdf6c827_Rx: ComBitPosition=32, ComSystemTemplateSystemSignalRef=VSS_TP_Auth_4_ST3
            VSS_TP_Auth_5_ST3_f096e197_Rx: ComBitPosition=40, ComSystemTemplateSystemSignalRef=VSS_TP_Auth_5_ST3
            VSS_TP_Auth_6_ST3_b7369b47_Rx: ComBitPosition=48, ComSystemTemplateSystemSignalRef=VSS_TP_Auth_6_ST3
            VSS_TP_Auth_7_ST3_8a56b2f7_Rx: ComBitPosition=56, ComSystemTemplateSystemSignalRef=VSS_TP_Auth_7_ST3
        VSS_TP_RealTmOffset_ST3_1t7vc44gftc0wv35k5kgc2in9_edbcea96_Rx: ComTransferProperty=TRIGGERED, ComSystemTemplateSignalGroupRef=VSS_TP_RealTmOffset_ST3_1t7vc44gftc0wv35k5kgc2in9
          8 x ComGroupSignal, all with ComBitSize=8, ComSignalEndianness=LITTLE_ENDIAN, ComSignalInitValue=255, ComSignalType=UINT8:
            VSS_TP_RealTmOffset_0_ST3_3a1a2c70_Rx: ComBitPosition=0, ComSystemTemplateSystemSignalRef=VSS_TP_RealTmOffset_0_ST3
            VSS_TP_RealTmOffset_1_ST3_077a05c0_Rx: ComBitPosition=8, ComSystemTemplateSystemSignalRef=VSS_TP_RealTmOffset_1_ST3
            VSS_TP_RealTmOffset_2_ST3_40da7f10_Rx: ComBitPosition=16, ComSystemTemplateSystemSignalRef=VSS_TP_RealTmOffset_2_ST3
            VSS_TP_RealTmOffset_3_ST3_7dba56a0_Rx: ComBitPosition=24, ComSystemTemplateSystemSignalRef=VSS_TP_RealTmOffset_3_ST3
            VSS_TP_RealTmOffset_4_ST3_cf9a8ab0_Rx: ComBitPosition=32, ComSystemTemplateSystemSignalRef=VSS_TP_RealTmOffset_4_ST3
            VSS_TP_RealTmOffset_5_ST3_f2faa300_Rx: ComBitPosition=40, ComSystemTemplateSystemSignalRef=VSS_TP_RealTmOffset_5_ST3
            VSS_TP_RealTmOffset_6_ST3_b55ad9d0_Rx: ComBitPosition=48, ComSystemTemplateSystemSignalRef=VSS_TP_RealTmOffset_6_ST3
            VSS_TP_RealTmOffset_7_ST3_883af060_Rx: ComBitPosition=56, ComSystemTemplateSystemSignalRef=VSS_TP_RealTmOffset_7_ST3
        VSS_TP_SecTickCount_Lvl1_ST3_mzmfdqtqz5kvv1kfpvg0kql3_7c2092e6_Rx: ComTransferProperty=TRIGGERED, ComSystemTemplateSignalGroupRef=VSS_TP_SecTickCount_Lvl1_ST3_mzmfdqtqz5kvv1kfpvg0kql3
          8 x ComGroupSignal, all with ComBitSize=8, ComSignalEndianness=LITTLE_ENDIAN, ComSignalInitValue=255, ComSignalType=UINT8:
            VSS_TP_SecTickCount_Lvl1_0_ST3_02ccc0c5_Rx: ComBitPosition=0, ComSystemTemplateSystemSignalRef=VSS_TP_SecTickCount_Lvl1_0_ST3
            VSS_TP_SecTickCount_Lvl1_1_ST3_3face975_Rx: ComBitPosition=8, ComSystemTemplateSystemSignalRef=VSS_TP_SecTickCount_Lvl1_1_ST3
            VSS_TP_SecTickCount_Lvl1_2_ST3_780c93a5_Rx: ComBitPosition=16, ComSystemTemplateSystemSignalRef=VSS_TP_SecTickCount_Lvl1_2_ST3
            VSS_TP_SecTickCount_Lvl1_3_ST3_456cba15_Rx: ComBitPosition=24, ComSystemTemplateSystemSignalRef=VSS_TP_SecTickCount_Lvl1_3_ST3
            VSS_TP_SecTickCount_Lvl1_4_ST3_f74c6605_Rx: ComBitPosition=32, ComSystemTemplateSystemSignalRef=VSS_TP_SecTickCount_Lvl1_4_ST3
            VSS_TP_SecTickCount_Lvl1_5_ST3_ca2c4fb5_Rx: ComBitPosition=40, ComSystemTemplateSystemSignalRef=VSS_TP_SecTickCount_Lvl1_5_ST3
            VSS_TP_SecTickCount_Lvl1_6_ST3_8d8c3565_Rx: ComBitPosition=48, ComSystemTemplateSystemSignalRef=VSS_TP_SecTickCount_Lvl1_6_ST3
            VSS_TP_SecTickCount_Lvl1_7_ST3_b0ec1cd5_Rx: ComBitPosition=56, ComSystemTemplateSystemSignalRef=VSS_TP_SecTickCount_Lvl1_7_ST3
        VSS_TP_SecTickCount_Lvl2_ST3_9eubq13iosat764o0lqh5xb6r_945278bd_Tx: ComTransferProperty=TRIGGERED, ComSystemTemplateSignalGroupRef=VSS_TP_SecTickCount_Lvl2_ST3_9eubq13iosat764o0lqh5xb6r
          8 x ComGroupSignal, all with ComBitSize=8, ComSignalEndianness=LITTLE_ENDIAN, ComSignalInitValue=255, ComSignalType=UINT8:
            VSS_TP_SecTickCount_Lvl2_0_ST3_c86f8105_Tx: ComBitPosition=0, ComSystemTemplateSystemSignalRef=VSS_TP_SecTickCount_Lvl2_0_ST3
            VSS_TP_SecTickCount_Lvl2_1_ST3_f50fa8b5_Tx: ComBitPosition=8, ComSystemTemplateSystemSignalRef=VSS_TP_SecTickCount_Lvl2_1_ST3
            VSS_TP_SecTickCount_Lvl2_2_ST3_b2afd265_Tx: ComBitPosition=16, ComSystemTemplateSystemSignalRef=VSS_TP_SecTickCount_Lvl2_2_ST3
            VSS_TP_SecTickCount_Lvl2_3_ST3_8fcffbd5_Tx: ComBitPosition=24, ComSystemTemplateSystemSignalRef=VSS_TP_SecTickCount_Lvl2_3_ST3
            VSS_TP_SecTickCount_Lvl2_4_ST3_3def27c5_Tx: ComBitPosition=32, ComSystemTemplateSystemSignalRef=VSS_TP_SecTickCount_Lvl2_4_ST3
            VSS_TP_SecTickCount_Lvl2_5_ST3_008f0e75_Tx: ComBitPosition=40, ComSystemTemplateSystemSignalRef=VSS_TP_SecTickCount_Lvl2_5_ST3
            VSS_TP_SecTickCount_Lvl2_6_ST3_472f74a5_Tx: ComBitPosition=48, ComSystemTemplateSystemSignalRef=VSS_TP_SecTickCount_Lvl2_6_ST3
            VSS_TP_SecTickCount_Lvl2_7_ST3_7a4f5d15_Tx: ComBitPosition=56, ComSystemTemplateSystemSignalRef=VSS_TP_SecTickCount_Lvl2_7_ST3
        VSS_TP_SecTickCount_Lvl2_ST3_9eubq13iosat764o0lqh5xb6r_98a4441d_Tx: ComTransferProperty=TRIGGERED, ComSystemTemplateSignalGroupRef=VSS_TP_SecTickCount_Lvl2_ST3_9eubq13iosat764o0lqh5xb6r
          8 x ComGroupSignal, all with ComBitSize=8, ComSignalEndianness=LITTLE_ENDIAN, ComSignalInitValue=255, ComSignalType=UINT8:
            VSS_TP_SecTickCount_Lvl2_0_ST3_f0485eec_Tx: ComBitPosition=0, ComSystemTemplateSystemSignalRef=VSS_TP_SecTickCount_Lvl2_0_ST3
            VSS_TP_SecTickCount_Lvl2_1_ST3_cd28775c_Tx: ComBitPosition=8, ComSystemTemplateSystemSignalRef=VSS_TP_SecTickCount_Lvl2_1_ST3
            VSS_TP_SecTickCount_Lvl2_2_ST3_8a880d8c_Tx: ComBitPosition=16, ComSystemTemplateSystemSignalRef=VSS_TP_SecTickCount_Lvl2_2_ST3
            VSS_TP_SecTickCount_Lvl2_3_ST3_b7e8243c_Tx: ComBitPosition=24, ComSystemTemplateSystemSignalRef=VSS_TP_SecTickCount_Lvl2_3_ST3
            VSS_TP_SecTickCount_Lvl2_4_ST3_05c8f82c_Tx: ComBitPosition=32, ComSystemTemplateSystemSignalRef=VSS_TP_SecTickCount_Lvl2_4_ST3
            VSS_TP_SecTickCount_Lvl2_5_ST3_38a8d19c_Tx: ComBitPosition=40, ComSystemTemplateSystemSignalRef=VSS_TP_SecTickCount_Lvl2_5_ST3
            VSS_TP_SecTickCount_Lvl2_6_ST3_7f08ab4c_Tx: ComBitPosition=48, ComSystemTemplateSystemSignalRef=VSS_TP_SecTickCount_Lvl2_6_ST3
            VSS_TP_SecTickCount_Lvl2_7_ST3_426882fc_Tx: ComBitPosition=56, ComSystemTemplateSystemSignalRef=VSS_TP_SecTickCount_Lvl2_7_ST3
        VSS_TP_SharedSecret_ST3_8pj4t8t4rm3tw3pk5hj7vonti_e726a839_Rx: ComTransferProperty=TRIGGERED, ComSystemTemplateSignalGroupRef=VSS_TP_SharedSecret_ST3_8pj4t8t4rm3tw3pk5hj7vonti
          8 x ComGroupSignal, all with ComBitSize=8, ComSignalEndianness=LITTLE_ENDIAN, ComSignalInitValue=255, ComSignalType=UINT8:
            VSS_TP_SharedSecret_0_ST3_ecaa6d13_Rx: ComBitPosition=0, ComSystemTemplateSystemSignalRef=VSS_TP_SharedSecret_0_ST3
            VSS_TP_SharedSecret_1_ST3_d1ca44a3_Rx: ComBitPosition=8, ComSystemTemplateSystemSignalRef=VSS_TP_SharedSecret_1_ST3
            VSS_TP_SharedSecret_2_ST3_966a3e73_Rx: ComBitPosition=16, ComSystemTemplateSystemSignalRef=VSS_TP_SharedSecret_2_ST3
            VSS_TP_SharedSecret_3_ST3_ab0a17c3_Rx: ComBitPosition=24, ComSystemTemplateSystemSignalRef=VSS_TP_SharedSecret_3_ST3
            VSS_TP_SharedSecret_4_ST3_192acbd3_Rx: ComBitPosition=32, ComSystemTemplateSystemSignalRef=VSS_TP_SharedSecret_4_ST3
            VSS_TP_SharedSecret_5_ST3_244ae263_Rx: ComBitPosition=40, ComSystemTemplateSystemSignalRef=VSS_TP_SharedSecret_5_ST3
            VSS_TP_SharedSecret_6_ST3_63ea98b3_Rx: ComBitPosition=48, ComSystemTemplateSystemSignalRef=VSS_TP_SharedSecret_6_ST3
            VSS_TP_SharedSecret_7_ST3_5e8ab103_Rx: ComBitPosition=56, ComSystemTemplateSystemSignalRef=VSS_TP_SharedSecret_7_ST3
        VSS_TP_VIN_ST3_bz1xsv84cxzl09j028gn39p69_9d855e1d_Rx: ComTransferProperty=TRIGGERED, ComSystemTemplateSignalGroupRef=VSS_TP_VIN_ST3_bz1xsv84cxzl09j028gn39p69
          8 x ComGroupSignal, all with ComBitSize=8, ComSignalEndianness=LITTLE_ENDIAN, ComSignalInitValue=63, ComSignalType=UINT8:
            VSS_TP_VIN_0_ST3_84224ccb_Rx: ComBitPosition=0, ComSystemTemplateSystemSignalRef=VSS_TP_VIN_0_ST3
            VSS_TP_VIN_1_ST3_b942657b_Rx: ComBitPosition=8, ComSystemTemplateSystemSignalRef=VSS_TP_VIN_1_ST3
            VSS_TP_VIN_2_ST3_fee21fab_Rx: ComBitPosition=16, ComSystemTemplateSystemSignalRef=VSS_TP_VIN_2_ST3
            VSS_TP_VIN_3_ST3_c382361b_Rx: ComBitPosition=24, ComSystemTemplateSystemSignalRef=VSS_TP_VIN_3_ST3
            VSS_TP_VIN_4_ST3_71a2ea0b_Rx: ComBitPosition=32, ComSystemTemplateSystemSignalRef=VSS_TP_VIN_4_ST3
            VSS_TP_VIN_5_ST3_4cc2c3bb_Rx: ComBitPosition=40, ComSystemTemplateSystemSignalRef=VSS_TP_VIN_5_ST3
            VSS_TP_VIN_6_ST3_0b62b96b_Rx: ComBitPosition=48, ComSystemTemplateSystemSignalRef=VSS_TP_VIN_6_ST3
            VSS_TP_VIN_7_ST3_360290db_Rx: ComBitPosition=56, ComSystemTemplateSystemSignalRef=VSS_TP_VIN_7_ST3
        VehSpd8_Pr5_ST3_168m1ogyookfwuxfakr38tbmv_c0deee46_Rx: ComTransferProperty=PENDING, ComSystemTemplateSignalGroupRef=VehSpd8_Pr5_ST3_168m1ogyookfwuxfakr38tbmv
          3 x ComGroupSignal, all with ComSignalEndianness=LITTLE_ENDIAN:
            CRC_VehSpd8_Pr5_ST3_845b3203_Rx: ComBitPosition=0, ComBitSize=16, ComSignalInitValue=19913, ComSignalType=UINT16, ComSystemTemplateSystemSignalRef=CRC_VehSpd8_Pr5_ST3
            SQC_VehSpd8_Pr5_ST3_7d9fd46b_Rx: ComBitPosition=16, ComBitSize=8, ComSignalInitValue=0, ComSignalType=UINT8, ComSystemTemplateSystemSignalRef=SQC_VehSpd8_Pr5_ST3
            VehSpd8_ST3_d7b0bb79_Rx: ComBitPosition=24, ComBitSize=8, ComSignalDataInvalidValue=255, ComSignalInitValue=255, ComSignalType=UINT8, ComSystemTemplateSystemSignalRef=VehSpd8_ST3
      ComTimeBase: ComGwTimeBase=0.005, ComRxTimeBase=0.005, ComTxTimeBase=0.005
    ComGeneral
  module config ComM
    ComMConfigSet: ComMPncEnabled=true
      7 x ComMChannel:
        ECU4_CRN_CAN1_Cluster4_6it1ke922hxi7y4c8scsqzzry_25bd0b69: ComMBusType=COMM_BUS_TYPE_CAN, ComMChannelId=0, ComMPncGatewayType=COMM_GATEWAY_TYPE_ACTIVE
          ComMNetworkManagement: ComMNmVariant=FULL
          ECU4_CRN_CAN1_Cluster4_6it1ke922hxi7y4c8scsqzzry_93656f17 (ComMUserPerChannel): ComMUserChannel=ECU4_CRN_CAN1_Cluster4_6it1ke922hxi7y4c8scsqzzry_328bd450
        ECU4_CRN_CANFD1_Cluster4_bx4qzxpu7xp7napnh6bsrtlzq_d98d74ac: ComMBusType=COMM_BUS_TYPE_CAN, ComMChannelId=1, ComMPncGatewayType=COMM_GATEWAY_TYPE_ACTIVE
          ComMNetworkManagement: ComMNmVariant=FULL
          ECU4_CRN_CANFD1_Cluster4_bx4qzxpu7xp7napnh6bsrtlzq_58aac057 (ComMUserPerChannel): ComMUserChannel=ECU4_CRN_CANFD1_Cluster4_bx4qzxpu7xp7napnh6bsrtlzq_7f986d5b
        ECU4_CRN_Eth_Cluster4_3g6xoesclytkmkqofl9pi6ol1_481bdd0f: ComMBusType=COMM_BUS_TYPE_ETH, ComMChannelId=4, ComMPncGatewayType=COMM_GATEWAY_TYPE_PASSIVE
          ComMNetworkManagement: ComMNmVariant=FULL
          ECU4_CRN_Eth_Cluster4_3g6xoesclytkmkqofl9pi6ol1_521c0980 (ComMUserPerChannel): ComMUserChannel=ECU4_CRN_Eth_Cluster4_3g6xoesclytkmkqofl9pi6ol1_4d91a935
        ECU4_CRN_Eth_Cluster4_3l8iyw65auc022so95pkbhyzp_3cc7b164: ComMBusType=COMM_BUS_TYPE_ETH, ComMChannelId=6, ComMPncGatewayType=COMM_GATEWAY_TYPE_NONE, ComMManageReference=ComMConfigSet/ECU4_CRN_Eth_Cluster4_3g6xoesclytkmkqofl9pi6ol1_481bdd0f
          ComMNetworkManagement: ComMNmVariant=FULL
          ECU4_CRN_Eth_Cluster4_3l8iyw65auc022so95pkbhyzp_06811964 (ComMUserPerChannel): ComMUserChannel=ECU4_CRN_Eth_Cluster4_3l8iyw65auc022so95pkbhyzp_e833255e
        ECU4_CRN_Eth_Cluster4_7f3fu4rgtopbi2t35la2b13rd_a7751c70: ComMBusType=COMM_BUS_TYPE_ETH, ComMChannelId=3, ComMPncGatewayType=COMM_GATEWAY_TYPE_NONE, ComMManageReference=ComMConfigSet/ECU4_CRN_Eth_Cluster4_3g6xoesclytkmkqofl9pi6ol1_481bdd0f
          ComMNetworkManagement: ComMNmVariant=FULL
          ECU4_CRN_Eth_Cluster4_7f3fu4rgtopbi2t35la2b13rd_4b6eb6a9 (ComMUserPerChannel): ComMUserChannel=ECU4_CRN_Eth_Cluster4_7f3fu4rgtopbi2t35la2b13rd_e81c7c77
        ECU4_CRN_Eth_Cluster4_a4tivcve7b3dlvxw1emxbqzmz_cc30adf6: ComMBusType=COMM_BUS_TYPE_ETH, ComMChannelId=5, ComMPncGatewayType=COMM_GATEWAY_TYPE_NONE, ComMManageReference=ComMConfigSet/ECU4_CRN_Eth_Cluster4_3g6xoesclytkmkqofl9pi6ol1_481bdd0f
          ComMNetworkManagement: ComMNmVariant=FULL
          ECU4_CRN_Eth_Cluster4_a4tivcve7b3dlvxw1emxbqzmz_b40dfee0 (ComMUserPerChannel): ComMUserChannel=ECU4_CRN_Eth_Cluster4_a4tivcve7b3dlvxw1emxbqzmz_930f76cc
        ECU4_CRN_LIN5_Cluster4_b21l9awrmlmhxxw03j6k8wiqt_0edbd2ed: ComMBusType=COMM_BUS_TYPE_LIN, ComMChannelId=2
          ComMNetworkManagement: ComMNmVariant=NONE
          ECU4_CRN_LIN5_Cluster4_b21l9awrmlmhxxw03j6k8wiqt_bb6fd877 (ComMUserPerChannel): ComMUserChannel=ECU4_CRN_LIN5_Cluster4_b21l9awrmlmhxxw03j6k8wiqt_956d640e
      7 x ComMPnc, all with ComMChannelPerPnc=ComMConfigSet/ECU4_CRN_Eth_Cluster4_3g6xoesclytkmkqofl9pi6ol1_481bdd0f, ComMChannelPerPnc=ComMConfigSet/ECU4_CRN_Eth_Cluster4_3l8iyw65auc022so95pkbhyzp_3cc7b164:
        PNC_00_MAPPING_b2c42696: ComMPncId=8, ComMChannelPerPnc=ComMConfigSet/ECU4_CRN_CAN1_Cluster4_6it1ke922hxi7y4c8scsqzzry_25bd0b69, ComMChannelPerPnc=ComMConfigSet/ECU4_CRN_CANFD1_Cluster4_bx4qzxpu7xp7napnh6bsrtlzq_d98d74ac, ComMChannelPerPnc=ComMConfigSet/ECU4_CRN_Eth_Cluster4_7f3fu4rgtopbi2t35la2b13rd_a7751c70, ComMChannelPerPnc=ComMConfigSet/ECU4_CRN_Eth_Cluster4_a4tivcve7b3dlvxw1emxbqzmz_cc30adf6, ComMUserPerPnc=PNC_00_MAPPING_60241c9f
          8 x ComMPncComSignal:
            ComSignalPnc_EIRA_CAN_Rx_1e4792f2: ComMPncComSignalDirection=RX, ComMPncComSignalKind=EIRA, ComMPncComSignalRef=ComSignalPnc_EIRA_CAN_Rx
            ComSignalPnc_EIRA_ETH_Rx_457536c1: ComMPncComSignalDirection=RX, ComMPncComSignalKind=EIRA, ComMPncComSignalRef=ComSignalPnc_EIRA_ETH_Rx
            ComSignalPnc_ERA_CAN_CAN1_Cluster4_53b2b17a_Rx_2b652ff7: ComMPncComSignalDirection=RX, ComMPncComSignalKind=ERA, ComMPncComSignalChannelRef=ComMConfigSet/ECU4_CRN_CAN1_Cluster4_6it1ke922hxi7y4c8scsqzzry_25bd0b69, ComMPncComSignalRef=ComSignalPnc_ERA_CAN_CAN1_Cluster4_53b2b17a_Rx
            ComSignalPnc_ERA_CAN_CANFD1_Cluster4_0f365fd3_Rx_66d70145: ComMPncComSignalDirection=RX, ComMPncComSignalKind=ERA, ComMPncComSignalChannelRef=ComMConfigSet/ECU4_CRN_CANFD1_Cluster4_bx4qzxpu7xp7napnh6bsrtlzq_d98d74ac, ComMPncComSignalRef=ComSignalPnc_ERA_CAN_CANFD1_Cluster4_0f365fd3_Rx
            ComSignalPnc_ERA_ETH_ECU4_CRN_Eth_Cluster4_3g6xoesclytkmkqofl9pi6ol1_481bdd0f_Rx_71607aa4: ComMPncComSignalDirection=RX, ComMPncComSignalKind=ERA, ComMPncComSignalChannelRef=ComMConfigSet/ECU4_CRN_Eth_Cluster4_3g6xoesclytkmkqofl9pi6ol1_481bdd0f, ComMPncComSignalRef=ComSignalPnc_ERA_ETH_ECU4_CRN_Eth_Cluster4_3g6xoesclytkmkqofl9pi6ol1_481bdd0f_Rx
            NM_C04_PNC_741720e0_Tx_14c93fc2: ComMPncComSignalDirection=TX, ComMPncComSignalKind=EIRA, ComMPncComSignalChannelRef=ComMConfigSet/ECU4_CRN_CAN1_Cluster4_6it1ke922hxi7y4c8scsqzzry_25bd0b69, ComMPncComSignalRef=NM_C04_PNC_741720e0_Tx
            NM_C04_PNC_8497b6a9_Tx_41ed8afc: ComMPncComSignalDirection=TX, ComMPncComSignalKind=EIRA, ComMPncComSignalChannelRef=ComMConfigSet/ECU4_CRN_Eth_Cluster4_3g6xoesclytkmkqofl9pi6ol1_481bdd0f, ComMPncComSignalRef=NM_C04_PNC_8497b6a9_Tx
            NM_C04_PNC_d0e8f103_Tx_f460d71f: ComMPncComSignalDirection=TX, ComMPncComSignalKind=EIRA, ComMPncComSignalChannelRef=ComMConfigSet/ECU4_CRN_CANFD1_Cluster4_bx4qzxpu7xp7napnh6bsrtlzq_d98d74ac, ComMPncComSignalRef=NM_C04_PNC_d0e8f103_Tx
        PNC_09_MAPPING_3f0a390d: ComMPncId=17, ComMChannelPerPnc=ComMConfigSet/ECU4_CRN_CAN1_Cluster4_6it1ke922hxi7y4c8scsqzzry_25bd0b69, ComMUserPerPnc=PNC_09_MAPPING_b373002b
          6 x ComMPncComSignal:
            ComSignalPnc_EIRA_CAN_Rx_1e4792f2: ComMPncComSignalDirection=RX, ComMPncComSignalKind=EIRA, ComMPncComSignalRef=ComSignalPnc_EIRA_CAN_Rx
            ComSignalPnc_EIRA_ETH_Rx_457536c1: ComMPncComSignalDirection=RX, ComMPncComSignalKind=EIRA, ComMPncComSignalRef=ComSignalPnc_EIRA_ETH_Rx
            ComSignalPnc_ERA_CAN_CAN1_Cluster4_53b2b17a_Rx_2b652ff7: ComMPncComSignalDirection=RX, ComMPncComSignalKind=ERA, ComMPncComSignalChannelRef=ComMConfigSet/ECU4_CRN_CAN1_Cluster4_6it1ke922hxi7y4c8scsqzzry_25bd0b69, ComMPncComSignalRef=ComSignalPnc_ERA_CAN_CAN1_Cluster4_53b2b17a_Rx
            ComSignalPnc_ERA_ETH_ECU4_CRN_Eth_Cluster4_3g6xoesclytkmkqofl9pi6ol1_481bdd0f_Rx_71607aa4: ComMPncComSignalDirection=RX, ComMPncComSignalKind=ERA, ComMPncComSignalChannelRef=ComMConfigSet/ECU4_CRN_Eth_Cluster4_3g6xoesclytkmkqofl9pi6ol1_481bdd0f, ComMPncComSignalRef=ComSignalPnc_ERA_ETH_ECU4_CRN_Eth_Cluster4_3g6xoesclytkmkqofl9pi6ol1_481bdd0f_Rx
            NM_C04_PNC_741720e0_Tx_14c93fc2: ComMPncComSignalDirection=TX, ComMPncComSignalKind=EIRA, ComMPncComSignalChannelRef=ComMConfigSet/ECU4_CRN_CAN1_Cluster4_6it1ke922hxi7y4c8scsqzzry_25bd0b69, ComMPncComSignalRef=NM_C04_PNC_741720e0_Tx
            NM_C04_PNC_8497b6a9_Tx_41ed8afc: ComMPncComSignalDirection=TX, ComMPncComSignalKind=EIRA, ComMPncComSignalChannelRef=ComMConfigSet/ECU4_CRN_Eth_Cluster4_3g6xoesclytkmkqofl9pi6ol1_481bdd0f, ComMPncComSignalRef=NM_C04_PNC_8497b6a9_Tx
        PNC_18_MAPPING_2513cfb2: ComMPncId=26, ComMUserPerPnc=PNC_18_MAPPING_4da1ea4a
          ComSignalPnc_EIRA_ETH_Rx_457536c1 (ComMPncComSignal): ComMPncComSignalDirection=RX, ComMPncComSignalKind=EIRA, ComMPncComSignalRef=ComSignalPnc_EIRA_ETH_Rx
          NM_C04_PNC_8497b6a9_Tx_41ed8afc (ComMPncComSignal):
            ComMPncComSignalDirection = TX
            ComMPncComSignalKind = EIRA
            ComMPncComSignalChannelRef = ComMConfigSet/ECU4_CRN_Eth_Cluster4_3g6xoesclytkmkqofl9pi6ol1_481bdd0f
            ComMPncComSignalRef = NM_C04_PNC_8497b6a9_Tx
        PNC_27_MAPPING_6a5f5cf6: ComMPncId=35, ComMUserPerPnc=PNC_27_MAPPING_1275ace7
          ComSignalPnc_EIRA_ETH_Rx_457536c1 (ComMPncComSignal): ComMPncComSignalDirection=RX, ComMPncComSignalKind=EIRA, ComMPncComSignalRef=ComSignalPnc_EIRA_ETH_Rx
          NM_C04_PNC_8497b6a9_Tx_41ed8afc (ComMPncComSignal):
            ComMPncComSignalDirection = TX
            ComMPncComSignalKind = EIRA
            ComMPncComSignalChannelRef = ComMConfigSet/ECU4_CRN_Eth_Cluster4_3g6xoesclytkmkqofl9pi6ol1_481bdd0f
            ComMPncComSignalRef = NM_C04_PNC_8497b6a9_Tx
        PNC_36_MAPPING_142a6f4d: ComMPncId=44, ComMChannelPerPnc=ComMConfigSet/ECU4_CRN_CANFD1_Cluster4_bx4qzxpu7xp7napnh6bsrtlzq_d98d74ac, ComMUserPerPnc=PNC_36_MAPPING_5c7e3504
          6 x ComMPncComSignal:
            ComSignalPnc_EIRA_CAN_Rx_1e4792f2: ComMPncComSignalDirection=RX, ComMPncComSignalKind=EIRA, ComMPncComSignalRef=ComSignalPnc_EIRA_CAN_Rx
            ComSignalPnc_EIRA_ETH_Rx_457536c1: ComMPncComSignalDirection=RX, ComMPncComSignalKind=EIRA, ComMPncComSignalRef=ComSignalPnc_EIRA_ETH_Rx
            ComSignalPnc_ERA_CAN_CANFD1_Cluster4_0f365fd3_Rx_66d70145: ComMPncComSignalDirection=RX, ComMPncComSignalKind=ERA, ComMPncComSignalChannelRef=ComMConfigSet/ECU4_CRN_CANFD1_Cluster4_bx4qzxpu7xp7napnh6bsrtlzq_d98d74ac, ComMPncComSignalRef=ComSignalPnc_ERA_CAN_CANFD1_Cluster4_0f365fd3_Rx
            ComSignalPnc_ERA_ETH_ECU4_CRN_Eth_Cluster4_3g6xoesclytkmkqofl9pi6ol1_481bdd0f_Rx_71607aa4: ComMPncComSignalDirection=RX, ComMPncComSignalKind=ERA, ComMPncComSignalChannelRef=ComMConfigSet/ECU4_CRN_Eth_Cluster4_3g6xoesclytkmkqofl9pi6ol1_481bdd0f, ComMPncComSignalRef=ComSignalPnc_ERA_ETH_ECU4_CRN_Eth_Cluster4_3g6xoesclytkmkqofl9pi6ol1_481bdd0f_Rx
            NM_C04_PNC_8497b6a9_Tx_41ed8afc: ComMPncComSignalDirection=TX, ComMPncComSignalKind=EIRA, ComMPncComSignalChannelRef=ComMConfigSet/ECU4_CRN_Eth_Cluster4_3g6xoesclytkmkqofl9pi6ol1_481bdd0f, ComMPncComSignalRef=NM_C04_PNC_8497b6a9_Tx
            NM_C04_PNC_d0e8f103_Tx_f460d71f: ComMPncComSignalDirection=TX, ComMPncComSignalKind=EIRA, ComMPncComSignalChannelRef=ComMConfigSet/ECU4_CRN_CANFD1_Cluster4_bx4qzxpu7xp7napnh6bsrtlzq_d98d74ac, ComMPncComSignalRef=NM_C04_PNC_d0e8f103_Tx
        PNC_45_MAPPING_99b81f07: ComMPncId=53, ComMUserPerPnc=PNC_45_MAPPING_61eb4d1e
          3 x ComMPncComSignal:
            ComSignalPnc_EIRA_ETH_Rx_457536c1: ComMPncComSignalDirection=RX, ComMPncComSignalKind=EIRA, ComMPncComSignalRef=ComSignalPnc_EIRA_ETH_Rx
            ComSignalPnc_ERA_ETH_ECU4_CRN_Eth_Cluster4_3g6xoesclytkmkqofl9pi6ol1_481bdd0f_Rx_71607aa4: ComMPncComSignalDirection=RX, ComMPncComSignalKind=ERA, ComMPncComSignalChannelRef=ComMConfigSet/ECU4_CRN_Eth_Cluster4_3g6xoesclytkmkqofl9pi6ol1_481bdd0f, ComMPncComSignalRef=ComSignalPnc_ERA_ETH_ECU4_CRN_Eth_Cluster4_3g6xoesclytkmkqofl9pi6ol1_481bdd0f_Rx
            NM_C04_PNC_8497b6a9_Tx_41ed8afc: ComMPncComSignalDirection=TX, ComMPncComSignalKind=EIRA, ComMPncComSignalChannelRef=ComMConfigSet/ECU4_CRN_Eth_Cluster4_3g6xoesclytkmkqofl9pi6ol1_481bdd0f, ComMPncComSignalRef=NM_C04_PNC_8497b6a9_Tx
        PNC_54_MAPPING_83a1e9b8: ComMPncId=62, ComMUserPerPnc=PNC_54_MAPPING_9f39a77f
          3 x ComMPncComSignal:
            ComSignalPnc_EIRA_ETH_Rx_457536c1: ComMPncComSignalDirection=RX, ComMPncComSignalKind=EIRA, ComMPncComSignalRef=ComSignalPnc_EIRA_ETH_Rx
            ComSignalPnc_ERA_ETH_ECU4_CRN_Eth_Cluster4_3g6xoesclytkmkqofl9pi6ol1_481bdd0f_Rx_71607aa4: ComMPncComSignalDirection=RX, ComMPncComSignalKind=ERA, ComMPncComSignalChannelRef=ComMConfigSet/ECU4_CRN_Eth_Cluster4_3g6xoesclytkmkqofl9pi6ol1_481bdd0f, ComMPncComSignalRef=ComSignalPnc_ERA_ETH_ECU4_CRN_Eth_Cluster4_3g6xoesclytkmkqofl9pi6ol1_481bdd0f_Rx
            NM_C04_PNC_8497b6a9_Tx_41ed8afc: ComMPncComSignalDirection=TX, ComMPncComSignalKind=EIRA, ComMPncComSignalChannelRef=ComMConfigSet/ECU4_CRN_Eth_Cluster4_3g6xoesclytkmkqofl9pi6ol1_481bdd0f, ComMPncComSignalRef=NM_C04_PNC_8497b6a9_Tx
      14 x ComMUser:
        ECU4_CRN_CAN1_Cluster4_6it1ke922hxi7y4c8scsqzzry_328bd450: ComMUserIdentifier=0
        ECU4_CRN_CANFD1_Cluster4_bx4qzxpu7xp7napnh6bsrtlzq_7f986d5b: ComMUserIdentifier=1
        ECU4_CRN_Eth_Cluster4_3g6xoesclytkmkqofl9pi6ol1_4d91a935: ComMUserIdentifier=4
        ECU4_CRN_Eth_Cluster4_3l8iyw65auc022so95pkbhyzp_e833255e: ComMUserIdentifier=6
        ECU4_CRN_Eth_Cluster4_7f3fu4rgtopbi2t35la2b13rd_e81c7c77: ComMUserIdentifier=3
        ECU4_CRN_Eth_Cluster4_a4tivcve7b3dlvxw1emxbqzmz_930f76cc: ComMUserIdentifier=5
        ECU4_CRN_LIN5_Cluster4_b21l9awrmlmhxxw03j6k8wiqt_956d640e: ComMUserIdentifier=2
        PNC_00_MAPPING_60241c9f: ComMUserIdentifier=7
        PNC_09_MAPPING_b373002b: ComMUserIdentifier=8
        PNC_18_MAPPING_4da1ea4a: ComMUserIdentifier=9
        PNC_27_MAPPING_1275ace7: ComMUserIdentifier=10
        PNC_36_MAPPING_5c7e3504: ComMUserIdentifier=11
        PNC_45_MAPPING_61eb4d1e: ComMUserIdentifier=12
        PNC_54_MAPPING_9f39a77f: ComMUserIdentifier=13
    ComMGeneral: ComMPncGatewayEnabled=true, ComMPncIdCounting=COMM_PNC_ID_COUNT_FROM_NM_MESSAGE, ComMPncPrepareSleepTimer=1.3, ComMPncSupport=true
  module config Dcm
    DcmConfigSet
      DcmDsl
        DcmDslProtocol
          DcmDslProtocolRow_29812fbf (DcmDslProtocolRow)
            3 x DcmDslConnection:
              DIAG_ECU4_CTP_03_ExtCAN_RQ_FD1_ST3_DIAG_ECU4_CTP_03_ExtCAN_RS_FD1_ST3_cc44614d
                DcmDslMainConnection: DcmDslProtocolRxTesterSourceAddr=3833
                  SDU_DIAG_ECU4_CTP_03_ExtCAN_RQ_FD1_ST3_af4ae167_Rx_77e78b1d (DcmDslProtocolRx):
                    DcmDslProtocolRxAddrType = DCM_PHYSICAL_TYPE
                    DcmDslProtocolRxPduId = 1
                    DcmDslProtocolRxComMChannelRef = ComMConfigSet/ECU4_CRN_CANFD1_Cluster4_bx4qzxpu7xp7napnh6bsrtlzq_d98d74ac
                    DcmDslProtocolRxPduRef = SDU_DIAG_ECU4_CTP_03_ExtCAN_RQ_FD1_ST3_af4ae167_Rx
                  SDU_DIAG_GLOBAL_ExtCAN_RQ_CANFD1_ST3_18b817bc_Rx_b45a246f (DcmDslProtocolRx):
                    DcmDslProtocolRxAddrType = DCM_FUNCTIONAL_TYPE
                    DcmDslProtocolRxPduId = 2
                    DcmDslProtocolRxComMChannelRef = ComMConfigSet/ECU4_CRN_CANFD1_Cluster4_bx4qzxpu7xp7napnh6bsrtlzq_d98d74ac
                    DcmDslProtocolRxPduRef = SDU_DIAG_GLOBAL_ExtCAN_RQ_CANFD1_ST3_18b817bc_Rx
                  SDU_DIAG_ECU4_CTP_03_ExtCAN_RS_FD1_ST3_81bcc9e1_Tx_0b743167 (DcmDslProtocolTx): DcmDslTxConfirmationPduId=0, DcmDslProtocolTxPduRef=EcucPduCollection/SDU_DIAG_ECU4_CTP_03_ExtCAN_RS_FD1_ST3_81bcc9e1_Tx
              DIAG_RQ_ExtEth_MAIN_OFBD_ST3_ECU04_C04_DIAG_RS_ExtEth_MAIN_OFBD_ST3_ECU04_C04_548a1069
                DcmDslMainConnection: DcmDslProtocolRxTesterSourceAddr=3832
                  SDU_DIAG_RQ_ExtEth_MAIN_OFBD_ST3_ECU04_C04_3a711a64_Rx_c08f6a46 (DcmDslProtocolRx):
                    DcmDslProtocolRxAddrType = DCM_PHYSICAL_TYPE
                    DcmDslProtocolRxPduId = 4
                    DcmDslProtocolRxComMChannelRef = ComMConfigSet/ECU4_CRN_Eth_Cluster4_7f3fu4rgtopbi2t35la2b13rd_a7751c70
                    DcmDslProtocolRxPduRef = SDU_DIAG_RQ_ExtEth_MAIN_OFBD_ST3_ECU04_C04_3a711a64_Rx
                  SDU_DIAG_RQ_ExtEth_MAIN_OFBD_ST3_ECU04_GLOBAL_d92b43b1_Rx_76ae0932 (DcmDslProtocolRx):
                    DcmDslProtocolRxAddrType = DCM_FUNCTIONAL_TYPE
                    DcmDslProtocolRxPduId = 5
                    DcmDslProtocolRxComMChannelRef = ComMConfigSet/ECU4_CRN_Eth_Cluster4_7f3fu4rgtopbi2t35la2b13rd_a7751c70
                    DcmDslProtocolRxPduRef = SDU_DIAG_RQ_ExtEth_MAIN_OFBD_ST3_ECU04_GLOBAL_d92b43b1_Rx
                  SDU_DIAG_RS_ExtEth_MAIN_OFBD_ST3_ECU04_C04_02b41771_Tx_a908de7b (DcmDslProtocolTx): DcmDslTxConfirmationPduId=3, DcmDslProtocolTxPduRef=EcucPduCollection/SDU_DIAG_RS_ExtEth_MAIN_OFBD_ST3_ECU04_C04_02b41771_Tx
              DIAG_RQ_IntEth_MAIN_ONBD_ST3_ECU04_C04_DIAG_RS_IntEth_MAIN_ONBD_ST3_ECU04_C04_c09c5d3e
                DcmDslMainConnection: DcmDslProtocolRxTesterSourceAddr=3853
                  SDU_DIAG_RQ_IntEth_MAIN_ONBD_ST3_ECU04_C04_7c45d2e1_Rx_73dfbbd5 (DcmDslProtocolRx):
                    DcmDslProtocolRxAddrType = DCM_PHYSICAL_TYPE
                    DcmDslProtocolRxPduId = 7
                    DcmDslProtocolRxComMChannelRef = ComMConfigSet/ECU4_CRN_Eth_Cluster4_a4tivcve7b3dlvxw1emxbqzmz_cc30adf6
                    DcmDslProtocolRxPduRef = SDU_DIAG_RQ_IntEth_MAIN_ONBD_ST3_ECU04_C04_7c45d2e1_Rx
                  SDU_DIAG_RQ_IntEth_MAIN_ONBD_ST3_ECU04_GLOBAL_1c42336f_Rx_867a57a8 (DcmDslProtocolRx):
                    DcmDslProtocolRxAddrType = DCM_FUNCTIONAL_TYPE
                    DcmDslProtocolRxPduId = 8
                    DcmDslProtocolRxComMChannelRef = ComMConfigSet/ECU4_CRN_Eth_Cluster4_a4tivcve7b3dlvxw1emxbqzmz_cc30adf6
                    DcmDslProtocolRxPduRef = SDU_DIAG_RQ_IntEth_MAIN_ONBD_ST3_ECU04_GLOBAL_1c42336f_Rx
                  SDU_DIAG_RS_IntEth_MAIN_ONBD_ST3_ECU04_C04_4480dff4_Tx_fa4aaad4 (DcmDslProtocolTx): DcmDslTxConfirmationPduId=6, DcmDslProtocolTxPduRef=EcucPduCollection/SDU_DIAG_RS_IntEth_MAIN_ONBD_ST3_ECU04_C04_4480dff4_Tx
  module config DoIP
    DoIPConfigSet
      10 x DoIPChannel:
        DIAG_RQ_ExtEth_MAIN_OFBD_ST3_ECU04_C04_ccc8b862: DoIPChannelSARef=DoIP_EF8_ceacd1e4, DoIPChannelTARef=DoIP_1004_28e738a9
          DoIPPduRRxPdu_4844561d (DoIPPduRRxPdu): DoIPPduRRxPduRef=EcucPduCollection/SDU_DIAG_RQ_ExtEth_MAIN_OFBD_ST3_ECU04_C04_52383531_Rx
          DoIPPduRTxPdu_4844561d (DoIPPduRTxPdu): DoIPPduType=DOIP_TPPDU, DoIPPduRTxPduRef=EcucPduCollection/SDU_DIAG_RS_ExtEth_MAIN_OFBD_ST3_ECU04_C04_89bbb3d7_Tx
        DIAG_RQ_ExtEth_MAIN_OFBD_ST3_ECU04_C10_59c5c01e: DoIPChannelSARef=DoIP_EF8_ceacd1e4, DoIPChannelTARef=DoIP_1010_3691cdf1
          DoIPPduRRxPdu_60bcc5e3 (DoIPPduRRxPdu): DoIPPduRRxPduRef=SDU_DIAG_RQ_ExtEth_MAIN_OFBD_ST3_ECU04_C10_e551aba5_Rx
          DoIPPduRTxPdu_60bcc5e3 (DoIPPduRTxPdu): DoIPPduType=DOIP_TPPDU, DoIPPduRTxPduRef=SDU_DIAG_RS_ExtEth_MAIN_OFBD_ST3_ECU04_C10_3ed22d43_Tx
        DIAG_RQ_ExtEth_MAIN_OFBD_ST3_ECU04_C19_42ca5a05: DoIPChannelSARef=DoIP_EF8_ceacd1e4, DoIPChannelTARef=DoIP_1019_4f4d7555
          DoIPPduRRxPdu_6effa70a (DoIPPduRRxPdu): DoIPPduRRxPduRef=SDU_DIAG_RQ_ExtEth_MAIN_OFBD_ST3_ECU04_C19_9bce685a_Rx
          DoIPPduRTxPdu_6effa70a (DoIPPduRTxPdu): DoIPPduType=DOIP_TPPDU, DoIPPduRTxPduRef=SDU_DIAG_RS_ExtEth_MAIN_OFBD_ST3_ECU04_C19_404deebc_Tx
        DIAG_RQ_ExtEth_MAIN_OFBD_ST3_ECU04_GLOBAL_8bf5fa50: DoIPChannelSARef=DoIP_EF8_ceacd1e4, DoIPChannelTARef=DoIP_EEF8_ee533782
          DoIPPduRRxPdu_a3967b3e (DoIPPduRRxPdu): DoIPPduRRxPduRef=SDU_DIAG_RQ_ExtEth_MAIN_OFBD_ST3_ECU04_GLOBAL_847c8b77_Rx
        DIAG_RQ_ExtEth_MAIN_OFBD_ST3_ECU04_Lin_S5_6aacdb0b: DoIPChannelSARef=DoIP_EF8_ceacd1e4, DoIPChannelTARef=DoIP_2005_4d55a7d1
          DoIPPduRRxPdu_ea55d67c (DoIPPduRRxPdu): DoIPPduRRxPduRef=SDU_DIAG_RQ_ExtEth_MAIN_OFBD_ST3_ECU04_Lin_S5_967470f7_Rx
          DoIPPduRTxPdu_ea55d67c (DoIPPduRTxPdu): DoIPPduType=DOIP_TPPDU, DoIPPduRTxPduRef=SDU_DIAG_RS_ExtEth_MAIN_OFBD_ST3_ECU04_Lin_S5_22733169_Tx
        DIAG_RQ_IntEth_MAIN_ONBD_ST3_ECU04_C04_478ab45d: DoIPChannelSARef=DoIP_F0D_9ad9b5e7, DoIPChannelTARef=DoIP_1004_70f99181
          DoIPPduRRxPdu_b08dcbff (DoIPPduRRxPdu): DoIPPduRRxPduRef=EcucPduCollection/SDU_DIAG_RQ_IntEth_MAIN_ONBD_ST3_ECU04_C04_fee93a6b_Rx
          DoIPPduRTxPdu_b08dcbff (DoIPPduRTxPdu): DoIPPduType=DOIP_TPPDU, DoIPPduRTxPduRef=EcucPduCollection/SDU_DIAG_RS_IntEth_MAIN_ONBD_ST3_ECU04_C04_256abc8d_Tx
        DIAG_RQ_IntEth_MAIN_ONBD_ST3_ECU04_C10_d287cc21: DoIPChannelSARef=DoIP_F0D_9ad9b5e7, DoIPChannelTARef=DoIP_1010_6e8f64d9
          DoIPPduRRxPdu_4daa3ea3 (DoIPPduRRxPdu): DoIPPduRRxPduRef=SDU_DIAG_RQ_IntEth_MAIN_ONBD_ST3_ECU04_C10_4980a4ff_Rx
          DoIPPduRTxPdu_4daa3ea3 (DoIPPduRTxPdu): DoIPPduType=DOIP_TPPDU, DoIPPduRTxPduRef=SDU_DIAG_RS_IntEth_MAIN_ONBD_ST3_ECU04_C10_92032219_Tx
        DIAG_RQ_IntEth_MAIN_ONBD_ST3_ECU04_C19_c988563a: DoIPChannelSARef=DoIP_F0D_9ad9b5e7, DoIPChannelTARef=DoIP_1019_1753dc7d
          DoIPPduRRxPdu_cd4c03cb (DoIPPduRRxPdu): DoIPPduRRxPduRef=SDU_DIAG_RQ_IntEth_MAIN_ONBD_ST3_ECU04_C19_371f6700_Rx
          DoIPPduRTxPdu_cd4c03cb (DoIPPduRTxPdu): DoIPPduType=DOIP_TPPDU, DoIPPduRTxPduRef=SDU_DIAG_RS_IntEth_MAIN_ONBD_ST3_ECU04_C19_ec9ce1e6_Tx
        DIAG_RQ_IntEth_MAIN_ONBD_ST3_ECU04_GLOBAL_2d78282a: DoIPChannelSARef=DoIP_F0D_9ad9b5e7, DoIPChannelTARef=DoIP_EF0D_94ddc394
          DoIPPduRRxPdu_13ca8e33 (DoIPPduRRxPdu): DoIPPduRRxPduRef=SDU_DIAG_RQ_IntEth_MAIN_ONBD_ST3_ECU04_GLOBAL_931bde30_Rx
        DIAG_RQ_IntEth_MAIN_ONBD_ST3_ECU04_Lin_S5_eeb1544f: DoIPChannelSARef=DoIP_F0D_9ad9b5e7, DoIPChannelTARef=DoIP_2005_154b0ef9
          DoIPPduRRxPdu_70546ae4 (DoIPPduRRxPdu): DoIPPduRRxPduRef=SDU_DIAG_RQ_IntEth_MAIN_ONBD_ST3_ECU04_Lin_S5_811325b0_Rx
          DoIPPduRTxPdu_70546ae4 (DoIPPduRTxPdu): DoIPPduType=DOIP_TPPDU, DoIPPduRTxPduRef=SDU_DIAG_RS_IntEth_MAIN_ONBD_ST3_ECU04_Lin_S5_3514642e_Tx
      DoIPConnections
        10 x DoIPTargetAddress:
          DoIP_1004_28e738a9: DoIPTargetAddressValue=4100
          DoIP_1004_70f99181: DoIPTargetAddressValue=4100
          DoIP_1010_3691cdf1: DoIPTargetAddressValue=4112
          DoIP_1010_6e8f64d9: DoIPTargetAddressValue=4112
          DoIP_1019_1753dc7d: DoIPTargetAddressValue=4121
          DoIP_1019_4f4d7555: DoIPTargetAddressValue=4121
          DoIP_2005_154b0ef9: DoIPTargetAddressValue=8197
          DoIP_2005_4d55a7d1: DoIPTargetAddressValue=8197
          DoIP_EEF8_ee533782: DoIPTargetAddressValue=61176
          DoIP_EF0D_94ddc394: DoIPTargetAddressValue=61197
        4 x DoIPTcpConnection:
          SCB_ECU4_CRN_DoIP_TCP_dhcpv4AndFixed_169_254_17_4_13400_30e6cc67
            DoIPSoAdTcpRxPdu_5de61baf (DoIPSoAdTcpRxPdu): DoIPSoAdTcpRxPduRef=DIAG_RQ_Eth_CTP_TCP_90fadfb5_Rx
            DoIPSoAdTcpTxPdu_5de61baf (DoIPSoAdTcpTxPdu): DoIPSoAdTcpTxPduRef=EcucPduCollection/DIAG_RS_Eth_CTP_TCP_27bc1914_Tx
          SCB_ECU4_CRN_DoIP_TCP_dhcpv4AndFixed_169_254_17_4_13400_55056e49
            DoIPSoAdTcpRxPdu_ff8212bc (DoIPSoAdTcpRxPdu): DoIPSoAdTcpRxPduRef=DIAG_RQ_Eth_CTP_TCP_2_00d24b67_Rx
            DoIPSoAdTcpTxPdu_ff8212bc (DoIPSoAdTcpTxPdu): DoIPSoAdTcpTxPduRef=EcucPduCollection/DIAG_RS_Eth_CTP_TCP_2_c5c9160c_Tx
          SCB_ECU4_CRN_DoIP_TCP_fixed_10_2_1_4_13400_27418eb4
            DoIPSoAdTcpRxPdu_8c706353 (DoIPSoAdTcpRxPdu): DoIPSoAdTcpRxPduRef=DIAG_RQ_Eth_CTP_TCP_2_29beb99a_Rx
            DoIPSoAdTcpTxPdu_8c706353 (DoIPSoAdTcpTxPdu): DoIPSoAdTcpTxPduRef=EcucPduCollection/DIAG_RS_Eth_CTP_TCP_2_eca5e4f1_Tx
          SCB_ECU4_CRN_DoIP_TCP_fixed_10_2_1_4_13400_86786c2c
            DoIPSoAdTcpRxPdu_9ba5f672 (DoIPSoAdTcpRxPdu): DoIPSoAdTcpRxPduRef=DIAG_RQ_Eth_CTP_TCP_7b509708_Rx
            DoIPSoAdTcpTxPdu_9ba5f672 (DoIPSoAdTcpTxPdu): DoIPSoAdTcpTxPduRef=EcucPduCollection/DIAG_RS_Eth_CTP_TCP_cc1651a9_Tx
        SCB_ECU4_CRN_UDP_dhcpv4AndFixed_169_254_17_4_13400_a3481a80 (DoIPUdpConnection)
          DoIPSoAdUdpRxPdu_8fca5b47 (DoIPSoAdUdpRxPdu): DoIPSoAdUdpRxPduRef=DIAG_RQ_Eth_CTP_2_247cf24d_Rx
          DoIPSoAdUdpTxPdu_8fca5b47 (DoIPSoAdUdpTxPdu): DoIPSoAdUdpTxPduRef=EcucPduCollection/DIAG_RS_Eth_CTP_2_6aaae912_Tx
        SCB_ECU4_CRN_UDP_fixed_10_2_1_4_13400_5677dce6 (DoIPUdpConnection)
          DoIPSoAdUdpRxPdu_e56f9e77 (DoIPSoAdUdpRxPdu): DoIPSoAdUdpRxPduRef=DIAG_RQ_Eth_CTP_2_8b3a5a2b_Rx
          DoIPSoAdUdpTxPdu_e56f9e77 (DoIPSoAdUdpTxPdu): DoIPSoAdUdpTxPduRef=EcucPduCollection/DIAG_RS_Eth_CTP_2_c5ec4174_Tx
        SCB_ECU4_CRN_UDP_dhcpv4AndFixed_169_254_17_4_13400_d4a3b8e2 (DoIPUdpVehicleAnnouncementConnection)
          DoIPSoAdUdpVehicleAnnouncementTxPdu_SCB_ECU4_CRN_UDP_dhcpv4AndFixed_169_254_17_4_13400_d4a3b8e2 (DoIPSoAdUdpVehicleAnnouncementTxPdu): DoIPSoAdUdpVehicleAnnouncementTxPduRef=EcucPduCollection/DIAG_RS_Eth_CTP_c52c4e87_Tx
        SCB_ECU4_CRN_UDP_fixed_10_2_1_4_13400_51df633c (DoIPUdpVehicleAnnouncementConnection)
          DoIPSoAdUdpVehicleAnnouncementTxPdu: DoIPSoAdUdpVehicleAnnouncementTxPduRef=EcucPduCollection/DIAG_RS_Eth_CTP_1f16b9a6_Tx
      DoIP_EF8_ceacd1e4 (DoIPTester): DoIPTesterSA=3832
      DoIP_F0D_9ad9b5e7 (DoIPTester): DoIPTesterSA=3853
    DoIPGeneral: DoIPNodeType=DOIP_GATEWAY
  module config EcuC
    EcucPduCollection: PduIdTypeEnum=UINT16, PduLengthTypeEnum=UINT16
      275 x Pdu:
        C04_CANFD_1_Container_ST3_C04_CANFD_1_Container_ST3_Ign_Stat_ST3_secured_b70215f6_Tx: DynamicLength=false, PduLength=8
        C04_CANFD_1_Container_ST3_ContainerIPdu_7bdf0645_Tx: DynamicLength=true, PduLength=64, SysTPduToFrameMappingRef=C04_CANFD_1_Container_ST3
        C04_CANFD_1_Container_ST3_ContainerIPdu_ff52b773_Tx: DynamicLength=true, PduLength=64
        C04_CANFD_1_Container_ST3_VSS_TP_Auth_ST3_d0ac74d2_Tx: DynamicLength=false, PduLength=8
        C04_CANFD_1_Container_ST3_VSS_TP_RealTmOffset_ST3_98caae4d_Tx: DynamicLength=false, PduLength=8
        C04_CANFD_1_Container_ST3_VSS_TP_SecTickCount_Lvl2_ST3_2da56e8b_Tx: DynamicLength=false, PduLength=8
        C04_CANFD_1_Container_ST3_VSS_TP_SharedSecret_ST3_9a04fb27_Tx: DynamicLength=false, PduLength=8
        C04_CANFD_1_Container_ST3_VSS_TP_VIN_ST3_0129cb01_Tx: DynamicLength=false, PduLength=8
        CANFD_Eth_ST3_TPA_c67344e4_Tx: DynamicLength=true, PduLength=800
        COM_C01_Pdu01_PN08_4daf151f_Rx: DynamicLength=false, PduLength=8
        COM_C01_Pdu01_PN08_80ad51b4_Rx: DynamicLength=false, PduLength=8
        COM_C01_Pdu01_PN17_9a48397c_Rx: DynamicLength=false, PduLength=8
        COM_C01_Pdu01_PN17_c40b39cf_Rx: DynamicLength=false, PduLength=8
        COM_C01_Pdu01_PN44_20759c30_Rx: DynamicLength=false, PduLength=8
        COM_C01_Pdu01_PN44_994d2473_Rx: DynamicLength=false, PduLength=8
        COM_C01_Pdu01_PN53_790696b5_Rx: DynamicLength=false, PduLength=8
        COM_C01_Pdu01_PN53_a70a38d2_Rx: DynamicLength=false, PduLength=8
        COM_C01_Pdu01_PN62_78059db0_Rx: DynamicLength=false, PduLength=8
        COM_C01_Pdu01_PN62_fb205b87_Rx: DynamicLength=false, PduLength=8
        COM_C04_C08_Pdu02_TpConnection_07a51284_Tx: DynamicLength=true, PduLength=5000
        COM_C04_C08_Pdu02_TpConnection_eda1cb96_Tx: DynamicLength=true, PduLength=5000
        COM_C04_C14_Pdu01_TpConnection_3728892a_Tx: DynamicLength=true, PduLength=4095
        COM_C04_C14_Pdu01_TpConnection_b97b4d4e_Tx: DynamicLength=true, PduLength=4095
        COM_C04_Frm05_COM_C04_Pdu05_afb7aab9_Tx: DynamicLength=false, PduLength=16
        COM_C04_Frm05_COM_C04_Pdu06_36befb03_Tx: DynamicLength=false, PduLength=16
        COM_C04_Frm05_COM_C04_Pdu07_41b9cb95_Tx: DynamicLength=false, PduLength=4
        COM_C04_Frm05_ContainerIPdu_09ce4b60_Tx: DynamicLength=true, PduLength=64, SysTPduToFrameMappingRef=COM_C04_Frm05
        COM_C04_Frm05_ContainerIPdu_a4bbe606_Tx: DynamicLength=true, PduLength=64
        COM_C04_Pdu01_PN08_1a3bebf9_Tx: DynamicLength=false, PduLength=8, SysTPduToFrameMappingRef=COM_C04_Pdu01_PN08
        COM_C04_Pdu01_PN08_35be779f_Tx: DynamicLength=false, PduLength=8
        COM_C04_Pdu01_PN08_d1242e36_Tx: DynamicLength=false, PduLength=8
        COM_C04_Pdu01_PN08_d50c620f_Tx: DynamicLength=false, PduLength=8
        COM_C04_Pdu01_PN08_f12ace0a_Tx: DynamicLength=false, PduLength=8, SysTPduToFrameMappingRef=COM_C04_Pdu01_PN08
        COM_C04_Pdu01_PN08_f4b54190_Tx: DynamicLength=false, PduLength=8
        COM_C04_Pdu01_PN17_5a714530_Tx: DynamicLength=false, PduLength=8, SysTPduToFrameMappingRef=COM_C04_Pdu01_PN17
        COM_C04_Pdu01_PN17_5ca84edf_Tx: DynamicLength=false, PduLength=8
        COM_C04_Pdu01_PN17_7d116d40_Tx: DynamicLength=false, PduLength=8
        COM_C04_Pdu01_PN17_cbc146fe_Tx: DynamicLength=false, PduLength=8
        COM_C04_Pdu01_PN44_097d567e_Tx: DynamicLength=false, PduLength=8, SysTPduToFrameMappingRef=COM_C04_Pdu01_PN44
        COM_C04_Pdu01_PN44_5864feb0_Tx: DynamicLength=false, PduLength=8
        COM_C04_Pdu01_PN44_b8d6eb20_Tx: DynamicLength=false, PduLength=8
        COM_C04_Pdu01_PN44_c8c45bf1_Tx: DynamicLength=false, PduLength=8
        COM_C04_Pdu01_PN53_288fe937_Tx: DynamicLength=false, PduLength=8
        COM_C04_Pdu01_PN53_3fa94fc2_Tx: DynamicLength=false, PduLength=8
        COM_C04_Pdu01_PN62_298ce232_Tx: DynamicLength=false, PduLength=8
        COM_C04_Pdu01_PN62_63832c97_Tx: DynamicLength=false, PduLength=8
        COM_C04_Pdu02_00ce023e_Tx: DynamicLength=false, PduLength=10
        COM_C04_Pdu02_Call_0ed7c659_Rx: DynamicLength=false, PduLength=9
        COM_C04_Pdu02_Call_582d6eb8_Rx: DynamicLength=false, PduLength=9
        COM_C04_Pdu02_e98e7a25_Tx: DynamicLength=false, PduLength=10
        COM_C04_Pdu03_9e894ab3_Tx: DynamicLength=false, PduLength=3013
        COM_C04_Pdu03_secured_044596e0_Tx: DynamicLength=false, PduLength=3017
        COM_C04_Pdu03_secured_e3281955_Tx: DynamicLength=false, PduLength=3017
        COM_C04_Pdu04_2a405515_Tx: DynamicLength=false, PduLength=8, SysTPduToFrameMappingRef=COM_C04_Pdu04
        COM_C04_Pdu04_ced66c03_Tx: DynamicLength=false, PduLength=8
        COM_C04_Pdu10_19e3c40e_Tx: DynamicLength=false, PduLength=10
        COM_C04_Pdu10_1e9b2a48_Tx: DynamicLength=false, PduLength=10
        COM_C04_Pdu11_699c1ade_Tx: DynamicLength=false, PduLength=15
        COM_C04_Pdu11_9dd2ddff_Tx: DynamicLength=false, PduLength=15
        COM_C04_Pdu12_caf0f1ad_Tx: DynamicLength=false, PduLength=15
        COM_C04_Pdu12_f0954b64_Tx: DynamicLength=false, PduLength=15
        COM_C04_Pdu13_4ec1e85c_Tx: DynamicLength=false, PduLength=15
        COM_C04_Pdu13_87927bf2_Tx: DynamicLength=false, PduLength=15
        COM_C04_Pdu14_19f6ee51_Tx: DynamicLength=false, PduLength=15
        COM_C04_Pdu14_64b4a909_Tx: DynamicLength=false, PduLength=15
        COM_C04_Pdu15_6ef1dec7_Tx: DynamicLength=false, PduLength=15
        COM_C04_Pdu15_e085b0f8_Tx: DynamicLength=false, PduLength=15
        COM_C04_Pdu16_b7a79caa_Tx: DynamicLength=false, PduLength=15
        COM_C04_Pdu16_f7f88f7d_Tx: DynamicLength=false, PduLength=15
        COM_C04_Pdu17_3396855b_Tx: DynamicLength=false, PduLength=15
        COM_C04_Pdu17_80ffbfeb_Tx: DynamicLength=false, PduLength=15
        COM_C04_Pdu18_1040a27a_Tx: DynamicLength=false, PduLength=15
        COM_C04_Pdu18_e34d1e00_Tx: DynamicLength=false, PduLength=15
        COM_C04_Pdu19_674792ec_Tx: DynamicLength=false, PduLength=15
        COM_C04_Pdu19_677c07f1_Tx: DynamicLength=false, PduLength=15
        COM_C04_Pdu20_35b6798b_Tx: DynamicLength=false, PduLength=15
        COM_C04_Pdu20_secured_393d7a18_Tx: DynamicLength=false, PduLength=19
        COM_C04_Pdu20_secured_eef90202_Tx: DynamicLength=false, PduLength=19
        COM_C04_Pdu21_42b1491d_Tx: DynamicLength=false, PduLength=9
        COM_C04_Pdu21_secured_2e466e5b_Tx: DynamicLength=false, PduLength=13
        COM_C04_Pdu21_secured_a43e0d91_Tx: DynamicLength=false, PduLength=13
        COM_C07_Pdu01_PN08_5773f977_Rx: DynamicLength=false, PduLength=8
        COM_C07_Pdu01_PN08_a292b0ff_Rx: DynamicLength=false, PduLength=8
        COM_C07_Pdu01_PN44_4e938cb0_Rx: DynamicLength=false, PduLength=8
        COM_C07_Pdu01_PN44_cf4839d0_Rx: DynamicLength=false, PduLength=8
        COM_C07_Pdu01_PN53_48379d32_Rx: DynamicLength=false, PduLength=8
        COM_C07_Pdu01_PN53_aed83e76_Rx: DynamicLength=false, PduLength=8
        COM_C08_C04_Pdu02_TpConnection_6f988d8e_Rx: DynamicLength=true, PduLength=5000
        COM_C08_C04_Pdu02_TpConnection_abbd4f8f_Rx: DynamicLength=true, PduLength=5000
        COM_C0X_Pdu10_528d0cd9_Rx: DynamicLength=false, PduLength=10
        COM_C0X_Pdu10_8fdf8f4c_Rx: DynamicLength=false, PduLength=10
        COM_C0X_Pdu11_0bee96bd_Rx: DynamicLength=false, PduLength=15
        COM_C0X_Pdu11_258a3c4f_Rx: DynamicLength=false, PduLength=15
        COM_C0X_Pdu12_5cccbaef_Rx: DynamicLength=false, PduLength=15
        COM_C0X_Pdu12_bc836df5_Rx: DynamicLength=false, PduLength=15
        COM_C0X_Pdu13_cb845d63_Rx: DynamicLength=false, PduLength=15
        COM_C0X_Pdu13_d8fda31e_Rx: DynamicLength=false, PduLength=15
        COM_C0X_Pdu14_55e0c8c0_Rx: DynamicLength=false, PduLength=15
        COM_C0X_Pdu14_f288e24b_Rx: DynamicLength=false, PduLength=15
        COM_C0X_Pdu15_22e7f856_Rx: DynamicLength=false, PduLength=15
        COM_C0X_Pdu15_76b9fbba_Rx: DynamicLength=false, PduLength=15
        COM_C0X_Pdu16_219bd7e8_Rx: DynamicLength=false, PduLength=15
        COM_C0X_Pdu16_bbeea9ec_Rx: DynamicLength=false, PduLength=15
        COM_C0X_Pdu17_a5aace19_Rx: DynamicLength=false, PduLength=15
        COM_C0X_Pdu17_cce9997a_Rx: DynamicLength=false, PduLength=15
        COM_C0X_Pdu18_5c5684eb_Rx: DynamicLength=false, PduLength=15
        COM_C0X_Pdu18_75715542_Rx: DynamicLength=false, PduLength=15
        COM_C0X_Pdu19_2b51b47d_Rx: DynamicLength=false, PduLength=15
        COM_C0X_Pdu19_f1404cb3_Rx: DynamicLength=false, PduLength=15
        COM_C0X_Pdu20_79a05f1a_Rx: DynamicLength=false, PduLength=15
        COM_C0X_Pdu20_secured_3ef6961f_Rx: DynamicLength=false, PduLength=19
        COM_C0X_Pdu20_secured_eeb3f377_Rx: DynamicLength=false, PduLength=19
        COM_C0X_Pdu21_0ea76f8c_Rx: DynamicLength=false, PduLength=9
        COM_C0X_Pdu21_secured_298d825c_Rx: DynamicLength=false, PduLength=13
        COM_C0X_Pdu21_secured_a474fce4_Rx: DynamicLength=false, PduLength=13
        COM_C10_Pdu01_PN08_0cb26b5d_Rx: DynamicLength=false, PduLength=8, SysTPduToFrameMappingRef=COM_C10_Pdu01_PN08
        COM_C10_Pdu01_PN08_2a25a36a_Rx: DynamicLength=false, PduLength=8
        COM_C10_Pdu01_PN17_4cf8c594_Rx: DynamicLength=false, PduLength=8, SysTPduToFrameMappingRef=COM_C10_Pdu01_PN17
        COM_C10_Pdu01_PN17_a3818fba_Rx: DynamicLength=false, PduLength=8
        COM_C14_C04_Pdu01_TpConnection_0752947e_Rx: DynamicLength=true, PduLength=4095
        COM_C14_C04_Pdu01_TpConnection_0d799aba_Rx: DynamicLength=true, PduLength=4095
        COM_C19_Frm02_COM_C19_Pdu02_5201838a_Rx: DynamicLength=false, PduLength=16
        COM_C19_Frm02_COM_C19_Pdu03_2506b31c_Rx: DynamicLength=false, PduLength=4
        COM_C19_Frm02_COM_C19_Pdu04_bb6226bf_Rx: DynamicLength=false, PduLength=16
        COM_C19_Frm02_ContainerIPdu_6a143bc8_Rx: DynamicLength=true, PduLength=64
        COM_C19_Frm02_ContainerIPdu_dfac1312_Rx: DynamicLength=true, PduLength=64, SysTPduToFrameMappingRef=COM_C19_Frm02
        COM_C19_Pdu01_PN08_7687aff4_Rx: DynamicLength=false, PduLength=8
        COM_C19_Pdu01_PN08_f0eb1e95_Rx: DynamicLength=false, PduLength=8, SysTPduToFrameMappingRef=COM_C19_Pdu01_PN08
        COM_C19_Pdu01_PN44_08bc86e1_Rx: DynamicLength=false, PduLength=8, SysTPduToFrameMappingRef=COM_C19_Pdu01_PN44
        COM_C19_Pdu01_PN44_1b5d26db_Rx: DynamicLength=false, PduLength=8
        COM_SL05_Pdu01_4f2ce2ed_Rx: DynamicLength=false, PduLength=1, SysTPduToFrameMappingRef=COM_SL05_Pdu01
        COM_SL05_Pdu01_dfc1d25f_Rx: DynamicLength=false, PduLength=1
        DIAG_C01_ONBD_Container_ST3_DIAG_Stat_ST3_1a17e5f9_Rx: DynamicLength=false, PduLength=4
        DIAG_C01_ONBD_Container_ST3_DIAG_Stat_ST3_bc0bc640_Rx: DynamicLength=false, PduLength=4
        DIAG_C10_ExtEth_RQ_CAN1_CTP_3bb44803_Tx: DynamicLength=false, PduLength=8, SysTPduToFrameMappingRef=DIAG_C10_ExtEth_RQ_CAN1_CTP
        DIAG_C10_ExtEth_RS_CAN1_CTP_c02ed27d_Rx: DynamicLength=false, PduLength=8, SysTPduToFrameMappingRef=DIAG_C10_ExtEth_RS_CAN1_CTP
        DIAG_C10_IntEth_RQ_CAN1_CTP_a74d823c_Tx: DynamicLength=false, PduLength=8, SysTPduToFrameMappingRef=DIAG_C10_IntEth_RQ_CAN1_CTP
        DIAG_C10_IntEth_RS_CAN1_CTP_5cd71842_Rx: DynamicLength=false, PduLength=8, SysTPduToFrameMappingRef=DIAG_C10_IntEth_RS_CAN1_CTP
        DIAG_C19_ExtEth_RQ_CANFD1_CTP_888f9b77_Tx: DynamicLength=false, PduLength=64, SysTPduToFrameMappingRef=DIAG_C19_ExtEth_RQ_CANFD1_CTP
        DIAG_C19_ExtEth_RS_CANFD1_CTP_497d5586_Rx: DynamicLength=false, PduLength=64, SysTPduToFrameMappingRef=DIAG_C19_ExtEth_RS_CANFD1_CTP
        DIAG_C19_IntEth_RQ_CANFD1_CTP_d161c6cc_Tx: DynamicLength=false, PduLength=64, SysTPduToFrameMappingRef=DIAG_C19_IntEth_RQ_CANFD1_CTP
        DIAG_C19_IntEth_RS_CANFD1_CTP_1093083d_Rx: DynamicLength=false, PduLength=64, SysTPduToFrameMappingRef=DIAG_C19_IntEth_RS_CANFD1_CTP
        DIAG_ECU4_CTP_03_ExtCAN_RQ_FD_ST3_ce3f6aac_Rx: DynamicLength=false, PduLength=64, SysTPduToFrameMappingRef=DIAG_ECU4_CTP_03_ExtCAN_RQ_FD_ST3
        DIAG_ECU4_CTP_03_ExtCAN_RS_FD_ST3_6f59bf14_Tx: DynamicLength=false, PduLength=64, SysTPduToFrameMappingRef=DIAG_ECU4_CTP_03_ExtCAN_RS_FD_ST3
        DIAG_NAD_5_RQ_LIN5_Cluster4_ST3_53b8f7da_Tx: DynamicLength=true, PduLength=4095
        DIAG_NAD_5_RS_LIN5_Cluster4_ST3_e174870c_Rx: DynamicLength=true, PduLength=4095
        DIAG_ROE_C04_Container_ST3_ROE_C04_PDU01_7787ca3b_Tx: DynamicLength=false, PduLength=8
        DIAG_ROE_C04_Container_ST3_ROE_C04_PDU01_f322ff21_Tx: DynamicLength=false, PduLength=8
        DIAG_RQ_Eth_CTP_2_247cf24d_Rx: DynamicLength=true, PduLength=1472
        DIAG_RQ_Eth_CTP_2_8b3a5a2b_Rx: DynamicLength=true, PduLength=1472
        DIAG_RQ_Eth_CTP_TCP_2_00d24b67_Rx: DynamicLength=true, PduLength=1512
        DIAG_RQ_Eth_CTP_TCP_2_29beb99a_Rx: DynamicLength=true, PduLength=1512
        DIAG_RQ_Eth_CTP_TCP_7b509708_Rx: DynamicLength=true, PduLength=1512
        DIAG_RQ_Eth_CTP_TCP_90fadfb5_Rx: DynamicLength=true, PduLength=1512
        DIAG_RQ_GLOBAL_ExtCAN_FD_ST3_078ee7f5_Rx: DynamicLength=false, PduLength=64, SysTPduToFrameMappingRef=DIAG_RQ_GLOBAL_ExtCAN_FD_ST3
        DIAG_RQ_GLOBAL_ExtEth_FD_ST3_3abb8ac0_Tx: DynamicLength=false, PduLength=64, SysTPduToFrameMappingRef=DIAG_RQ_GLOBAL_ExtEth_FD_ST3
        DIAG_RQ_GLOBAL_ExtEth_ST3_45b46da7_Tx: DynamicLength=false, PduLength=8, SysTPduToFrameMappingRef=DIAG_RQ_GLOBAL_ExtEth_ST3
        DIAG_RQ_GLOBAL_IntEth_FD_ST3_ca771c04_Tx: DynamicLength=false, PduLength=64, SysTPduToFrameMappingRef=DIAG_RQ_GLOBAL_IntEth_FD_ST3
        DIAG_RQ_GLOBAL_IntEth_ST3_f921c7ba_Tx: DynamicLength=false, PduLength=8, SysTPduToFrameMappingRef=DIAG_RQ_GLOBAL_IntEth_ST3
        DIAG_RS_Eth_CTP_1f16b9a6_Tx: DynamicLength=true, PduLength=1472
        DIAG_RS_Eth_CTP_2_6aaae912_Tx: DynamicLength=true, PduLength=1472
        DIAG_RS_Eth_CTP_2_c5ec4174_Tx: DynamicLength=true, PduLength=1472
        DIAG_RS_Eth_CTP_TCP_27bc1914_Tx: DynamicLength=true, PduLength=1512
        DIAG_RS_Eth_CTP_TCP_2_c5c9160c_Tx: DynamicLength=true, PduLength=1512
        DIAG_RS_Eth_CTP_TCP_2_eca5e4f1_Tx: DynamicLength=true, PduLength=1512
        DIAG_RS_Eth_CTP_TCP_cc1651a9_Tx: DynamicLength=true, PduLength=1512
        DIAG_RS_Eth_CTP_c52c4e87_Tx: DynamicLength=true, PduLength=1472
        DI_OdoSpeedometer_ST3_ffe5aaae_Rx: DynamicLength=false, PduLength=8
        DI_OdoSpeedometer_ST3_secured_3b3f85d1_Rx: DynamicLength=false, PduLength=12
        DI_OdoSpeedometer_ST3_secured_79fb4c12_Rx: DynamicLength=false, PduLength=12
        ECU4_CRN_CAN1_Cluster4NMNODE_0f1af05c_Rx: PduLength=8, SysTPduToFrameMappingRef=NM_C10
        ECU4_CRN_CANFD1_Cluster4NMNODE_9a3f72ab_Rx: PduLength=8, SysTPduToFrameMappingRef=NM_Dummy_ST3
        ECU_Stat_C04_CAN1_2bd34198_Tx: DynamicLength=false, PduLength=8
        ECU_Stat_C04_CAN1_d3b8616c_Tx: DynamicLength=false, PduLength=8, SysTPduToFrameMappingRef=ECU_Stat_C04_CAN1
        ECU_Stat_C04_CANFD1_ca9d12b7_Tx: DynamicLength=false, PduLength=8, SysTPduToFrameMappingRef=ECU_Stat_C04_CANFD1
        ECU_Stat_C04_CANFD1_fd91aa71_Tx: DynamicLength=false, PduLength=8
        ECU_Stat_C04_ETH_Container_ECU_Stat_C04_ETH_411314f1_Tx: DynamicLength=false, PduLength=8
        ECU_Stat_C04_ETH_Container_ECU_Stat_C04_ETH_47aafe39_Tx: DynamicLength=false, PduLength=8
        Eth_CANFD_ST3_TPA_5c803507_Rx: DynamicLength=true, PduLength=55
        FBL_Cfg_Star3_ST3_b7257cce_Rx: DynamicLength=false, PduLength=1
        FBL_Cfg_Star3_ST3_bdf2a476_Rx: DynamicLength=false, PduLength=1, SysTPduToFrameMappingRef=FBL_Cfg_Star3_ST3
        GTS_Main_CAN_CTP_57e9dba0_Tx: DynamicLength=true, PduLength=8, SysTPduToFrameMappingRef=GTS_Main_CAN_CTP
        GTS_Main_CAN_CTP_e86d90c4_Tx: DynamicLength=true, PduLength=8, SysTPduToFrameMappingRef=GTS_Main_CAN_CTP
        Ign_Stat_ST3_dacb1e38_Rx: DynamicLength=false, PduLength=4
        Ign_Stat_ST3_secured_326d9726_Rx: DynamicLength=false, PduLength=8
        Ign_Stat_ST3_secured_562d2a8e_Rx: DynamicLength=false, PduLength=8
        Ign_Stat_ST3_secured_e8d6e35b_Tx: DynamicLength=false, PduLength=8, SysTPduToFrameMappingRef=Ign_Stat_ST3
        MasterReq_bc6814bb_Tx: DynamicLength=false, PduLength=8, SysTPduToFrameMappingRef=MasterReq
        NM_C04_04d2ea88_Tx: PduLength=7
        NM_C04_0b5d1bc3_Tx: PduLength=7
        NM_C04_0c2fc3f3_Tx: DynamicLength=false, PduLength=8
        NM_C04_4fc72dfa_Tx: DynamicLength=false, PduLength=8, SysTPduToFrameMappingRef=NM_C04
        NM_C04_80f31308_Tx: DynamicLength=false, PduLength=8, SysTPduToFrameMappingRef=NM_C04
        NM_C04_d7c6e387_Tx: PduLength=7
        NM_Dummy_ST3_eb0914da_Rx: DynamicLength=false, PduLength=8  # NM_Dummy__ST3
        PN14_Master_Stat1_ST3_7ba93c2a_Rx: DynamicLength=false, PduLength=8
        PN14_Master_Stat1_ST3_secured_5caa91b2_Rx: DynamicLength=false, PduLength=12
        PN14_Master_Stat1_ST3_secured_dc8c4316_Rx: DynamicLength=false, PduLength=12
        PT4_PTCoor4_ST3_0379360e_Rx: DynamicLength=false, PduLength=4
        PT4_PTCoor4_ST3_secured_201e7857_Rx: DynamicLength=false, PduLength=8
        PT4_PTCoor4_ST3_secured_5e7a1571_Rx: DynamicLength=false, PduLength=8
        PduPnc_EIRA_CAN_Rx: PduLength=7
        PduPnc_EIRA_ETH_Rx: PduLength=7
        PduPnc_ERA_CAN_CAN1_Cluster4_53b2b17a_Rx: PduLength=7
        PduPnc_ERA_CAN_CANFD1_Cluster4_0f365fd3_Rx: PduLength=7
        PduPnc_ERA_ETH_ECU4_CRN_Eth_Cluster4_3g6xoesclytkmkqofl9pi6ol1_481bdd0f_Rx: PduLength=7
        SDU_DIAG_C10_ExtEth_RQ_CAN1_CTP_4b29347a_Tx: DynamicLength=true, PduLength=4095
        SDU_DIAG_C10_ExtEth_RS_CAN1_CTP_b0b3ae04_Rx: DynamicLength=true, PduLength=4095
        SDU_DIAG_C10_IntEth_RQ_CAN1_CTP_d7d0fe45_Tx: DynamicLength=true, PduLength=4095
        SDU_DIAG_C10_IntEth_RS_CAN1_CTP_2c4a643b_Rx: DynamicLength=true, PduLength=4095
        SDU_DIAG_C19_ExtEth_RQ_CANFD1_CTP_83b6231d_Tx: DynamicLength=true, PduLength=4095
        SDU_DIAG_C19_ExtEth_RS_CANFD1_CTP_4244edec_Rx: DynamicLength=true, PduLength=4095
        SDU_DIAG_C19_IntEth_RQ_CANFD1_CTP_da587ea6_Tx: DynamicLength=true, PduLength=4095
        SDU_DIAG_C19_IntEth_RS_CANFD1_CTP_1baab057_Rx: DynamicLength=true, PduLength=4095
        SDU_DIAG_ECU4_CTP_03_ExtCAN_RQ_FD1_ST3_8b6dc0cd_Rx: DynamicLength=true, PduLength=4095
        SDU_DIAG_ECU4_CTP_03_ExtCAN_RQ_FD1_ST3_af4ae167_Rx: DynamicLength=true, PduLength=4095
        SDU_DIAG_ECU4_CTP_03_ExtCAN_RS_FD1_ST3_4e769da6_Tx: DynamicLength=true, PduLength=4095
        SDU_DIAG_ECU4_CTP_03_ExtCAN_RS_FD1_ST3_81bcc9e1_Tx: DynamicLength=true, PduLength=4095
        SDU_DIAG_GLOBAL_ExtCAN_RQ_CANFD1_ST3_18b817bc_Rx: DynamicLength=true, PduLength=7
        SDU_DIAG_GLOBAL_ExtCAN_RQ_CANFD1_ST3_35fdc983_Rx: DynamicLength=true, PduLength=7
        SDU_DIAG_GLOBAL_ExtEth_RQ_CAN1_ST3_35cde3a1_Tx: DynamicLength=true, PduLength=7
        SDU_DIAG_GLOBAL_ExtEth_RQ_CANFD1_ST3_104c4878_Tx: DynamicLength=true, PduLength=7
        SDU_DIAG_GLOBAL_IntEth_RQ_CAN1_ST3_a934299e_Tx: DynamicLength=true, PduLength=7
        SDU_DIAG_GLOBAL_IntEth_RQ_CANFD1_ST3_49a215c3_Tx: DynamicLength=true, PduLength=7
        SDU_DIAG_RQ_ExtEth_MAIN_OFBD_ST3_ECU04_C04_3a711a64_Rx: DynamicLength=true, PduLength=1500
        SDU_DIAG_RQ_ExtEth_MAIN_OFBD_ST3_ECU04_C04_52383531_Rx: DynamicLength=true, PduLength=1500
        SDU_DIAG_RQ_ExtEth_MAIN_OFBD_ST3_ECU04_C10_e551aba5_Rx: DynamicLength=true, PduLength=1500
        SDU_DIAG_RQ_ExtEth_MAIN_OFBD_ST3_ECU04_C19_9bce685a_Rx: DynamicLength=true, PduLength=1500
        SDU_DIAG_RQ_ExtEth_MAIN_OFBD_ST3_ECU04_GLOBAL_847c8b77_Rx: DynamicLength=true, PduLength=1500
        SDU_DIAG_RQ_ExtEth_MAIN_OFBD_ST3_ECU04_GLOBAL_d92b43b1_Rx: DynamicLength=true, PduLength=1500
        SDU_DIAG_RQ_ExtEth_MAIN_OFBD_ST3_ECU04_Lin_S5_967470f7_Rx: DynamicLength=true, PduLength=1500
        SDU_DIAG_RQ_IntEth_MAIN_ONBD_ST3_ECU04_C04_7c45d2e1_Rx: DynamicLength=true, PduLength=1500
        SDU_DIAG_RQ_IntEth_MAIN_ONBD_ST3_ECU04_C04_fee93a6b_Rx: DynamicLength=true, PduLength=1500
        SDU_DIAG_RQ_IntEth_MAIN_ONBD_ST3_ECU04_C10_4980a4ff_Rx: DynamicLength=true, PduLength=1500
        SDU_DIAG_RQ_IntEth_MAIN_ONBD_ST3_ECU04_C19_371f6700_Rx: DynamicLength=true, PduLength=1500
        SDU_DIAG_RQ_IntEth_MAIN_ONBD_ST3_ECU04_GLOBAL_1c42336f_Rx: DynamicLength=true, PduLength=1500
        SDU_DIAG_RQ_IntEth_MAIN_ONBD_ST3_ECU04_GLOBAL_931bde30_Rx: DynamicLength=true, PduLength=1500
        SDU_DIAG_RQ_IntEth_MAIN_ONBD_ST3_ECU04_Lin_S5_811325b0_Rx: DynamicLength=true, PduLength=1500
        SDU_DIAG_RS_ExtEth_MAIN_OFBD_ST3_ECU04_C04_02b41771_Tx: DynamicLength=true, PduLength=1500
        SDU_DIAG_RS_ExtEth_MAIN_OFBD_ST3_ECU04_C04_89bbb3d7_Tx: DynamicLength=true, PduLength=1500
        SDU_DIAG_RS_ExtEth_MAIN_OFBD_ST3_ECU04_C10_3ed22d43_Tx: DynamicLength=true, PduLength=1500
        SDU_DIAG_RS_ExtEth_MAIN_OFBD_ST3_ECU04_C19_404deebc_Tx: DynamicLength=true, PduLength=1500
        SDU_DIAG_RS_ExtEth_MAIN_OFBD_ST3_ECU04_Lin_S5_22733169_Tx: DynamicLength=true, PduLength=1500
        SDU_DIAG_RS_IntEth_MAIN_ONBD_ST3_ECU04_C04_256abc8d_Tx: DynamicLength=true, PduLength=1500
        SDU_DIAG_RS_IntEth_MAIN_ONBD_ST3_ECU04_C04_4480dff4_Tx: DynamicLength=true, PduLength=1500
        SDU_DIAG_RS_IntEth_MAIN_ONBD_ST3_ECU04_C10_92032219_Tx: DynamicLength=true, PduLength=1500
        SDU_DIAG_RS_IntEth_MAIN_ONBD_ST3_ECU04_C19_ec9ce1e6_Tx: DynamicLength=true, PduLength=1500
        SDU_DIAG_RS_IntEth_MAIN_ONBD_ST3_ECU04_Lin_S5_3514642e_Tx: DynamicLength=true, PduLength=1500
        SDU_TPA_CANFD_Eth_ST3_e66fe46e_Rx: DynamicLength=true, PduLength=800
        SDU_TPA_Eth_CANFD_ST3_b43e9f18_Tx: DynamicLength=true, PduLength=55
        SD_Ctrl_Rx_7ba60884_Rx: DynamicLength=true, PduLength=1472
        SD_Ctrl_Rx_Multicast_963ccc44_Rx: DynamicLength=true, PduLength=1472
        SD_Ctrl_Tx_aab32b2d_Tx: DynamicLength=true, PduLength=1472
        SlaveResp_29fc2280_Rx: DynamicLength=false, PduLength=8, SysTPduToFrameMappingRef=SlaveResp
        TPA_CANFD_Eth_ST3_0c07352b_Rx: DynamicLength=false, PduLength=64, SysTPduToFrameMappingRef=TPA_CANFD_Eth_ST3
        TPA_Eth_CANFD_ST3_5e564e5d_Tx: DynamicLength=false, PduLength=64, SysTPduToFrameMappingRef=TPA_Eth_CANFD_ST3
        VSS_TP_Auth_ST3_021b649a_Rx: DynamicLength=false, PduLength=8
        VSS_TP_Auth_ST3_72bf77fe_Tx: DynamicLength=false, PduLength=8, SysTPduToFrameMappingRef=VSS_TP_Auth_ST3
        VSS_TP_Auth_ST3_c0e08494_Rx: DynamicLength=false, PduLength=8
        VSS_TP_RealTmOffset_ST3_0b3c026b_Rx: DynamicLength=false, PduLength=8
        VSS_TP_RealTmOffset_ST3_cbb996f7_Rx: DynamicLength=false, PduLength=8
        VSS_TP_RealTmOffset_ST3_e30a3a18_Tx: DynamicLength=false, PduLength=8, SysTPduToFrameMappingRef=VSS_TP_RealTmOffset_ST3
        VSS_TP_SecTickCount_Lvl1_ST3_9c1812ac_Rx: DynamicLength=false, PduLength=8
        VSS_TP_SecTickCount_Lvl1_ST3_c81cbef9_Rx: DynamicLength=false, PduLength=8
        VSS_TP_SecTickCount_Lvl2_ST3_97652edb_Tx: DynamicLength=false, PduLength=8, SysTPduToFrameMappingRef=VSS_TP_SecTickCount_Lvl2_ST3
        VSS_TP_SecTickCount_Lvl2_ST3_a413568f_Tx: DynamicLength=false, PduLength=8
        VSS_TP_SharedSecret_ST3_06868470_Tx: DynamicLength=false, PduLength=8, SysTPduToFrameMappingRef=VSS_TP_SharedSecret_ST3
        VSS_TP_SharedSecret_ST3_09f25701_Rx: DynamicLength=false, PduLength=8
        VSS_TP_SharedSecret_ST3_78e14c8b_Rx: DynamicLength=false, PduLength=8
        VSS_TP_VIN_ST3_938749e1_Tx: DynamicLength=false, PduLength=8, SysTPduToFrameMappingRef=VSS_TP_VIN_ST3
        VSS_TP_VIN_ST3_97a3d79b_Rx: DynamicLength=false, PduLength=8
        VSS_TP_VIN_ST3_dc926874_Rx: DynamicLength=false, PduLength=8
        VehSpd_8_ST3_a4557cc9_Rx: DynamicLength=false, PduLength=4
        VehSpd_8_ST3_secured_7c0bf7a3_Rx: DynamicLength=false, PduLength=8
        VehSpd_8_ST3_secured_f1100af2_Rx: DynamicLength=false, PduLength=8
  module config EcuM
    EcuMConfiguration
      EcuMCommonConfiguration
        EcuMDriverInitListOne
        EcuMDriverRestartList
        3 x EcuMWakeupSource:
          ECU4_CRN_CAN1_Cluster4_6it1ke922hxi7y4c8scsqzzry_25bd0b69: EcuMWakeupSourceId=5, EcuMComMChannelRef=ComMConfigSet/ECU4_CRN_CAN1_Cluster4_6it1ke922hxi7y4c8scsqzzry_25bd0b69
          ECU4_CRN_CANFD1_Cluster4_bx4qzxpu7xp7napnh6bsrtlzq_d98d74ac: EcuMWakeupSourceId=6, EcuMComMChannelRef=ComMConfigSet/ECU4_CRN_CANFD1_Cluster4_bx4qzxpu7xp7napnh6bsrtlzq_d98d74ac
          ECU4_CRN_LIN5_Cluster4_b21l9awrmlmhxxw03j6k8wiqt_0edbd2ed: EcuMWakeupSourceId=7, EcuMComMChannelRef=ComMConfigSet/ECU4_CRN_LIN5_Cluster4_b21l9awrmlmhxxw03j6k8wiqt_0edbd2ed
      EcuMFlexConfiguration: EcuMFlexModuleConfigurationRef=CanConfigSet, EcuMFlexModuleConfigurationRef=LinGlobalConfig
  module config Eth
    EthConfigSet
      ECU4_CRN_Eth_Cluster4_9be318fb (EthCtrlConfig): EthCtrlIdx=0, EthCtrlPhysAddr=00:11:22:33:44:04, EthCtrlRxBufLenByte=1522, EthCtrlTxBufLenByte=1522
    EthGeneral
