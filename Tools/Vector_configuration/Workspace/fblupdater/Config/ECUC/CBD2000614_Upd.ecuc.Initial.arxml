[part 2 of 2: package /InitialEcuC]
AUTOSAR XML (schema 00046)
package /InitialEcuC  (continued)
  module config EthIf
    EthIfConfigSet
      4 x EthIfController, all with EthIfCtrlMtu=1500, EthIfEnableVLAN=true, EthIfPhysControllerRef=ECU4_CRN_Eth_Cluster4_9be318fb:
        ECU4_CRN_Eth_Cluster4_3g6xoesclytkmkqofl9pi6ol1_481bdd0f: EthIfCtrlIdx=0, EthIfVlanId=127
        ECU4_CRN_Eth_Cluster4_3l8iyw65auc022so95pkbhyzp_3cc7b164: EthIfCtrlIdx=1, EthIfVlanId=20
        ECU4_CRN_Eth_Cluster4_7f3fu4rgtopbi2t35la2b13rd_a7751c70: EthIfCtrlIdx=2, EthIfVlanId=1
        ECU4_CRN_Eth_Cluster4_a4tivcve7b3dlvxw1emxbqzmz_cc30adf6: EthIfCtrlIdx=3, EthIfVlanId=2
      Cluster4_ECU4_CRN_Switch_7c5a75bf (EthIfSwitch): EthIfSwitchIndex=0, EthIfEthSwtRef=EthSwt/Cluster4_ECU4_CRN_Switch_7c5a75bf
    EthIfGeneral
  module config EthSM
    EthSMGeneral
    4 x EthSMNetwork:
      ECU4_CRN_Eth_Cluster4_3g6xoesclytkmkqofl9pi6ol1_481bdd0f: EthSMComMNetworkHandleRef=ComMConfigSet/ECU4_CRN_Eth_Cluster4_3g6xoesclytkmkqofl9pi6ol1_481bdd0f, EthSMEthIfControllerRef=EthIfConfigSet/ECU4_CRN_Eth_Cluster4_3g6xoesclytkmkqofl9pi6ol1_481bdd0f
      ECU4_CRN_Eth_Cluster4_3l8iyw65auc022so95pkbhyzp_3cc7b164: EthSMComMNetworkHandleRef=ComMConfigSet/ECU4_CRN_Eth_Cluster4_3l8iyw65auc022so95pkbhyzp_3cc7b164, EthSMEthIfControllerRef=EthIfConfigSet/ECU4_CRN_Eth_Cluster4_3l8iyw65auc022so95pkbhyzp_3cc7b164
      ECU4_CRN_Eth_Cluster4_7f3fu4rgtopbi2t35la2b13rd_a7751c70: EthSMComMNetworkHandleRef=ComMConfigSet/ECU4_CRN_Eth_Cluster4_7f3fu4rgtopbi2t35la2b13rd_a7751c70, EthSMEthIfControllerRef=EthIfConfigSet/ECU4_CRN_Eth_Cluster4_7f3fu4rgtopbi2t35la2b13rd_a7751c70
      ECU4_CRN_Eth_Cluster4_a4tivcve7b3dlvxw1emxbqzmz_cc30adf6: EthSMComMNetworkHandleRef=ComMConfigSet/ECU4_CRN_Eth_Cluster4_a4tivcve7b3dlvxw1emxbqzmz_cc30adf6, EthSMEthIfControllerRef=EthIfConfigSet/ECU4_CRN_Eth_Cluster4_a4tivcve7b3dlvxw1emxbqzmz_cc30adf6
  module config EthSwt
    Cluster4_ECU4_CRN_Switch_7c5a75bf (EthSwtConfig)
      4 x EthSwtPort, all with EthSwtPortPredefinedMacAddresses=01:00:5E:00:00:01, EthSwtPortPredefinedMacAddresses=01:00:5E:7F:00:01, EthSwtPortPredefinedMacAddresses=01:00:5E:7F:00:02:
        ECU1_CRN_Switch_1b279b09: EthSwtPortPhysicalLayerType=SWITCH_PORT_BROAD_R_REACH
          EthSwtPortEgress: EthSwtPortEgressLastSchedulerRef=STRICT_PRIORITY_SCHEDULAR_464c6f8f
            8 x EthSwtPortFifo:
              FIFO_0_e0f879b0: EthSwtPortFifoTrafficClassAssignment=0
              FIFO_1_97ff4926: EthSwtPortFifoTrafficClassAssignment=1
              FIFO_2_0ef6189c: EthSwtPortFifoTrafficClassAssignment=2
              FIFO_3_79f1280a: EthSwtPortFifoTrafficClassAssignment=3
              FIFO_4_e795bda9: EthSwtPortFifoTrafficClassAssignment=4
              FIFO_5_90928d3f: EthSwtPortFifoTrafficClassAssignment=5
              FIFO_6_099bdc85: EthSwtPortFifoTrafficClassAssignment=6
              FIFO_7_7e9cec13: EthSwtPortFifoTrafficClassAssignment=7
            STRICT_PRIORITY_SCHEDULAR_464c6f8f (EthSwtPortScheduler): EthSwtPortSchedulerAlgorithm=ETHSWT_SCHEDULER_STRICT_PRIORITY
              8 x EthSwtPortSchedulerPredecessor:
                EthSwtPortSchedulerPredecessor_0: EthSwtPortSchedulerPredecessorOrder=0, EthSwtPortEgressPredecessorRef=FIFO_7_7e9cec13
                EthSwtPortSchedulerPredecessor_1: EthSwtPortSchedulerPredecessorOrder=1, EthSwtPortEgressPredecessorRef=FIFO_6_099bdc85
                EthSwtPortSchedulerPredecessor_2: EthSwtPortSchedulerPredecessorOrder=2, EthSwtPortEgressPredecessorRef=FIFO_5_90928d3f
                EthSwtPortSchedulerPredecessor_3: EthSwtPortSchedulerPredecessorOrder=3, EthSwtPortEgressPredecessorRef=FIFO_4_SHAPER_cb3ef276
                EthSwtPortSchedulerPredecessor_4: EthSwtPortSchedulerPredecessorOrder=4, EthSwtPortEgressPredecessorRef=FIFO_3_79f1280a
                EthSwtPortSchedulerPredecessor_5: EthSwtPortSchedulerPredecessorOrder=5, EthSwtPortEgressPredecessorRef=FIFO_2_0ef6189c
                EthSwtPortSchedulerPredecessor_6: EthSwtPortSchedulerPredecessorOrder=6, EthSwtPortEgressPredecessorRef=FIFO_1_97ff4926
                EthSwtPortSchedulerPredecessor_7: EthSwtPortSchedulerPredecessorOrder=7, EthSwtPortEgressPredecessorRef=FIFO_0_e0f879b0
            FIFO_4_SHAPER_cb3ef276 (EthSwtPortShaper): EthSwtPortShaperIdleSlope=80000000, EthSwtPortEgressPredecessorFifoRef=FIFO_4_e795bda9
            4 x EthSwtPortVlanForwarding, all with EthSwtPortVlanDefaultPriority=0:
              Eth_Cluster4_1_d180297d: EthSwtPortVlanForwardingId=1, EthSwtPortVlanForwardingType=ETHSWT_SENT_TAGGED
              Eth_Cluster4_3_bc9abb59: EthSwtPortVlanForwardingId=3, EthSwtPortVlanForwardingType=ETHSWT_NOT_SENT
              Eth_Cluster4_4_3d384427: EthSwtPortVlanForwardingId=4, EthSwtPortVlanForwardingType=ETHSWT_SENT_TAGGED
              Eth_Cluster4_7_66af9f11: EthSwtPortVlanForwardingId=7, EthSwtPortVlanForwardingType=ETHSWT_SENT_TAGGED
          EthSwtPortIngress
            8 x EthSwtPriorityTrafficClassAssignment:
              EthSwtPriorityTrafficClassAssignment_{0..7}: EthSwtPriorityTrafficClassAssignmentPriority={0..7}, EthSwtPriorityTrafficClassAssignmentTrafficClass={0..7}  # TrafficClass_{0..7}
        ECU4_CRN_Switch_8384ec19: EthSwtPortPhysicalLayerType=SWITCH_PORT_X_MII
          EthSwtPortEgress: EthSwtPortEgressLastSchedulerRef=STRICT_PRIORITY_SCHEDULAR_90746f26
            8 x EthSwtPortFifo:
              FIFO_0_de72f40a: EthSwtPortFifoTrafficClassAssignment=0
              FIFO_1_a975c49c: EthSwtPortFifoTrafficClassAssignment=1
              FIFO_2_307c9526: EthSwtPortFifoTrafficClassAssignment=2
              FIFO_3_477ba5b0: EthSwtPortFifoTrafficClassAssignment=3
              FIFO_4_d91f3013: EthSwtPortFifoTrafficClassAssignment=4
              FIFO_5_ae180085: EthSwtPortFifoTrafficClassAssignment=5
              FIFO_6_3711513f: EthSwtPortFifoTrafficClassAssignment=6
              FIFO_7_401661a9: EthSwtPortFifoTrafficClassAssignment=7
            STRICT_PRIORITY_SCHEDULAR_90746f26 (EthSwtPortScheduler): EthSwtPortSchedulerAlgorithm=ETHSWT_SCHEDULER_STRICT_PRIORITY
              8 x EthSwtPortSchedulerPredecessor:
                EthSwtPortSchedulerPredecessor_0: EthSwtPortSchedulerPredecessorOrder=0, EthSwtPortEgressPredecessorRef=FIFO_7_401661a9
                EthSwtPortSchedulerPredecessor_1: EthSwtPortSchedulerPredecessorOrder=1, EthSwtPortEgressPredecessorRef=FIFO_6_3711513f
                EthSwtPortSchedulerPredecessor_2: EthSwtPortSchedulerPredecessorOrder=2, EthSwtPortEgressPredecessorRef=FIFO_5_ae180085
                EthSwtPortSchedulerPredecessor_3: EthSwtPortSchedulerPredecessorOrder=3, EthSwtPortEgressPredecessorRef=FIFO_4_SHAPER_06b7c23f
                EthSwtPortSchedulerPredecessor_4: EthSwtPortSchedulerPredecessorOrder=4, EthSwtPortEgressPredecessorRef=FIFO_3_477ba5b0
                EthSwtPortSchedulerPredecessor_5: EthSwtPortSchedulerPredecessorOrder=5, EthSwtPortEgressPredecessorRef=FIFO_2_307c9526
                EthSwtPortSchedulerPredecessor_6: EthSwtPortSchedulerPredecessorOrder=6, EthSwtPortEgressPredecessorRef=FIFO_1_a975c49c
                EthSwtPortSchedulerPredecessor_7: EthSwtPortSchedulerPredecessorOrder=7, EthSwtPortEgressPredecessorRef=FIFO_0_de72f40a
            FIFO_4_SHAPER_06b7c23f (EthSwtPortShaper): EthSwtPortShaperIdleSlope=80000000, EthSwtPortEgressPredecessorFifoRef=FIFO_4_d91f3013
            4 x EthSwtPortVlanForwarding, all with EthSwtPortVlanDefaultPriority=0:
              Eth_Cluster4_1_49235e6d: EthSwtPortVlanForwardingId=1, EthSwtPortVlanForwardingType=ETHSWT_SENT_TAGGED
              Eth_Cluster4_3_2439cc49: EthSwtPortVlanForwardingId=3, EthSwtPortVlanForwardingType=ETHSWT_NOT_SENT
              Eth_Cluster4_4_a59b3337: EthSwtPortVlanForwardingId=4, EthSwtPortVlanForwardingType=ETHSWT_SENT_TAGGED
              Eth_Cluster4_7_fe0ce801: EthSwtPortVlanForwardingId=7, EthSwtPortVlanForwardingType=ETHSWT_SENT_TAGGED
          EthSwtPortIngress
            8 x EthSwtPriorityTrafficClassAssignment:
              EthSwtPriorityTrafficClassAssignment_{0..7}: EthSwtPriorityTrafficClassAssignmentPriority={0..7}, EthSwtPriorityTrafficClassAssignmentTrafficClass={0..7}  # TrafficClass_{0..7}
        ECU5_e60deb9b: EthSwtPortPhysicalLayerType=SWITCH_PORT_BROAD_R_REACH
          EthSwtPortEgress: EthSwtPortEgressLastSchedulerRef=STRICT_PRIORITY_SCHEDULAR_9b3ae2fa
            8 x EthSwtPortFifo:
              FIFO_0_6cf0eabb: EthSwtPortFifoTrafficClassAssignment=0
              FIFO_1_1bf7da2d: EthSwtPortFifoTrafficClassAssignment=1
              FIFO_2_82fe8b97: EthSwtPortFifoTrafficClassAssignment=2
              FIFO_3_f5f9bb01: EthSwtPortFifoTrafficClassAssignment=3
              FIFO_4_6b9d2ea2: EthSwtPortFifoTrafficClassAssignment=4
              FIFO_5_1c9a1e34: EthSwtPortFifoTrafficClassAssignment=5
              FIFO_6_85934f8e: EthSwtPortFifoTrafficClassAssignment=6
              FIFO_7_f2947f18: EthSwtPortFifoTrafficClassAssignment=7
            STRICT_PRIORITY_SCHEDULAR_9b3ae2fa (EthSwtPortScheduler): EthSwtPortSchedulerAlgorithm=ETHSWT_SCHEDULER_STRICT_PRIORITY
              8 x EthSwtPortSchedulerPredecessor:
                EthSwtPortSchedulerPredecessor_0: EthSwtPortSchedulerPredecessorOrder=0, EthSwtPortEgressPredecessorRef=FIFO_7_f2947f18
                EthSwtPortSchedulerPredecessor_1: EthSwtPortSchedulerPredecessorOrder=1, EthSwtPortEgressPredecessorRef=FIFO_6_85934f8e
                EthSwtPortSchedulerPredecessor_2: EthSwtPortSchedulerPredecessorOrder=2, EthSwtPortEgressPredecessorRef=FIFO_5_1c9a1e34
                EthSwtPortSchedulerPredecessor_3: EthSwtPortSchedulerPredecessorOrder=3, EthSwtPortEgressPredecessorRef=FIFO_4_SHAPER_c5348023
                EthSwtPortSchedulerPredecessor_4: EthSwtPortSchedulerPredecessorOrder=4, EthSwtPortEgressPredecessorRef=FIFO_3_f5f9bb01
                EthSwtPortSchedulerPredecessor_5: EthSwtPortSchedulerPredecessorOrder=5, EthSwtPortEgressPredecessorRef=FIFO_2_82fe8b97
                EthSwtPortSchedulerPredecessor_6: EthSwtPortSchedulerPredecessorOrder=6, EthSwtPortEgressPredecessorRef=FIFO_1_1bf7da2d
                EthSwtPortSchedulerPredecessor_7: EthSwtPortSchedulerPredecessorOrder=7, EthSwtPortEgressPredecessorRef=FIFO_0_6cf0eabb
            FIFO_4_SHAPER_c5348023 (EthSwtPortShaper): EthSwtPortShaperIdleSlope=80000000, EthSwtPortEgressPredecessorFifoRef=FIFO_4_6b9d2ea2
            4 x EthSwtPortVlanForwarding, all with EthSwtPortVlanDefaultPriority=0:
              Eth_Cluster4_1_e0710e96: EthSwtPortVlanForwardingId=1, EthSwtPortVlanForwardingType=ETHSWT_SENT_TAGGED
              Eth_Cluster4_3_e0ab0b9a: EthSwtPortVlanForwardingId=3, EthSwtPortVlanForwardingType=ETHSWT_NOT_SENT
              Eth_Cluster4_4_e1a80608: EthSwtPortVlanForwardingId=4, EthSwtPortVlanForwardingType=ETHSWT_SENT_TAGGED
              Eth_Cluster4_7_e11f0182: EthSwtPortVlanForwardingId=7, EthSwtPortVlanForwardingType=ETHSWT_SENT_TAGGED
          EthSwtPortIngress
            8 x EthSwtPriorityTrafficClassAssignment:
              EthSwtPriorityTrafficClassAssignment_{0..7}: EthSwtPriorityTrafficClassAssignmentPriority={0..7}, EthSwtPriorityTrafficClassAssignmentTrafficClass={0..7}  # TrafficClass_{0..7}
        ECU7_08038ab7: EthSwtPortPhysicalLayerType=SWITCH_PORT_BROAD_R_REACH
          EthSwtPortEgress: EthSwtPortEgressLastSchedulerRef=STRICT_PRIORITY_SCHEDULAR_4622d478
            8 x EthSwtPortFifo:
              FIFO_0_2ed5edc6: EthSwtPortFifoTrafficClassAssignment=0
              FIFO_1_59d2dd50: EthSwtPortFifoTrafficClassAssignment=1
              FIFO_2_c0db8cea: EthSwtPortFifoTrafficClassAssignment=2
              FIFO_3_b7dcbc7c: EthSwtPortFifoTrafficClassAssignment=3
              FIFO_4_29b829df: EthSwtPortFifoTrafficClassAssignment=4
              FIFO_5_5ebf1949: EthSwtPortFifoTrafficClassAssignment=5
              FIFO_6_c7b648f3: EthSwtPortFifoTrafficClassAssignment=6
              FIFO_7_b0b17865: EthSwtPortFifoTrafficClassAssignment=7
            STRICT_PRIORITY_SCHEDULAR_4622d478 (EthSwtPortScheduler): EthSwtPortSchedulerAlgorithm=ETHSWT_SCHEDULER_STRICT_PRIORITY
              8 x EthSwtPortSchedulerPredecessor:
                EthSwtPortSchedulerPredecessor_0: EthSwtPortSchedulerPredecessorOrder=0, EthSwtPortEgressPredecessorRef=FIFO_7_b0b17865
                EthSwtPortSchedulerPredecessor_1: EthSwtPortSchedulerPredecessorOrder=1, EthSwtPortEgressPredecessorRef=FIFO_6_c7b648f3
                EthSwtPortSchedulerPredecessor_2: EthSwtPortSchedulerPredecessorOrder=2, EthSwtPortEgressPredecessorRef=FIFO_5_5ebf1949
                EthSwtPortSchedulerPredecessor_3: EthSwtPortSchedulerPredecessorOrder=3, EthSwtPortEgressPredecessorRef=FIFO_4_SHAPER_6db231b2
                EthSwtPortSchedulerPredecessor_4: EthSwtPortSchedulerPredecessorOrder=4, EthSwtPortEgressPredecessorRef=FIFO_3_b7dcbc7c
                EthSwtPortSchedulerPredecessor_5: EthSwtPortSchedulerPredecessorOrder=5, EthSwtPortEgressPredecessorRef=FIFO_2_c0db8cea
                EthSwtPortSchedulerPredecessor_6: EthSwtPortSchedulerPredecessorOrder=6, EthSwtPortEgressPredecessorRef=FIFO_1_59d2dd50
                EthSwtPortSchedulerPredecessor_7: EthSwtPortSchedulerPredecessorOrder=7, EthSwtPortEgressPredecessorRef=FIFO_0_2ed5edc6
            FIFO_4_SHAPER_6db231b2 (EthSwtPortShaper): EthSwtPortShaperIdleSlope=80000000, EthSwtPortEgressPredecessorFifoRef=FIFO_4_29b829df
            4 x EthSwtPortVlanForwarding, all with EthSwtPortVlanDefaultPriority=0:
              Eth_Cluster4_1_0e7f6fba: EthSwtPortVlanForwardingId=1, EthSwtPortVlanForwardingType=ETHSWT_SENT_TAGGED
              Eth_Cluster4_3_0ea56ab6: EthSwtPortVlanForwardingId=3, EthSwtPortVlanForwardingType=ETHSWT_NOT_SENT
              Eth_Cluster4_4_0fa66724: EthSwtPortVlanForwardingId=4, EthSwtPortVlanForwardingType=ETHSWT_SENT_TAGGED
              Eth_Cluster4_7_0f1160ae: EthSwtPortVlanForwardingId=7, EthSwtPortVlanForwardingType=ETHSWT_SENT_TAGGED
          EthSwtPortIngress
            8 x EthSwtPriorityTrafficClassAssignment:
              EthSwtPriorityTrafficClassAssignment_{0..7}: EthSwtPriorityTrafficClassAssignmentPriority={0..7}, EthSwtPriorityTrafficClassAssignmentTrafficClass={0..7}  # TrafficClass_{0..7}
    EthSwtGeneral
  module config EthTSyn
    EthTSynGeneral
    GTD_Eth_Cluster4_0_127_5e02ab5e (EthTSynGlobalTimeDomain): EthTSynGlobalTimeDomainId=0, EthTSynSynchronizedTimeBaseRef=StbM/GTD_Eth_Cluster4_0_127_5e02ab5e
  module config IpduM
    IpduMConfig
    IpduMGeneral: IpduMStaticPartExists=false
  module config Lin
    LinGlobalConfig
      ECU4_CRN_LIN5_Cluster4_b21l9awrmlmhxxw03j6k8wiqt_0edbd2ed (LinChannel):
        LinChannelBaudRate = 19200
        LinChannelId = 0
        LinNodeType = MASTER
        LinChannelEcuMWakeupSource = EcuMCommonConfiguration/ECU4_CRN_LIN5_Cluster4_b21l9awrmlmhxxw03j6k8wiqt_0edbd2ed
  module config LinIf
    LinIfGeneral: LinIfJ2602ResponseToleranceSupport=false
    LinIfGlobalConfig
      LIN5_Cluster4_11beef17 (LinIfChannel):
        LinIfClusterTimeBase = 0.005
        LinIfChannelRef = LinGlobalConfig/ECU4_CRN_LIN5_Cluster4_b21l9awrmlmhxxw03j6k8wiqt_0edbd2ed
        LinIfComMNetworkHandleRef = ComMConfigSet/ECU4_CRN_LIN5_Cluster4_b21l9awrmlmhxxw03j6k8wiqt_0edbd2ed
        4 x LinIfFrame:
          COM_C04_Frm04_9m4e9s8snxdt2v1tshjqcauak_9b40c348_Tx: LinIfChecksumType=ENHANCED, LinIfLength=8, LinIfPid=26
            LinIfPduDirection
              LinIfTxPdu_938f507c (LinIfTxPdu): LinIfTxPduRef=EcucPduCollection/COM_C04_Pdu04_2a405515_Tx
          COM_SL05_Frm01_d31ioqpgpujnqirldjwaglz4s_871166bd_Rx: LinIfChecksumType=ENHANCED, LinIfLength=2, LinIfPid=55
            LinIfPduDirection
              LinIfRxPdu: LinIfRxPduRef=EcucPduCollection/COM_SL05_Pdu01_4f2ce2ed_Rx
          MasterReq_c10fc2c7_Tx: LinIfChecksumType=CLASSIC, LinIfFrameType=MRF, LinIfLength=8, LinIfPid=60
            LinIfPduDirection
              LinIfInternalPdu
          XDIS_d8rs41pce8j439a3n5metj3ro_ced523f2_Rx: LinIfChecksumType=CLASSIC, LinIfFrameType=SRF, LinIfLength=8, LinIfPid=125
            LinIfPduDirection
              LinIfInternalPdu
        LinIfNodeType  # ECU4_CRN_LIN5_Cluster4
          ECU4_CRN_LIN5_Cluster4_d7cf7598 (LinIfMaster): LinIfJitter=0.000176
        4 x LinIfScheduleTable, all with LinIfRunMode=RUN_CONTINUOUS:
          NULLSchedule: LinIfResumePosition=CONTINUE_AT_IT_POINT, LinIfScheduleMode=LINTP_APPLICATIVE_SCHEDULE, LinIfScheduleTableIndex=0
          sch_appl_0_aa011986: LinIfScheduleTableIndex=1, LinIfScheduleTableName=
            sch_appl_0_6aba4968 (LinIfEntry): LinIfDelay=0.04, LinIfEntryIndex=0, LinIfFrameRef=COM_C04_Frm04_9m4e9s8snxdt2v1tshjqcauak_9b40c348_Tx
            sch_appl_0_85e8ff89 (LinIfEntry): LinIfDelay=0.04, LinIfEntryIndex=1, LinIfFrameRef=COM_SL05_Frm01_d31ioqpgpujnqirldjwaglz4s_871166bd_Rx
          sch_mreq_f604fce4: LinIfScheduleTableIndex=2, LinIfScheduleTableName=
            sch_mreq_430d6db3 (LinIfEntry): LinIfDelay=0.01, LinIfEntryIndex=0, LinIfFrameRef=MasterReq_c10fc2c7_Tx
          sch_sresp_c870f74d: LinIfScheduleTableIndex=3, LinIfScheduleTableName=
            sch_sresp_1a2a77b0 (LinIfEntry): LinIfDelay=0.01, LinIfEntryIndex=0, LinIfFrameRef=XDIS_d8rs41pce8j439a3n5metj3ro_ced523f2_Rx
  module config LinSM
    LinSMConfigSet
      LIN5_Cluster4_11beef17 (LinSMChannel): LinSMNodeType=MASTER, LinSMComMNetworkHandleRef=ComMConfigSet/ECU4_CRN_LIN5_Cluster4_b21l9awrmlmhxxw03j6k8wiqt_0edbd2ed
        4 x LinSMSchedule:
          LIN5_Cluster4_11beef17_9579cfe5: LinSMScheduleIndex=0, LinSMScheduleIndexRef=NULLSchedule
          sch_appl_0_aa011986: LinSMScheduleIndex=1, LinSMScheduleIndexRef=LIN5_Cluster4_11beef17/sch_appl_0_aa011986
          sch_mreq_f604fce4: LinSMScheduleIndex=2, LinSMScheduleIndexRef=LIN5_Cluster4_11beef17/sch_mreq_f604fce4
          sch_sresp_c870f74d: LinSMScheduleIndex=3, LinSMScheduleIndexRef=LIN5_Cluster4_11beef17/sch_sresp_c870f74d
  module config LinTp
    LinTpGeneral: LinTpFunctionalRequestsSupported=false
    LinTpGlobalConfig
      LIN5_Cluster4_11beef17 (LinTpChannelConfig): LinTpChannelRef=LinIfGlobalConfig/LIN5_Cluster4_11beef17
      DIAG_NAD_5_RS_LIN5_Cluster4_ST3_518146a0_Rx (LinTpRxNSdu):
        LinTpDl = 4095
        LinTpRxNSduNad = 5
        LinTpRxNSduChannelRef = LinIfGlobalConfig/LIN5_Cluster4_11beef17
        LinTpRxNSduPduRef = DIAG_NAD_5_RS_LIN5_Cluster4_ST3_e174870c_Rx
      DIAG_NAD_5_RQ_LIN5_Cluster4_ST3_25354051_Tx (LinTpTxNSdu): LinTpTxNSduNad=5, LinTpTxNSduChannelRef=LinIfGlobalConfig/LIN5_Cluster4_11beef17, LinTpTxNSduPduRef=DIAG_NAD_5_RQ_LIN5_Cluster4_ST3_53b8f7da_Tx
  module config Nm
    3 x NmChannelConfig, all with NmChannelSleepMaster=false, NmSynchronizingNetwork=false:
      ECU4_CRN_CAN1_Cluster4_6it1ke922hxi7y4c8scsqzzry_25bd0b69: NmComMChannelRef=ComMConfigSet/ECU4_CRN_CAN1_Cluster4_6it1ke922hxi7y4c8scsqzzry_25bd0b69
        CAN1_Cluster4_940f0938 (NmBusType)
          NmStandardBusNmConfig: NmStandardBusType=NM_BUSNM_CANNM  # CAN1_Cluster4
      ECU4_CRN_CANFD1_Cluster4_bx4qzxpu7xp7napnh6bsrtlzq_d98d74ac: NmComMChannelRef=ComMConfigSet/ECU4_CRN_CANFD1_Cluster4_bx4qzxpu7xp7napnh6bsrtlzq_d98d74ac
        CANFD1_Cluster4_95fff329 (NmBusType)
          NmStandardBusNmConfig: NmStandardBusType=NM_BUSNM_CANNM  # CANFD1_Cluster4
      ECU4_CRN_Eth_Cluster4_3g6xoesclytkmkqofl9pi6ol1_481bdd0f: NmComMChannelRef=ComMConfigSet/ECU4_CRN_Eth_Cluster4_3g6xoesclytkmkqofl9pi6ol1_481bdd0f
        Eth_Cluster4_127_d3de5ffe (NmBusType)
          NmStandardBusNmConfig: NmStandardBusType=NM_BUSNM_UDPNM  # Eth_Cluster4_127
    NmGlobalConfig
      NmGlobalFeatures:
        NmComControlEnabled = true
        NmComUserDataSupport = true
        NmNodeDetectionEnabled = false
        NmNodeIdEnabled = false
        NmRemoteSleepIndEnabled = false
        NmRepeatMsgIndEnabled = false
        NmUserDataEnabled = false
      NmGlobalProperties
  module config PduR
    PduRGeneral
    PduRRoutingTables
      PduRRoutingTable
        121 x PduRRoutingPath:
          C04_CANFD_1_Container_ST3_ContainerIPdu_ff52b773_Tx
            C04_CANFD_1_Container_ST3_ContainerIPdu_7bdf0645_Tx (PduRDestPdu): PduRDestPduRef=EcucPduCollection/C04_CANFD_1_Container_ST3_ContainerIPdu_7bdf0645_Tx
            PduRSrcPdu_0c928f44 (PduRSrcPdu): PduRSrcPduRef=EcucPduCollection/C04_CANFD_1_Container_ST3_ContainerIPdu_ff52b773_Tx
          C04_CANFD_1_Container_ST3_VSS_TP_SecTickCount_Lvl2_ST3_2da56e8b_Tx
            C04_CANFD_1_Container_ST3_VSS_TP_SecTickCount_Lvl2_ST3_2da56e8b_Tx (PduRDestPdu): PduRDestPduRef=EcucPduCollection/C04_CANFD_1_Container_ST3_VSS_TP_SecTickCount_Lvl2_ST3_2da56e8b_Tx
            PduRSrcPdu_93e1f618 (PduRSrcPdu): PduRSrcPduRef=EcucPduCollection/C04_CANFD_1_Container_ST3_VSS_TP_SecTickCount_Lvl2_ST3_2da56e8b_Tx
          COM_C01_Pdu01_PN08_80ad51b4_Rx
            COM_C01_Pdu01_PN08_80ad51b4_Rx_e3cd6a80_Rx (PduRDestPdu): PduRDestPduRef=EcucPduCollection/COM_C01_Pdu01_PN08_4daf151f_Rx
            PduRSrcPdu_e3cd6a80 (PduRSrcPdu): PduRSrcPduRef=EcucPduCollection/COM_C01_Pdu01_PN08_80ad51b4_Rx
          COM_C01_Pdu01_PN17_9a48397c_Rx
            COM_C01_Pdu01_PN17_9a48397c_Rx_dd0c4e32_Rx (PduRDestPdu): PduRDestPduRef=EcucPduCollection/COM_C01_Pdu01_PN17_c40b39cf_Rx
            PduRSrcPdu_dd0c4e32 (PduRSrcPdu): PduRSrcPduRef=EcucPduCollection/COM_C01_Pdu01_PN17_9a48397c_Rx
          COM_C01_Pdu01_PN44_994d2473_Rx
            COM_C01_Pdu01_PN44_994d2473_Rx_9dcb7b6c_Rx (PduRDestPdu): PduRDestPduRef=EcucPduCollection/COM_C01_Pdu01_PN44_20759c30_Rx
            PduRSrcPdu_9dcb7b6c (PduRSrcPdu): PduRSrcPduRef=EcucPduCollection/COM_C01_Pdu01_PN44_994d2473_Rx
          COM_C01_Pdu01_PN53_790696b5_Rx
            COM_C01_Pdu01_PN53_790696b5_Rx_ff79f865_Rx (PduRDestPdu): PduRDestPduRef=EcucPduCollection/COM_C01_Pdu01_PN53_a70a38d2_Rx
            PduRSrcPdu_ff79f865 (PduRSrcPdu): PduRSrcPduRef=EcucPduCollection/COM_C01_Pdu01_PN53_790696b5_Rx
          COM_C01_Pdu01_PN62_78059db0_Rx
            COM_C01_Pdu01_PN62_78059db0_Rx_495b3128_Rx (PduRDestPdu): PduRDestPduRef=EcucPduCollection/COM_C01_Pdu01_PN62_fb205b87_Rx
            PduRSrcPdu_495b3128 (PduRSrcPdu): PduRSrcPduRef=EcucPduCollection/COM_C01_Pdu01_PN62_78059db0_Rx
          COM_C04_C08_Pdu02_TpConnection_07a51284_Tx
            COM_C04_C08_Pdu02_TpConnection_eda1cb96_Tx (PduRDestPdu): PduRDestPduRef=EcucPduCollection/COM_C04_C08_Pdu02_TpConnection_eda1cb96_Tx
            PduRSrcPdu_c8899013 (PduRSrcPdu): PduRSrcPduRef=EcucPduCollection/COM_C04_C08_Pdu02_TpConnection_07a51284_Tx
          COM_C04_C14_Pdu01_TpConnection_3728892a_Tx
            COM_C04_C14_Pdu01_TpConnection_b97b4d4e_Tx (PduRDestPdu): PduRDestPduRef=EcucPduCollection/COM_C04_C14_Pdu01_TpConnection_b97b4d4e_Tx
            PduRSrcPdu_9eb69f24 (PduRSrcPdu): PduRSrcPduRef=EcucPduCollection/COM_C04_C14_Pdu01_TpConnection_3728892a_Tx
          COM_C04_Frm05_COM_C04_Pdu05_afb7aab9_Tx
            COM_C04_Frm05_COM_C04_Pdu05_afb7aab9_Tx (PduRDestPdu): PduRDestPduRef=EcucPduCollection/COM_C04_Frm05_COM_C04_Pdu05_afb7aab9_Tx
            PduRSrcPdu_3894e68a (PduRSrcPdu): PduRSrcPduRef=EcucPduCollection/COM_C04_Frm05_COM_C04_Pdu05_afb7aab9_Tx
          COM_C04_Frm05_COM_C04_Pdu06_36befb03_Tx
            COM_C04_Frm05_COM_C04_Pdu06_36befb03_Tx (PduRDestPdu): PduRDestPduRef=EcucPduCollection/COM_C04_Frm05_COM_C04_Pdu06_36befb03_Tx
            PduRSrcPdu_65c6acbd (PduRSrcPdu): PduRSrcPduRef=EcucPduCollection/COM_C04_Frm05_COM_C04_Pdu06_36befb03_Tx
          COM_C04_Frm05_COM_C04_Pdu07_41b9cb95_Tx
            COM_C04_Frm05_COM_C04_Pdu07_41b9cb95_Tx (PduRDestPdu): PduRDestPduRef=EcucPduCollection/COM_C04_Frm05_COM_C04_Pdu07_41b9cb95_Tx
            PduRSrcPdu_0b7d8f41 (PduRSrcPdu): PduRSrcPduRef=EcucPduCollection/COM_C04_Frm05_COM_C04_Pdu07_41b9cb95_Tx
          COM_C04_Frm05_ContainerIPdu_a4bbe606_Tx
            COM_C04_Frm05_ContainerIPdu_09ce4b60_Tx (PduRDestPdu): PduRDestPduRef=EcucPduCollection/COM_C04_Frm05_ContainerIPdu_09ce4b60_Tx
            PduRSrcPdu_2586ee12 (PduRSrcPdu): PduRSrcPduRef=EcucPduCollection/COM_C04_Frm05_ContainerIPdu_a4bbe606_Tx
          COM_C04_Pdu01_PN08_35be779f_Tx
            COM_C04_Pdu01_PN08_f12ace0a_Tx (PduRDestPdu): PduRDestPduRef=EcucPduCollection/COM_C04_Pdu01_PN08_f12ace0a_Tx
            PduRSrcPdu_029a8de2 (PduRSrcPdu): PduRSrcPduRef=EcucPduCollection/COM_C04_Pdu01_PN08_35be779f_Tx
          COM_C04_Pdu01_PN08_d50c620f_Tx
            COM_C04_Pdu01_PN08_d1242e36_Tx (PduRDestPdu): PduRDestPduRef=EcucPduCollection/COM_C04_Pdu01_PN08_d1242e36_Tx
            PduRSrcPdu_327edd44 (PduRSrcPdu): PduRSrcPduRef=EcucPduCollection/COM_C04_Pdu01_PN08_d50c620f_Tx
          COM_C04_Pdu01_PN08_f4b54190_Tx
            COM_C04_Pdu01_PN08_1a3bebf9_Tx (PduRDestPdu): PduRDestPduRef=EcucPduCollection/COM_C04_Pdu01_PN08_1a3bebf9_Tx
            PduRSrcPdu_b840cd82 (PduRSrcPdu): PduRSrcPduRef=EcucPduCollection/COM_C04_Pdu01_PN08_f4b54190_Tx
          COM_C04_Pdu01_PN17_5ca84edf_Tx
            COM_C04_Pdu01_PN17_cbc146fe_Tx (PduRDestPdu): PduRDestPduRef=EcucPduCollection/COM_C04_Pdu01_PN17_cbc146fe_Tx
            PduRSrcPdu_a3d9e724 (PduRSrcPdu): PduRSrcPduRef=EcucPduCollection/COM_C04_Pdu01_PN17_5ca84edf_Tx
          COM_C04_Pdu01_PN17_7d116d40_Tx
            COM_C04_Pdu01_PN17_5a714530_Tx (PduRDestPdu): PduRDestPduRef=EcucPduCollection/COM_C04_Pdu01_PN17_5a714530_Tx
            PduRSrcPdu_fec242f8 (PduRSrcPdu): PduRSrcPduRef=EcucPduCollection/COM_C04_Pdu01_PN17_7d116d40_Tx
          COM_C04_Pdu01_PN44_5864feb0_Tx
            COM_C04_Pdu01_PN44_097d567e_Tx (PduRDestPdu): PduRDestPduRef=EcucPduCollection/COM_C04_Pdu01_PN44_097d567e_Tx
            PduRSrcPdu_4fb4fc88 (PduRSrcPdu): PduRSrcPduRef=EcucPduCollection/COM_C04_Pdu01_PN44_5864feb0_Tx
          COM_C04_Pdu01_PN44_b8d6eb20_Tx
            COM_C04_Pdu01_PN44_c8c45bf1_Tx (PduRDestPdu): PduRDestPduRef=EcucPduCollection/COM_C04_Pdu01_PN44_c8c45bf1_Tx
            PduRSrcPdu_144ebf4c (PduRSrcPdu): PduRSrcPduRef=EcucPduCollection/COM_C04_Pdu01_PN44_b8d6eb20_Tx
          COM_C04_Pdu01_PN53_3fa94fc2_Tx
            COM_C04_Pdu01_PN53_288fe937_Tx (PduRDestPdu): PduRDestPduRef=EcucPduCollection/COM_C04_Pdu01_PN53_288fe937_Tx
            PduRSrcPdu_c821357b (PduRSrcPdu): PduRSrcPduRef=EcucPduCollection/COM_C04_Pdu01_PN53_3fa94fc2_Tx
          COM_C04_Pdu01_PN62_63832c97_Tx
            COM_C04_Pdu01_PN62_298ce232_Tx (PduRDestPdu): PduRDestPduRef=EcucPduCollection/COM_C04_Pdu01_PN62_298ce232_Tx
            PduRSrcPdu_7eed405f (PduRSrcPdu): PduRSrcPduRef=EcucPduCollection/COM_C04_Pdu01_PN62_63832c97_Tx
          COM_C04_Pdu02_Call_0ed7c659_Rx
            COM_C04_Pdu02_Call_0ed7c659_Rx_679e06b2_Rx (PduRDestPdu): PduRDestPduRef=EcucPduCollection/COM_C04_Pdu02_Call_582d6eb8_Rx
            PduRSrcPdu_679e06b2 (PduRSrcPdu): PduRSrcPduRef=EcucPduCollection/COM_C04_Pdu02_Call_0ed7c659_Rx
          COM_C04_Pdu02_e98e7a25_Tx
            COM_C04_Pdu02_00ce023e_Tx (PduRDestPdu): PduRDestPduRef=EcucPduCollection/COM_C04_Pdu02_00ce023e_Tx
            PduRSrcPdu_09065c6b (PduRSrcPdu): PduRSrcPduRef=EcucPduCollection/COM_C04_Pdu02_e98e7a25_Tx
          COM_C04_Pdu03_9e894ab3_Tx
            COM_C04_Pdu03_9e894ab3_Tx (PduRDestPdu): PduRDestPduRef=EcucPduCollection/COM_C04_Pdu03_9e894ab3_Tx
            PduRSrcPdu_2b05c0c8 (PduRSrcPdu): PduRSrcPduRef=EcucPduCollection/COM_C04_Pdu03_9e894ab3_Tx
          COM_C04_Pdu03_secured_044596e0_Tx
            COM_C04_Pdu03_secured_e3281955_Tx (PduRDestPdu): PduRDestPduRef=EcucPduCollection/COM_C04_Pdu03_secured_e3281955_Tx
            PduRSrcPdu_92e4b001 (PduRSrcPdu): PduRSrcPduRef=EcucPduCollection/COM_C04_Pdu03_secured_044596e0_Tx
          COM_C04_Pdu04_ced66c03_Tx
            COM_C04_Pdu04_2a405515_Tx (PduRDestPdu): PduRDestPduRef=EcucPduCollection/COM_C04_Pdu04_2a405515_Tx
            PduRSrcPdu_19a5cf77 (PduRSrcPdu): PduRSrcPduRef=EcucPduCollection/COM_C04_Pdu04_ced66c03_Tx
          COM_C04_Pdu10_1e9b2a48_Tx
            COM_C04_Pdu10_19e3c40e_Tx (PduRDestPdu): PduRDestPduRef=EcucPduCollection/COM_C04_Pdu10_19e3c40e_Tx
            PduRSrcPdu_adb6dfb6 (PduRSrcPdu): PduRSrcPduRef=EcucPduCollection/COM_C04_Pdu10_1e9b2a48_Tx
          COM_C04_Pdu11_699c1ade_Tx
            COM_C04_Pdu11_9dd2ddff_Tx (PduRDestPdu): PduRDestPduRef=EcucPduCollection/COM_C04_Pdu11_9dd2ddff_Tx
            PduRSrcPdu_060577c1 (PduRSrcPdu): PduRSrcPduRef=EcucPduCollection/COM_C04_Pdu11_699c1ade_Tx
          COM_C04_Pdu12_f0954b64_Tx
            COM_C04_Pdu12_caf0f1ad_Tx (PduRDestPdu): PduRDestPduRef=EcucPduCollection/COM_C04_Pdu12_caf0f1ad_Tx
            PduRSrcPdu_49e3bec5 (PduRSrcPdu): PduRSrcPduRef=EcucPduCollection/COM_C04_Pdu12_f0954b64_Tx
          COM_C04_Pdu13_87927bf2_Tx
            COM_C04_Pdu13_4ec1e85c_Tx (PduRDestPdu): PduRDestPduRef=EcucPduCollection/COM_C04_Pdu13_4ec1e85c_Tx
            PduRSrcPdu_7a340988 (PduRSrcPdu): PduRSrcPduRef=EcucPduCollection/COM_C04_Pdu13_87927bf2_Tx
          COM_C04_Pdu14_19f6ee51_Tx
            COM_C04_Pdu14_64b4a909_Tx (PduRDestPdu): PduRDestPduRef=EcucPduCollection/COM_C04_Pdu14_64b4a909_Tx
            PduRSrcPdu_8f2b5368 (PduRSrcPdu): PduRSrcPduRef=EcucPduCollection/COM_C04_Pdu14_19f6ee51_Tx
          COM_C04_Pdu15_6ef1dec7_Tx
            COM_C04_Pdu15_e085b0f8_Tx (PduRDestPdu): PduRDestPduRef=EcucPduCollection/COM_C04_Pdu15_e085b0f8_Tx
            PduRSrcPdu_e6249eb2 (PduRSrcPdu): PduRSrcPduRef=EcucPduCollection/COM_C04_Pdu15_6ef1dec7_Tx
          COM_C04_Pdu16_f7f88f7d_Tx
            COM_C04_Pdu16_b7a79caa_Tx (PduRDestPdu): PduRDestPduRef=EcucPduCollection/COM_C04_Pdu16_b7a79caa_Tx
            PduRSrcPdu_f7345a2c (PduRSrcPdu): PduRSrcPduRef=EcucPduCollection/COM_C04_Pdu16_f7f88f7d_Tx
          COM_C04_Pdu17_80ffbfeb_Tx
            COM_C04_Pdu17_3396855b_Tx (PduRDestPdu): PduRDestPduRef=EcucPduCollection/COM_C04_Pdu17_3396855b_Tx
            PduRSrcPdu_4207fa88 (PduRSrcPdu): PduRSrcPduRef=EcucPduCollection/COM_C04_Pdu17_80ffbfeb_Tx
          COM_C04_Pdu18_1040a27a_Tx
            COM_C04_Pdu18_e34d1e00_Tx (PduRDestPdu): PduRDestPduRef=EcucPduCollection/COM_C04_Pdu18_e34d1e00_Tx
            PduRSrcPdu_2746e1b0 (PduRSrcPdu): PduRSrcPduRef=EcucPduCollection/COM_C04_Pdu18_1040a27a_Tx
          COM_C04_Pdu19_674792ec_Tx
            COM_C04_Pdu19_677c07f1_Tx (PduRDestPdu): PduRDestPduRef=EcucPduCollection/COM_C04_Pdu19_677c07f1_Tx
            PduRSrcPdu_c312cc26 (PduRSrcPdu): PduRSrcPduRef=EcucPduCollection/COM_C04_Pdu19_674792ec_Tx
          COM_C04_Pdu20_35b6798b_Tx
            COM_C04_Pdu20_35b6798b_Tx (PduRDestPdu): PduRDestPduRef=EcucPduCollection/COM_C04_Pdu20_35b6798b_Tx
            PduRSrcPdu_c2614089 (PduRSrcPdu): PduRSrcPduRef=EcucPduCollection/COM_C04_Pdu20_35b6798b_Tx
          COM_C04_Pdu20_secured_393d7a18_Tx
            COM_C04_Pdu20_secured_eef90202_Tx (PduRDestPdu): PduRDestPduRef=EcucPduCollection/COM_C04_Pdu20_secured_eef90202_Tx
            PduRSrcPdu_1fc88ab4 (PduRSrcPdu): PduRSrcPduRef=EcucPduCollection/COM_C04_Pdu20_secured_393d7a18_Tx
          COM_C04_Pdu21_42b1491d_Tx
            COM_C04_Pdu21_42b1491d_Tx (PduRDestPdu): PduRDestPduRef=EcucPduCollection/COM_C04_Pdu21_42b1491d_Tx
            PduRSrcPdu_c746b9df (PduRSrcPdu): PduRSrcPduRef=EcucPduCollection/COM_C04_Pdu21_42b1491d_Tx
          COM_C04_Pdu21_secured_2e466e5b_Tx
            COM_C04_Pdu21_secured_a43e0d91_Tx (PduRDestPdu): PduRDestPduRef=EcucPduCollection/COM_C04_Pdu21_secured_a43e0d91_Tx
            PduRSrcPdu_fd0029fa (PduRSrcPdu): PduRSrcPduRef=EcucPduCollection/COM_C04_Pdu21_secured_2e466e5b_Tx
          COM_C07_Pdu01_PN08_5773f977_Rx
            COM_C07_Pdu01_PN08_5773f977_Rx_383b329f_Rx (PduRDestPdu): PduRDestPduRef=EcucPduCollection/COM_C07_Pdu01_PN08_a292b0ff_Rx
            PduRSrcPdu_383b329f (PduRSrcPdu): PduRSrcPduRef=EcucPduCollection/COM_C07_Pdu01_PN08_5773f977_Rx
          COM_C07_Pdu01_PN44_4e938cb0_Rx
            COM_C07_Pdu01_PN44_4e938cb0_Rx_bc5b9721_Rx (PduRDestPdu): PduRDestPduRef=EcucPduCollection/COM_C07_Pdu01_PN44_cf4839d0_Rx
            PduRSrcPdu_bc5b9721 (PduRSrcPdu): PduRSrcPduRef=EcucPduCollection/COM_C07_Pdu01_PN44_4e938cb0_Rx
          COM_C07_Pdu01_PN53_aed83e76_Rx
            COM_C07_Pdu01_PN53_aed83e76_Rx_8a7f139e_Rx (PduRDestPdu): PduRDestPduRef=EcucPduCollection/COM_C07_Pdu01_PN53_48379d32_Rx
            PduRSrcPdu_8a7f139e (PduRSrcPdu): PduRSrcPduRef=EcucPduCollection/COM_C07_Pdu01_PN53_aed83e76_Rx
          COM_C08_C04_Pdu02_TpConnection_abbd4f8f_Rx
            COM_C08_C04_Pdu02_TpConnection_abbd4f8f_Rx_a692d248_Rx (PduRDestPdu): PduRDestPduRef=EcucPduCollection/COM_C08_C04_Pdu02_TpConnection_6f988d8e_Rx
            PduRSrcPdu_a692d248 (PduRSrcPdu): PduRSrcPduRef=EcucPduCollection/COM_C08_C04_Pdu02_TpConnection_abbd4f8f_Rx
          COM_C0X_Pdu10_8fdf8f4c_Rx
            COM_C0X_Pdu10_8fdf8f4c_Rx_42fd3863_Rx (PduRDestPdu): PduRDestPduRef=EcucPduCollection/COM_C0X_Pdu10_528d0cd9_Rx
            PduRSrcPdu_42fd3863 (PduRSrcPdu): PduRSrcPduRef=EcucPduCollection/COM_C0X_Pdu10_8fdf8f4c_Rx
          COM_C0X_Pdu11_0bee96bd_Rx
            COM_C0X_Pdu11_0bee96bd_Rx_35cab2e8_Rx (PduRDestPdu): PduRDestPduRef=EcucPduCollection/COM_C0X_Pdu11_258a3c4f_Rx
            PduRSrcPdu_35cab2e8 (PduRSrcPdu): PduRSrcPduRef=EcucPduCollection/COM_C0X_Pdu11_0bee96bd_Rx
          COM_C0X_Pdu12_5cccbaef_Rx
            COM_C0X_Pdu12_5cccbaef_Rx_8b90f8ce_Rx (PduRDestPdu): PduRDestPduRef=EcucPduCollection/COM_C0X_Pdu12_bc836df5_Rx
            PduRSrcPdu_8b90f8ce (PduRSrcPdu): PduRSrcPduRef=EcucPduCollection/COM_C0X_Pdu12_5cccbaef_Rx
          COM_C0X_Pdu13_d8fda31e_Rx
            COM_C0X_Pdu13_d8fda31e_Rx_411867c2_Rx (PduRDestPdu): PduRDestPduRef=EcucPduCollection/COM_C0X_Pdu13_cb845d63_Rx
            PduRSrcPdu_411867c2 (PduRSrcPdu): PduRSrcPduRef=EcucPduCollection/COM_C0X_Pdu13_d8fda31e_Rx
          COM_C0X_Pdu14_f288e24b_Rx
            COM_C0X_Pdu14_f288e24b_Rx_a1187480_Rx (PduRDestPdu): PduRDestPduRef=EcucPduCollection/COM_C0X_Pdu14_55e0c8c0_Rx
            PduRSrcPdu_a1187480 (PduRSrcPdu): PduRSrcPduRef=EcucPduCollection/COM_C0X_Pdu14_f288e24b_Rx
          COM_C0X_Pdu15_76b9fbba_Rx
            COM_C0X_Pdu15_76b9fbba_Rx_7f034302_Rx (PduRDestPdu): PduRDestPduRef=EcucPduCollection/COM_C0X_Pdu15_22e7f856_Rx
            PduRSrcPdu_7f034302 (PduRSrcPdu): PduRSrcPduRef=EcucPduCollection/COM_C0X_Pdu15_76b9fbba_Rx
          COM_C0X_Pdu16_219bd7e8_Rx
            COM_C0X_Pdu16_219bd7e8_Rx_66f0bc99_Rx (PduRDestPdu): PduRDestPduRef=EcucPduCollection/COM_C0X_Pdu16_bbeea9ec_Rx
            PduRSrcPdu_66f0bc99 (PduRSrcPdu): PduRSrcPduRef=EcucPduCollection/COM_C0X_Pdu16_219bd7e8_Rx
          COM_C0X_Pdu17_a5aace19_Rx
            COM_C0X_Pdu17_a5aace19_Rx_e51a03d2_Rx (PduRDestPdu): PduRDestPduRef=EcucPduCollection/COM_C0X_Pdu17_cce9997a_Rx
            PduRSrcPdu_e51a03d2 (PduRSrcPdu): PduRSrcPduRef=EcucPduCollection/COM_C0X_Pdu17_a5aace19_Rx
          COM_C0X_Pdu18_75715542_Rx
            COM_C0X_Pdu18_75715542_Rx_5565d6b1_Rx (PduRDestPdu): PduRDestPduRef=EcucPduCollection/COM_C0X_Pdu18_5c5684eb_Rx
            PduRSrcPdu_5565d6b1 (PduRSrcPdu): PduRSrcPduRef=EcucPduCollection/COM_C0X_Pdu18_75715542_Rx
          COM_C0X_Pdu19_f1404cb3_Rx
            COM_C0X_Pdu19_f1404cb3_Rx_be402ca1_Rx (PduRDestPdu): PduRDestPduRef=EcucPduCollection/COM_C0X_Pdu19_2b51b47d_Rx
            PduRSrcPdu_be402ca1 (PduRSrcPdu): PduRSrcPduRef=EcucPduCollection/COM_C0X_Pdu19_f1404cb3_Rx
          COM_C0X_Pdu20_79a05f1a_Rx
            COM_C0X_Pdu20_79a05f1a_Rx (PduRDestPdu): PduRDestPduRef=EcucPduCollection/COM_C0X_Pdu20_79a05f1a_Rx
            PduRSrcPdu_3f9bad8e (PduRSrcPdu): PduRSrcPduRef=EcucPduCollection/COM_C0X_Pdu20_79a05f1a_Rx
          COM_C0X_Pdu20_secured_eeb3f377_Rx
            COM_C0X_Pdu20_secured_eeb3f377_Rx_ee351d00_Rx (PduRDestPdu): PduRDestPduRef=EcucPduCollection/COM_C0X_Pdu20_secured_3ef6961f_Rx
            PduRSrcPdu_ee351d00 (PduRSrcPdu): PduRSrcPduRef=EcucPduCollection/COM_C0X_Pdu20_secured_eeb3f377_Rx
          COM_C0X_Pdu21_0ea76f8c_Rx
            COM_C0X_Pdu21_0ea76f8c_Rx (PduRDestPdu): PduRDestPduRef=EcucPduCollection/COM_C0X_Pdu21_0ea76f8c_Rx
            PduRSrcPdu_f42abe30 (PduRSrcPdu): PduRSrcPduRef=EcucPduCollection/COM_C0X_Pdu21_0ea76f8c_Rx
          COM_C0X_Pdu21_secured_a474fce4_Rx
            COM_C0X_Pdu21_secured_a474fce4_Rx_f90836f8_Rx (PduRDestPdu): PduRDestPduRef=EcucPduCollection/COM_C0X_Pdu21_secured_298d825c_Rx
            PduRSrcPdu_f90836f8 (PduRSrcPdu): PduRSrcPduRef=EcucPduCollection/COM_C0X_Pdu21_secured_a474fce4_Rx
          COM_C10_Pdu01_PN08_0cb26b5d_Rx
            COM_C10_Pdu01_PN08_0cb26b5d_Rx_7f8bf99e_Rx (PduRDestPdu): PduRDestPduRef=EcucPduCollection/COM_C10_Pdu01_PN08_2a25a36a_Rx
            PduRSrcPdu_7f8bf99e (PduRSrcPdu): PduRSrcPduRef=EcucPduCollection/COM_C10_Pdu01_PN08_0cb26b5d_Rx
          COM_C10_Pdu01_PN17_4cf8c594_Rx
            COM_C10_Pdu01_PN17_4cf8c594_Rx_d79aef67_Rx (PduRDestPdu): PduRDestPduRef=EcucPduCollection/COM_C10_Pdu01_PN17_a3818fba_Rx
            PduRSrcPdu_d79aef67 (PduRSrcPdu): PduRSrcPduRef=EcucPduCollection/COM_C10_Pdu01_PN17_4cf8c594_Rx
          COM_C14_C04_Pdu01_TpConnection_0752947e_Rx
            COM_C14_C04_Pdu01_TpConnection_0752947e_Rx_4fc6a803_Rx (PduRDestPdu): PduRDestPduRef=EcucPduCollection/COM_C14_C04_Pdu01_TpConnection_0d799aba_Rx
            PduRSrcPdu_4fc6a803 (PduRSrcPdu): PduRSrcPduRef=EcucPduCollection/COM_C14_C04_Pdu01_TpConnection_0752947e_Rx
          COM_C19_Frm02_COM_C19_Pdu02_5201838a_Rx
            COM_C19_Frm02_COM_C19_Pdu02_5201838a_Rx (PduRDestPdu): PduRDestPduRef=EcucPduCollection/COM_C19_Frm02_COM_C19_Pdu02_5201838a_Rx
            PduRSrcPdu_5f39b427 (PduRSrcPdu): PduRSrcPduRef=EcucPduCollection/COM_C19_Frm02_COM_C19_Pdu02_5201838a_Rx
          COM_C19_Frm02_COM_C19_Pdu03_2506b31c_Rx
            COM_C19_Frm02_COM_C19_Pdu03_2506b31c_Rx (PduRDestPdu): PduRDestPduRef=EcucPduCollection/COM_C19_Frm02_COM_C19_Pdu03_2506b31c_Rx
            PduRSrcPdu_63317642 (PduRSrcPdu): PduRSrcPduRef=EcucPduCollection/COM_C19_Frm02_COM_C19_Pdu03_2506b31c_Rx
          COM_C19_Frm02_COM_C19_Pdu04_bb6226bf_Rx
            COM_C19_Frm02_COM_C19_Pdu04_bb6226bf_Rx (PduRDestPdu): PduRDestPduRef=EcucPduCollection/COM_C19_Frm02_COM_C19_Pdu04_bb6226bf_Rx
            PduRSrcPdu_f1117a52 (PduRSrcPdu): PduRSrcPduRef=EcucPduCollection/COM_C19_Frm02_COM_C19_Pdu04_bb6226bf_Rx
          COM_C19_Frm02_ContainerIPdu_dfac1312_Rx
            COM_C19_Frm02_ContainerIPdu_dfac1312_Rx_0892285e_Rx (PduRDestPdu): PduRDestPduRef=COM_C19_Frm02_ContainerIPdu_6a143bc8_Rx
            PduRSrcPdu_0892285e (PduRSrcPdu): PduRSrcPduRef=EcucPduCollection/COM_C19_Frm02_ContainerIPdu_dfac1312_Rx
          COM_C19_Pdu01_PN08_f0eb1e95_Rx
            COM_C19_Pdu01_PN08_f0eb1e95_Rx_b12f9fd4_Rx (PduRDestPdu): PduRDestPduRef=EcucPduCollection/COM_C19_Pdu01_PN08_7687aff4_Rx
            PduRSrcPdu_b12f9fd4 (PduRSrcPdu): PduRSrcPduRef=EcucPduCollection/COM_C19_Pdu01_PN08_f0eb1e95_Rx
          COM_C19_Pdu01_PN44_08bc86e1_Rx
            COM_C19_Pdu01_PN44_08bc86e1_Rx_742d19e7_Rx (PduRDestPdu): PduRDestPduRef=EcucPduCollection/COM_C19_Pdu01_PN44_1b5d26db_Rx
            PduRSrcPdu_742d19e7 (PduRSrcPdu): PduRSrcPduRef=EcucPduCollection/COM_C19_Pdu01_PN44_08bc86e1_Rx
          COM_SL05_Pdu01_4f2ce2ed_Rx
            COM_SL05_Pdu01_4f2ce2ed_Rx_7d7dec66_Rx (PduRDestPdu): PduRDestPduRef=EcucPduCollection/COM_SL05_Pdu01_dfc1d25f_Rx
            PduRSrcPdu_7d7dec66 (PduRSrcPdu): PduRSrcPduRef=EcucPduCollection/COM_SL05_Pdu01_4f2ce2ed_Rx
          ComIPduPnc_EIRA_CAN_Rx_cca0f11f_Rx
            ComIPduPnc_EIRA_CAN_Rx_cca0f11f_Rx_bb7efc37_Rx (PduRDestPdu): PduRDestPduRef=PduPnc_EIRA_CAN_Rx
            PduRSrcPdu_bb7efc37 (PduRSrcPdu): PduRSrcPduRef=PduPnc_EIRA_CAN_Rx
          ComIPduPnc_EIRA_ETH_Rx_9792552c_Rx
            ComIPduPnc_EIRA_ETH_Rx_9792552c_Rx_5dff20f8_Rx (PduRDestPdu): PduRDestPduRef=PduPnc_EIRA_ETH_Rx
            PduRSrcPdu_5dff20f8 (PduRSrcPdu): PduRSrcPduRef=PduPnc_EIRA_ETH_Rx
          ComIPduPnc_ERA_CAN_CAN1_Cluster4_53b2b17a_Rx_d9fafb17_Rx
            ComIPduPnc_ERA_CAN_CAN1_Cluster4_53b2b17a_Rx_d9fafb17_Rx_055a83cb_Rx (PduRDestPdu): PduRDestPduRef=PduPnc_ERA_CAN_CAN1_Cluster4_53b2b17a_Rx
            PduRSrcPdu_055a83cb (PduRSrcPdu): PduRSrcPduRef=PduPnc_ERA_CAN_CAN1_Cluster4_53b2b17a_Rx
          ComIPduPnc_ERA_CAN_CANFD1_Cluster4_0f365fd3_Rx_b91716fb_Rx
            ComIPduPnc_ERA_CAN_CANFD1_Cluster4_0f365fd3_Rx_b91716fb_Rx_d4237926_Rx (PduRDestPdu): PduRDestPduRef=PduPnc_ERA_CAN_CANFD1_Cluster4_0f365fd3_Rx
            PduRSrcPdu_d4237926 (PduRSrcPdu): PduRSrcPduRef=PduPnc_ERA_CAN_CANFD1_Cluster4_0f365fd3_Rx
          ComIPduPnc_ERA_ETH_ECU4_CRN_Eth_Cluster4_3g6xoesclytkmkqofl9pi6ol1_481bdd0f_Rx_b8319223_Rx
            ComIPduPnc_ERA_ETH_ECU4_CRN_Eth_Cluster4_3g6xoesclytkmkqofl9pi6ol1_481bdd0f_Rx_b8319223_Rx_ff01c663_Rx (PduRDestPdu): PduRDestPduRef=PduPnc_ERA_ETH_ECU4_CRN_Eth_Cluster4_3g6xoesclytkmkqofl9pi6ol1_481bdd0f_Rx
            PduRSrcPdu_ff01c663 (PduRSrcPdu): PduRSrcPduRef=PduPnc_ERA_ETH_ECU4_CRN_Eth_Cluster4_3g6xoesclytkmkqofl9pi6ol1_481bdd0f_Rx
          DIAG_C01_ONBD_Container_ST3_DIAG_Stat_ST3_bc0bc640_Rx
            DIAG_C01_ONBD_Container_ST3_DIAG_Stat_ST3_bc0bc640_Rx_ca9e8210_Rx (PduRDestPdu): PduRDestPduRef=EcucPduCollection/DIAG_C01_ONBD_Container_ST3_DIAG_Stat_ST3_1a17e5f9_Rx
            PduRSrcPdu_ca9e8210 (PduRSrcPdu): PduRSrcPduRef=EcucPduCollection/DIAG_C01_ONBD_Container_ST3_DIAG_Stat_ST3_bc0bc640_Rx
          DIAG_ROE_C04_Container_ST3_ROE_C04_PDU01_f322ff21_Tx
            DIAG_ROE_C04_Container_ST3_ROE_C04_PDU01_7787ca3b_Tx (PduRDestPdu): PduRDestPduRef=EcucPduCollection/DIAG_ROE_C04_Container_ST3_ROE_C04_PDU01_7787ca3b_Tx
            PduRSrcPdu_8b4e83c7 (PduRSrcPdu): PduRSrcPduRef=EcucPduCollection/DIAG_ROE_C04_Container_ST3_ROE_C04_PDU01_f322ff21_Tx
          DI_OdoSpeedometer_ST3_ffe5aaae_Rx
            DI_OdoSpeedometer_ST3_ffe5aaae_Rx (PduRDestPdu): PduRDestPduRef=EcucPduCollection/DI_OdoSpeedometer_ST3_ffe5aaae_Rx
            PduRSrcPdu_c2462fcc (PduRSrcPdu): PduRSrcPduRef=EcucPduCollection/DI_OdoSpeedometer_ST3_ffe5aaae_Rx
          DI_OdoSpeedometer_ST3_secured_79fb4c12_Rx
            DI_OdoSpeedometer_ST3_secured_79fb4c12_Rx_4acceff6_Rx (PduRDestPdu): PduRDestPduRef=EcucPduCollection/DI_OdoSpeedometer_ST3_secured_3b3f85d1_Rx
            PduRSrcPdu_4acceff6 (PduRSrcPdu): PduRSrcPduRef=EcucPduCollection/DI_OdoSpeedometer_ST3_secured_79fb4c12_Rx
          ECU4_CRN_0e1fb113_Rx
            ECU4_CRN_f323ea63_Tx (PduRDestPdu): PduRTpThreshold=4095, PduRDestPduRef=SDU_DIAG_RS_ExtEth_MAIN_OFBD_ST3_ECU04_C10_3ed22d43_Tx
            PduRSrcPdu_4a06fe69 (PduRSrcPdu): PduRSrcPduRef=SDU_DIAG_C10_ExtEth_RS_CAN1_CTP_b0b3ae04_Rx
          ECU4_CRN_11a27b39_Rx
            3 x PduRDestPdu:
              ECU4_CRN_11a27b39_Rx_76c3b49c_Rx: PduRDestPduRef=EcucPduCollection/VSS_TP_RealTmOffset_ST3_0b3c026b_Rx
              ECU4_CRN_646ab29f_Tx: PduRDestPduRef=C04_CANFD_1_Container_ST3_VSS_TP_RealTmOffset_ST3_98caae4d_Tx
                PduRDefaultValue
                  8 x PduRDefaultValueElement, all with PduRDefaultValueElement=255:
                    ECU4_CRN_0fc13427: PduRDefaultValueElementBytePosition=4
                    ECU4_CRN_32a11d97: PduRDefaultValueElementBytePosition=5
                    ECU4_CRN_48614ef7: PduRDefaultValueElementBytePosition=7
                    ECU4_CRN_75016747: PduRDefaultValueElementBytePosition=6
                    ECU4_CRN_8081c187: PduRDefaultValueElementBytePosition=2
                    ECU4_CRN_bde1e837: PduRDefaultValueElementBytePosition=3
                    ECU4_CRN_c721bb57: PduRDefaultValueElementBytePosition=1
                    ECU4_CRN_fa4192e7: PduRDefaultValueElementBytePosition=0
              ECU4_CRN_9f0cce42_Tx: PduRDestPduRef=VSS_TP_RealTmOffset_ST3_e30a3a18_Tx
                PduRDefaultValue
                  8 x PduRDefaultValueElement, all with PduRDefaultValueElement=255:
                    ECU4_CRN_0fc13427: PduRDefaultValueElementBytePosition=4
                    ECU4_CRN_32a11d97: PduRDefaultValueElementBytePosition=5
                    ECU4_CRN_48614ef7: PduRDefaultValueElementBytePosition=7
                    ECU4_CRN_75016747: PduRDefaultValueElementBytePosition=6
                    ECU4_CRN_8081c187: PduRDefaultValueElementBytePosition=2
                    ECU4_CRN_bde1e837: PduRDefaultValueElementBytePosition=3
                    ECU4_CRN_c721bb57: PduRDefaultValueElementBytePosition=1
                    ECU4_CRN_fa4192e7: PduRDefaultValueElementBytePosition=0
            PduRSrcPdu_76c3b49c (PduRSrcPdu): PduRSrcPduRef=VSS_TP_RealTmOffset_ST3_cbb996f7_Rx
          ECU4_CRN_20096158_Rx
            ECU4_CRN_216d26c6_Tx (PduRDestPdu): PduRTpThreshold=8191, PduRDestPduRef=SDU_DIAG_RS_IntEth_MAIN_ONBD_ST3_ECU04_C19_ec9ce1e6_Tx
            PduRSrcPdu_233113e8 (PduRSrcPdu): PduRSrcPduRef=SDU_DIAG_C19_IntEth_RS_CANFD1_CTP_1baab057_Rx
          ECU4_CRN_28a06c85_Rx
            ECU4_CRN_f5852b6d_Tx (PduRDestPdu): PduRTpThreshold=4095, PduRDestPduRef=SDU_DIAG_C10_ExtEth_RQ_CAN1_CTP_4b29347a_Tx
            PduRSrcPdu_013ca892 (PduRSrcPdu): PduRSrcPduRef=SDU_DIAG_RQ_ExtEth_MAIN_OFBD_ST3_ECU04_C10_e551aba5_Rx
          ECU4_CRN_563faf7a_Rx
            ECU4_CRN_b815f212_Tx (PduRDestPdu): PduRTpThreshold=8191, PduRDestPduRef=SDU_DIAG_C19_ExtEth_RQ_CANFD1_CTP_83b6231d_Tx
            PduRSrcPdu_89a357bd (PduRSrcPdu): PduRSrcPduRef=SDU_DIAG_RQ_ExtEth_MAIN_OFBD_ST3_ECU04_C19_9bce685a_Rx
          ECU4_CRN_5fd8981b_Rx
            ECU4_CRN_4358a100_Tx (PduRDestPdu): PduRTpThreshold=4095, PduRDestPduRef=SDU_DIAG_RS_IntEth_MAIN_ONBD_ST3_ECU04_Lin_S5_3514642e_Tx
            ECU4_CRN_543ff447_Tx (PduRDestPdu): PduRTpThreshold=4095, PduRDestPduRef=SDU_DIAG_RS_ExtEth_MAIN_OFBD_ST3_ECU04_Lin_S5_22733169_Tx
            PduRSrcPdu_dd6388a7 (PduRSrcPdu): PduRSrcPduRef=DIAG_NAD_5_RS_LIN5_Cluster4_ST3_e174870c_Rx
          ECU4_CRN_6d27eb02_Rx
            3 x PduRDestPdu:
              ECU4_CRN_0ce32691_Tx: PduRDestPduRef=Ign_Stat_ST3_secured_e8d6e35b_Tx
                PduRDefaultValue
                  8 x PduRDefaultValueElement:
                    ECU4_CRN_04fbbffb: PduRDefaultValueElement=81, PduRDefaultValueElementBytePosition=1
                    ECU4_CRN_236ea8fa: PduRDefaultValueElement=0, PduRDefaultValueElementBytePosition=2
                    ECU4_CRN_24670026: PduRDefaultValueElement=0, PduRDefaultValueElementBytePosition=6
                    ECU4_CRN_25a56a11: PduRDefaultValueElement=0, PduRDefaultValueElementBytePosition=7
                    ECU4_CRN_2621be7f: PduRDefaultValueElement=0, PduRDefaultValueElementBytePosition=5
                    ECU4_CRN_27e3d448: PduRDefaultValueElement=0, PduRDefaultValueElementBytePosition=4
                    ECU4_CRN_886dd831: PduRDefaultValueElement=150, PduRDefaultValueElementBytePosition=0
                    ECU4_CRN_bcc8576e: PduRDefaultValueElement=7, PduRDefaultValueElementBytePosition=3
              ECU4_CRN_4d86ea2b_Tx: PduRDestPduRef=C04_CANFD_1_Container_ST3_C04_CANFD_1_Container_ST3_Ign_Stat_ST3_secured_b70215f6_Tx
                PduRDefaultValue
                  8 x PduRDefaultValueElement:
                    ECU4_CRN_04fbbffb: PduRDefaultValueElement=81, PduRDefaultValueElementBytePosition=1
                    ECU4_CRN_236ea8fa: PduRDefaultValueElement=0, PduRDefaultValueElementBytePosition=2
                    ECU4_CRN_24670026: PduRDefaultValueElement=0, PduRDefaultValueElementBytePosition=6
                    ECU4_CRN_25a56a11: PduRDefaultValueElement=0, PduRDefaultValueElementBytePosition=7
                    ECU4_CRN_2621be7f: PduRDefaultValueElement=0, PduRDefaultValueElementBytePosition=5
                    ECU4_CRN_27e3d448: PduRDefaultValueElement=0, PduRDefaultValueElementBytePosition=4
                    ECU4_CRN_886dd831: PduRDefaultValueElement=150, PduRDefaultValueElementBytePosition=0
                    ECU4_CRN_bcc8576e: PduRDefaultValueElement=7, PduRDefaultValueElementBytePosition=3
              ECU4_CRN_6d27eb02_Rx_27119a8b_Rx: PduRDestPduRef=EcucPduCollection/Ign_Stat_ST3_secured_326d9726_Rx
            PduRSrcPdu_27119a8b (PduRSrcPdu): PduRSrcPduRef=Ign_Stat_ST3_secured_562d2a8e_Rx
          ECU4_CRN_79e73ce3_Rx
            ECU4_CRN_8dbc299c_Tx (PduRDestPdu): PduRTpThreshold=8191, PduRDestPduRef=SDU_DIAG_RS_ExtEth_MAIN_OFBD_ST3_ECU04_C19_404deebc_Tx
            PduRSrcPdu_7f504cfa (PduRSrcPdu): PduRSrcPduRef=SDU_DIAG_C19_ExtEth_RS_CANFD1_CTP_4244edec_Rx
          ECU4_CRN_847163df_Rx
            ECU4_CRN_697ce152_Tx (PduRDestPdu): PduRTpThreshold=4095, PduRDestPduRef=SDU_DIAG_C10_IntEth_RQ_CAN1_CTP_d7d0fe45_Tx
            PduRSrcPdu_1c98a28b (PduRSrcPdu): PduRSrcPduRef=SDU_DIAG_RQ_IntEth_MAIN_ONBD_ST3_ECU04_C10_4980a4ff_Rx
          ECU4_CRN_8e4ef78a_Rx
            ECU4_CRN_4f5ab1ff_Tx (PduRDestPdu): PduRDestPduRef=EcucPduCollection/CANFD_Eth_ST3_TPA_c67344e4_Tx
            PduRSrcPdu_7adf3fd6 (PduRSrcPdu): PduRSrcPduRef=SDU_TPA_CANFD_Eth_ST3_e66fe46e_Rx
          ECU4_CRN_92e67b2c_Rx
            ECU4_CRN_5ff2e539_Tx (PduRDestPdu): PduRTpThreshold=4095, PduRDestPduRef=SDU_DIAG_RS_IntEth_MAIN_ONBD_ST3_ECU04_C10_92032219_Tx
            PduRSrcPdu_6741775a (PduRSrcPdu): PduRSrcPduRef=SDU_DIAG_C10_IntEth_RS_CAN1_CTP_2c4a643b_Rx
          ECU4_CRN_a10f87d0_Rx
            3 x PduRDestPdu:
              ECU4_CRN_3a230a8d_Tx: PduRDestPduRef=C04_CANFD_1_Container_ST3_VSS_TP_VIN_ST3_0129cb01_Tx
                PduRDefaultValue
                  8 x PduRDefaultValueElement, all with PduRDefaultValueElement=63:
                    ECU4_CRN_43a8036b: PduRDefaultValueElementBytePosition=4
                    ECU4_CRN_511dac85: PduRDefaultValueElementBytePosition=7
                    ECU4_CRN_66c35cb7: PduRDefaultValueElementBytePosition=2
                    ECU4_CRN_7476f359: PduRDefaultValueElementBytePosition=1
                    ECU4_CRN_ccca943c: PduRDefaultValueElementBytePosition=0
                    ECU4_CRN_de7f3bd2: PduRDefaultValueElementBytePosition=3
                    ECU4_CRN_e9a1cbe0: PduRDefaultValueElementBytePosition=6
                    ECU4_CRN_fb14640e: PduRDefaultValueElementBytePosition=5
              ECU4_CRN_4241b3ff_Tx: PduRDestPduRef=VSS_TP_VIN_ST3_938749e1_Tx
                PduRDefaultValue
                  8 x PduRDefaultValueElement, all with PduRDefaultValueElement=63:
                    ECU4_CRN_43a8036b: PduRDefaultValueElementBytePosition=4
                    ECU4_CRN_511dac85: PduRDefaultValueElementBytePosition=7
                    ECU4_CRN_66c35cb7: PduRDefaultValueElementBytePosition=2
                    ECU4_CRN_7476f359: PduRDefaultValueElementBytePosition=1
                    ECU4_CRN_ccca943c: PduRDefaultValueElementBytePosition=0
                    ECU4_CRN_de7f3bd2: PduRDefaultValueElementBytePosition=3
                    ECU4_CRN_e9a1cbe0: PduRDefaultValueElementBytePosition=6
                    ECU4_CRN_fb14640e: PduRDefaultValueElementBytePosition=5
              ECU4_CRN_a10f87d0_Rx_e708744d_Rx: PduRDestPduRef=EcucPduCollection/VSS_TP_VIN_ST3_97a3d79b_Rx
            PduRSrcPdu_e708744d (PduRSrcPdu): PduRSrcPduRef=VSS_TP_VIN_ST3_dc926874_Rx
          ECU4_CRN_a2faa145_Rx
            3 x PduRDestPdu:
              ECU4_CRN_66a4e7f5_Tx: PduRDestPduRef=C04_CANFD_1_Container_ST3_VSS_TP_SharedSecret_ST3_9a04fb27_Tx
                PduRDefaultValue
                  8 x PduRDefaultValueElement, all with PduRDefaultValueElement=255:
                    ECU4_CRN_0fc13427: PduRDefaultValueElementBytePosition=4
                    ECU4_CRN_32a11d97: PduRDefaultValueElementBytePosition=5
                    ECU4_CRN_48614ef7: PduRDefaultValueElementBytePosition=7
                    ECU4_CRN_75016747: PduRDefaultValueElementBytePosition=6
                    ECU4_CRN_8081c187: PduRDefaultValueElementBytePosition=2
                    ECU4_CRN_bde1e837: PduRDefaultValueElementBytePosition=3
                    ECU4_CRN_c721bb57: PduRDefaultValueElementBytePosition=1
                    ECU4_CRN_fa4192e7: PduRDefaultValueElementBytePosition=0
              ECU4_CRN_7a80702a_Tx: PduRDestPduRef=VSS_TP_SharedSecret_ST3_06868470_Tx
                PduRDefaultValue
                  8 x PduRDefaultValueElement, all with PduRDefaultValueElement=255:
                    ECU4_CRN_0fc13427: PduRDefaultValueElementBytePosition=4
                    ECU4_CRN_32a11d97: PduRDefaultValueElementBytePosition=5
                    ECU4_CRN_48614ef7: PduRDefaultValueElementBytePosition=7
                    ECU4_CRN_75016747: PduRDefaultValueElementBytePosition=6
                    ECU4_CRN_8081c187: PduRDefaultValueElementBytePosition=2
                    ECU4_CRN_bde1e837: PduRDefaultValueElementBytePosition=3
                    ECU4_CRN_c721bb57: PduRDefaultValueElementBytePosition=1
                    ECU4_CRN_fa4192e7: PduRDefaultValueElementBytePosition=0
              ECU4_CRN_a2faa145_Rx_686b8e2b_Rx: PduRDestPduRef=EcucPduCollection/VSS_TP_SharedSecret_ST3_09f25701_Rx
            PduRSrcPdu_686b8e2b (PduRSrcPdu): PduRSrcPduRef=VSS_TP_SharedSecret_ST3_78e14c8b_Rx
          ECU4_CRN_d3dd9e84_Rx
            3 x PduRDestPdu:
              ECU4_CRN_3499b118_Tx: PduRDestPduRef=C04_CANFD_1_Container_ST3_VSS_TP_Auth_ST3_d0ac74d2_Tx
                PduRDefaultValue
                  8 x PduRDefaultValueElement, all with PduRDefaultValueElement=255:
                    ECU4_CRN_0fc13427: PduRDefaultValueElementBytePosition=4
                    ECU4_CRN_32a11d97: PduRDefaultValueElementBytePosition=5
                    ECU4_CRN_48614ef7: PduRDefaultValueElementBytePosition=7
                    ECU4_CRN_75016747: PduRDefaultValueElementBytePosition=6
                    ECU4_CRN_8081c187: PduRDefaultValueElementBytePosition=2
                    ECU4_CRN_bde1e837: PduRDefaultValueElementBytePosition=3
                    ECU4_CRN_c721bb57: PduRDefaultValueElementBytePosition=1
                    ECU4_CRN_fa4192e7: PduRDefaultValueElementBytePosition=0
              ECU4_CRN_88618c67_Tx: PduRDestPduRef=VSS_TP_Auth_ST3_72bf77fe_Tx
                PduRDefaultValue
                  8 x PduRDefaultValueElement, all with PduRDefaultValueElement=255:
                    ECU4_CRN_0fc13427: PduRDefaultValueElementBytePosition=4
                    ECU4_CRN_32a11d97: PduRDefaultValueElementBytePosition=5
                    ECU4_CRN_48614ef7: PduRDefaultValueElementBytePosition=7
                    ECU4_CRN_75016747: PduRDefaultValueElementBytePosition=6
                    ECU4_CRN_8081c187: PduRDefaultValueElementBytePosition=2
                    ECU4_CRN_bde1e837: PduRDefaultValueElementBytePosition=3
                    ECU4_CRN_c721bb57: PduRDefaultValueElementBytePosition=1
                    ECU4_CRN_fa4192e7: PduRDefaultValueElementBytePosition=0
              ECU4_CRN_d3dd9e84_Rx_6a8108e0_Rx: PduRDestPduRef=EcucPduCollection/VSS_TP_Auth_ST3_c0e08494_Rx
            PduRSrcPdu_6a8108e0 (PduRSrcPdu): PduRSrcPduRef=VSS_TP_Auth_ST3_021b649a_Rx
          ECU4_CRN_d5a9c01c_Rx
            ECU4_CRN_dc1f8cfc_Tx (PduRDestPdu): PduRDestPduRef=SDU_TPA_Eth_CANFD_ST3_b43e9f18_Tx
            PduRSrcPdu_6307a128 (PduRSrcPdu): PduRSrcPduRef=Eth_CANFD_ST3_TPA_5c803507_Rx
          ECU4_CRN_e038b5d9_Rx
            ECU4_CRN_ed14e8cd_Tx_ECU4_CRN_e038b5d9_Rx (PduRDestPdu): PduRTpThreshold=4095, PduRDestPduRef=DIAG_NAD_5_RQ_LIN5_Cluster4_ST3_53b8f7da_Tx
            PduRSrcPdu_7657e9b8 (PduRSrcPdu): PduRSrcPduRef=SDU_DIAG_RQ_ExtEth_MAIN_OFBD_ST3_ECU04_Lin_S5_967470f7_Rx
          ECU4_CRN_e5571b1e_Rx
            3 x PduRDestPdu:
              ECU4_CRN_950254c9_Tx: PduRDestPduRef=SDU_DIAG_GLOBAL_IntEth_RQ_CANFD1_ST3_49a215c3_Tx
              ECU4_CRN_a2677d88_Tx: PduRDestPduRef=SDU_DIAG_GLOBAL_IntEth_RQ_CAN1_ST3_a934299e_Tx
              ECU4_CRN_e5571b1e_Rx_48da721e_Rx: PduRDestPduRef=SDU_DIAG_RQ_IntEth_MAIN_ONBD_ST3_ECU04_GLOBAL_1c42336f_Rx
            PduRSrcPdu_48da721e (PduRSrcPdu): PduRSrcPduRef=SDU_DIAG_RQ_IntEth_MAIN_ONBD_ST3_ECU04_GLOBAL_931bde30_Rx
          ECU4_CRN_f2304e59_Rx
            3 x PduRDestPdu:
              ECU4_CRN_3e9eb7b7_Tx: PduRDestPduRef=SDU_DIAG_GLOBAL_ExtEth_RQ_CAN1_ST3_35cde3a1_Tx
              ECU4_CRN_ccec0972_Tx: PduRDestPduRef=SDU_DIAG_GLOBAL_ExtEth_RQ_CANFD1_ST3_104c4878_Tx
              ECU4_CRN_f2304e59_Rx_715d7630_Rx: PduRDestPduRef=SDU_DIAG_RQ_ExtEth_MAIN_OFBD_ST3_ECU04_GLOBAL_d92b43b1_Rx
            PduRSrcPdu_715d7630 (PduRSrcPdu): PduRSrcPduRef=SDU_DIAG_RQ_ExtEth_MAIN_OFBD_ST3_ECU04_GLOBAL_847c8b77_Rx
          ECU4_CRN_f75fe09e_Rx
            ECU4_CRN_ed14e8cd_Tx (PduRDestPdu): PduRTpThreshold=4095, PduRDestPduRef=DIAG_NAD_5_RQ_LIN5_Cluster4_ST3_53b8f7da_Tx
            PduRSrcPdu_eaed18e3 (PduRSrcPdu): PduRSrcPduRef=SDU_DIAG_RQ_IntEth_MAIN_ONBD_ST3_ECU04_Lin_S5_811325b0_Rx
          ECU4_CRN_faeea020_Rx
            ECU4_CRN_e1fbafa9_Tx (PduRDestPdu): PduRTpThreshold=8191, PduRDestPduRef=SDU_DIAG_C19_IntEth_RQ_CANFD1_CTP_da587ea6_Tx
            PduRSrcPdu_dd7642eb (PduRSrcPdu): PduRSrcPduRef=SDU_DIAG_RQ_IntEth_MAIN_ONBD_ST3_ECU04_C19_371f6700_Rx
          ECU_Stat_C04_CAN1_2bd34198_Tx
            ECU_Stat_C04_CAN1_d3b8616c_Tx (PduRDestPdu): PduRDestPduRef=EcucPduCollection/ECU_Stat_C04_CAN1_d3b8616c_Tx
            PduRSrcPdu_2131113b (PduRSrcPdu): PduRSrcPduRef=EcucPduCollection/ECU_Stat_C04_CAN1_2bd34198_Tx
          ECU_Stat_C04_CANFD1_fd91aa71_Tx
            ECU_Stat_C04_CANFD1_ca9d12b7_Tx (PduRDestPdu): PduRDestPduRef=EcucPduCollection/ECU_Stat_C04_CANFD1_ca9d12b7_Tx
            PduRSrcPdu_45a142d9 (PduRSrcPdu): PduRSrcPduRef=EcucPduCollection/ECU_Stat_C04_CANFD1_fd91aa71_Tx
          ECU_Stat_C04_ETH_Container_ECU_Stat_C04_ETH_47aafe39_Tx
            ECU_Stat_C04_ETH_Container_ECU_Stat_C04_ETH_411314f1_Tx (PduRDestPdu): PduRDestPduRef=EcucPduCollection/ECU_Stat_C04_ETH_Container_ECU_Stat_C04_ETH_411314f1_Tx
            PduRSrcPdu_80cb3b9e (PduRSrcPdu): PduRSrcPduRef=EcucPduCollection/ECU_Stat_C04_ETH_Container_ECU_Stat_C04_ETH_47aafe39_Tx
          FBL_Cfg_Star3_ST3_bdf2a476_Rx
            FBL_Cfg_Star3_ST3_bdf2a476_Rx_5d5fc6f9_Rx (PduRDestPdu): PduRDestPduRef=EcucPduCollection/FBL_Cfg_Star3_ST3_b7257cce_Rx
            PduRSrcPdu_5d5fc6f9 (PduRSrcPdu): PduRSrcPduRef=EcucPduCollection/FBL_Cfg_Star3_ST3_bdf2a476_Rx
          Ign_Stat_ST3_dacb1e38_Rx
            Ign_Stat_ST3_dacb1e38_Rx (PduRDestPdu): PduRDestPduRef=EcucPduCollection/Ign_Stat_ST3_dacb1e38_Rx
            PduRSrcPdu_7202cc32 (PduRSrcPdu): PduRSrcPduRef=EcucPduCollection/Ign_Stat_ST3_dacb1e38_Rx
          NM_C04_04d2ea88_Tx
            NM_C04_04d2ea88_Tx_4328a151_Tx (PduRDestPdu): PduRDestPduRef=EcucPduCollection/NM_C04_04d2ea88_Tx
            PduRSrcPdu_4328a151 (PduRSrcPdu): PduRSrcPduRef=EcucPduCollection/NM_C04_04d2ea88_Tx
          NM_C04_0b5d1bc3_Tx
            NM_C04_0b5d1bc3_Tx_c88e3efb_Tx (PduRDestPdu): PduRDestPduRef=EcucPduCollection/NM_C04_0b5d1bc3_Tx
            PduRSrcPdu_c88e3efb (PduRSrcPdu): PduRSrcPduRef=EcucPduCollection/NM_C04_0b5d1bc3_Tx
          NM_C04_d7c6e387_Tx
            NM_C04_d7c6e387_Tx_99766e6d_Tx (PduRDestPdu): PduRDestPduRef=EcucPduCollection/NM_C04_d7c6e387_Tx
            PduRSrcPdu_99766e6d (PduRSrcPdu): PduRSrcPduRef=EcucPduCollection/NM_C04_d7c6e387_Tx
          PN14_Master_Stat1_ST3_7ba93c2a_Rx
            PN14_Master_Stat1_ST3_7ba93c2a_Rx (PduRDestPdu): PduRDestPduRef=EcucPduCollection/PN14_Master_Stat1_ST3_7ba93c2a_Rx
            PduRSrcPdu_9cd16b2d (PduRSrcPdu): PduRSrcPduRef=EcucPduCollection/PN14_Master_Stat1_ST3_7ba93c2a_Rx
          PN14_Master_Stat1_ST3_secured_dc8c4316_Rx
            PN14_Master_Stat1_ST3_secured_dc8c4316_Rx_ae13e1f9_Rx (PduRDestPdu): PduRDestPduRef=EcucPduCollection/PN14_Master_Stat1_ST3_secured_5caa91b2_Rx
            PduRSrcPdu_ae13e1f9 (PduRSrcPdu): PduRSrcPduRef=EcucPduCollection/PN14_Master_Stat1_ST3_secured_dc8c4316_Rx
          PT4_PTCoor4_ST3_0379360e_Rx
            PT4_PTCoor4_ST3_0379360e_Rx (PduRDestPdu): PduRDestPduRef=EcucPduCollection/PT4_PTCoor4_ST3_0379360e_Rx
            PduRSrcPdu_bcdf56f7 (PduRSrcPdu): PduRSrcPduRef=EcucPduCollection/PT4_PTCoor4_ST3_0379360e_Rx
          PT4_PTCoor4_ST3_secured_201e7857_Rx
            PT4_PTCoor4_ST3_secured_201e7857_Rx_a9d5ce57_Rx (PduRDestPdu): PduRDestPduRef=EcucPduCollection/PT4_PTCoor4_ST3_secured_5e7a1571_Rx
            PduRSrcPdu_a9d5ce57 (PduRSrcPdu): PduRSrcPduRef=EcucPduCollection/PT4_PTCoor4_ST3_secured_201e7857_Rx
          SDU_DIAG_ECU4_CTP_03_ExtCAN_RQ_FD1_ST3_8b6dc0cd_Rx
            SDU_DIAG_ECU4_CTP_03_ExtCAN_RQ_FD1_ST3_8b6dc0cd_Rx_59cc7805_Rx (PduRDestPdu): PduRDestPduRef=SDU_DIAG_ECU4_CTP_03_ExtCAN_RQ_FD1_ST3_af4ae167_Rx
            PduRSrcPdu_59cc7805 (PduRSrcPdu): PduRSrcPduRef=EcucPduCollection/SDU_DIAG_ECU4_CTP_03_ExtCAN_RQ_FD1_ST3_8b6dc0cd_Rx
          SDU_DIAG_ECU4_CTP_03_ExtCAN_RS_FD1_ST3_81bcc9e1_Tx
            SDU_DIAG_ECU4_CTP_03_ExtCAN_RS_FD1_ST3_4e769da6_Tx (PduRDestPdu): PduRDestPduRef=EcucPduCollection/SDU_DIAG_ECU4_CTP_03_ExtCAN_RS_FD1_ST3_4e769da6_Tx
            PduRSrcPdu_c896a12e (PduRSrcPdu): PduRSrcPduRef=EcucPduCollection/SDU_DIAG_ECU4_CTP_03_ExtCAN_RS_FD1_ST3_81bcc9e1_Tx
          SDU_DIAG_GLOBAL_ExtCAN_RQ_CANFD1_ST3_35fdc983_Rx
            SDU_DIAG_GLOBAL_ExtCAN_RQ_CANFD1_ST3_35fdc983_Rx_61ca31bf_Rx (PduRDestPdu): PduRDestPduRef=SDU_DIAG_GLOBAL_ExtCAN_RQ_CANFD1_ST3_18b817bc_Rx
            PduRSrcPdu_61ca31bf (PduRSrcPdu): PduRSrcPduRef=EcucPduCollection/SDU_DIAG_GLOBAL_ExtCAN_RQ_CANFD1_ST3_35fdc983_Rx
          SDU_DIAG_RQ_ExtEth_MAIN_OFBD_ST3_ECU04_C04_52383531_Rx
            SDU_DIAG_RQ_ExtEth_MAIN_OFBD_ST3_ECU04_C04_52383531_Rx_b22e5ec0_Rx (PduRDestPdu): PduRDestPduRef=SDU_DIAG_RQ_ExtEth_MAIN_OFBD_ST3_ECU04_C04_3a711a64_Rx
            PduRSrcPdu_b22e5ec0 (PduRSrcPdu): PduRSrcPduRef=EcucPduCollection/SDU_DIAG_RQ_ExtEth_MAIN_OFBD_ST3_ECU04_C04_52383531_Rx
          SDU_DIAG_RQ_IntEth_MAIN_ONBD_ST3_ECU04_C04_fee93a6b_Rx
            SDU_DIAG_RQ_IntEth_MAIN_ONBD_ST3_ECU04_C04_fee93a6b_Rx_4a3e9c18_Rx (PduRDestPdu): PduRDestPduRef=SDU_DIAG_RQ_IntEth_MAIN_ONBD_ST3_ECU04_C04_7c45d2e1_Rx
            PduRSrcPdu_4a3e9c18 (PduRSrcPdu): PduRSrcPduRef=EcucPduCollection/SDU_DIAG_RQ_IntEth_MAIN_ONBD_ST3_ECU04_C04_fee93a6b_Rx
          SDU_DIAG_RS_ExtEth_MAIN_OFBD_ST3_ECU04_C04_02b41771_Tx
            SDU_DIAG_RS_ExtEth_MAIN_OFBD_ST3_ECU04_C04_89bbb3d7_Tx (PduRDestPdu): PduRDestPduRef=EcucPduCollection/SDU_DIAG_RS_ExtEth_MAIN_OFBD_ST3_ECU04_C04_89bbb3d7_Tx
            PduRSrcPdu_dc227358 (PduRSrcPdu): PduRSrcPduRef=EcucPduCollection/SDU_DIAG_RS_ExtEth_MAIN_OFBD_ST3_ECU04_C04_02b41771_Tx
          SDU_DIAG_RS_IntEth_MAIN_ONBD_ST3_ECU04_C04_4480dff4_Tx
            SDU_DIAG_RS_IntEth_MAIN_ONBD_ST3_ECU04_C04_256abc8d_Tx (PduRDestPdu): PduRDestPduRef=EcucPduCollection/SDU_DIAG_RS_IntEth_MAIN_ONBD_ST3_ECU04_C04_256abc8d_Tx
            PduRSrcPdu_8f6007f7 (PduRSrcPdu): PduRSrcPduRef=EcucPduCollection/SDU_DIAG_RS_IntEth_MAIN_ONBD_ST3_ECU04_C04_4480dff4_Tx
          VSS_TP_SecTickCount_Lvl1_ST3_9c1812ac_Rx
            VSS_TP_SecTickCount_Lvl1_ST3_9c1812ac_Rx_4d4bd3d7_Rx (PduRDestPdu): PduRDestPduRef=EcucPduCollection/VSS_TP_SecTickCount_Lvl1_ST3_c81cbef9_Rx
            PduRSrcPdu_4d4bd3d7 (PduRSrcPdu): PduRSrcPduRef=EcucPduCollection/VSS_TP_SecTickCount_Lvl1_ST3_9c1812ac_Rx
          VSS_TP_SecTickCount_Lvl2_ST3_a413568f_Tx
            VSS_TP_SecTickCount_Lvl2_ST3_97652edb_Tx (PduRDestPdu): PduRDestPduRef=EcucPduCollection/VSS_TP_SecTickCount_Lvl2_ST3_97652edb_Tx
            PduRSrcPdu_e157a95e (PduRSrcPdu): PduRSrcPduRef=EcucPduCollection/VSS_TP_SecTickCount_Lvl2_ST3_a413568f_Tx
          VehSpd_8_ST3_a4557cc9_Rx
            VehSpd_8_ST3_a4557cc9_Rx (PduRDestPdu): PduRDestPduRef=EcucPduCollection/VehSpd_8_ST3_a4557cc9_Rx
            PduRSrcPdu_0776bc49 (PduRSrcPdu): PduRSrcPduRef=EcucPduCollection/VehSpd_8_ST3_a4557cc9_Rx
          VehSpd_8_ST3_secured_f1100af2_Rx
            VehSpd_8_ST3_secured_f1100af2_Rx_b72802aa_Rx (PduRDestPdu): PduRDestPduRef=EcucPduCollection/VehSpd_8_ST3_secured_7c0bf7a3_Rx
            PduRSrcPdu_b72802aa (PduRSrcPdu): PduRSrcPduRef=EcucPduCollection/VehSpd_8_ST3_secured_f1100af2_Rx
  module config Sd
    SdConfig
      ECU4_CRN_Eth_Cluster4_3l8iyw65auc022so95pkbhyzp_3cc7b164 (SdInstance)
        8 x SdClientService, all with SdClientServiceMajorVersion=1, SdClientServiceMinorVersion=0:
          CSI_12577_Service_Eth_CANFD_ST3_TPA_10_cb17163c: SdClientServiceId=12577, SdClientServiceInstanceId=10, SdClientServiceTimerRef=CSI_12577_Service_Eth_CANFD_ST3_TPA_10_1a0a0643
            EG_12577_1_Eth_CANFD_da798e3a (SdConsumedEventGroup):
              SdConsumedEventGroupId = 1
              SdConsumedEventGroupTcpActivationRef = Service_Id_12577_SI_ID_10_Eth_CANFD_AC_d28c2093
              SdConsumedEventGroupTimerRef = EG_12577_1_Eth_CANFD_6ac11952
          CSI_12804_DI_OdoSpeedometer_Service_ST3_0_0614c334: SdClientServiceId=12804, SdClientServiceInstanceId=0, SdClientServiceTimerRef=CSI_12804_DI_OdoSpeedometer_Service_ST3_0_e547b20b
            EG_12804_0_DI_Master_Odometer_8bede747 (SdConsumedEventGroup):
              SdConsumedEventGroupId = 0
              SdConsumedEventGroupTimerRef = EG_12804_0_DI_Master_Odometer_8208d449
              SdConsumedEventGroupUdpActivationRef = Service_Id_12804_SI_ID_0_DI_Master_Odometer_AC_93a1f098
          CSI_128_Immobilizer_Master_Service_ST3_1_0_9b76f1fc: SdClientServiceId=128, SdClientServiceInstanceId=0, SdClientServiceTimerRef=CSI_128_Immobilizer_Master_Service_ST3_1_0_598742a7
            EG_128_0_Ign_Stat_2ae92f1e (SdConsumedEventGroup):
              SdConsumedEventGroupId = 0
              SdConsumedEventGroupMulticastActivationRef = Service_Id_128_SI_ID_0_Ign_Stat_AM_2f00d482
              SdConsumedEventGroupTimerRef = EG_128_0_Ign_Stat_9714868c
              SdConsumedEventGroupUdpActivationRef = Service_Id_128_SI_ID_0_Ign_Stat_ACT_231eb536
          CSI_14596_PT4_PTCoor_Service_ST3_0_3918b492: SdClientServiceId=14596, SdClientServiceInstanceId=0, SdClientServiceTimerRef=CSI_14596_PT4_PTCoor_Service_ST3_0_06a2c3f8
            EG_14596_0_PT4_PTCoor4_2793a980 (SdConsumedEventGroup):
              SdConsumedEventGroupId = 0
              SdConsumedEventGroupMulticastActivationRef = Service_Id_14596_SI_ID_0_PT4_PTCoor4_AM_abd0aae4
              SdConsumedEventGroupTimerRef = EG_14596_0_PT4_PTCoor4_75ff7a37
              SdConsumedEventGroupUdpActivationRef = Service_Id_14596_SI_ID_0_PT4_PTCoor4_AC_4c6887e3
          CSI_14720_PN14_Master_Service_ST3_0_47ebb197: SdClientServiceId=14720, SdClientServiceInstanceId=0, SdClientServiceTimerRef=CSI_14720_PN14_Master_Service_ST3_0_ae943408
            EG_14720_0_PN14_Master_e2f87c8d (SdConsumedEventGroup):
              SdConsumedEventGroupId = 0
              SdConsumedEventGroupMulticastActivationRef = Service_Id_14720_SI_ID_0_PN14_Master_AM_9da4b2b2
              SdConsumedEventGroupTimerRef = EG_14720_0_PN14_Master_52dec41a
              SdConsumedEventGroupUdpActivationRef = Service_Id_14720_SI_ID_0_PN14_Master_AC_7a1c9fb5
          CSI_16640_VSS_Service_CTP_0_6b8ab588: SdClientServiceId=16640, SdClientServiceInstanceId=0, SdClientServiceTimerRef=CSI_16640_VSS_Service_CTP_0_b1bf7a32
            EG_16640_0_VSS_12fc2163 (SdConsumedEventGroup):
              SdConsumedEventGroupId = 0
              SdConsumedEventGroupMulticastActivationRef = Service_Id_16640_SI_ID_0_VSS_AM_cc70e810
              SdConsumedEventGroupTimerRef = EG_16640_0_VSS_a0280a51
              SdConsumedEventGroupUdpActivationRef = Service_Id_16640_SI_ID_0_VSS_ACT_3dfc3762
          CSI_4244_COM_C0X_Srv100_CTP_10_830f39fd: SdClientServiceId=4244, SdClientServiceInstanceId=10, SdClientServiceTimerRef=CSI_4244_COM_C0X_Srv100_CTP_10_1de4116d
            EG_4244_1_Event_1_a8561fff (SdConsumedEventGroup):
              SdConsumedEventGroupId = 1
              SdConsumedEventGroupMulticastActivationRef = Service_Id_4244_SI_ID_10_Event_1_AM_cffe50fa
              SdConsumedEventGroupTimerRef = EG_4244_1_Event_1_5c2f3bbd
              SdConsumedEventGroupUdpActivationRef = Service_Id_4244_SI_ID_10_Event_1_AC_28467dfd
            EG_4244_2_Event_2_08d27280 (SdConsumedEventGroup):
              SdConsumedEventGroupId = 2
              SdConsumedEventGroupMulticastActivationRef = Service_Id_4244_SI_ID_10_Event_2_AM_dd4bff14
              SdConsumedEventGroupTimerRef = EG_4244_2_Event_2_f1587150
              SdConsumedEventGroupUdpActivationRef = Service_Id_4244_SI_ID_10_Event_2_AC_3af3d213
          CSI_7810_Veh_Speed_Service_ST3_1_d1948ff1: SdClientServiceId=7810, SdClientServiceInstanceId=1, SdClientServiceTimerRef=CSI_7810_Veh_Speed_Service_ST3_1_797114ae
            EG_7810_7_Vehspd_8_bf8c88f2 (SdConsumedEventGroup):
              SdConsumedEventGroupId = 7
              SdConsumedEventGroupMulticastActivationRef = Service_Id_7810_SI_ID_1_Vehspd_8_AM_da805f87
              SdConsumedEventGroupTimerRef = EG_7810_7_Vehspd_8_d38b35ac
              SdConsumedEventGroupUdpActivationRef = Service_Id_7810_SI_ID_1_Vehspd_8_AC_3d387280
        17 x SdClientTimer, all with SdClientTimerInitialFindRepetitionsBaseDelay=0.04, SdClientTimerInitialFindRepetitionsMax=9, SdClientTimerRequestResponseMaxDelay=0.02, SdClientTimerRequestResponseMinDelay=0, SdClientTimerTTL=16777215:
          CSI_12577_Service_Eth_CANFD_ST3_TPA_10_1a0a0643: SdClientTimerInitialFindDelayMax=0.02, SdClientTimerInitialFindDelayMin=0.02
          CSI_12804_DI_OdoSpeedometer_Service_ST3_0_e547b20b: SdClientTimerInitialFindDelayMax=0.105, SdClientTimerInitialFindDelayMin=0.105
          CSI_128_Immobilizer_Master_Service_ST3_1_0_598742a7: SdClientTimerInitialFindDelayMax=0, SdClientTimerInitialFindDelayMin=0
          CSI_14596_PT4_PTCoor_Service_ST3_0_06a2c3f8: SdClientTimerInitialFindDelayMax=0.07, SdClientTimerInitialFindDelayMin=0.07
          CSI_14720_PN14_Master_Service_ST3_0_ae943408: SdClientTimerInitialFindDelayMax=0.015, SdClientTimerInitialFindDelayMin=0.015
          CSI_16640_VSS_Service_CTP_0_b1bf7a32: SdClientTimerInitialFindDelayMax=0, SdClientTimerInitialFindDelayMin=0
          CSI_4244_COM_C0X_Srv100_CTP_10_1de4116d: SdClientTimerInitialFindDelayMax=0.04, SdClientTimerInitialFindDelayMin=0.04
          CSI_7810_Veh_Speed_Service_ST3_1_797114ae: SdClientTimerInitialFindDelayMax=0.01, SdClientTimerInitialFindDelayMin=0.01
          EG_12577_1_Eth_CANFD_6ac11952: SdClientTimerInitialFindDelayMax=0.02, SdClientTimerInitialFindDelayMin=0.02
          EG_12804_0_DI_Master_Odometer_8208d449: SdClientTimerInitialFindDelayMax=0.105, SdClientTimerInitialFindDelayMin=0.105
          EG_128_0_Ign_Stat_9714868c: SdClientTimerInitialFindDelayMax=0, SdClientTimerInitialFindDelayMin=0
          EG_14596_0_PT4_PTCoor4_75ff7a37: SdClientTimerInitialFindDelayMax=0.07, SdClientTimerInitialFindDelayMin=0.07
          EG_14720_0_PN14_Master_52dec41a: SdClientTimerInitialFindDelayMax=0.015, SdClientTimerInitialFindDelayMin=0.015
          EG_16640_0_VSS_a0280a51: SdClientTimerInitialFindDelayMax=0, SdClientTimerInitialFindDelayMin=0
          EG_4244_1_Event_1_5c2f3bbd: SdClientTimerInitialFindDelayMax=0.04, SdClientTimerInitialFindDelayMin=0.04
          EG_4244_2_Event_2_f1587150: SdClientTimerInitialFindDelayMax=0.04, SdClientTimerInitialFindDelayMin=0.04
          EG_7810_7_Vehspd_8_d38b35ac: SdClientTimerInitialFindDelayMax=0.01, SdClientTimerInitialFindDelayMin=0.01
        SdInstanceMulticastRxPdu: SdRxPduRef=SD_Ctrl_Rx_Multicast_963ccc44_Rx
        SdInstanceTxPdu: SdTxPduRef=EcucPduCollection/SD_Ctrl_Tx_aab32b2d_Tx
        SdInstanceUnicastRxPdu: SdRxPduRef=SD_Ctrl_Rx_7ba60884_Rx
        4 x SdServerService, all with SdServerServiceMajorVersion=1, SdServerServiceMinorVersion=0:
          PSI_1025_COM_C04_Frm02_1_ee2d80f7: SdServerServiceId=1025, SdServerServiceInstanceId=1, SdServerServiceTimerRef=PSI_1025_COM_C04_Frm02_1_226c1291
            SdProvidedMethods: SdServerServiceActivationRef=Service_1025_SI_ID_1_Methods_2cb8f438
          PSI_1026_COM_C04_Frm03_1_ec16ece5: SdServerServiceId=1026, SdServerServiceInstanceId=1, SdServerServiceTimerRef=PSI_1026_COM_C04_Frm03_1_b57004ce
            EH_1026_EG01_3e065637 (SdEventHandler): SdEventHandlerEventGroupId=1, SdEventHandlerMulticastThreshold=0, SdEventHandlerTimerRef=EH_1026_EG01_cec153e5
              SdEventHandlerTcp: SdEventActivationRef=Service_Id_1026_SI_ID_1_EG01_AC_15b5e2e2
          PSI_12576_Service_CANFD_Eth_ST3_TPA_10_73f97216: SdServerServiceId=12576, SdServerServiceInstanceId=10, SdServerServiceTimerRef=PSI_12576_Service_CANFD_Eth_ST3_TPA_10_56c74872
            EH_12576_CANFD_Eth_552b325e (SdEventHandler): SdEventHandlerEventGroupId=1, SdEventHandlerMulticastThreshold=0, SdEventHandlerTimerRef=EH_12576_CANFD_Eth_c8ea7c80
              SdEventHandlerTcp: SdEventActivationRef=Service_Id_12576_SI_ID_10_CANFD_Eth_AC_db39ea6d
          PSI_4116_COM_C04_Srv100_CTP_10_80d15222: SdServerServiceId=4116, SdServerServiceInstanceId=10, SdServerServiceTimerRef=PSI_4116_COM_C04_Srv100_CTP_10_b5cf27c5
            EH_4116_Event_1_29241775 (SdEventHandler): SdEventHandlerEventGroupId=1, SdEventHandlerMulticastThreshold=7, SdEventHandlerTimerRef=EH_4116_Event_1_43e31b6b
              SdEventHandlerMulticast: SdEventActivationRef=Service_Id_4116_SI_ID_10_Event_1_AM_16569f7a
              SdEventHandlerUdp: SdEventActivationRef=Service_Id_4116_SI_ID_10_Event_1_AC_f1eeb27d
            EH_4116_Event_2_b02d46cf (SdEventHandler): SdEventHandlerEventGroupId=2, SdEventHandlerMulticastThreshold=7, SdEventHandlerTimerRef=EH_4116_Event_2_ec4a56a1
              SdEventHandlerMulticast: SdEventActivationRef=Service_Id_4116_SI_ID_10_Event_2_AM_04e33094
              SdEventHandlerUdp: SdEventActivationRef=Service_Id_4116_SI_ID_10_Event_2_AC_e35b1d93
        8 x SdServerTimer, all with SdServerTimerInitialOfferRepetitionBaseDelay=0.15, SdServerTimerInitialOfferRepetitionsMax=2, SdServerTimerOfferCyclicDelay=0, SdServerTimerRequestResponseMaxDelay=0, SdServerTimerRequestResponseMinDelay=0, SdServerTimerTTL=16777215:
          EH_1026_EG01_cec153e5: SdServerTimerInitialOfferDelayMax=0.025, SdServerTimerInitialOfferDelayMin=0.025
          EH_12576_CANFD_Eth_c8ea7c80: SdServerTimerInitialOfferDelayMax=0.02, SdServerTimerInitialOfferDelayMin=0.02
          EH_4116_Event_1_43e31b6b: SdServerTimerInitialOfferDelayMax=0.005, SdServerTimerInitialOfferDelayMin=0.005
          EH_4116_Event_2_ec4a56a1: SdServerTimerInitialOfferDelayMax=0.005, SdServerTimerInitialOfferDelayMin=0.005
          PSI_1025_COM_C04_Frm02_1_226c1291: SdServerTimerInitialOfferDelayMax=0.015, SdServerTimerInitialOfferDelayMin=0.015
          PSI_1026_COM_C04_Frm03_1_b57004ce: SdServerTimerInitialOfferDelayMax=0.025, SdServerTimerInitialOfferDelayMin=0.025
          PSI_12576_Service_CANFD_Eth_ST3_TPA_10_56c74872: SdServerTimerInitialOfferDelayMax=0.02, SdServerTimerInitialOfferDelayMin=0.02
          PSI_4116_COM_C04_Srv100_CTP_10_b5cf27c5: SdServerTimerInitialOfferDelayMax=0.005, SdServerTimerInitialOfferDelayMin=0.005
    SdGeneral
  module config SecOC
    7 x SecOCRxPduProcessing, all with SecOCAuthInfoTxLength=24, SecOCAuthenticationVerifyAttempts=0, SecOCFreshnessValueId=1, SecOCFreshnessValueLength=40, SecOCFreshnessValueTxLength=8:
      COM_C0X_Pdu20_secured_3ef6961f_Rx: SecOCDataId=43676
        COM_C0X_Pdu20_79a05f1a_Rx (SecOCRxAuthenticPduLayer): SecOCRxAuthenticLayerPduRef=EcucPduCollection/COM_C0X_Pdu20_79a05f1a_Rx
        SecOCRxSecuredPduLayer
          COM_C0X_Pdu20_secured_3ef6961f_Rx (SecOCRxSecuredPdu): SecOCRxSecuredLayerPduRef=EcucPduCollection/COM_C0X_Pdu20_secured_3ef6961f_Rx
      COM_C0X_Pdu21_secured_298d825c_Rx: SecOCDataId=3394
        COM_C0X_Pdu21_0ea76f8c_Rx (SecOCRxAuthenticPduLayer): SecOCRxAuthenticLayerPduRef=EcucPduCollection/COM_C0X_Pdu21_0ea76f8c_Rx
        SecOCRxSecuredPduLayer
          COM_C0X_Pdu21_secured_298d825c_Rx (SecOCRxSecuredPdu): SecOCRxSecuredLayerPduRef=EcucPduCollection/COM_C0X_Pdu21_secured_298d825c_Rx
      DI_OdoSpeedometer_ST3_secured_3b3f85d1_Rx: SecOCDataId=64886
        DI_OdoSpeedometer_ST3_ffe5aaae_Rx (SecOCRxAuthenticPduLayer): SecOCRxAuthenticLayerPduRef=EcucPduCollection/DI_OdoSpeedometer_ST3_ffe5aaae_Rx
        SecOCRxSecuredPduLayer
          DI_OdoSpeedometer_ST3_secured_3b3f85d1_Rx (SecOCRxSecuredPdu): SecOCRxSecuredLayerPduRef=EcucPduCollection/DI_OdoSpeedometer_ST3_secured_3b3f85d1_Rx
      Ign_Stat_ST3_secured_326d9726_Rx: SecOCDataId=28212
        Ign_Stat_ST3_dacb1e38_Rx (SecOCRxAuthenticPduLayer): SecOCRxAuthenticLayerPduRef=EcucPduCollection/Ign_Stat_ST3_dacb1e38_Rx
        SecOCRxSecuredPduLayer
          Ign_Stat_ST3_secured_326d9726_Rx (SecOCRxSecuredPdu): SecOCRxSecuredLayerPduRef=EcucPduCollection/Ign_Stat_ST3_secured_326d9726_Rx
      PN14_Master_Stat1_ST3_secured_5caa91b2_Rx: SecOCDataId=57668
        PN14_Master_Stat1_ST3_7ba93c2a_Rx (SecOCRxAuthenticPduLayer): SecOCRxAuthenticLayerPduRef=EcucPduCollection/PN14_Master_Stat1_ST3_7ba93c2a_Rx
        SecOCRxSecuredPduLayer
          PN14_Master_Stat1_ST3_secured_5caa91b2_Rx (SecOCRxSecuredPdu): SecOCRxSecuredLayerPduRef=EcucPduCollection/PN14_Master_Stat1_ST3_secured_5caa91b2_Rx
      PT4_PTCoor4_ST3_secured_5e7a1571_Rx: SecOCDataId=26743
        PT4_PTCoor4_ST3_0379360e_Rx (SecOCRxAuthenticPduLayer): SecOCRxAuthenticLayerPduRef=EcucPduCollection/PT4_PTCoor4_ST3_0379360e_Rx
        SecOCRxSecuredPduLayer
          PT4_PTCoor4_ST3_secured_5e7a1571_Rx (SecOCRxSecuredPdu): SecOCRxSecuredLayerPduRef=EcucPduCollection/PT4_PTCoor4_ST3_secured_5e7a1571_Rx
      VehSpd_8_ST3_secured_7c0bf7a3_Rx: SecOCDataId=47310
        VehSpd_8_ST3_a4557cc9_Rx (SecOCRxAuthenticPduLayer): SecOCRxAuthenticLayerPduRef=EcucPduCollection/VehSpd_8_ST3_a4557cc9_Rx
        SecOCRxSecuredPduLayer
          VehSpd_8_ST3_secured_7c0bf7a3_Rx (SecOCRxSecuredPdu): SecOCRxSecuredLayerPduRef=EcucPduCollection/VehSpd_8_ST3_secured_7c0bf7a3_Rx
    3 x SecOCTxPduProcessing, all with SecOCAuthInfoTxLength=24, SecOCFreshnessValueId=1, SecOCFreshnessValueLength=40, SecOCFreshnessValueTxLength=8:
      COM_C04_Pdu03_secured_044596e0_Tx: SecOCDataId=24029
        COM_C04_Pdu03_9e894ab3_Tx (SecOCTxAuthenticPduLayer): SecOCTxAuthenticLayerPduRef=EcucPduCollection/COM_C04_Pdu03_9e894ab3_Tx
        SecOCTxSecuredPduLayer
          COM_C04_Pdu03_secured_044596e0_Tx (SecOCTxSecuredPdu): SecOCTxSecuredLayerPduRef=EcucPduCollection/COM_C04_Pdu03_secured_044596e0_Tx
      COM_C04_Pdu20_secured_393d7a18_Tx: SecOCDataId=41925
        COM_C04_Pdu20_35b6798b_Tx (SecOCTxAuthenticPduLayer): SecOCTxAuthenticLayerPduRef=EcucPduCollection/COM_C04_Pdu20_35b6798b_Tx
        SecOCTxSecuredPduLayer
          COM_C04_Pdu20_secured_393d7a18_Tx (SecOCTxSecuredPdu): SecOCTxSecuredLayerPduRef=EcucPduCollection/COM_C04_Pdu20_secured_393d7a18_Tx
      COM_C04_Pdu21_secured_2e466e5b_Tx: SecOCDataId=38145
        COM_C04_Pdu21_42b1491d_Tx (SecOCTxAuthenticPduLayer): SecOCTxAuthenticLayerPduRef=EcucPduCollection/COM_C04_Pdu21_42b1491d_Tx
        SecOCTxSecuredPduLayer
          COM_C04_Pdu21_secured_2e466e5b_Tx (SecOCTxSecuredPdu): SecOCTxSecuredLayerPduRef=EcucPduCollection/COM_C04_Pdu21_secured_2e466e5b_Tx
  module config SoAd
    SoAdConfig
      34 x SoAdPduRoute:
        CANFD_Eth_ST3_TPA_c67344e4_Tx: SoAdTxIfTriggerTransmit=false, SoAdTxUpperLayerType=IF, SoAdTxPduRef=EcucPduCollection/CANFD_Eth_ST3_TPA_c67344e4_Tx
          SCB_ECU4_CRN_TCP_TX_fixed_10_20_1_4_50022_3b3a6a32 (SoAdPduRouteDest):
            SoAdTxPduHeaderId = 824213505
            SoAdTxRoutingGroupRef = Service_Id_12576_SI_ID_10_CANFD_Eth_AC_db39ea6d
            SoAdTxSocketConnOrSocketConnBundleRef = SoAdConfig/SCB_ECU4_CRN_TCP_TX_fixed_10_20_1_4_50022_3b3a6a32
        COM_C04_C08_Pdu02_TpConnection_eda1cb96_Tx: SoAdTxUpperLayerType=TP, SoAdTxPduRef=EcucPduCollection/COM_C04_C08_Pdu02_TpConnection_eda1cb96_Tx
          SCB_ECU4_CRN_TCP_fixed_10_20_1_4_50030_46c68c35 (SoAdPduRouteDest):
            SoAdTxPduHeaderId = 4261429256
            SoAdTxSocketConnOrSocketConnBundleRef = SCB_ECU4_CRN_TCP_fixed_10_20_1_4_50030_c3c45321/SCB_ECU4_CRN_TCP_fixed_10_20_1_4_50030_46c68c35
        COM_C04_C14_Pdu01_TpConnection_b97b4d4e_Tx: SoAdTxUpperLayerType=TP, SoAdTxPduRef=EcucPduCollection/COM_C04_C14_Pdu01_TpConnection_b97b4d4e_Tx
          SCB_ECU4_CRN_TCP_fixed_10_20_1_4_50021_3b2bbb1c (SoAdPduRouteDest):
            SoAdTxPduHeaderId = 4261429268
            SoAdTxSocketConnOrSocketConnBundleRef = SCB_ECU4_CRN_TCP_fixed_10_20_1_4_50021_add852f6/SCB_ECU4_CRN_TCP_fixed_10_20_1_4_50021_3b2bbb1c
        COM_C04_Pdu01_PN08_d1242e36_Tx: SoAdTxIfTriggerTransmit=false, SoAdTxUpperLayerType=IF, SoAdTxPduRef=EcucPduCollection/COM_C04_Pdu01_PN08_d1242e36_Tx
          SCB_ECU4_CRN_UDP_fixed_10_20_1_4_50013_459e8f73 (SoAdPduRouteDest): SoAdTxSocketConnOrSocketConnBundleRef=SCB_ECU4_CRN_UDP_fixed_10_20_1_4_50013_fc68c760/SCB_ECU4_CRN_UDP_fixed_10_20_1_4_50013_459e8f73
          SCB_ECU4_CRN_UDP_fixed_10_20_1_4_50013_a45e358d (SoAdPduRouteDest): SoAdTxSocketConnOrSocketConnBundleRef=SCB_ECU4_CRN_UDP_fixed_10_20_1_4_50013_fc68c760/SCB_ECU4_CRN_UDP_fixed_10_20_1_4_50013_a45e358d
        COM_C04_Pdu01_PN17_cbc146fe_Tx: SoAdTxIfTriggerTransmit=false, SoAdTxUpperLayerType=IF, SoAdTxPduRef=EcucPduCollection/COM_C04_Pdu01_PN17_cbc146fe_Tx
          SCB_ECU4_CRN_UDP_fixed_10_20_1_4_50014_9bd2f775 (SoAdPduRouteDest): SoAdTxSocketConnOrSocketConnBundleRef=SCB_ECU4_CRN_UDP_fixed_10_20_1_4_50014_620c52c3/SCB_ECU4_CRN_UDP_fixed_10_20_1_4_50014_9bd2f775
        COM_C04_Pdu01_PN44_c8c45bf1_Tx: SoAdTxIfTriggerTransmit=false, SoAdTxUpperLayerType=IF, SoAdTxPduRef=EcucPduCollection/COM_C04_Pdu01_PN44_c8c45bf1_Tx
          SCB_ECU4_CRN_UDP_fixed_10_20_1_4_50015_38863d99 (SoAdPduRouteDest): SoAdTxSocketConnOrSocketConnBundleRef=SCB_ECU4_CRN_UDP_fixed_10_20_1_4_50015_150b6255/SCB_ECU4_CRN_UDP_fixed_10_20_1_4_50015_38863d99
          SCB_ECU4_CRN_UDP_fixed_10_20_1_4_50015_d9468767 (SoAdPduRouteDest): SoAdTxSocketConnOrSocketConnBundleRef=SCB_ECU4_CRN_UDP_fixed_10_20_1_4_50015_150b6255/SCB_ECU4_CRN_UDP_fixed_10_20_1_4_50015_d9468767
        COM_C04_Pdu01_PN53_288fe937_Tx: SoAdTxIfTriggerTransmit=false, SoAdTxUpperLayerType=IF, SoAdTxPduRef=EcucPduCollection/COM_C04_Pdu01_PN53_288fe937_Tx
          SCB_ECU4_CRN_UDP_fixed_10_20_1_4_50016_060a64ec (SoAdPduRouteDest): SoAdTxSocketConnOrSocketConnBundleRef=SCB_ECU4_CRN_UDP_fixed_10_20_1_4_50016_8c0233ef/SCB_ECU4_CRN_UDP_fixed_10_20_1_4_50016_060a64ec
          SCB_ECU4_CRN_UDP_fixed_10_20_1_4_50016_e7cade12 (SoAdPduRouteDest): SoAdTxSocketConnOrSocketConnBundleRef=SCB_ECU4_CRN_UDP_fixed_10_20_1_4_50016_8c0233ef/SCB_ECU4_CRN_UDP_fixed_10_20_1_4_50016_e7cade12
        COM_C04_Pdu01_PN62_298ce232_Tx: SoAdTxIfTriggerTransmit=false, SoAdTxUpperLayerType=IF, SoAdTxPduRef=EcucPduCollection/COM_C04_Pdu01_PN62_298ce232_Tx
          SCB_ECU4_CRN_UDP_fixed_10_20_1_4_50017_a55eae00 (SoAdPduRouteDest): SoAdTxSocketConnOrSocketConnBundleRef=SCB_ECU4_CRN_UDP_fixed_10_20_1_4_50017_fb050379/SCB_ECU4_CRN_UDP_fixed_10_20_1_4_50017_a55eae00
        COM_C04_Pdu02_00ce023e_Tx: SoAdTxIfTriggerTransmit=false, SoAdTxUpperLayerType=IF, SoAdTxPduRef=EcucPduCollection/COM_C04_Pdu02_00ce023e_Tx
          SCB_ECU4_CRN_UDP_fixed_10_20_1_4_40000_411a8e2b (SoAdPduRouteDest):
            SoAdTxPduHeaderId = 67174401
            SoAdTxUdpTriggerMode = TRIGGER_ALWAYS
            SoAdTxRoutingGroupRef = Service_1025_SI_ID_1_Methods_2cb8f438
            SoAdTxSocketConnOrSocketConnBundleRef = SoAdConfig/SCB_ECU4_CRN_UDP_fixed_10_20_1_4_40000_411a8e2b
        COM_C04_Pdu03_secured_e3281955_Tx: SoAdTxIfTriggerTransmit=false, SoAdTxUpperLayerType=IF, SoAdTxPduRef=EcucPduCollection/COM_C04_Pdu03_secured_e3281955_Tx
          SCB_ECU4_CRN_TCP_TX_fixed_10_20_1_4_45000_edbcb01e (SoAdPduRouteDest):
            SoAdTxPduHeaderId = 67272706
            SoAdTxRoutingGroupRef = Service_Id_1026_SI_ID_1_EG01_AC_15b5e2e2
            SoAdTxSocketConnOrSocketConnBundleRef = SoAdConfig/SCB_ECU4_CRN_TCP_TX_fixed_10_20_1_4_45000_edbcb01e
        COM_C04_Pdu10_19e3c40e_Tx: SoAdTxIfTriggerTransmit=false, SoAdTxUpperLayerType=IF, SoAdTxPduRef=EcucPduCollection/COM_C04_Pdu10_19e3c40e_Tx
          SCB_ECU4_CRN_UDP_fixed_10_20_1_4_40000_411a8e2b (SoAdPduRouteDest):
            SoAdTxPduHeaderId = 269778960
            SoAdTxUdpTriggerMode = TRIGGER_NEVER
            SoAdTxRoutingGroupRef = Service_Id_4116_SI_ID_10_Event_1_AC_f1eeb27d
            SoAdTxRoutingGroupRef = Service_Id_4116_SI_ID_10_Event_1_AM_16569f7a
            SoAdTxSocketConnOrSocketConnBundleRef = SoAdConfig/SCB_ECU4_CRN_UDP_fixed_10_20_1_4_40000_411a8e2b
        COM_C04_Pdu11_9dd2ddff_Tx: SoAdTxIfTriggerTransmit=false, SoAdTxUpperLayerType=IF, SoAdTxPduRef=EcucPduCollection/COM_C04_Pdu11_9dd2ddff_Tx
          SCB_ECU4_CRN_UDP_fixed_10_20_1_4_40000_411a8e2b (SoAdPduRouteDest):
            SoAdTxPduHeaderId = 269778961
            SoAdTxUdpTriggerMode = TRIGGER_NEVER
            SoAdTxRoutingGroupRef = Service_Id_4116_SI_ID_10_Event_1_AC_f1eeb27d
            SoAdTxRoutingGroupRef = Service_Id_4116_SI_ID_10_Event_1_AM_16569f7a
            SoAdTxRoutingGroupRef = Service_Id_4116_SI_ID_10_Event_2_AC_e35b1d93
            SoAdTxRoutingGroupRef = Service_Id_4116_SI_ID_10_Event_2_AM_04e33094
            SoAdTxSocketConnOrSocketConnBundleRef = SoAdConfig/SCB_ECU4_CRN_UDP_fixed_10_20_1_4_40000_411a8e2b
        COM_C04_Pdu12_caf0f1ad_Tx: SoAdTxIfTriggerTransmit=false, SoAdTxUpperLayerType=IF, SoAdTxPduRef=EcucPduCollection/COM_C04_Pdu12_caf0f1ad_Tx
          SCB_ECU4_CRN_UDP_fixed_10_20_1_4_40000_411a8e2b (SoAdPduRouteDest):
            SoAdTxPduHeaderId = 269778962
            SoAdTxUdpTriggerMode = TRIGGER_NEVER
            SoAdTxRoutingGroupRef = Service_Id_4116_SI_ID_10_Event_1_AC_f1eeb27d
            SoAdTxRoutingGroupRef = Service_Id_4116_SI_ID_10_Event_1_AM_16569f7a
            SoAdTxRoutingGroupRef = Service_Id_4116_SI_ID_10_Event_2_AC_e35b1d93
            SoAdTxRoutingGroupRef = Service_Id_4116_SI_ID_10_Event_2_AM_04e33094
            SoAdTxSocketConnOrSocketConnBundleRef = SoAdConfig/SCB_ECU4_CRN_UDP_fixed_10_20_1_4_40000_411a8e2b
        COM_C04_Pdu13_4ec1e85c_Tx: SoAdTxIfTriggerTransmit=false, SoAdTxUpperLayerType=IF, SoAdTxPduRef=EcucPduCollection/COM_C04_Pdu13_4ec1e85c_Tx
          SCB_ECU4_CRN_UDP_fixed_10_20_1_4_40000_411a8e2b (SoAdPduRouteDest):
            SoAdTxPduHeaderId = 269778963
            SoAdTxUdpTriggerMode = TRIGGER_NEVER
            SoAdTxRoutingGroupRef = Service_Id_4116_SI_ID_10_Event_1_AC_f1eeb27d
            SoAdTxRoutingGroupRef = Service_Id_4116_SI_ID_10_Event_1_AM_16569f7a
            SoAdTxRoutingGroupRef = Service_Id_4116_SI_ID_10_Event_2_AC_e35b1d93
            SoAdTxRoutingGroupRef = Service_Id_4116_SI_ID_10_Event_2_AM_04e33094
            SoAdTxSocketConnOrSocketConnBundleRef = SoAdConfig/SCB_ECU4_CRN_UDP_fixed_10_20_1_4_40000_411a8e2b
        COM_C04_Pdu14_64b4a909_Tx: SoAdTxIfTriggerTransmit=false, SoAdTxUpperLayerType=IF, SoAdTxPduRef=EcucPduCollection/COM_C04_Pdu14_64b4a909_Tx
          SCB_ECU4_CRN_UDP_fixed_10_20_1_4_40000_411a8e2b (SoAdPduRouteDest):
            SoAdTxPduHeaderId = 269778964
            SoAdTxUdpTriggerMode = TRIGGER_NEVER
            SoAdTxRoutingGroupRef = Service_Id_4116_SI_ID_10_Event_1_AC_f1eeb27d
            SoAdTxRoutingGroupRef = Service_Id_4116_SI_ID_10_Event_1_AM_16569f7a
            SoAdTxRoutingGroupRef = Service_Id_4116_SI_ID_10_Event_2_AC_e35b1d93
            SoAdTxRoutingGroupRef = Service_Id_4116_SI_ID_10_Event_2_AM_04e33094
            SoAdTxSocketConnOrSocketConnBundleRef = SoAdConfig/SCB_ECU4_CRN_UDP_fixed_10_20_1_4_40000_411a8e2b
        COM_C04_Pdu15_e085b0f8_Tx: SoAdTxIfTriggerTransmit=false, SoAdTxUpperLayerType=IF, SoAdTxPduRef=EcucPduCollection/COM_C04_Pdu15_e085b0f8_Tx
          SCB_ECU4_CRN_UDP_fixed_10_20_1_4_40000_411a8e2b (SoAdPduRouteDest):
            SoAdTxPduHeaderId = 269778965
            SoAdTxUdpTriggerMode = TRIGGER_NEVER
            SoAdTxRoutingGroupRef = Service_Id_4116_SI_ID_10_Event_1_AC_f1eeb27d
            SoAdTxRoutingGroupRef = Service_Id_4116_SI_ID_10_Event_1_AM_16569f7a
            SoAdTxRoutingGroupRef = Service_Id_4116_SI_ID_10_Event_2_AC_e35b1d93
            SoAdTxRoutingGroupRef = Service_Id_4116_SI_ID_10_Event_2_AM_04e33094
            SoAdTxSocketConnOrSocketConnBundleRef = SoAdConfig/SCB_ECU4_CRN_UDP_fixed_10_20_1_4_40000_411a8e2b
        COM_C04_Pdu16_b7a79caa_Tx: SoAdTxIfTriggerTransmit=false, SoAdTxUpperLayerType=IF, SoAdTxPduRef=EcucPduCollection/COM_C04_Pdu16_b7a79caa_Tx
          SCB_ECU4_CRN_UDP_fixed_10_20_1_4_40000_411a8e2b (SoAdPduRouteDest):
            SoAdTxPduHeaderId = 269778966
            SoAdTxUdpTriggerMode = TRIGGER_NEVER
            SoAdTxRoutingGroupRef = Service_Id_4116_SI_ID_10_Event_1_AC_f1eeb27d
            SoAdTxRoutingGroupRef = Service_Id_4116_SI_ID_10_Event_1_AM_16569f7a
            SoAdTxSocketConnOrSocketConnBundleRef = SoAdConfig/SCB_ECU4_CRN_UDP_fixed_10_20_1_4_40000_411a8e2b
        COM_C04_Pdu17_3396855b_Tx: SoAdTxIfTriggerTransmit=false, SoAdTxUpperLayerType=IF, SoAdTxPduRef=EcucPduCollection/COM_C04_Pdu17_3396855b_Tx
          SCB_ECU4_CRN_UDP_fixed_10_20_1_4_40000_411a8e2b (SoAdPduRouteDest):
            SoAdTxPduHeaderId = 269778967
            SoAdTxUdpTriggerMode = TRIGGER_NEVER
            SoAdTxRoutingGroupRef = Service_Id_4116_SI_ID_10_Event_1_AC_f1eeb27d
            SoAdTxRoutingGroupRef = Service_Id_4116_SI_ID_10_Event_1_AM_16569f7a
            SoAdTxSocketConnOrSocketConnBundleRef = SoAdConfig/SCB_ECU4_CRN_UDP_fixed_10_20_1_4_40000_411a8e2b
        COM_C04_Pdu18_e34d1e00_Tx: SoAdTxIfTriggerTransmit=false, SoAdTxUpperLayerType=IF, SoAdTxPduRef=EcucPduCollection/COM_C04_Pdu18_e34d1e00_Tx
          SCB_ECU4_CRN_UDP_fixed_10_20_1_4_40000_411a8e2b (SoAdPduRouteDest):
            SoAdTxPduHeaderId = 269778968
            SoAdTxUdpTriggerMode = TRIGGER_NEVER
            SoAdTxRoutingGroupRef = Service_Id_4116_SI_ID_10_Event_1_AC_f1eeb27d
            SoAdTxRoutingGroupRef = Service_Id_4116_SI_ID_10_Event_1_AM_16569f7a
            SoAdTxSocketConnOrSocketConnBundleRef = SoAdConfig/SCB_ECU4_CRN_UDP_fixed_10_20_1_4_40000_411a8e2b
        COM_C04_Pdu19_677c07f1_Tx: SoAdTxIfTriggerTransmit=false, SoAdTxUpperLayerType=IF, SoAdTxPduRef=EcucPduCollection/COM_C04_Pdu19_677c07f1_Tx
          SCB_ECU4_CRN_UDP_fixed_10_20_1_4_40000_411a8e2b (SoAdPduRouteDest):
            SoAdTxPduHeaderId = 269778969
            SoAdTxUdpTriggerMode = TRIGGER_NEVER
            SoAdTxRoutingGroupRef = Service_Id_4116_SI_ID_10_Event_1_AC_f1eeb27d
            SoAdTxRoutingGroupRef = Service_Id_4116_SI_ID_10_Event_1_AM_16569f7a
            SoAdTxSocketConnOrSocketConnBundleRef = SoAdConfig/SCB_ECU4_CRN_UDP_fixed_10_20_1_4_40000_411a8e2b
        COM_C04_Pdu20_secured_eef90202_Tx: SoAdTxIfTriggerTransmit=false, SoAdTxUpperLayerType=IF, SoAdTxPduRef=EcucPduCollection/COM_C04_Pdu20_secured_eef90202_Tx
          SCB_ECU4_CRN_UDP_fixed_10_20_1_4_40000_411a8e2b (SoAdPduRouteDest):
            SoAdTxPduHeaderId = 269778976
            SoAdTxUdpTriggerMode = TRIGGER_NEVER
            SoAdTxRoutingGroupRef = Service_Id_4116_SI_ID_10_Event_1_AC_f1eeb27d
            SoAdTxRoutingGroupRef = Service_Id_4116_SI_ID_10_Event_1_AM_16569f7a
            SoAdTxSocketConnOrSocketConnBundleRef = SoAdConfig/SCB_ECU4_CRN_UDP_fixed_10_20_1_4_40000_411a8e2b
        COM_C04_Pdu21_secured_a43e0d91_Tx: SoAdTxIfTriggerTransmit=false, SoAdTxUpperLayerType=IF, SoAdTxPduRef=EcucPduCollection/COM_C04_Pdu21_secured_a43e0d91_Tx
          SCB_ECU4_CRN_UDP_fixed_10_20_1_4_40000_411a8e2b (SoAdPduRouteDest):
            SoAdTxPduHeaderId = 269778977
            SoAdTxUdpTriggerMode = TRIGGER_NEVER
            SoAdTxRoutingGroupRef = Service_Id_4116_SI_ID_10_Event_1_AC_f1eeb27d
            SoAdTxRoutingGroupRef = Service_Id_4116_SI_ID_10_Event_1_AM_16569f7a
            SoAdTxSocketConnOrSocketConnBundleRef = SoAdConfig/SCB_ECU4_CRN_UDP_fixed_10_20_1_4_40000_411a8e2b
        DIAG_ROE_C04_Container_ST3_ROE_C04_PDU01_7787ca3b_Tx: SoAdTxIfTriggerTransmit=false, SoAdTxUpperLayerType=IF, SoAdTxPduRef=EcucPduCollection/DIAG_ROE_C04_Container_ST3_ROE_C04_PDU01_7787ca3b_Tx
          SCB_ECU4_CRN_UDP_dhcpv4AndFixed_169_254_17_4_60000_ccfd02b3 (SoAdPduRouteDest):
            SoAdTxPduHeaderId = 1073840129
            SoAdTxUdpTriggerMode = TRIGGER_NEVER
            SoAdTxUdpTriggerTimeout = 0.02
            SoAdTxSocketConnOrSocketConnBundleRef = SCB_ECU4_CRN_UDP_dhcpv4AndFixed_169_254_17_4_60000_fa5b07ac/SCB_ECU4_CRN_UDP_dhcpv4AndFixed_169_254_17_4_60000_ccfd02b3
        DIAG_RS_Eth_CTP_1f16b9a6_Tx: SoAdTxIfTriggerTransmit=false, SoAdTxUpperLayerType=IF, SoAdTxPduRef=EcucPduCollection/DIAG_RS_Eth_CTP_1f16b9a6_Tx
          SCB_ECU4_CRN_UDP_fixed_10_2_1_4_13400_51df633c (SoAdPduRouteDest): SoAdTxSocketConnOrSocketConnBundleRef=SCB_ECU4_CRN_UDP_fixed_10_2_1_4_13400_2ccf2d0f/SCB_ECU4_CRN_UDP_fixed_10_2_1_4_13400_51df633c
        DIAG_RS_Eth_CTP_2_6aaae912_Tx: SoAdTxIfTriggerTransmit=false, SoAdTxUpperLayerType=IF, SoAdTxPduRef=EcucPduCollection/DIAG_RS_Eth_CTP_2_6aaae912_Tx
          SCB_ECU4_CRN_UDP_dhcpv4AndFixed_169_254_17_4_13400_a3481a80 (SoAdPduRouteDest):
            SoAdTxSocketConnOrSocketConnBundleRef = SCB_ECU4_CRN_UDP_dhcpv4AndFixed_169_254_17_4_13400_5dc7dc8e/SCB_ECU4_CRN_UDP_dhcpv4AndFixed_169_254_17_4_13400_a3481a80
        DIAG_RS_Eth_CTP_2_c5ec4174_Tx: SoAdTxIfTriggerTransmit=false, SoAdTxUpperLayerType=IF, SoAdTxPduRef=EcucPduCollection/DIAG_RS_Eth_CTP_2_c5ec4174_Tx
          SCB_ECU4_CRN_UDP_fixed_10_2_1_4_13400_5677dce6 (SoAdPduRouteDest): SoAdTxSocketConnOrSocketConnBundleRef=SCB_ECU4_CRN_UDP_fixed_10_2_1_4_13400_2ccf2d0f/SCB_ECU4_CRN_UDP_fixed_10_2_1_4_13400_5677dce6
        DIAG_RS_Eth_CTP_TCP_27bc1914_Tx: SoAdTxUpperLayerType=TP, SoAdTxPduRef=EcucPduCollection/DIAG_RS_Eth_CTP_TCP_27bc1914_Tx
          SCB_ECU4_CRN_DoIP_TCP_dhcpv4AndFixed_169_254_17_4_13400_30e6cc67 (SoAdPduRouteDest):
            SoAdTxSocketConnOrSocketConnBundleRef = SCB_ECU4_CRN_DoIP_TCP_dhcpv4AndFixed_169_254_17_4_13400_c10cc7ff/SCB_ECU4_CRN_DoIP_TCP_dhcpv4AndFixed_169_254_17_4_13400_30e6cc67
        DIAG_RS_Eth_CTP_TCP_2_c5c9160c_Tx: SoAdTxUpperLayerType=TP, SoAdTxPduRef=EcucPduCollection/DIAG_RS_Eth_CTP_TCP_2_c5c9160c_Tx
          SCB_ECU4_CRN_DoIP_TCP_dhcpv4AndFixed_169_254_17_4_13400_55056e49 (SoAdPduRouteDest):
            SoAdTxSocketConnOrSocketConnBundleRef = SCB_ECU4_CRN_DoIP_TCP_dhcpv4AndFixed_169_254_17_4_13400_c10cc7ff/SCB_ECU4_CRN_DoIP_TCP_dhcpv4AndFixed_169_254_17_4_13400_55056e49
        DIAG_RS_Eth_CTP_TCP_2_eca5e4f1_Tx: SoAdTxUpperLayerType=TP, SoAdTxPduRef=EcucPduCollection/DIAG_RS_Eth_CTP_TCP_2_eca5e4f1_Tx
          SCB_ECU4_CRN_DoIP_TCP_fixed_10_2_1_4_13400_27418eb4 (SoAdPduRouteDest):
            SoAdTxSocketConnOrSocketConnBundleRef = SCB_ECU4_CRN_DoIP_TCP_fixed_10_2_1_4_13400_178bb553/SCB_ECU4_CRN_DoIP_TCP_fixed_10_2_1_4_13400_27418eb4
        DIAG_RS_Eth_CTP_TCP_cc1651a9_Tx: SoAdTxUpperLayerType=TP, SoAdTxPduRef=EcucPduCollection/DIAG_RS_Eth_CTP_TCP_cc1651a9_Tx
          SCB_ECU4_CRN_DoIP_TCP_fixed_10_2_1_4_13400_86786c2c (SoAdPduRouteDest):
            SoAdTxSocketConnOrSocketConnBundleRef = SCB_ECU4_CRN_DoIP_TCP_fixed_10_2_1_4_13400_178bb553/SCB_ECU4_CRN_DoIP_TCP_fixed_10_2_1_4_13400_86786c2c
        DIAG_RS_Eth_CTP_c52c4e87_Tx: SoAdTxIfTriggerTransmit=false, SoAdTxUpperLayerType=IF, SoAdTxPduRef=EcucPduCollection/DIAG_RS_Eth_CTP_c52c4e87_Tx
          SCB_ECU4_CRN_UDP_dhcpv4AndFixed_169_254_17_4_13400_d4a3b8e2 (SoAdPduRouteDest):
            SoAdTxSocketConnOrSocketConnBundleRef = SCB_ECU4_CRN_UDP_dhcpv4AndFixed_169_254_17_4_13400_5dc7dc8e/SCB_ECU4_CRN_UDP_dhcpv4AndFixed_169_254_17_4_13400_d4a3b8e2
        ECU_Stat_C04_ETH_Container_ECU_Stat_C04_ETH_411314f1_Tx: SoAdTxIfTriggerTransmit=false, SoAdTxUpperLayerType=IF, SoAdTxPduRef=EcucPduCollection/ECU_Stat_C04_ETH_Container_ECU_Stat_C04_ETH_411314f1_Tx
          3 x SoAdPduRouteDest, all with SoAdTxPduHeaderId=972980228, SoAdTxUdpTriggerMode=TRIGGER_NEVER:
            SCB_ECU4_CRN_UDP_fixed_10_127_1_4_40002_1310a00d: SoAdTxSocketConnOrSocketConnBundleRef=SCB_ECU4_CRN_UDP_fixed_10_127_1_4_40002_200b7bdf/SCB_ECU4_CRN_UDP_fixed_10_127_1_4_40002_1310a00d
            SCB_ECU4_CRN_UDP_fixed_10_127_1_4_40002_23bc5ad1: SoAdTxSocketConnOrSocketConnBundleRef=SCB_ECU4_CRN_UDP_fixed_10_127_1_4_40002_200b7bdf/SCB_ECU4_CRN_UDP_fixed_10_127_1_4_40002_23bc5ad1
            SCB_ECU4_CRN_UDP_fixed_10_127_1_4_40002_3bea27bf: SoAdTxSocketConnOrSocketConnBundleRef=SCB_ECU4_CRN_UDP_fixed_10_127_1_4_40002_200b7bdf/SCB_ECU4_CRN_UDP_fixed_10_127_1_4_40002_3bea27bf
        NM_C04_0c2fc3f3_Tx: SoAdTxIfTriggerTransmit=false, SoAdTxUpperLayerType=IF, SoAdTxPduRef=EcucPduCollection/NM_C04_0c2fc3f3_Tx
          SCB_ECU4_CRN_UDP_fixed_10_127_1_4_20000_44cb0734 (SoAdPduRouteDest): SoAdTxSocketConnOrSocketConnBundleRef=SCB_ECU4_CRN_UDP_fixed_10_127_1_4_20000_4145ef53/SCB_ECU4_CRN_UDP_fixed_10_127_1_4_20000_44cb0734
        SD_Ctrl_Tx_aab32b2d_Tx: SoAdTxUpperLayerType=IF, SoAdTxPduRef=EcucPduCollection/SD_Ctrl_Tx_aab32b2d_Tx
          ECU4_CRN_SD_Bundle_367c5ca5 (SoAdPduRouteDest): SoAdTxPduHeaderId=4294934784, SoAdTxSocketConnOrSocketConnBundleRef=ECU4_CRN_SD_Bundle_9c7db8fe/ECU4_CRN_SD_Bundle_367c5ca5
      23 x SoAdRoutingGroup:
        Service_1025_SI_ID_1_Methods_2cb8f438
        Service_Id_1026_SI_ID_1_EG01_AC_15b5e2e2
        Service_Id_12576_SI_ID_10_CANFD_Eth_AC_db39ea6d
        Service_Id_12577_SI_ID_10_Eth_CANFD_AC_d28c2093
        Service_Id_12804_SI_ID_0_DI_Master_Odometer_AC_93a1f098
        Service_Id_128_SI_ID_0_Ign_Stat_ACT_231eb536
        Service_Id_128_SI_ID_0_Ign_Stat_AM_2f00d482
        Service_Id_14596_SI_ID_0_PT4_PTCoor4_AC_4c6887e3
        Service_Id_14596_SI_ID_0_PT4_PTCoor4_AM_abd0aae4
        Service_Id_14720_SI_ID_0_PN14_Master_AC_7a1c9fb5
        Service_Id_14720_SI_ID_0_PN14_Master_AM_9da4b2b2
        Service_Id_16640_SI_ID_0_VSS_ACT_3dfc3762
        Service_Id_16640_SI_ID_0_VSS_AM_cc70e810
        Service_Id_4116_SI_ID_10_Event_1_AC_f1eeb27d
        Service_Id_4116_SI_ID_10_Event_1_AM_16569f7a
        Service_Id_4116_SI_ID_10_Event_2_AC_e35b1d93
        Service_Id_4116_SI_ID_10_Event_2_AM_04e33094
        Service_Id_4244_SI_ID_10_Event_1_AC_28467dfd
        Service_Id_4244_SI_ID_10_Event_1_AM_cffe50fa
        Service_Id_4244_SI_ID_10_Event_2_AC_3af3d213
        Service_Id_4244_SI_ID_10_Event_2_AM_dd4bff14
        Service_Id_7810_SI_ID_1_Vehspd_8_AC_3d387280
        Service_Id_7810_SI_ID_1_Vehspd_8_AM_da805f87
      32 x SoAdSocketConnectionGroup:
        ECU4_CRN_SD_Bundle_9c7db8fe: SoAdPduHeaderEnable=true, SoAdSocketFramePriority=5, SoAdSocketLocalPort=30490, SoAdSocketLocalAddressRef=NE_fixed_10_20_1_4_a84d5d3c
          ECU4_CRN_SD_Bundle_367c5ca5 (SoAdSocketConnection)
            SoAdSocketRemoteAddress: SoAdSocketRemoteIpAddress=, SoAdSocketRemotePort=0
          SoAdSocketProtocol
            SoAdSocketUdp
        ECU4_CRN_SD_Bundle_Multicast_Rx_47d6a472: SoAdPduHeaderEnable=true, SoAdSocketFramePriority=5, SoAdSocketLocalPort=30490, SoAdSocketLocalAddressRef=NE_Multicast_Rx_fixed_239_20_0_2_f00b1a7a
          ECU4_CRN_SD_Bundle_Multicast_Rx_7881f48f (SoAdSocketConnection)
            SoAdSocketRemoteAddress: SoAdSocketRemoteIpAddress=, SoAdSocketRemotePort=0
          SoAdSocketProtocol
            SoAdSocketUdp
        SCB_ECU4_CRN_DoIP_TCP_dhcpv4AndFixed_169_254_17_4_13400_c10cc7ff: SoAdSocketFramePriority=0, SoAdSocketLocalPort=13400, SoAdSocketLocalAddressRef=NE_dhcpv4AndFixed_169_254_17_4_853345fc
          SCB_ECU4_CRN_DoIP_TCP_dhcpv4AndFixed_169_254_17_4_13400_30e6cc67 (SoAdSocketConnection)
            SoAdSocketRemoteAddress: SoAdSocketRemoteIpAddress=, SoAdSocketRemotePort=0
          SCB_ECU4_CRN_DoIP_TCP_dhcpv4AndFixed_169_254_17_4_13400_55056e49 (SoAdSocketConnection)
            SoAdSocketRemoteAddress: SoAdSocketRemoteIpAddress=, SoAdSocketRemotePort=0
          SoAdSocketProtocol
            SoAdSocketTcp: SoAdSocketTcpInitiate=false
        SCB_ECU4_CRN_DoIP_TCP_fixed_10_2_1_4_13400_178bb553: SoAdSocketFramePriority=0, SoAdSocketLocalPort=13400, SoAdSocketLocalAddressRef=NE_fixed_10_2_1_4_0df3b795
          SCB_ECU4_CRN_DoIP_TCP_fixed_10_2_1_4_13400_27418eb4 (SoAdSocketConnection)
            SoAdSocketRemoteAddress: SoAdSocketRemoteIpAddress=, SoAdSocketRemotePort=0
          SCB_ECU4_CRN_DoIP_TCP_fixed_10_2_1_4_13400_86786c2c (SoAdSocketConnection)
            SoAdSocketRemoteAddress: SoAdSocketRemoteIpAddress=, SoAdSocketRemotePort=0
          SoAdSocketProtocol
            SoAdSocketTcp: SoAdSocketTcpInitiate=false
        SCB_ECU4_CRN_TCP_RX_Any_DynamicPort_8e70b440: SoAdPduHeaderEnable=true, SoAdSocketFramePriority=5, SoAdSocketLocalPort=50023, SoAdSocketLocalAddressRef=NE_fixed_10_20_1_4_a84d5d3c
          SCB_ECU4_CRN_TCP_RX_Any_DynamicPort_479f244f (SoAdSocketConnection)
            SoAdSocketRemoteAddress: SoAdSocketRemoteIpAddress=, SoAdSocketRemotePort=0
          SoAdSocketProtocol
            SoAdSocketTcp: SoAdSocketTcpInitiate=true
        SCB_ECU4_CRN_TCP_TX_fixed_10_20_1_4_45000_edbcb01e: SoAdPduHeaderEnable=true, SoAdSocketFramePriority=1, SoAdSocketLocalPort=45000, SoAdSocketLocalAddressRef=NE_fixed_10_20_1_4_a84d5d3c
          SCB_ECU4_CRN_TCP_TX_fixed_10_20_1_4_45000_8c9aef98 (SoAdSocketConnection)
            SoAdSocketRemoteAddress: SoAdSocketRemoteIpAddress=, SoAdSocketRemotePort=0
          SoAdSocketProtocol
            SoAdSocketTcp: SoAdSocketTcpInitiate=false
        SCB_ECU4_CRN_TCP_TX_fixed_10_20_1_4_50022_3b3a6a32: SoAdPduHeaderEnable=true, SoAdSocketFramePriority=5, SoAdSocketLocalPort=50022, SoAdSocketLocalAddressRef=NE_fixed_10_20_1_4_a84d5d3c
          SCB_ECU4_CRN_TCP_TX_fixed_10_20_1_4_50022_838e27a7 (SoAdSocketConnection)
            SoAdSocketRemoteAddress: SoAdSocketRemoteIpAddress=, SoAdSocketRemotePort=0
          SoAdSocketProtocol
            SoAdSocketTcp: SoAdSocketTcpInitiate=false
        SCB_ECU4_CRN_TCP_fixed_10_20_1_4_50021_add852f6: SoAdPduHeaderEnable=true, SoAdSocketFramePriority=5, SoAdSocketLocalPort=50021, SoAdSocketLocalAddressRef=NE_fixed_10_20_1_4_a84d5d3c
          SCB_ECU4_CRN_TCP_fixed_10_20_1_4_50021_3b2bbb1c (SoAdSocketConnection)
            SoAdSocketRemoteAddress: SoAdSocketRemoteIpAddress=10.20.1.1, SoAdSocketRemotePort=50021
          SoAdSocketProtocol
            SoAdSocketTcp: SoAdSocketTcpInitiate=false
        SCB_ECU4_CRN_TCP_fixed_10_20_1_4_50030_c3c45321: SoAdPduHeaderEnable=true, SoAdSocketFramePriority=5, SoAdSocketLocalPort=50030, SoAdSocketLocalAddressRef=NE_fixed_10_20_1_4_a84d5d3c
          SCB_ECU4_CRN_TCP_fixed_10_20_1_4_50030_46c68c35 (SoAdSocketConnection)
            SoAdSocketRemoteAddress: SoAdSocketRemoteIpAddress=10.20.1.1, SoAdSocketRemotePort=50030
          SCB_ECU4_CRN_TCP_fixed_10_20_1_4_50030_4ba92126 (SoAdSocketConnection)
            SoAdSocketRemoteAddress: SoAdSocketRemoteIpAddress=10.20.1.7, SoAdSocketRemotePort=50030
          SoAdSocketProtocol
            SoAdSocketTcp: SoAdSocketTcpInitiate=false
        SCB_ECU4_CRN_UDP_Multicast_Rx_Any_40000_fe219239: SoAdPduHeaderEnable=true, SoAdSocketFramePriority=5, SoAdSocketLocalPort=40000, SoAdSocketLocalAddressRef=TcpIpConfig/NE_Multicast_Rx_Any_998169c7
          SCB_ECU4_CRN_UDP_Multicast_Rx_Any_40000_a079f169 (SoAdSocketConnection)
            SoAdSocketRemoteAddress: SoAdSocketRemoteIpAddress=, SoAdSocketRemotePort=0
          SoAdSocketProtocol
            SoAdSocketUdp
        SCB_ECU4_CRN_UDP_Multicast_Rx_fixed_239_127_0_1_20000_799aaae6: SoAdSocketFramePriority=5, SoAdSocketLocalPort=20000, SoAdSocketLocalAddressRef=NE_Multicast_Rx_fixed_239_127_0_1_51f2c1b0
          SCB_ECU4_CRN_UDP_Multicast_Rx_fixed_239_127_0_1_20000_b0a881ab (SoAdSocketConnection)
            SoAdSocketRemoteAddress: SoAdSocketRemoteIpAddress=, SoAdSocketRemotePort=0
          SoAdSocketProtocol
            SoAdSocketUdp
        SCB_ECU4_CRN_UDP_Multicast_Rx_fixed_239_2_0_17_40001_02bf42eb: SoAdPduHeaderEnable=true, SoAdSocketFramePriority=0, SoAdSocketLocalPort=40001, SoAdSocketLocalAddressRef=NE_Multicast_Rx_fixed_239_2_0_17_e0a8c9cc
          SCB_ECU4_CRN_UDP_Multicast_Rx_fixed_239_2_0_17_40001_33c8a959 (SoAdSocketConnection)
            SoAdSocketRemoteAddress: SoAdSocketRemoteIpAddress=10.2.1.1, SoAdSocketRemotePort=40001
          SoAdSocketProtocol
            SoAdSocketUdp
        SCB_ECU4_CRN_UDP_dhcpv4AndFixed_169_254_17_4_13400_5dc7dc8e: SoAdSocketFramePriority=0, SoAdSocketLocalPort=13400, SoAdSocketLocalAddressRef=NE_dhcpv4AndFixed_169_254_17_4_853345fc
          SCB_ECU4_CRN_UDP_dhcpv4AndFixed_169_254_17_4_13400_a3481a80 (SoAdSocketConnection)
            SoAdSocketRemoteAddress: SoAdSocketRemoteIpAddress=, SoAdSocketRemotePort=0
          SCB_ECU4_CRN_UDP_dhcpv4AndFixed_169_254_17_4_13400_d4a3b8e2 (SoAdSocketConnection)
            SoAdSocketRemoteAddress: SoAdSocketRemoteIpAddress=255.255.255.255, SoAdSocketRemotePort=13400
          SoAdSocketProtocol
            SoAdSocketUdp
        SCB_ECU4_CRN_UDP_dhcpv4AndFixed_169_254_17_4_60000_fa5b07ac: SoAdPduHeaderEnable=true, SoAdSocketFramePriority=0, SoAdSocketLocalPort=60000, SoAdSocketLocalAddressRef=NE_dhcpv4AndFixed_169_254_17_4_853345fc
          SCB_ECU4_CRN_UDP_dhcpv4AndFixed_169_254_17_4_60000_ccfd02b3 (SoAdSocketConnection)
            SoAdSocketRemoteAddress: SoAdSocketRemoteIpAddress=239.1.0.8, SoAdSocketRemotePort=60000
          SoAdSocketProtocol
            SoAdSocketUdp: SoAdSocketUdpTriggerTimeout=0.1, SoAdSocketnPduUdpTxBufferMin=1472
        SCB_ECU4_CRN_UDP_fixed_10_127_1_4_20000_4145ef53: SoAdSocketFramePriority=5, SoAdSocketLocalPort=20000, SoAdSocketLocalAddressRef=NE_fixed_10_127_1_4_2de67ff6
          SCB_ECU4_CRN_UDP_fixed_10_127_1_4_20000_44cb0734 (SoAdSocketConnection)
            SoAdSocketRemoteAddress: SoAdSocketRemoteIpAddress=239.127.0.1, SoAdSocketRemotePort=20000
          SoAdSocketProtocol
            SoAdSocketUdp
        SCB_ECU4_CRN_UDP_fixed_10_127_1_4_40002_200b7bdf: SoAdPduHeaderEnable=true, SoAdSocketFramePriority=5, SoAdSocketLocalPort=40002, SoAdSocketLocalAddressRef=NE_fixed_10_127_1_4_2de67ff6
          3 x SoAdSocketConnection:
            SCB_ECU4_CRN_UDP_fixed_10_127_1_4_40002_1310a00d
              SoAdSocketRemoteAddress: SoAdSocketRemoteIpAddress=10.127.1.1, SoAdSocketRemotePort=40002
            SCB_ECU4_CRN_UDP_fixed_10_127_1_4_40002_23bc5ad1
              SoAdSocketRemoteAddress: SoAdSocketRemoteIpAddress=10.127.1.5, SoAdSocketRemotePort=40002
            SCB_ECU4_CRN_UDP_fixed_10_127_1_4_40002_3bea27bf
              SoAdSocketRemoteAddress: SoAdSocketRemoteIpAddress=10.127.1.7, SoAdSocketRemotePort=40002
          SoAdSocketProtocol
            SoAdSocketUdp: SoAdSocketUdpTriggerTimeout=0.01, SoAdSocketnPduUdpTxBufferMin=1472
        SCB_ECU4_CRN_UDP_fixed_10_20_1_4_40000_411a8e2b: SoAdPduHeaderEnable=true, SoAdSocketLocalPort=40000, SoAdSocketLocalAddressRef=NE_fixed_10_20_1_4_a84d5d3c
          8 x SoAdSocketConnection:
            SCB_ECU4_CRN_UDP_fixed_10_20_1_4_40000_0dffb1bb
              SoAdSocketRemoteAddress: SoAdSocketRemoteIpAddress=, SoAdSocketRemotePort=0
            SCB_ECU4_CRN_UDP_fixed_10_20_1_4_40000_297de08d
              SoAdSocketRemoteAddress: SoAdSocketRemoteIpAddress=, SoAdSocketRemotePort=0
            SCB_ECU4_CRN_UDP_fixed_10_20_1_4_40000_607942e1
              SoAdSocketRemoteAddress: SoAdSocketRemoteIpAddress=, SoAdSocketRemotePort=0
            SCB_ECU4_CRN_UDP_fixed_10_20_1_4_40000_9ff6f563
              SoAdSocketRemoteAddress: SoAdSocketRemoteIpAddress=, SoAdSocketRemotePort=0
            SCB_ECU4_CRN_UDP_fixed_10_20_1_4_40000_bb74a455
              SoAdSocketRemoteAddress: SoAdSocketRemoteIpAddress=, SoAdSocketRemotePort=0
            SCB_ECU4_CRN_UDP_fixed_10_20_1_4_40000_d6f2570f
              SoAdSocketRemoteAddress: SoAdSocketRemoteIpAddress=, SoAdSocketRemotePort=0
            SCB_ECU4_CRN_UDP_fixed_10_20_1_4_40000_f2700639
              SoAdSocketRemoteAddress: SoAdSocketRemoteIpAddress=, SoAdSocketRemotePort=0
            SCB_ECU4_CRN_UDP_fixed_10_20_1_4_40000_fe8ef92c
              SoAdSocketRemoteAddress: SoAdSocketRemoteIpAddress=239.20.0.3, SoAdSocketRemotePort=40000
          SoAdSocketProtocol
            SoAdSocketUdp: SoAdSocketUdpTriggerTimeout=0.01, SoAdSocketnPduUdpTxBufferMin=1472
        SCB_ECU4_CRN_UDP_fixed_10_20_1_4_50001_0b7d970d: SoAdSocketFramePriority=5, SoAdSocketLocalPort=50001, SoAdSocketLocalAddressRef=NE_fixed_10_20_1_4_a84d5d3c
          SCB_ECU4_CRN_UDP_fixed_10_20_1_4_50001_7159e673 (SoAdSocketConnection)
            SoAdSocketRemoteAddress: SoAdSocketRemoteIpAddress=10.20.1.1, SoAdSocketRemotePort=50001
          SoAdSocketProtocol
            SoAdSocketUdp
        SCB_ECU4_CRN_UDP_fixed_10_20_1_4_50002_9274c6b7: SoAdSocketFramePriority=5, SoAdSocketLocalPort=50002, SoAdSocketLocalAddressRef=NE_fixed_10_20_1_4_a84d5d3c
          SCB_ECU4_CRN_UDP_fixed_10_20_1_4_50002_4fd5bf06 (SoAdSocketConnection)
            SoAdSocketRemoteAddress: SoAdSocketRemoteIpAddress=10.20.1.1, SoAdSocketRemotePort=50002
          SoAdSocketProtocol
            SoAdSocketUdp
        SCB_ECU4_CRN_UDP_fixed_10_20_1_4_50005_0c105314: SoAdSocketFramePriority=5, SoAdSocketLocalPort=50005, SoAdSocketLocalAddressRef=NE_fixed_10_20_1_4_a84d5d3c
          SCB_ECU4_CRN_UDP_fixed_10_20_1_4_50005_9199c700 (SoAdSocketConnection)
            SoAdSocketRemoteAddress: SoAdSocketRemoteIpAddress=10.20.1.1, SoAdSocketRemotePort=50005
          SoAdSocketProtocol
            SoAdSocketUdp
        SCB_ECU4_CRN_UDP_fixed_10_20_1_4_50006_951902ae: SoAdSocketFramePriority=5, SoAdSocketLocalPort=50006, SoAdSocketLocalAddressRef=NE_fixed_10_20_1_4_a84d5d3c
          SCB_ECU4_CRN_UDP_fixed_10_20_1_4_50006_af159e75 (SoAdSocketConnection)
            SoAdSocketRemoteAddress: SoAdSocketRemoteIpAddress=10.20.1.1, SoAdSocketRemotePort=50006
          SoAdSocketProtocol
            SoAdSocketUdp
        SCB_ECU4_CRN_UDP_fixed_10_20_1_4_50007_e21e3238: SoAdSocketFramePriority=5, SoAdSocketLocalPort=50007, SoAdSocketLocalAddressRef=NE_fixed_10_20_1_4_a84d5d3c
          SCB_ECU4_CRN_UDP_fixed_10_20_1_4_50007_0c415499 (SoAdSocketConnection)
            SoAdSocketRemoteAddress: SoAdSocketRemoteIpAddress=10.20.1.1, SoAdSocketRemotePort=50007
          SoAdSocketProtocol
            SoAdSocketUdp
        SCB_ECU4_CRN_UDP_fixed_10_20_1_4_50013_fc68c760: SoAdSocketFramePriority=5, SoAdSocketLocalPort=50013, SoAdSocketLocalAddressRef=NE_fixed_10_20_1_4_a84d5d3c
          SCB_ECU4_CRN_UDP_fixed_10_20_1_4_50013_459e8f73 (SoAdSocketConnection)
            SoAdSocketRemoteAddress: SoAdSocketRemoteIpAddress=10.20.1.1, SoAdSocketRemotePort=50013
          SCB_ECU4_CRN_UDP_fixed_10_20_1_4_50013_a45e358d (SoAdSocketConnection)
            SoAdSocketRemoteAddress: SoAdSocketRemoteIpAddress=10.20.1.7, SoAdSocketRemotePort=50013
          SoAdSocketProtocol
            SoAdSocketUdp
        SCB_ECU4_CRN_UDP_fixed_10_20_1_4_50014_620c52c3: SoAdSocketFramePriority=5, SoAdSocketLocalPort=50014, SoAdSocketLocalAddressRef=NE_fixed_10_20_1_4_a84d5d3c
          SCB_ECU4_CRN_UDP_fixed_10_20_1_4_50014_9bd2f775 (SoAdSocketConnection)
            SoAdSocketRemoteAddress: SoAdSocketRemoteIpAddress=10.20.1.1, SoAdSocketRemotePort=50014
          SoAdSocketProtocol
            SoAdSocketUdp
        SCB_ECU4_CRN_UDP_fixed_10_20_1_4_50015_150b6255: SoAdSocketFramePriority=5, SoAdSocketLocalPort=50015, SoAdSocketLocalAddressRef=NE_fixed_10_20_1_4_a84d5d3c
          SCB_ECU4_CRN_UDP_fixed_10_20_1_4_50015_38863d99 (SoAdSocketConnection)
            SoAdSocketRemoteAddress: SoAdSocketRemoteIpAddress=10.20.1.1, SoAdSocketRemotePort=50015
          SCB_ECU4_CRN_UDP_fixed_10_20_1_4_50015_d9468767 (SoAdSocketConnection)
            SoAdSocketRemoteAddress: SoAdSocketRemoteIpAddress=10.20.1.7, SoAdSocketRemotePort=50015
          SoAdSocketProtocol
            SoAdSocketUdp
        SCB_ECU4_CRN_UDP_fixed_10_20_1_4_50016_8c0233ef: SoAdSocketFramePriority=5, SoAdSocketLocalPort=50016, SoAdSocketLocalAddressRef=NE_fixed_10_20_1_4_a84d5d3c
          SCB_ECU4_CRN_UDP_fixed_10_20_1_4_50016_060a64ec (SoAdSocketConnection)
            SoAdSocketRemoteAddress: SoAdSocketRemoteIpAddress=10.20.1.1, SoAdSocketRemotePort=50016
          SCB_ECU4_CRN_UDP_fixed_10_20_1_4_50016_e7cade12 (SoAdSocketConnection)
            SoAdSocketRemoteAddress: SoAdSocketRemoteIpAddress=10.20.1.7, SoAdSocketRemotePort=50016
          SoAdSocketProtocol
            SoAdSocketUdp
        SCB_ECU4_CRN_UDP_fixed_10_20_1_4_50017_fb050379: SoAdSocketFramePriority=5, SoAdSocketLocalPort=50017, SoAdSocketLocalAddressRef=NE_fixed_10_20_1_4_a84d5d3c
          SCB_ECU4_CRN_UDP_fixed_10_20_1_4_50017_a55eae00 (SoAdSocketConnection)
            SoAdSocketRemoteAddress: SoAdSocketRemoteIpAddress=10.20.1.1, SoAdSocketRemotePort=50017
          SoAdSocketProtocol
            SoAdSocketUdp
        SCB_ECU4_CRN_UDP_fixed_10_20_1_4_50031_2050c4ce: SoAdPduHeaderEnable=true, SoAdSocketFramePriority=5, SoAdSocketLocalPort=50031, SoAdSocketLocalAddressRef=NE_fixed_10_20_1_4_a84d5d3c
          SCB_ECU4_CRN_UDP_fixed_10_20_1_4_50031_b0c85567 (SoAdSocketConnection)
            SoAdSocketRemoteAddress: SoAdSocketRemoteIpAddress=10.20.1.7, SoAdSocketRemotePort=50031
          SoAdSocketProtocol
            SoAdSocketUdp
        SCB_ECU4_CRN_UDP_fixed_10_20_1_4_50032_b9599574: SoAdPduHeaderEnable=true, SoAdSocketFramePriority=5, SoAdSocketLocalPort=50032, SoAdSocketLocalAddressRef=NE_fixed_10_20_1_4_a84d5d3c
          SCB_ECU4_CRN_UDP_fixed_10_20_1_4_50032_8e440c12 (SoAdSocketConnection)
            SoAdSocketRemoteAddress: SoAdSocketRemoteIpAddress=10.20.1.7, SoAdSocketRemotePort=50032
          SoAdSocketProtocol
            SoAdSocketUdp
        SCB_ECU4_CRN_UDP_fixed_10_2_1_4_13400_2ccf2d0f: SoAdSocketFramePriority=0, SoAdSocketLocalPort=13400, SoAdSocketLocalAddressRef=NE_fixed_10_2_1_4_0df3b795
          SCB_ECU4_CRN_UDP_fixed_10_2_1_4_13400_51df633c (SoAdSocketConnection)
            SoAdSocketRemoteAddress: SoAdSocketRemoteIpAddress=255.255.255.255, SoAdSocketRemotePort=13400
          SCB_ECU4_CRN_UDP_fixed_10_2_1_4_13400_5677dce6 (SoAdSocketConnection)
            SoAdSocketRemoteAddress: SoAdSocketRemoteIpAddress=, SoAdSocketRemotePort=0
          SoAdSocketProtocol
            SoAdSocketUdp
        SCB_TCP_fixed_10_20_1_1_50022_fe1f5efd: SoAdPduHeaderEnable=true, SoAdSocketFramePriority=5, SoAdSocketLocalPort=50022, SoAdSocketLocalAddressRef=NE_fixed_10_20_1_4_a84d5d3c
          SCB_TCP_fixed_10_20_1_1_50022_d46cdb48 (SoAdSocketConnection)
            SoAdSocketRemoteAddress: SoAdSocketRemoteIpAddress=10.20.1.1, SoAdSocketRemotePort=50022
          SoAdSocketProtocol
            SoAdSocketTcp: SoAdSocketTcpInitiate=true
        SCB_TCP_fixed_10_20_1_1_50031_bb1c6729: SoAdPduHeaderEnable=true, SoAdSocketFramePriority=5, SoAdSocketLocalPort=50031, SoAdSocketLocalAddressRef=NE_fixed_10_20_1_4_a84d5d3c
          SCB_TCP_fixed_10_20_1_1_50031_547ebbb3 (SoAdSocketConnection)
            SoAdSocketRemoteAddress: SoAdSocketRemoteIpAddress=10.20.1.1, SoAdSocketRemotePort=50031
          SoAdSocketProtocol
            SoAdSocketTcp: SoAdSocketTcpInitiate=true
      66 x SoAdSocketRoute:
        ECU4_CRN_SD_Bundle_Multicast_Rx_b6cf9c92_Rx: SoAdRxPduHeaderId=4294934784, SoAdRxSocketConnOrSocketConnBundleRef=ECU4_CRN_SD_Bundle_Multicast_Rx_7881f48f
          ECU4_CRN_SD_Bundle_Multicast_Rx_2f2fa5e3 (SoAdSocketRouteDest): SoAdRxUpperLayerType=IF, SoAdRxPduRef=SD_Ctrl_Rx_Multicast_963ccc44_Rx
        ECU4_CRN_SD_Bundle_afb16a4e_Rx: SoAdRxPduHeaderId=4294934784, SoAdRxSocketConnOrSocketConnBundleRef=ECU4_CRN_SD_Bundle_9c7db8fe/ECU4_CRN_SD_Bundle_367c5ca5
          ECU4_CRN_SD_Bundle_12d3fea6 (SoAdSocketRouteDest): SoAdRxUpperLayerType=IF, SoAdRxPduRef=SD_Ctrl_Rx_7ba60884_Rx
        SCB_ECU4_CRN_DoIP_TCP_dhcpv4AndFixed_169_254_17_4_13400_0f61c4e2_Rx: SoAdRxSocketConnOrSocketConnBundleRef=SCB_ECU4_CRN_DoIP_TCP_dhcpv4AndFixed_169_254_17_4_13400_c10cc7ff/SCB_ECU4_CRN_DoIP_TCP_dhcpv4AndFixed_169_254_17_4_13400_30e6cc67
          SCB_ECU4_CRN_DoIP_TCP_dhcpv4AndFixed_169_254_17_4_13400_519609df (SoAdSocketRouteDest): SoAdRxUpperLayerType=TP, SoAdRxPduRef=DIAG_RQ_Eth_CTP_TCP_90fadfb5_Rx
        SCB_ECU4_CRN_DoIP_TCP_dhcpv4AndFixed_169_254_17_4_13400_286668d6_Rx: SoAdRxSocketConnOrSocketConnBundleRef=SCB_ECU4_CRN_DoIP_TCP_dhcpv4AndFixed_169_254_17_4_13400_c10cc7ff/SCB_ECU4_CRN_DoIP_TCP_dhcpv4AndFixed_169_254_17_4_13400_55056e49
          SCB_ECU4_CRN_DoIP_TCP_dhcpv4AndFixed_169_254_17_4_13400_6a327634 (SoAdSocketRouteDest): SoAdRxUpperLayerType=TP, SoAdRxPduRef=DIAG_RQ_Eth_CTP_TCP_2_00d24b67_Rx
        SCB_ECU4_CRN_DoIP_TCP_fixed_10_2_1_4_13400_c23f49f9_Rx: SoAdRxSocketConnOrSocketConnBundleRef=SCB_ECU4_CRN_DoIP_TCP_fixed_10_2_1_4_13400_178bb553/SCB_ECU4_CRN_DoIP_TCP_fixed_10_2_1_4_13400_86786c2c
          SCB_ECU4_CRN_DoIP_TCP_fixed_10_2_1_4_13400_38656774 (SoAdSocketRouteDest): SoAdRxUpperLayerType=TP, SoAdRxPduRef=DIAG_RQ_Eth_CTP_TCP_7b509708_Rx
        SCB_ECU4_CRN_DoIP_TCP_fixed_10_2_1_4_13400_f6a726df_Rx: SoAdRxSocketConnOrSocketConnBundleRef=SCB_ECU4_CRN_DoIP_TCP_fixed_10_2_1_4_13400_178bb553/SCB_ECU4_CRN_DoIP_TCP_fixed_10_2_1_4_13400_27418eb4
          SCB_ECU4_CRN_DoIP_TCP_fixed_10_2_1_4_13400_a94cbc75 (SoAdSocketRouteDest): SoAdRxUpperLayerType=TP, SoAdRxPduRef=DIAG_RQ_Eth_CTP_TCP_2_29beb99a_Rx
        SCB_ECU4_CRN_TCP_RX_Any_DynamicPort_4ae64757_Rx: SoAdRxPduHeaderId=824279041, SoAdRxSocketConnOrSocketConnBundleRef=SCB_ECU4_CRN_TCP_RX_Any_DynamicPort_479f244f
          SCB_ECU4_CRN_TCP_RX_Any_DynamicPort_40849541 (SoAdSocketRouteDest): SoAdRxUpperLayerType=IF, SoAdRxPduRef=Eth_CANFD_ST3_TPA_5c803507_Rx, SoAdRxRoutingGroupRef=Service_Id_12577_SI_ID_10_Eth_CANFD_AC_d28c2093
        SCB_ECU4_CRN_TCP_fixed_10_20_1_4_50030_edd282a7_Rx: SoAdRxPduHeaderId=268992513, SoAdRxSocketConnOrSocketConnBundleRef=SCB_ECU4_CRN_TCP_fixed_10_20_1_4_50030_4ba92126
          SCB_ECU4_CRN_TCP_fixed_10_20_1_4_50030_c7ae1e21 (SoAdSocketRouteDest): SoAdRxUpperLayerType=IF, SoAdRxPduRef=EcucPduCollection/COM_C07_Pdu01_PN08_5773f977_Rx
        SCB_ECU4_CRN_UDP_Multicast_Rx_Any_40000_051de628_Rx: SoAdRxPduHeaderId=1090551810, SoAdRxSocketConnOrSocketConnBundleRef=SCB_ECU4_CRN_UDP_Multicast_Rx_Any_40000_fe219239
          SCB_ECU4_CRN_UDP_Multicast_Rx_Any_40000_8a7cc002 (SoAdSocketRouteDest): SoAdRxUpperLayerType=IF, SoAdRxPduRef=VSS_TP_RealTmOffset_ST3_cbb996f7_Rx, SoAdRxRoutingGroupRef=Service_Id_16640_SI_ID_0_VSS_AM_cc70e810
        SCB_ECU4_CRN_UDP_Multicast_Rx_Any_40000_12bac2d5_Rx: SoAdRxPduHeaderId=278167569, SoAdRxSocketConnOrSocketConnBundleRef=SCB_ECU4_CRN_UDP_Multicast_Rx_Any_40000_fe219239
          SCB_ECU4_CRN_UDP_Multicast_Rx_Any_40000_4d2e1c12 (SoAdSocketRouteDest):
            SoAdRxUpperLayerType = IF
            SoAdRxPduRef = EcucPduCollection/COM_C0X_Pdu11_0bee96bd_Rx
            SoAdRxRoutingGroupRef = Service_Id_4244_SI_ID_10_Event_1_AM_cffe50fa
            SoAdRxRoutingGroupRef = Service_Id_4244_SI_ID_10_Event_2_AM_dd4bff14
        SCB_ECU4_CRN_UDP_Multicast_Rx_Any_40000_38cf8380_Rx: SoAdRxPduHeaderId=278167574, SoAdRxSocketConnOrSocketConnBundleRef=SCB_ECU4_CRN_UDP_Multicast_Rx_Any_40000_fe219239
          SCB_ECU4_CRN_UDP_Multicast_Rx_Any_40000_17cab7cc (SoAdSocketRouteDest):
            SoAdRxUpperLayerType = IF
            SoAdRxPduRef = EcucPduCollection/COM_C0X_Pdu16_219bd7e8_Rx
            SoAdRxRoutingGroupRef = Service_Id_4244_SI_ID_10_Event_1_AM_cffe50fa
        SCB_ECU4_CRN_UDP_Multicast_Rx_Any_40000_3a79373f_Rx: SoAdRxPduHeaderId=839155712, SoAdRxSocketConnOrSocketConnBundleRef=SCB_ECU4_CRN_UDP_Multicast_Rx_Any_40000_fe219239
          SCB_ECU4_CRN_UDP_Multicast_Rx_Any_40000_6148b9b5 (SoAdSocketRouteDest): SoAdRxUpperLayerType=IF, SoAdRxPduRef=EcucPduCollection/DI_OdoSpeedometer_ST3_secured_79fb4c12_Rx
        SCB_ECU4_CRN_UDP_Multicast_Rx_Any_40000_3ed4338f_Rx: SoAdRxPduHeaderId=511868937, SoAdRxSocketConnOrSocketConnBundleRef=SCB_ECU4_CRN_UDP_Multicast_Rx_Any_40000_fe219239
          SCB_ECU4_CRN_UDP_Multicast_Rx_Any_40000_e663ee22 (SoAdSocketRouteDest):
            SoAdRxUpperLayerType = IF
            SoAdRxPduRef = EcucPduCollection/VehSpd_8_ST3_secured_f1100af2_Rx
            SoAdRxRoutingGroupRef = Service_Id_7810_SI_ID_1_Vehspd_8_AM_da805f87
        SCB_ECU4_CRN_UDP_Multicast_Rx_Any_40000_4598ee87_Rx: SoAdRxPduHeaderId=278167570, SoAdRxSocketConnOrSocketConnBundleRef=SCB_ECU4_CRN_UDP_Multicast_Rx_Any_40000_fe219239
          SCB_ECU4_CRN_UDP_Multicast_Rx_Any_40000_879414fe (SoAdSocketRouteDest):
            SoAdRxUpperLayerType = IF
            SoAdRxPduRef = EcucPduCollection/COM_C0X_Pdu12_5cccbaef_Rx
            SoAdRxRoutingGroupRef = Service_Id_4244_SI_ID_10_Event_1_AM_cffe50fa
            SoAdRxRoutingGroupRef = Service_Id_4244_SI_ID_10_Event_2_AM_dd4bff14
        SCB_ECU4_CRN_UDP_Multicast_Rx_Any_40000_6c25012a_Rx: SoAdRxPduHeaderId=278167576, SoAdRxSocketConnOrSocketConnBundleRef=SCB_ECU4_CRN_UDP_Multicast_Rx_Any_40000_fe219239
          SCB_ECU4_CRN_UDP_Multicast_Rx_Any_40000_cd358c27 (SoAdSocketRouteDest):
            SoAdRxUpperLayerType = IF
            SoAdRxPduRef = EcucPduCollection/COM_C0X_Pdu18_75715542_Rx
            SoAdRxRoutingGroupRef = Service_Id_4244_SI_ID_10_Event_1_AM_cffe50fa
        SCB_ECU4_CRN_UDP_Multicast_Rx_Any_40000_6fedafd2_Rx: SoAdRxPduHeaderId=278167573, SoAdRxSocketConnOrSocketConnBundleRef=SCB_ECU4_CRN_UDP_Multicast_Rx_Any_40000_fe219239
          SCB_ECU4_CRN_UDP_Multicast_Rx_Any_40000_23042121 (SoAdSocketRouteDest):
            SoAdRxUpperLayerType = IF
            SoAdRxPduRef = EcucPduCollection/COM_C0X_Pdu15_76b9fbba_Rx
            SoAdRxRoutingGroupRef = Service_Id_4244_SI_ID_10_Event_1_AM_cffe50fa
            SoAdRxRoutingGroupRef = Service_Id_4244_SI_ID_10_Event_2_AM_dd4bff14
        SCB_ECU4_CRN_UDP_Multicast_Rx_Any_40000_778a55c4_Rx: SoAdRxPduHeaderId=1090551812, SoAdRxSocketConnOrSocketConnBundleRef=SCB_ECU4_CRN_UDP_Multicast_Rx_Any_40000_fe219239
          SCB_ECU4_CRN_UDP_Multicast_Rx_Any_40000_24f1831b (SoAdSocketRouteDest):
            SoAdRxUpperLayerType = IF
            SoAdRxPduRef = EcucPduCollection/VSS_TP_SecTickCount_Lvl1_ST3_9c1812ac_Rx
            SoAdRxRoutingGroupRef = Service_Id_16640_SI_ID_0_VSS_AM_cc70e810
        SCB_ECU4_CRN_UDP_Multicast_Rx_Any_40000_8a0f355c_Rx: SoAdRxPduHeaderId=278167585, SoAdRxSocketConnOrSocketConnBundleRef=SCB_ECU4_CRN_UDP_Multicast_Rx_Any_40000_fe219239
          SCB_ECU4_CRN_UDP_Multicast_Rx_Any_40000_a55ab3bc (SoAdSocketRouteDest):
            SoAdRxUpperLayerType = IF
            SoAdRxPduRef = EcucPduCollection/COM_C0X_Pdu21_secured_a474fce4_Rx
            SoAdRxRoutingGroupRef = Service_Id_4244_SI_ID_10_Event_1_AM_cffe50fa
        SCB_ECU4_CRN_UDP_Multicast_Rx_Any_40000_968bdb24_Rx: SoAdRxPduHeaderId=278167568, SoAdRxSocketConnOrSocketConnBundleRef=SCB_ECU4_CRN_UDP_Multicast_Rx_Any_40000_fe219239
          SCB_ECU4_CRN_UDP_Multicast_Rx_Any_40000_a8980e06 (SoAdSocketRouteDest):
            SoAdRxUpperLayerType = IF
            SoAdRxPduRef = EcucPduCollection/COM_C0X_Pdu10_8fdf8f4c_Rx
            SoAdRxRoutingGroupRef = Service_Id_4244_SI_ID_10_Event_1_AM_cffe50fa
        SCB_ECU4_CRN_UDP_Multicast_Rx_Any_40000_99e913f3_Rx: SoAdRxPduHeaderId=8421376, SoAdRxSocketConnOrSocketConnBundleRef=SCB_ECU4_CRN_UDP_Multicast_Rx_Any_40000_fe219239
          SCB_ECU4_CRN_UDP_Multicast_Rx_Any_40000_74c47900 (SoAdSocketRouteDest): SoAdRxUpperLayerType=IF, SoAdRxPduRef=Ign_Stat_ST3_secured_562d2a8e_Rx, SoAdRxRoutingGroupRef=Service_Id_128_SI_ID_0_Ign_Stat_AM_2f00d482
        SCB_ECU4_CRN_UDP_Multicast_Rx_Any_40000_9f0e383b_Rx: SoAdRxPduHeaderId=964722688, SoAdRxSocketConnOrSocketConnBundleRef=SCB_ECU4_CRN_UDP_Multicast_Rx_Any_40000_fe219239
          SCB_ECU4_CRN_UDP_Multicast_Rx_Any_40000_7685c9d0 (SoAdSocketRouteDest):
            SoAdRxUpperLayerType = IF
            SoAdRxPduRef = EcucPduCollection/PN14_Master_Stat1_ST3_secured_dc8c4316_Rx
            SoAdRxRoutingGroupRef = Service_Id_14720_SI_ID_0_PN14_Master_AM_9da4b2b2
        SCB_ECU4_CRN_UDP_Multicast_Rx_Any_40000_9fe2d54a_Rx: SoAdRxPduHeaderId=1090551808, SoAdRxSocketConnOrSocketConnBundleRef=SCB_ECU4_CRN_UDP_Multicast_Rx_Any_40000_fe219239
          SCB_ECU4_CRN_UDP_Multicast_Rx_Any_40000_051f368b (SoAdSocketRouteDest): SoAdRxUpperLayerType=IF, SoAdRxPduRef=VSS_TP_VIN_ST3_dc926874_Rx, SoAdRxRoutingGroupRef=Service_Id_16640_SI_ID_0_VSS_AM_cc70e810
        SCB_ECU4_CRN_UDP_Multicast_Rx_Any_40000_b6453c54_Rx: SoAdRxPduHeaderId=1090551811, SoAdRxSocketConnOrSocketConnBundleRef=SCB_ECU4_CRN_UDP_Multicast_Rx_Any_40000_fe219239
          SCB_ECU4_CRN_UDP_Multicast_Rx_Any_40000_3a7c4e3c (SoAdSocketRouteDest): SoAdRxUpperLayerType=IF, SoAdRxPduRef=VSS_TP_SharedSecret_ST3_78e14c8b_Rx, SoAdRxRoutingGroupRef=Service_Id_16640_SI_ID_0_VSS_AM_cc70e810
        SCB_ECU4_CRN_UDP_Multicast_Rx_Any_40000_bcfe9a71_Rx: SoAdRxPduHeaderId=278167575, SoAdRxSocketConnOrSocketConnBundleRef=SCB_ECU4_CRN_UDP_Multicast_Rx_Any_40000_fe219239
          SCB_ECU4_CRN_UDP_Multicast_Rx_Any_40000_801aa537 (SoAdSocketRouteDest):
            SoAdRxUpperLayerType = IF
            SoAdRxPduRef = EcucPduCollection/COM_C0X_Pdu17_a5aace19_Rx
            SoAdRxRoutingGroupRef = Service_Id_4244_SI_ID_10_Event_1_AM_cffe50fa
        SCB_ECU4_CRN_UDP_Multicast_Rx_Any_40000_c0c83acf_Rx: SoAdRxPduHeaderId=278167584, SoAdRxSocketConnOrSocketConnBundleRef=SCB_ECU4_CRN_UDP_Multicast_Rx_Any_40000_fe219239
          SCB_ECU4_CRN_UDP_Multicast_Rx_Any_40000_346bf9bb (SoAdSocketRouteDest):
            SoAdRxUpperLayerType = IF
            SoAdRxPduRef = EcucPduCollection/COM_C0X_Pdu20_secured_eeb3f377_Rx
            SoAdRxRoutingGroupRef = Service_Id_4244_SI_ID_10_Event_1_AM_cffe50fa
        SCB_ECU4_CRN_UDP_Multicast_Rx_Any_40000_c1a9f776_Rx: SoAdRxPduHeaderId=278167571, SoAdRxSocketConnOrSocketConnBundleRef=SCB_ECU4_CRN_UDP_Multicast_Rx_Any_40000_fe219239
          SCB_ECU4_CRN_UDP_Multicast_Rx_Any_40000_bff8ed48 (SoAdSocketRouteDest):
            SoAdRxUpperLayerType = IF
            SoAdRxPduRef = EcucPduCollection/COM_C0X_Pdu13_d8fda31e_Rx
            SoAdRxRoutingGroupRef = Service_Id_4244_SI_ID_10_Event_1_AM_cffe50fa
            SoAdRxRoutingGroupRef = Service_Id_4244_SI_ID_10_Event_2_AM_dd4bff14
        SCB_ECU4_CRN_UDP_Multicast_Rx_Any_40000_c339098c_Rx: SoAdRxPduHeaderId=1090551809, SoAdRxSocketConnOrSocketConnBundleRef=SCB_ECU4_CRN_UDP_Multicast_Rx_Any_40000_fe219239
          SCB_ECU4_CRN_UDP_Multicast_Rx_Any_40000_35807dbd (SoAdSocketRouteDest): SoAdRxUpperLayerType=IF, SoAdRxPduRef=VSS_TP_Auth_ST3_021b649a_Rx, SoAdRxRoutingGroupRef=Service_Id_16640_SI_ID_0_VSS_AM_cc70e810
        SCB_ECU4_CRN_UDP_Multicast_Rx_Any_40000_e81418db_Rx: SoAdRxPduHeaderId=278167577, SoAdRxSocketConnOrSocketConnBundleRef=SCB_ECU4_CRN_UDP_Multicast_Rx_Any_40000_fe219239
          SCB_ECU4_CRN_UDP_Multicast_Rx_Any_40000_a632b6e5 (SoAdSocketRouteDest):
            SoAdRxUpperLayerType = IF
            SoAdRxPduRef = EcucPduCollection/COM_C0X_Pdu19_f1404cb3_Rx
            SoAdRxRoutingGroupRef = Service_Id_4244_SI_ID_10_Event_1_AM_cffe50fa
        SCB_ECU4_CRN_UDP_Multicast_Rx_Any_40000_ebdcb623_Rx: SoAdRxPduHeaderId=278167572, SoAdRxSocketConnOrSocketConnBundleRef=SCB_ECU4_CRN_UDP_Multicast_Rx_Any_40000_fe219239
          SCB_ECU4_CRN_UDP_Multicast_Rx_Any_40000_06a6b2fa (SoAdSocketRouteDest):
            SoAdRxUpperLayerType = IF
            SoAdRxPduRef = EcucPduCollection/COM_C0X_Pdu14_f288e24b_Rx
            SoAdRxRoutingGroupRef = Service_Id_4244_SI_ID_10_Event_1_AM_cffe50fa
            SoAdRxRoutingGroupRef = Service_Id_4244_SI_ID_10_Event_2_AM_dd4bff14
        SCB_ECU4_CRN_UDP_Multicast_Rx_Any_40000_eeba0888_Rx: SoAdRxPduHeaderId=956596230, SoAdRxSocketConnOrSocketConnBundleRef=SCB_ECU4_CRN_UDP_Multicast_Rx_Any_40000_fe219239
          SCB_ECU4_CRN_UDP_Multicast_Rx_Any_40000_59eb7f31 (SoAdSocketRouteDest):
            SoAdRxUpperLayerType = IF
            SoAdRxPduRef = EcucPduCollection/PT4_PTCoor4_ST3_secured_201e7857_Rx
            SoAdRxRoutingGroupRef = Service_Id_14596_SI_ID_0_PT4_PTCoor4_AM_abd0aae4
        SCB_ECU4_CRN_UDP_Multicast_Rx_fixed_239_127_0_1_20000_61e64a74_Rx: SoAdRxSocketConnOrSocketConnBundleRef=SCB_ECU4_CRN_UDP_Multicast_Rx_fixed_239_127_0_1_20000_b0a881ab
          SCB_ECU4_CRN_UDP_Multicast_Rx_fixed_239_127_0_1_20000_e6eb2e33 (SoAdSocketRouteDest): SoAdRxUpperLayerType=IF, SoAdRxPduRef=NM_Dummy_ST3_eb0914da_Rx
        SCB_ECU4_CRN_UDP_Multicast_Rx_fixed_239_2_0_17_40001_b7998378_Rx: SoAdRxPduHeaderId=973242368, SoAdRxSocketConnOrSocketConnBundleRef=SCB_ECU4_CRN_UDP_Multicast_Rx_fixed_239_2_0_17_40001_33c8a959
          SCB_ECU4_CRN_UDP_Multicast_Rx_fixed_239_2_0_17_40001_1ec6351a (SoAdSocketRouteDest): SoAdRxUpperLayerType=IF, SoAdRxPduRef=EcucPduCollection/DIAG_C01_ONBD_Container_ST3_DIAG_Stat_ST3_bc0bc640_Rx
        SCB_ECU4_CRN_UDP_dhcpv4AndFixed_169_254_17_4_13400_85381f72_Rx: SoAdRxSocketConnOrSocketConnBundleRef=SCB_ECU4_CRN_UDP_dhcpv4AndFixed_169_254_17_4_13400_5dc7dc8e/SCB_ECU4_CRN_UDP_dhcpv4AndFixed_169_254_17_4_13400_a3481a80
          SCB_ECU4_CRN_UDP_dhcpv4AndFixed_169_254_17_4_13400_04bf362b (SoAdSocketRouteDest): SoAdRxUpperLayerType=IF, SoAdRxPduRef=DIAG_RQ_Eth_CTP_2_247cf24d_Rx
        SCB_ECU4_CRN_UDP_fixed_10_20_1_4_40000_064b5f71_Rx: SoAdRxPduHeaderId=956596230, SoAdRxSocketConnOrSocketConnBundleRef=SoAdConfig/SCB_ECU4_CRN_UDP_fixed_10_20_1_4_40000_411a8e2b
          SCB_ECU4_CRN_UDP_fixed_10_20_1_4_40000_68b41a05 (SoAdSocketRouteDest):
            SoAdRxUpperLayerType = IF
            SoAdRxPduRef = EcucPduCollection/PT4_PTCoor4_ST3_secured_201e7857_Rx
            SoAdRxRoutingGroupRef = Service_Id_14596_SI_ID_0_PT4_PTCoor4_AC_4c6887e3
        SCB_ECU4_CRN_UDP_fixed_10_20_1_4_40000_08f58203_Rx: SoAdRxPduHeaderId=278167572, SoAdRxSocketConnOrSocketConnBundleRef=SoAdConfig/SCB_ECU4_CRN_UDP_fixed_10_20_1_4_40000_411a8e2b
          SCB_ECU4_CRN_UDP_fixed_10_20_1_4_40000_83f3f354 (SoAdSocketRouteDest):
            SoAdRxUpperLayerType = IF
            SoAdRxPduRef = EcucPduCollection/COM_C0X_Pdu14_f288e24b_Rx
            SoAdRxRoutingGroupRef = Service_Id_4244_SI_ID_10_Event_1_AC_28467dfd
            SoAdRxRoutingGroupRef = Service_Id_4244_SI_ID_10_Event_2_AC_3af3d213
        SCB_ECU4_CRN_UDP_fixed_10_20_1_4_40000_0b3d2cfb_Rx: SoAdRxPduHeaderId=278167577, SoAdRxSocketConnOrSocketConnBundleRef=SoAdConfig/SCB_ECU4_CRN_UDP_fixed_10_20_1_4_40000_411a8e2b
          SCB_ECU4_CRN_UDP_fixed_10_20_1_4_40000_2367f74b (SoAdSocketRouteDest):
            SoAdRxUpperLayerType = IF
            SoAdRxPduRef = EcucPduCollection/COM_C0X_Pdu19_f1404cb3_Rx
            SoAdRxRoutingGroupRef = Service_Id_4244_SI_ID_10_Event_1_AC_28467dfd
        SCB_ECU4_CRN_UDP_fixed_10_20_1_4_40000_1bfc9cef_Rx: SoAdRxPduHeaderId=839155712, SoAdRxSocketConnOrSocketConnBundleRef=SoAdConfig/SCB_ECU4_CRN_UDP_fixed_10_20_1_4_40000_411a8e2b
          SCB_ECU4_CRN_UDP_fixed_10_20_1_4_40000_19b69460 (SoAdSocketRouteDest):
            SoAdRxUpperLayerType = IF
            SoAdRxPduRef = EcucPduCollection/DI_OdoSpeedometer_ST3_secured_79fb4c12_Rx
            SoAdRxRoutingGroupRef = Service_Id_12804_SI_ID_0_DI_Master_Odometer_AC_93a1f098
        SCB_ECU4_CRN_UDP_fixed_10_20_1_4_40000_2280c356_Rx: SoAdRxPduHeaderId=278167571, SoAdRxSocketConnOrSocketConnBundleRef=SoAdConfig/SCB_ECU4_CRN_UDP_fixed_10_20_1_4_40000_411a8e2b
          SCB_ECU4_CRN_UDP_fixed_10_20_1_4_40000_3aadace6 (SoAdSocketRouteDest):
            SoAdRxUpperLayerType = IF
            SoAdRxPduRef = EcucPduCollection/COM_C0X_Pdu13_d8fda31e_Rx
            SoAdRxRoutingGroupRef = Service_Id_4244_SI_ID_10_Event_1_AC_28467dfd
            SoAdRxRoutingGroupRef = Service_Id_4244_SI_ID_10_Event_2_AC_3af3d213
        SCB_ECU4_CRN_UDP_fixed_10_20_1_4_40000_2a453029_Rx: SoAdRxPduHeaderId=278167584, SoAdRxSocketConnOrSocketConnBundleRef=SoAdConfig/SCB_ECU4_CRN_UDP_fixed_10_20_1_4_40000_411a8e2b
          SCB_ECU4_CRN_UDP_fixed_10_20_1_4_40000_b13eb815 (SoAdSocketRouteDest):
            SoAdRxUpperLayerType = IF
            SoAdRxPduRef = EcucPduCollection/COM_C0X_Pdu20_secured_eeb3f377_Rx
            SoAdRxRoutingGroupRef = Service_Id_4244_SI_ID_10_Event_1_AC_28467dfd
        SCB_ECU4_CRN_UDP_fixed_10_20_1_4_40000_46d530f0_Rx: SoAdRxPduHeaderId=1090551812, SoAdRxSocketConnOrSocketConnBundleRef=SoAdConfig/SCB_ECU4_CRN_UDP_fixed_10_20_1_4_40000_411a8e2b
          SCB_ECU4_CRN_UDP_fixed_10_20_1_4_40000_225c7058 (SoAdSocketRouteDest):
            SoAdRxUpperLayerType = IF
            SoAdRxPduRef = EcucPduCollection/VSS_TP_SecTickCount_Lvl1_ST3_9c1812ac_Rx
            SoAdRxRoutingGroupRef = Service_Id_16640_SI_ID_0_VSS_ACT_3dfc3762
        SCB_ECU4_CRN_UDP_fixed_10_20_1_4_40000_5eb46bad_Rx: SoAdRxPduHeaderId=1090551811, SoAdRxSocketConnOrSocketConnBundleRef=SoAdConfig/SCB_ECU4_CRN_UDP_fixed_10_20_1_4_40000_411a8e2b
          SCB_ECU4_CRN_UDP_fixed_10_20_1_4_40000_cb113c6b (SoAdSocketRouteDest): SoAdRxUpperLayerType=IF, SoAdRxPduRef=VSS_TP_SharedSecret_ST3_78e14c8b_Rx, SoAdRxRoutingGroupRef=Service_Id_16640_SI_ID_0_VSS_ACT_3dfc3762
        SCB_ECU4_CRN_UDP_fixed_10_20_1_4_40000_5fd7ae51_Rx: SoAdRxPduHeaderId=278167575, SoAdRxSocketConnOrSocketConnBundleRef=SoAdConfig/SCB_ECU4_CRN_UDP_fixed_10_20_1_4_40000_411a8e2b
          SCB_ECU4_CRN_UDP_fixed_10_20_1_4_40000_054fe499 (SoAdSocketRouteDest):
            SoAdRxUpperLayerType = IF
            SoAdRxPduRef = EcucPduCollection/COM_C0X_Pdu17_a5aace19_Rx
            SoAdRxRoutingGroupRef = Service_Id_4244_SI_ID_10_Event_1_AC_28467dfd
        SCB_ECU4_CRN_UDP_fixed_10_20_1_4_40000_60823fba_Rx: SoAdRxPduHeaderId=278167585, SoAdRxSocketConnOrSocketConnBundleRef=SoAdConfig/SCB_ECU4_CRN_UDP_fixed_10_20_1_4_40000_411a8e2b
          SCB_ECU4_CRN_UDP_fixed_10_20_1_4_40000_200ff212 (SoAdSocketRouteDest):
            SoAdRxUpperLayerType = IF
            SoAdRxPduRef = EcucPduCollection/COM_C0X_Pdu21_secured_a474fce4_Rx
            SoAdRxRoutingGroupRef = Service_Id_4244_SI_ID_10_Event_1_AC_28467dfd
        SCB_ECU4_CRN_UDP_fixed_10_20_1_4_40000_6699ec0b_Rx: SoAdRxPduHeaderId=511868937, SoAdRxSocketConnOrSocketConnBundleRef=SoAdConfig/SCB_ECU4_CRN_UDP_fixed_10_20_1_4_40000_411a8e2b
          SCB_ECU4_CRN_UDP_fixed_10_20_1_4_40000_22ea55cd (SoAdSocketRouteDest):
            SoAdRxUpperLayerType = IF
            SoAdRxPduRef = EcucPduCollection/VehSpd_8_ST3_secured_f1100af2_Rx
            SoAdRxRoutingGroupRef = Service_Id_7810_SI_ID_1_Vehspd_8_AC_3d387280
        SCB_ECU4_CRN_UDP_fixed_10_20_1_4_40000_75a2ef04_Rx: SoAdRxPduHeaderId=278167568, SoAdRxSocketConnOrSocketConnBundleRef=SoAdConfig/SCB_ECU4_CRN_UDP_fixed_10_20_1_4_40000_411a8e2b
          SCB_ECU4_CRN_UDP_fixed_10_20_1_4_40000_2dcd4fa8 (SoAdSocketRouteDest):
            SoAdRxUpperLayerType = IF
            SoAdRxPduRef = EcucPduCollection/COM_C0X_Pdu10_8fdf8f4c_Rx
            SoAdRxRoutingGroupRef = Service_Id_4244_SI_ID_10_Event_1_AC_28467dfd
        SCB_ECU4_CRN_UDP_fixed_10_20_1_4_40000_77093ab2_Rx: SoAdRxPduHeaderId=1090551809, SoAdRxSocketConnOrSocketConnBundleRef=SoAdConfig/SCB_ECU4_CRN_UDP_fixed_10_20_1_4_40000_411a8e2b
          SCB_ECU4_CRN_UDP_fixed_10_20_1_4_40000_1405d66d (SoAdSocketRouteDest): SoAdRxUpperLayerType=IF, SoAdRxPduRef=VSS_TP_Auth_ST3_021b649a_Rx, SoAdRxRoutingGroupRef=Service_Id_16640_SI_ID_0_VSS_ACT_3dfc3762
        SCB_ECU4_CRN_UDP_fixed_10_20_1_4_40000_8cc49bf2_Rx: SoAdRxPduHeaderId=278167573, SoAdRxSocketConnOrSocketConnBundleRef=SoAdConfig/SCB_ECU4_CRN_UDP_fixed_10_20_1_4_40000_411a8e2b
          SCB_ECU4_CRN_UDP_fixed_10_20_1_4_40000_a651608f (SoAdSocketRouteDest):
            SoAdRxUpperLayerType = IF
            SoAdRxPduRef = EcucPduCollection/COM_C0X_Pdu15_76b9fbba_Rx
            SoAdRxRoutingGroupRef = Service_Id_4244_SI_ID_10_Event_1_AC_28467dfd
            SoAdRxRoutingGroupRef = Service_Id_4244_SI_ID_10_Event_2_AC_3af3d213
        SCB_ECU4_CRN_UDP_fixed_10_20_1_4_40000_8f0c350a_Rx: SoAdRxPduHeaderId=278167576, SoAdRxSocketConnOrSocketConnBundleRef=SoAdConfig/SCB_ECU4_CRN_UDP_fixed_10_20_1_4_40000_411a8e2b
          SCB_ECU4_CRN_UDP_fixed_10_20_1_4_40000_4860cd89 (SoAdSocketRouteDest):
            SoAdRxUpperLayerType = IF
            SoAdRxPduRef = EcucPduCollection/COM_C0X_Pdu18_75715542_Rx
            SoAdRxRoutingGroupRef = Service_Id_4244_SI_ID_10_Event_1_AC_28467dfd
        SCB_ECU4_CRN_UDP_fixed_10_20_1_4_40000_a46fdcb6_Rx: SoAdRxPduHeaderId=1090551808, SoAdRxSocketConnOrSocketConnBundleRef=SoAdConfig/SCB_ECU4_CRN_UDP_fixed_10_20_1_4_40000_411a8e2b
          SCB_ECU4_CRN_UDP_fixed_10_20_1_4_40000_344053bf (SoAdSocketRouteDest): SoAdRxUpperLayerType=IF, SoAdRxPduRef=VSS_TP_VIN_ST3_dc926874_Rx, SoAdRxRoutingGroupRef=Service_Id_16640_SI_ID_0_VSS_ACT_3dfc3762
        SCB_ECU4_CRN_UDP_fixed_10_20_1_4_40000_a6b1daa7_Rx: SoAdRxPduHeaderId=278167570, SoAdRxSocketConnOrSocketConnBundleRef=SoAdConfig/SCB_ECU4_CRN_UDP_fixed_10_20_1_4_40000_411a8e2b
          SCB_ECU4_CRN_UDP_fixed_10_20_1_4_40000_02c15550 (SoAdSocketRouteDest):
            SoAdRxUpperLayerType = IF
            SoAdRxPduRef = EcucPduCollection/COM_C0X_Pdu12_5cccbaef_Rx
            SoAdRxRoutingGroupRef = Service_Id_4244_SI_ID_10_Event_1_AC_28467dfd
            SoAdRxRoutingGroupRef = Service_Id_4244_SI_ID_10_Event_2_AC_3af3d213
        SCB_ECU4_CRN_UDP_fixed_10_20_1_4_40000_be8b93eb_Rx: SoAdRxPduHeaderId=964722688, SoAdRxSocketConnOrSocketConnBundleRef=SoAdConfig/SCB_ECU4_CRN_UDP_fixed_10_20_1_4_40000_411a8e2b
          SCB_ECU4_CRN_UDP_fixed_10_20_1_4_40000_0e7be405 (SoAdSocketRouteDest):
            SoAdRxUpperLayerType = IF
            SoAdRxPduRef = EcucPduCollection/PN14_Master_Stat1_ST3_secured_dc8c4316_Rx
            SoAdRxRoutingGroupRef = Service_Id_14720_SI_ID_0_PN14_Master_AC_7a1c9fb5
        SCB_ECU4_CRN_UDP_fixed_10_20_1_4_40000_c1a4cc77_Rx: SoAdRxPduHeaderId=8421376, SoAdRxSocketConnOrSocketConnBundleRef=SoAdConfig/SCB_ECU4_CRN_UDP_fixed_10_20_1_4_40000_411a8e2b
          SCB_ECU4_CRN_UDP_fixed_10_20_1_4_40000_9c352ef9 (SoAdSocketRouteDest): SoAdRxUpperLayerType=IF, SoAdRxPduRef=Ign_Stat_ST3_secured_562d2a8e_Rx, SoAdRxRoutingGroupRef=Service_Id_128_SI_ID_0_Ign_Stat_ACT_231eb536
        SCB_ECU4_CRN_UDP_fixed_10_20_1_4_40000_dbe6b7a0_Rx: SoAdRxPduHeaderId=278167574, SoAdRxSocketConnOrSocketConnBundleRef=SoAdConfig/SCB_ECU4_CRN_UDP_fixed_10_20_1_4_40000_411a8e2b
          SCB_ECU4_CRN_UDP_fixed_10_20_1_4_40000_929ff662 (SoAdSocketRouteDest):
            SoAdRxUpperLayerType = IF
            SoAdRxPduRef = EcucPduCollection/COM_C0X_Pdu16_219bd7e8_Rx
            SoAdRxRoutingGroupRef = Service_Id_4244_SI_ID_10_Event_1_AC_28467dfd
        SCB_ECU4_CRN_UDP_fixed_10_20_1_4_40000_edecb1d1_Rx: SoAdRxPduHeaderId=1090551810, SoAdRxSocketConnOrSocketConnBundleRef=SoAdConfig/SCB_ECU4_CRN_UDP_fixed_10_20_1_4_40000_411a8e2b
          SCB_ECU4_CRN_UDP_fixed_10_20_1_4_40000_7b11b255 (SoAdSocketRouteDest): SoAdRxUpperLayerType=IF, SoAdRxPduRef=VSS_TP_RealTmOffset_ST3_cbb996f7_Rx, SoAdRxRoutingGroupRef=Service_Id_16640_SI_ID_0_VSS_ACT_3dfc3762
        SCB_ECU4_CRN_UDP_fixed_10_20_1_4_40000_ef08d0e6_Rx: SoAdRxPduHeaderId=67174401, SoAdRxSocketConnOrSocketConnBundleRef=SoAdConfig/SCB_ECU4_CRN_UDP_fixed_10_20_1_4_40000_411a8e2b
          SCB_ECU4_CRN_UDP_fixed_10_20_1_4_40000_427cdeaf (SoAdSocketRouteDest):
            SoAdRxUpperLayerType = IF
            SoAdRxPduRef = EcucPduCollection/COM_C04_Pdu02_Call_0ed7c659_Rx
            SoAdRxRoutingGroupRef = Service_1025_SI_ID_1_Methods_2cb8f438
        SCB_ECU4_CRN_UDP_fixed_10_20_1_4_40000_f193f6f5_Rx: SoAdRxPduHeaderId=278167569, SoAdRxSocketConnOrSocketConnBundleRef=SoAdConfig/SCB_ECU4_CRN_UDP_fixed_10_20_1_4_40000_411a8e2b
          SCB_ECU4_CRN_UDP_fixed_10_20_1_4_40000_c87b5dbc (SoAdSocketRouteDest):
            SoAdRxUpperLayerType = IF
            SoAdRxPduRef = EcucPduCollection/COM_C0X_Pdu11_0bee96bd_Rx
            SoAdRxRoutingGroupRef = Service_Id_4244_SI_ID_10_Event_1_AC_28467dfd
            SoAdRxRoutingGroupRef = Service_Id_4244_SI_ID_10_Event_2_AC_3af3d213
        SCB_ECU4_CRN_UDP_fixed_10_20_1_4_50001_43a4979a_Rx: SoAdRxSocketConnOrSocketConnBundleRef=SCB_ECU4_CRN_UDP_fixed_10_20_1_4_50001_7159e673
          SCB_ECU4_CRN_UDP_fixed_10_20_1_4_50001_727f5ce1 (SoAdSocketRouteDest): SoAdRxUpperLayerType=IF, SoAdRxPduRef=EcucPduCollection/COM_C01_Pdu01_PN08_80ad51b4_Rx
        SCB_ECU4_CRN_UDP_fixed_10_20_1_4_50002_7f823bd2_Rx: SoAdRxSocketConnOrSocketConnBundleRef=SCB_ECU4_CRN_UDP_fixed_10_20_1_4_50002_4fd5bf06
          SCB_ECU4_CRN_UDP_fixed_10_20_1_4_50002_e1c7fdba (SoAdSocketRouteDest): SoAdRxUpperLayerType=IF, SoAdRxPduRef=EcucPduCollection/COM_C01_Pdu01_PN17_9a48397c_Rx
        SCB_ECU4_CRN_UDP_fixed_10_20_1_4_50005_8861e3cc_Rx: SoAdRxSocketConnOrSocketConnBundleRef=SCB_ECU4_CRN_UDP_fixed_10_20_1_4_50005_9199c700
          SCB_ECU4_CRN_UDP_fixed_10_20_1_4_50005_7e51064b (SoAdSocketRouteDest): SoAdRxUpperLayerType=IF, SoAdRxPduRef=EcucPduCollection/COM_C01_Pdu01_PN44_994d2473_Rx
        SCB_ECU4_CRN_UDP_fixed_10_20_1_4_50006_e91c1497_Rx: SoAdRxSocketConnOrSocketConnBundleRef=SCB_ECU4_CRN_UDP_fixed_10_20_1_4_50006_af159e75
          SCB_ECU4_CRN_UDP_fixed_10_20_1_4_50006_98dd5d27 (SoAdSocketRouteDest): SoAdRxUpperLayerType=IF, SoAdRxPduRef=EcucPduCollection/COM_C01_Pdu01_PN53_790696b5_Rx
        SCB_ECU4_CRN_UDP_fixed_10_20_1_4_50007_ed8359e7_Rx: SoAdRxSocketConnOrSocketConnBundleRef=SCB_ECU4_CRN_UDP_fixed_10_20_1_4_50007_0c415499
          SCB_ECU4_CRN_UDP_fixed_10_20_1_4_50007_1990e5a4 (SoAdSocketRouteDest): SoAdRxUpperLayerType=IF, SoAdRxPduRef=EcucPduCollection/COM_C01_Pdu01_PN62_78059db0_Rx
        SCB_ECU4_CRN_UDP_fixed_10_20_1_4_50031_3aa77067_Rx: SoAdRxPduHeaderId=268992514, SoAdRxSocketConnOrSocketConnBundleRef=SCB_ECU4_CRN_UDP_fixed_10_20_1_4_50031_b0c85567
          SCB_ECU4_CRN_UDP_fixed_10_20_1_4_50031_dbf0037d (SoAdSocketRouteDest): SoAdRxUpperLayerType=IF, SoAdRxPduRef=EcucPduCollection/COM_C07_Pdu01_PN44_4e938cb0_Rx
        SCB_ECU4_CRN_UDP_fixed_10_20_1_4_50032_5bda873c_Rx: SoAdRxPduHeaderId=268992515, SoAdRxSocketConnOrSocketConnBundleRef=SCB_ECU4_CRN_UDP_fixed_10_20_1_4_50032_8e440c12
          SCB_ECU4_CRN_UDP_fixed_10_20_1_4_50032_7e5163c4 (SoAdSocketRouteDest): SoAdRxUpperLayerType=IF, SoAdRxPduRef=EcucPduCollection/COM_C07_Pdu01_PN53_aed83e76_Rx
        SCB_ECU4_CRN_UDP_fixed_10_2_1_4_13400_34a84cb9_Rx: SoAdRxSocketConnOrSocketConnBundleRef=SCB_ECU4_CRN_UDP_fixed_10_2_1_4_13400_2ccf2d0f/SCB_ECU4_CRN_UDP_fixed_10_2_1_4_13400_5677dce6
          SCB_ECU4_CRN_UDP_fixed_10_2_1_4_13400_c8e822c1 (SoAdSocketRouteDest): SoAdRxUpperLayerType=IF, SoAdRxPduRef=DIAG_RQ_Eth_CTP_2_8b3a5a2b_Rx
        SCB_TCP_fixed_10_20_1_1_50022_0ec581cf_Rx: SoAdRxPduHeaderId=4261494788, SoAdRxSocketConnOrSocketConnBundleRef=SCB_TCP_fixed_10_20_1_1_50022_d46cdb48
          SCB_TCP_fixed_10_20_1_1_50022_1fa56c69 (SoAdSocketRouteDest): SoAdRxUpperLayerType=TP, SoAdRxPduRef=EcucPduCollection/COM_C14_C04_Pdu01_TpConnection_0752947e_Rx
        SCB_TCP_fixed_10_20_1_1_50031_411036fa_Rx: SoAdRxPduHeaderId=4261445636, SoAdRxSocketConnOrSocketConnBundleRef=SCB_TCP_fixed_10_20_1_1_50031_547ebbb3
          SCB_TCP_fixed_10_20_1_1_50031_8a527079 (SoAdSocketRouteDest): SoAdRxUpperLayerType=TP, SoAdRxPduRef=EcucPduCollection/COM_C08_C04_Pdu02_TpConnection_abbd4f8f_Rx
    SoAdGeneral
  module config StbM
    GTD_Eth_Cluster4_0_127_5e02ab5e (StbMSynchronizedTimeBase): StbMSynchronizedTimeBaseIdentifier=0
  module config TcpIp
    TcpIpConfig
      4 x TcpIpCtrl:
        ECU4_CRN_Eth_Cluster4_3g6xoesclytkmkqofl9pi6ol1_c43ceafe: TcpIpIpFramePrioDefault=5, TcpIpEthIfCtrlRef=EthIfConfigSet/ECU4_CRN_Eth_Cluster4_3g6xoesclytkmkqofl9pi6ol1_481bdd0f
          TcpIpIpVXCtrl
            TcpIpIpV4Ctrl_TcpIpIpVXCtrl (TcpIpIpV4Ctrl)
        ECU4_CRN_Eth_Cluster4_3l8iyw65auc022so95pkbhyzp_877b2708: TcpIpIpFramePrioDefault=5, TcpIpEthIfCtrlRef=EthIfConfigSet/ECU4_CRN_Eth_Cluster4_3l8iyw65auc022so95pkbhyzp_3cc7b164
          TcpIpIpVXCtrl
            TcpIpIpV4Ctrl_0001 (TcpIpIpV4Ctrl)
        ECU4_CRN_Eth_Cluster4_7f3fu4rgtopbi2t35la2b13rd_dab5b268: TcpIpIpFramePrioDefault=0, TcpIpEthIfCtrlRef=EthIfConfigSet/ECU4_CRN_Eth_Cluster4_7f3fu4rgtopbi2t35la2b13rd_a7751c70
          TcpIpIpVXCtrl
            TcpIpIpV4Ctrl_0002 (TcpIpIpV4Ctrl): TcpIpIpDefaultTtl=1
        ECU4_CRN_Eth_Cluster4_a4tivcve7b3dlvxw1emxbqzmz_b6978bb1: TcpIpIpFramePrioDefault=0, TcpIpEthIfCtrlRef=EthIfConfigSet/ECU4_CRN_Eth_Cluster4_a4tivcve7b3dlvxw1emxbqzmz_cc30adf6
          TcpIpIpVXCtrl
            TcpIpIpV4Ctrl
      8 x TcpIpLocalAddr, all with TcpIpDomainType=TCPIP_AF_INET:
        NE_Multicast_Rx_Any_998169c7: TcpIpAddressType=TCPIP_MULTICAST, TcpIpCtrlRef=ECU4_CRN_Eth_Cluster4_3l8iyw65auc022so95pkbhyzp_877b2708
          NE_Multicast_Rx_Any_998169c7 (TcpIpAddrAssignment)
        NE_Multicast_Rx_fixed_239_127_0_1_51f2c1b0: TcpIpAddressType=TCPIP_MULTICAST, TcpIpCtrlRef=ECU4_CRN_Eth_Cluster4_3g6xoesclytkmkqofl9pi6ol1_c43ceafe
          NE_Multicast_Rx_fixed_239_127_0_1_6c0ba8ab (TcpIpAddrAssignment): TcpIpAssignmentMethod=TCPIP_STATIC
          TcpIpStaticIpAddressConfig: TcpIpStaticIpAddress=239.127.0.1
        NE_Multicast_Rx_fixed_239_20_0_2_f00b1a7a: TcpIpAddressType=TCPIP_MULTICAST, TcpIpCtrlRef=ECU4_CRN_Eth_Cluster4_3l8iyw65auc022so95pkbhyzp_877b2708
          NE_Multicast_Rx_fixed_239_20_0_2_0189b54b (TcpIpAddrAssignment): TcpIpAssignmentMethod=TCPIP_STATIC
          TcpIpStaticIpAddressConfig: TcpIpStaticIpAddress=239.20.0.2
        NE_Multicast_Rx_fixed_239_2_0_17_e0a8c9cc: TcpIpAddressType=TCPIP_MULTICAST, TcpIpCtrlRef=ECU4_CRN_Eth_Cluster4_a4tivcve7b3dlvxw1emxbqzmz_b6978bb1
          NE_Multicast_Rx_fixed_239_2_0_17_40b75531 (TcpIpAddrAssignment): TcpIpAssignmentMethod=TCPIP_STATIC
          TcpIpStaticIpAddressConfig: TcpIpStaticIpAddress=239.2.0.17
        NE_dhcpv4AndFixed_169_254_17_4_853345fc: TcpIpAddressType=TCPIP_UNICAST, TcpIpCtrlRef=ECU4_CRN_Eth_Cluster4_7f3fu4rgtopbi2t35la2b13rd_dab5b268
          NE_dhcpv4AndFixed_169_254_17_4_14866061 (TcpIpAddrAssignment): TcpIpAssignmentMethod=TCPIP_STATIC, TcpIpAssignmentPriority=2
          NE_dhcpv4AndFixed_169_254_17_4_5f8c3c45 (TcpIpAddrAssignment): TcpIpAssignmentLifetime=TCPIP_FORGET, TcpIpAssignmentMethod=TCPIP_DHCP, TcpIpAssignmentPriority=1
          TcpIpStaticIpAddressConfig: TcpIpNetmask=16, TcpIpStaticIpAddress=169.254.17.4
        NE_fixed_10_127_1_4_2de67ff6: TcpIpAddressType=TCPIP_UNICAST, TcpIpCtrlRef=ECU4_CRN_Eth_Cluster4_3g6xoesclytkmkqofl9pi6ol1_c43ceafe
          NE_fixed_10_127_1_4_986da653 (TcpIpAddrAssignment): TcpIpAssignmentMethod=TCPIP_STATIC
          TcpIpStaticIpAddressConfig: TcpIpNetmask=16, TcpIpStaticIpAddress=10.127.1.4
        NE_fixed_10_20_1_4_a84d5d3c: TcpIpAddressType=TCPIP_UNICAST, TcpIpCtrlRef=ECU4_CRN_Eth_Cluster4_3l8iyw65auc022so95pkbhyzp_877b2708
          NE_fixed_10_20_1_4_ee8ba08a (TcpIpAddrAssignment): TcpIpAssignmentMethod=TCPIP_STATIC
          TcpIpStaticIpAddressConfig: TcpIpNetmask=16, TcpIpStaticIpAddress=10.20.1.4
        NE_fixed_10_2_1_4_0df3b795: TcpIpAddressType=TCPIP_UNICAST, TcpIpCtrlRef=ECU4_CRN_Eth_Cluster4_a4tivcve7b3dlvxw1emxbqzmz_b6978bb1
          NE_fixed_10_2_1_4_90e299f0 (TcpIpAddrAssignment): TcpIpAssignmentMethod=TCPIP_STATIC
          TcpIpStaticIpAddressConfig: TcpIpNetmask=16, TcpIpStaticIpAddress=10.2.1.4
      TcpIpTcpConfig
      TcpIpUdpConfig
    TcpIpGeneral: TcpIpTcpEnabled=true, TcpIpUdpEnabled=true
      TcpIpIpV4General: TcpIpDhcpClientEnabled=true, TcpIpIpV4Enabled=true
  module config UdpNm
    UdpNmGlobalConfig:
      UdpNmComControlEnabled = true
      UdpNmComUserDataSupport = true
      UdpNmNodeIdEnabled = false
      UdpNmPassiveModeEnabled = false
      UdpNmPnEiraCalcEnabled = true
      UdpNmPnResetTime = 1.1
      UdpNmRemoteSleepIndEnabled = false
      UdpNmUserDataEnabled = false
      UdpNmPnEiraRxNSduRef = PduPnc_EIRA_ETH_Rx
      ECU4_CRN_Eth_Cluster4_3g6xoesclytkmkqofl9pi6ol1_481bdd0f (UdpNmChannelConfig):
        UdpNmImmediateNmCycleTime = 0.02
        UdpNmImmediateNmTransmissions = 6
        UdpNmMsgCycleTime = 1
        UdpNmMsgTimeoutTime = 0.5
        UdpNmPduCbvPosition = UDPNM_PDU_BYTE_0
        UdpNmPduLength = 8
        UdpNmPnEnabled = true
        UdpNmPnEraCalcEnabled = true
        UdpNmRepeatMessageTime = 3
        UdpNmTimeoutTime = 2.5
        UdpNmUserDataLength = 7
        UdpNmWaitBusSleepTime = 1.5
        UdpNmComMNetworkHandleRef = ComMConfigSet/ECU4_CRN_Eth_Cluster4_3g6xoesclytkmkqofl9pi6ol1_481bdd0f
        UdpNmPnEraRxNSduRef = PduPnc_ERA_ETH_ECU4_CRN_Eth_Cluster4_3g6xoesclytkmkqofl9pi6ol1_481bdd0f_Rx
        NM_Dummy_ST3_41f714c4 (UdpNmRxPdu): UdpNmRxPduRef=NM_Dummy_ST3_eb0914da_Rx  # NM_Dummy__ST3
        NM_C04_d7c6e387 (UdpNmTxPdu): UdpNmTxPduRef=EcucPduCollection/NM_C04_0c2fc3f3_Tx
        NM_C04_d023786f (UdpNmUserDataTxPdu): UdpNmTxUserDataPduRef=EcucPduCollection/NM_C04_d7c6e387_Tx
      UdpNmPnInfo: UdpNmPnInfoLength=7, UdpNmPnInfoOffset=1
        7 x UdpNmPnFilterMaskByte:
          UdpNmPnFilterMaskByte_0: UdpNmPnFilterMaskByteIndex=0, UdpNmPnFilterMaskByteValue=1
          UdpNmPnFilterMaskByte_1: UdpNmPnFilterMaskByteIndex=1, UdpNmPnFilterMaskByteValue=2
          UdpNmPnFilterMaskByte_2: UdpNmPnFilterMaskByteIndex=2, UdpNmPnFilterMaskByteValue=4
          UdpNmPnFilterMaskByte_3: UdpNmPnFilterMaskByteIndex=3, UdpNmPnFilterMaskByteValue=8
          UdpNmPnFilterMaskByte_4: UdpNmPnFilterMaskByteIndex=4, UdpNmPnFilterMaskByteValue=16
          UdpNmPnFilterMaskByte_5: UdpNmPnFilterMaskByteIndex=5, UdpNmPnFilterMaskByteValue=32
          UdpNmPnFilterMaskByte_6: UdpNmPnFilterMaskByteIndex=6, UdpNmPnFilterMaskByteValue=64
