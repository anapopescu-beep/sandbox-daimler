AUTOSAR XML (schema 00046)
package /ActiveEcuC
  module config FblSb: implementation-config-variant=VARIANT-PRE-COMPILE, module-description=FblSb_Impl
    FblSbGeneral:
      FblSbFblLbtVerification = false
      FblSbHeaderVerification = false
      FblSbVerificationList = false
      FblSbCopyFlashDriver = false
      FblSbSecureBootUpdateSignatureAlgorithm = ED25519
      FblSbSecureBootUpdateSignatureLength = 64
      FblSbSecureBootUpdateSignaturePosition = BeforeSegmentationTable
      FblSbInitialStartupKeyRef = CsmKey_SecureBoot_WriteOnceKey
    FblSbMacOperation_Appl (FblSbMacOperation): FblSbMacOperationId=0, FblSbGroupId=12, FblSbVerifyForceSequential=false
    FblSbMacOperation_Fbl (FblSbMacOperation): FblSbMacOperationId=1, FblSbGroupId=4, FblSbVerifyForceSequential=false
