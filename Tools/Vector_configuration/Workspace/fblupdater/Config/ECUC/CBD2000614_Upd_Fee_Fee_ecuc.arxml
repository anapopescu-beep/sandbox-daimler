AUTOSAR XML (schema 00046)
package /ActiveEcuC
  module config Fee: implementation-config-variant=VARIANT-POST-BUILD, module-description=Fee_Impl
    FeeBlockConfiguration:
      FeeBlockNumber = 16
      FeeQsBlockInstances = 0
      FeeQsBlockAddress = 0
      FeeQuasiStaticManager = false
      FeeBlockSize = 4
      FeeImmediateData = false
      FeeNumberOfWriteCycles = 0
      FeeDeviceIndex = FlsGeneral
    FeeGeneral:
      FeeDevErrorDetect = true
      FeeSafetyEnable = false
      FeeInitCheckApi = false
      FeeMainFunctionPeriod = 0.01
      FeePollingMode = false
      FeeSetModeSupported = true
      FeeVersionInfoApi = true
      FeeVirtualPageSize = 8
      FeeBlockTypeConfigured = FEE_DOUBLE_SECTOR_DATA_ONLY
      FeeNvmJobEndNotification = NULL_PTR
      FeeQsJobEndNotification = QS_JobEndNotification
      FeeQsJobErrorNotification = QS_JobErrorNotification
    FeePublishedInformation: FeeBlockOverhead=17, FeePageOverhead=1
    FeeIfxSpecificConfig:
      FeeThresholdValue = 200
      FeeMaxBlockCount = 99
      FeeUseEraseSuspend = false
      FeeStateVarStructure = Fee_StateVar
      FeeUnConfigBlock = FEE_UNCONFIG_BLOCK_KEEP
      FeeUnConfigBlkOverflowHandle = FEE_CONTINUE
      FeeGcRestart = FEE_GC_RESTART_INIT
      FeeGetCycleCountApi = true
      FeeEraseAllEnable = false
      FeeGetPrevDataApi = false
      FeeCancelAllApi = false
      FeeMaxBytesPerCycle = FEE_MAX_BYTES_512
      FeeNvmIllegalStateNotification = NULL_PTR
      FeeQsIllegalStateNotification = NULL_PTR
      FeeQsHardenErrorNotification = NULL_PTR
      FeeVirginFlashIllegalState = false
      FeeEccErrorInfoApi = false
      FeeRunTimeErrorDetect = true
      FeeBlocksScannedPerCycle = 0
    CommonPublishedInformation:
      ArMajorVersion = 4
      ArMinorVersion = 4
      ArPatchVersion = 0
      SwMajorVersion = 20
      SwMinorVersion = 0
      SwPatchVersion = 2
      ModuleId = 21
      VendorId = 17
      Release = _TRICORE_TC332
    68 x FeeBlockConfiguration, all with FeeQsBlockInstances=0, FeeQsBlockAddress=0, FeeQuasiStaticManager=false, FeeNumberOfWriteCycles=0, FeeDeviceIndex=FlsGeneral:
      FeeNvm_Ssa_TrustModelBackendCert: FeeBlockNumber=64, FeeBlockSize=1012, FeeImmediateData=false
      Fee_Ssa_TrustModelEcuCert: FeeBlockNumber=80, FeeBlockSize=1012, FeeImmediateData=false
      Fee_Ssa_TrustModelIntermediateCert: FeeBlockNumber=96, FeeBlockSize=1012, FeeImmediateData=false
      FeeSsa_TrustModelRootCert: FeeBlockNumber=112, FeeBlockSize=1012, FeeImmediateData=false
      FeeCp_MBBL_SsaAppl_CodingNvBlockNeed_CodingData: FeeBlockNumber=128, FeeBlockSize=12, FeeImmediateData=false
      FeeSsa_CodingNvM_Coding_CodingVIN: FeeBlockNumber=496, FeeBlockSize=20, FeeImmediateData=false
      FeeSsa_CodingNvM_Coding_CurrentVIN: FeeBlockNumber=144, FeeBlockSize=20, FeeImmediateData=false
      FeeSsa_RightsM_NvM_RightsM_AclVersion: FeeBlockNumber=160, FeeBlockSize=13, FeeImmediateData=false
      FeeSsa_RightsM_NvM_RightsM_Nonce: FeeBlockNumber=176, FeeBlockSize=50, FeeImmediateData=false
      FeeSsa_RightsM_NvM_RigthsM_CentralAuthStatusProduction: FeeBlockNumber=192, FeeBlockSize=1, FeeImmediateData=false
      FeeSsa_SecLogNvM_SecLog_LogDataEvnt10_FailedPduMacVerif: FeeBlockNumber=208, FeeBlockSize=130, FeeImmediateData=false
      FeeSsa_SecLogNvM_SecLog_LogDataEvnt11_SecOrAuthBoot: FeeBlockNumber=224, FeeBlockSize=61, FeeImmediateData=false
      FeeSsa_SecLogNvM_SecLog_LogDataEvnt12_ChangeOfVin: FeeBlockNumber=240, FeeBlockSize=78, FeeImmediateData=false
      FeeSsa_SecLogNvM_SecLog_LogDataEvnt13_AclReplacement: FeeBlockNumber=256, FeeBlockSize=97, FeeImmediateData=false
      FeeSsa_SecLogNvM_SecLog_LogDataEvnt1_FailedCertVerif: FeeBlockNumber=272, FeeBlockSize=178, FeeImmediateData=false
      FeeSsa_SecLogNvM_SecLog_LogDataEvnt2_SucCertVerif: FeeBlockNumber=288, FeeBlockSize=246, FeeImmediateData=false
      FeeSsa_SecLogNvM_SecLog_LogDataEvnt3_SucAuthAndEnhanceRights: FeeBlockNumber=304, FeeBlockSize=393, FeeImmediateData=false
      FeeSsa_SecLogNvM_SecLog_LogDataEvnt4_AuthBySecAccess: FeeBlockNumber=320, FeeBlockSize=70, FeeImmediateData=false
      FeeSsa_SecLogNvM_SecLog_LogDataEvnt5_SucDiagServiceExec: FeeBlockNumber=336, FeeBlockSize=140, FeeImmediateData=false
      FeeSsa_SecLogNvM_SecLog_LogDataEvnt6_RightsMgmt: FeeBlockNumber=352, FeeBlockSize=218, FeeImmediateData=false
      FeeSsa_SecLogNvM_SecLog_LogDataEvnt7_SigVerif: FeeBlockNumber=368, FeeBlockSize=96, FeeImmediateData=false
      FeeSsa_SecLogNvM_SecLog_LogDataEvnt8_TickCountDateAndTime: FeeBlockNumber=384, FeeBlockSize=234, FeeImmediateData=false
      FeeSsa_SecLogNvM_SecLog_LogDataEvnt9_SecOcMisconfig: FeeBlockNumber=400, FeeBlockSize=64, FeeImmediateData=false
      FeeSsa_SecLogNvM_SecLog_LogFailedMacVerifCount_ExceededTh1: FeeBlockNumber=416, FeeBlockSize=202, FeeImmediateData=false
      FeeSsa_SecLogNvM_SecLog_LogFailedMacVerifCount_ExceededTh2: FeeBlockNumber=432, FeeBlockSize=202, FeeImmediateData=false
      FeeSsa_SecLogNvM_SecLog_LogFailedMacVerifCount_ExceededTh3: FeeBlockNumber=448, FeeBlockSize=202, FeeImmediateData=false
      FeeSsa_TimeM_NvM_TimeM_RealTimeOffset: FeeBlockNumber=464, FeeBlockSize=18, FeeImmediateData=false
      FeeSsa_TimeM_NvM_TimeM_TickCount: FeeBlockNumber=480, FeeBlockSize=10, FeeImmediateData=false
      FeeCt_MBBL_SsaAppl_CodingNvBlockNeed_CodingData: FeeBlockNumber=512, FeeBlockSize=12, FeeImmediateData=false
      FeeCt_MBBL_SsaAppl_CodingNvmCoding_CurrentVehicleEquipment: FeeBlockNumber=528, FeeBlockSize=16, FeeImmediateData=false
      FeeCt_MBBL_SsaAppl_CodingNvmCoding_TensioningCycleBSR: FeeBlockNumber=544, FeeBlockSize=235, FeeImmediateData=false
      FeeCt_MBBL_SsaAppl_CodingNvmCoding_PreSafeCyclesLevel: FeeBlockNumber=576, FeeBlockSize=1075, FeeImmediateData=false
      FeeCt_MBBL_SsaAppl_CodingNvmCoding_ReleaseCyclesBsrAndPreSafe: FeeBlockNumber=560, FeeBlockSize=146, FeeImmediateData=false
      FeeCt_MBBL_SsaAppl_CodingNvmCoding_ZZZVehicleEquipmentDevelopment: FeeBlockNumber=592, FeeBlockSize=5, FeeImmediateData=false
      FeeCt_MBBL_SsaAppl_CodingNvmCoding_CalibrationID: FeeBlockNumber=608, FeeBlockSize=20, FeeImmediateData=false
      FeeBlockDescriptor_FblMetaData: FeeBlockNumber=32, FeeBlockSize=145, FeeImmediateData=true
      FeeBlockConfiguration_cons0: FeeBlockNumber=17, FeeBlockSize=4, FeeImmediateData=false
      FeeBlockDescriptor_FblMetaData_cons0: FeeBlockNumber=33, FeeBlockSize=145, FeeImmediateData=true
      Fee_NVP_BLOCK_ID_ECU_LOCATION: FeeBlockNumber=624, FeeBlockSize=5, FeeImmediateData=true
      Fee_NVP_BLOCK_ID_BELT_ASSEMBLY_MANUF_DATE_AND_SN: FeeBlockNumber=640, FeeBlockSize=30, FeeImmediateData=false
      Fee_NVP_BLOCK_ID_HB_CALIBRATION: FeeBlockNumber=1716, FeeBlockSize=42, FeeImmediateData=false
      Fee_NVP_BLOCK_ID_AEE_TRACEABILITY: FeeBlockNumber=672, FeeImmediateData=false, FeeBlockSize=14
      Fee_NVP_BLOCK_ID_EXECUTION_COUNTERS: FeeBlockNumber=688, FeeImmediateData=false, FeeBlockSize=22
      Fee_NVP_BLOCK_ID_TESTS_PARAM: FeeBlockNumber=704, FeeImmediateData=false, FeeBlockSize=99
      Fee_NVP_BLOCK_ID_CYCLE: FeeImmediateData=false, FeeBlockSize=422, FeeBlockNumber=720
      Fee_NVP_BLOCK_ID_STEP: FeeBlockSize=1164, FeeImmediateData=false, FeeBlockNumber=784
      Fee_CALIB_BLOCK_ID_EOL_PARAM: FeeImmediateData=false, FeeBlockSize=42, FeeBlockNumber=1104
      Fee_CALIB_BLOCK_ID_BFS_PRIO_PARAM: FeeImmediateData=false, FeeBlockSize=40, FeeBlockNumber=1120
      Fee_CALIB_BLOCK_ID_PID_PARAM: FeeImmediateData=false, FeeBlockSize=8, FeeBlockNumber=1136
      Fee_CALIB_BLOCK_ID_WEIGHT_REL_TABLE: FeeImmediateData=false, FeeBlockSize=23, FeeBlockNumber=1152
      Fee_CALIB_BLOCK_ID_WEIGHT_TENS0_TABLE: FeeImmediateData=false, FeeBlockSize=23, FeeBlockNumber=1168
      Fee_CALIB_BLOCK_ID_WEIGHT_TENS1_TABLE: FeeImmediateData=false, FeeBlockSize=23, FeeBlockNumber=1184
      Fee_CALIB_BLOCK_ID_WEIGHT_TENS2_TABLE: FeeBlockNumber=1200, FeeImmediateData=false, FeeBlockSize=23
      Fee_CALIB_BLOCK_ID_WEIGHT_TENS3_TABLE: FeeImmediateData=false, FeeBlockSize=23, FeeBlockNumber=1216
      Fee_CALIB_BLOCK_ID_INT_CURRENT_CORR: FeeBlockNumber=1232, FeeImmediateData=false, FeeBlockSize=23
      Fee_CALIB_BLOCK_ID_INT_CURRENT_TABLE: FeeBlockNumber=1248, FeeImmediateData=false, FeeBlockSize=130
      Fee_CALIB_BLOCK_ID_POWER_DEGRADATION: FeeBlockNumber=1264, FeeImmediateData=false, FeeBlockSize=20
      Fee_CALIB_BLOCK_ID_ECPL_ALPHA_TABLE: FeeBlockNumber=1280, FeeImmediateData=false, FeeBlockSize=11
      Fee_CALIB_BLOCK_ID_ECPL_BETA_TABLE: FeeBlockNumber=1408, FeeImmediateData=false, FeeBlockSize=11
      Fee_CALIB_BLOCK_ID_ECPL_OTHER_PARAM: FeeBlockNumber=1312, FeeImmediateData=false, FeeBlockSize=9
      Fee_CALIB_BLOCK_ID_BPA_MOTOR_CURRENT: FeeBlockNumber=1328, FeeImmediateData=false, FeeBlockSize=23
      Fee_CALIB_BLOCK_ID_VOLT_THRS: FeeBlockNumber=1344, FeeImmediateData=false, FeeBlockSize=34
      Fee_CALIB_BLOCK_ID_BATTERY_LOSS_DETECTION_THRS: FeeBlockNumber=1360, FeeImmediateData=false, FeeBlockSize=6
      Fee_CALIB_BLOCK_ID_BOOST: FeeBlockNumber=1376, FeeImmediateData=false, FeeBlockSize=6
      Fee_CALIB_BLOCK_ID_ECU_PROPERTIES: FeeBlockNumber=48, FeeImmediateData=false, FeeBlockSize=12
      Fee_CALIB_BLOCK_ID_SW_SELF_PROTECTION_THRS: FeeBlockNumber=1392, FeeImmediateData=false, FeeBlockSize=22
      Fee_CALIB_BLOCK_ID_MOTOR_RESIST_PARAM: FeeBlockNumber=1424, FeeImmediateData=false, FeeBlockSize=23
      Fee_CALIB_BLOCK_ID_BOOST_ACTIVATION: FeeBlockNumber=1440, FeeImmediateData=false, FeeBlockSize=3
    FeeDemEventParameterRefs
    40 x FeeBlockConfiguration, all with FeeQsBlockInstances=0, FeeQsBlockAddress=0, FeeQuasiStaticManager=false, FeeNumberOfWriteCycles=0, FeeDeviceIndex=FlsGeneral:
      Fee_NVP_BLOCK_ID_MEASUREMENT_FRAME_12_CONFIG: FeeBlockNumber=712, FeeBlockSize=9, FeeImmediateData=false
      Fee_NVP_BLOCK_ID_MEASUREMENT_FRAME_CONFIG: FeeBlockNumber=716, FeeBlockSize=8, FeeImmediateData=false
      Fee_NVP_BLOCK_ID_WARM_RESET: FeeBlockNumber=788, FeeBlockSize=10, FeeImmediateData=false
      Fee_NVP_BLOCK_ID_HWA_REPETITION: FeeBlockNumber=792, FeeBlockSize=4, FeeImmediateData=false
      Fee_NVP_BLOCK_TEMP_SENSOR_TABLE: FeeBlockNumber=100, FeeBlockSize=44, FeeImmediateData=false
      FEE_NVP_BLOCK_ID_VELOCITY_PID_PARAM: FeeBlockNumber=8, FeeBlockSize=32, FeeImmediateData=false
      Fee_NVP_BLOCK_ID_AEC_STATUS: FeeBlockNumber=12, FeeBlockSize=66, FeeImmediateData=false
      Fee_NVP_BLOCK_ID_ATM_ENABLE_PARAM: FeeBlockNumber=104, FeeBlockSize=55, FeeImmediateData=false
      Fee_Dem_Primary_0: FeeBlockNumber=36, FeeBlockSize=38, FeeImmediateData=true
      Fee_Dem_Admin_Data: FeeBlockNumber=28, FeeBlockSize=14, FeeImmediateData=true
      Fee_Dem_Primary_1: FeeBlockNumber=24, FeeBlockSize=38, FeeImmediateData=true
      Fee_Dem_Primary_2: FeeBlockNumber=76, FeeBlockSize=38, FeeImmediateData=true
      Fee_Dem_Primary_3: FeeBlockNumber=72, FeeBlockSize=38, FeeImmediateData=true
      Fee_Dem_Primary_4: FeeBlockNumber=68, FeeBlockSize=38, FeeImmediateData=true
      Fee_Dem_Primary_5: FeeBlockNumber=60, FeeBlockSize=38, FeeImmediateData=true
      Fee_Dem_Primary_6: FeeBlockNumber=56, FeeBlockSize=38, FeeImmediateData=true
      Fee_Dem_Primary_7: FeeBlockNumber=52, FeeBlockSize=38, FeeImmediateData=true
      Fee_Dem_Primary_8: FeeBlockNumber=44, FeeBlockSize=38, FeeImmediateData=true
      Fee_Dem_Primary_9: FeeBlockNumber=84, FeeBlockSize=38, FeeImmediateData=true
      Fee_Dem_Status: FeeBlockNumber=40, FeeBlockSize=96, FeeImmediateData=true
      FeeBlockDescriptor_VerificationKey: FeeBlockNumber=20, FeeBlockSize=33, FeeImmediateData=true
      FeeBlockDescriptor_SecAccessDelayFlag: FeeBlockNumber=4, FeeBlockSize=1, FeeImmediateData=true
      FeeSsa_KeyM_NvM_KeyM_TrustModelChainOfTrustState: FeeBlockNumber=88, FeeBlockSize=1, FeeImmediateData=false
      Fee_NVP_BLOCK_ID_PRE_SAFE_RECORDER_1: FeeBlockNumber=1448, FeeBlockSize=24, FeeImmediateData=false
      Fee_NVP_BLOCK_ID_PRE_SAFE_RECORDER_2: FeeBlockNumber=1472, FeeBlockSize=24, FeeImmediateData=false
      FeeBlockDescriptor_FblMetaData_cons1: FeeBlockNumber=34, FeeBlockSize=145, FeeImmediateData=true
      Fee_Rtm_CpuLoadPersistencyData: FeeBlockNumber=1496, FeeBlockSize=48, FeeImmediateData=false
      Fee_Rtm_MaxTaskStackUsage: FeeBlockNumber=1544, FeeBlockSize=44, FeeImmediateData=false
      Fee_NVP_BLOCK_ID_PRE_SAFE_RECORDER_ID: FeeBlockSize=3, FeeImmediateData=false, FeeBlockNumber=1588
      NVP_BLOCK_ID_SYSTEM_CONTEXT_0: FeeBlockNumber=1680, FeeBlockSize=14, FeeImmediateData=false
      NVP_BLOCK_ID_SYSTEM_CONTEXT_1: FeeBlockNumber=1692, FeeBlockSize=14, FeeImmediateData=false
      NVP_BLOCK_ID_SYSTEM_CONTEXT_2: FeeBlockNumber=1708, FeeBlockSize=14, FeeImmediateData=false
      Fee_NVP_BLOCK_ID_CYCLE_DELAYS_MB: FeeImmediateData=false, FeeBlockSize=11, FeeBlockNumber=1644
      Fee_NVP_BLOCK_ID_HAPTIC_CONFIG_MB: FeeImmediateData=false, FeeBlockSize=11, FeeBlockNumber=1612
      Fee_NVP_BLOCK_ID_EOL_MAPPING_MB: FeeImmediateData=false, FeeBlockSize=14, FeeBlockNumber=1628
      FeeNVP_BLOCK_ID_HW_VERSION: FeeBlockNumber=1712, FeeBlockSize=5, FeeImmediateData=true
      Fee_NVP_BLOCK_ID_CAN_INPUT_SIGNALS: FeeImmediateData=false, FeeBlockSize=5, FeeBlockNumber=1760
      Fee_NVP_BLOCK_ID_PCBA_PPN: FeeBlockNumber=1768, FeeImmediateData=false, FeeBlockSize=12
      Fee_NVP_BLOCK_ID_CSR_SUPPLIER_SIGNATURE: FeeBlockNumber=1788, FeeBlockSize=260, FeeImmediateData=false
      FeeNVP_BLOCK_ID_HW_PARTNUMBER: FeeBlockSize=22, FeeImmediateData=true, FeeBlockNumber=1792
