AUTOSAR XML (schema 00046)
package /ActiveEcuC
  module config vLinkGen: implementation-config-variant=VARIANT-PRE-COMPILE, module-description=vLinkGen_Impl
    vLinkGenMemLayout
      5 x vLinkGenMemoryRegion, all with vLinkGenMemoryRegionAddrOffset=0, vLinkGenMemoryRegionAvailable=true:
        MemRegion_LMU0_NonCached: vLinkGenMemoryRegionSize=8192, vLinkGenMemoryRegionAddress=2952790016, vLinkGenMemoryRegionHwRegion=LMU0_NonCached
          RegionBlock_0_LMU0_vHsm_Shared (vLinkGenMemoryRegionBlock):
            vLinkGenMemoryRegionBlockPosition = 0
            vLinkGenMemoryRegionBlockSize = 7680
            vLinkGenMemoryRegionBlockAddress = 2952790016
            vLinkGenMemoryRegionBlockBoundary = LOWER
            vLinkGenMemoryRegionBlockInitStage = NONE
          RegionBlock_0_LMU0_ReprogrammingData (vLinkGenMemoryRegionBlock):
            vLinkGenMemoryRegionBlockPosition = 1
            vLinkGenMemoryRegionBlockSize = 512
            vLinkGenMemoryRegionBlockAddress = 2952797696
            vLinkGenMemoryRegionBlockBoundary = LOWER
            vLinkGenMemoryRegionBlockInitStage = NONE
        MemRegion_BMHD0: vLinkGenMemoryRegionSize=512, vLinkGenMemoryRegionAddress=2940207104, vLinkGenMemoryRegionHwRegion=BMHD0
          RegionBlock_0_BMHD0 (vLinkGenMemoryRegionBlock):
            vLinkGenMemoryRegionBlockPosition = 0
            vLinkGenMemoryRegionBlockSize = 512
            vLinkGenMemoryRegionBlockAddress = 2940207104
            vLinkGenMemoryRegionBlockBoundary = LOWER
            vLinkGenMemoryRegionBlockInitStage = NONE
        MemRegion_BMHD1: vLinkGenMemoryRegionSize=512, vLinkGenMemoryRegionAddress=2940207616, vLinkGenMemoryRegionHwRegion=BMHD1
          RegionBlock_0_BMHD1 (vLinkGenMemoryRegionBlock):
            vLinkGenMemoryRegionBlockPosition = 0
            vLinkGenMemoryRegionBlockSize = 512
            vLinkGenMemoryRegionBlockAddress = 2940207616
            vLinkGenMemoryRegionBlockBoundary = LOWER
            vLinkGenMemoryRegionBlockInitStage = NONE
        MemRegion_BMHD2: vLinkGenMemoryRegionSize=512, vLinkGenMemoryRegionAddress=2940208128, vLinkGenMemoryRegionHwRegion=BMHD2
          RegionBlock_0_BMHD2 (vLinkGenMemoryRegionBlock):
            vLinkGenMemoryRegionBlockPosition = 0
            vLinkGenMemoryRegionBlockSize = 512
            vLinkGenMemoryRegionBlockAddress = 2940208128
            vLinkGenMemoryRegionBlockBoundary = LOWER
            vLinkGenMemoryRegionBlockInitStage = NONE
        MemRegion_BMHD3: vLinkGenMemoryRegionSize=512, vLinkGenMemoryRegionAddress=2940208640, vLinkGenMemoryRegionHwRegion=BMHD3
          RegionBlock_0_BMHD3 (vLinkGenMemoryRegionBlock):
            vLinkGenMemoryRegionBlockPosition = 0
            vLinkGenMemoryRegionBlockSize = 512
            vLinkGenMemoryRegionBlockAddress = 2940208640
            vLinkGenMemoryRegionBlockBoundary = LOWER
            vLinkGenMemoryRegionBlockInitStage = NONE
      STACK_C0 (vLinkGenLogicalVarGroup): vLinkGenVarGroupPosition=4096, vLinkGenVarGroupInitCore=0, vLinkGenVarGroupRegion=DefaultRamArea_Stack
        STACK_C0 (vLinkGenVarSectionGroup):
          vLinkGenVarSectionGroupAlignment = 4
          vLinkGenVarSectionGroupEndAlignment = 0
          vLinkGenVarSectionGroupSize = 16380
          vLinkGenVarSectionGroupInit = ZERO_INIT
          vLinkGenVarSectionGroupInitStage = EARLY
          vLinkGenVarSectionGroupPosition = 0
          vLinkGenVarSectionGroupFlag = vLinkGenVarGroupFlags/ORDERED
          vLinkGenVarSectionGroupFlag = vLinkGenVarGroupFlags/CONTIGUOUS
          vLinkGenVarSectionGroupFlag = vLinkGenVarGroupFlags/FILL
          vLinkGenVarSectionGroupFlag = vLinkGenVarGroupFlags/READ
          vLinkGenVarSectionGroupFlag = vLinkGenVarGroupFlags/WRITE
      CSA_CORE0 (vLinkGenLogicalVarGroup): vLinkGenVarGroupPosition=0, vLinkGenVarGroupRegion=DefaultRamArea_DSPR0
        CSA_CORE0 (vLinkGenVarSectionGroup):
          vLinkGenVarSectionGroupAlignment = 64
          vLinkGenVarSectionGroupSize = 16384
          vLinkGenVarSectionGroupPosition = 0
          vLinkGenVarSectionGroupInit = NONE
          vLinkGenVarSectionGroupInitStage = ONE
          vLinkGenVarSectionGroupFlag = vLinkGenVarGroupFlags/ORDERED
          vLinkGenVarSectionGroupFlag = vLinkGenVarGroupFlags/CONTIGUOUS
          vLinkGenVarSectionGroupFlag = vLinkGenVarGroupFlags/FILL
          vLinkGenVarSectionGroupFlag = vLinkGenVarGroupFlags/READ
          vLinkGenVarSectionGroupFlag = vLinkGenVarGroupFlags/WRITE
      3 x vLinkGenLogicalSymbolGroup, all with vLinkGenSymbolGroupPosition=0:
        Startup_Labels
          9 x vLinkGenLinkerSymbol, all with vLinkGenLinkerSymbolValue=brsStartupEntry, vLinkGenLinkerSymbolPosition=0:
            Startup_Labels1: vLinkGenLinkerSymbolName=_RESET
            Startup_Labels2: vLinkGenLinkerSymbolName=_start
            Startup_Labels3: vLinkGenLinkerSymbolName=_start_tc0
            Startup_Labels4: vLinkGenLinkerSymbolName=_start_tc1
            Startup_Labels5: vLinkGenLinkerSymbolName=_start_tc2
            Startup_Labels6: vLinkGenLinkerSymbolName=_start_tc3
            Startup_Labels7: vLinkGenLinkerSymbolName=_start_tc4
            Startup_Labels8: vLinkGenLinkerSymbolName=_start_tc5
            Startup_Labels9: vLinkGenLinkerSymbolName=_brsStartupEntry
        CSA_LABELS
          CSA_LABELS1 (vLinkGenLinkerSymbol): vLinkGenLinkerSymbolName=__CSA_BEGIN_CPU0_, vLinkGenLinkerSymbolValue=_CSA_CORE0_START, vLinkGenLinkerSymbolPosition=0
          CSA_LABELS2 (vLinkGenLinkerSymbol): vLinkGenLinkerSymbolName=__CSA_END_CPU0_, vLinkGenLinkerSymbolValue=_CSA_CORE0_LIMIT, vLinkGenLinkerSymbolPosition=0
        Startup_Stack
          Startup_Stack_c0 (vLinkGenLinkerSymbol): vLinkGenLinkerSymbolName=__STARTUPSTACK_CORE0, vLinkGenLinkerSymbolValue=_STACK_C0_LIMIT, vLinkGenLinkerSymbolPosition=0
      vLinkGenLinkerSections
        Workaround_Ramcode_ESCAN00104538 (vLinkGenLinkerSpecSection): vLinkGenLinkerSpecSectionValue=[.]text.fbl_flio*, vLinkGenLinkerSpecSectionAlignment=0, vLinkGenLinkerSpecSectionPad=0
        Workaround_Ramconst_ESCAN00104538 (vLinkGenLinkerSpecSection): vLinkGenLinkerSpecSectionValue=[.]rodata.fbl_flio*, vLinkGenLinkerSpecSectionAlignment=0, vLinkGenLinkerSpecSectionPad=0
        ProgConditionSection (vLinkGenLinkerVarSection): vLinkGenLinkerVarSectionName=ProgConditionSection, vLinkGenLinkerVarSectionFast=false, vLinkGenLinkerVarSectionAlignment=0
        brsStartupEntry (vLinkGenLinkerCodeSection): vLinkGenLinkerCodeSectionName=brsStartupEntry, vLinkGenLinkerCodeSectionAlignment=8, vLinkGenLinkerCodeSectionFast=false
        brsStartup (vLinkGenLinkerCodeSection): vLinkGenLinkerCodeSectionName=brsStartup, vLinkGenLinkerCodeSectionAlignment=8, vLinkGenLinkerCodeSectionFast=false
        BMHD0 (vLinkGenLinkerConstSection): vLinkGenLinkerConstSectionName=BMHD0, vLinkGenLinkerConstSectionAlignment=32, vLinkGenLinkerConstSectionFast=false
        brsExcVect (vLinkGenLinkerCodeSection): vLinkGenLinkerCodeSectionName=brsExcVect, vLinkGenLinkerCodeSectionFast=false, vLinkGenLinkerCodeSectionAlignment=0
        BmHeaderSection (vLinkGenLinkerConstSection): vLinkGenLinkerConstSectionName=BmHeaderSection, vLinkGenLinkerConstSectionFast=false, vLinkGenLinkerConstSectionAlignment=0
        RamCodeSection (vLinkGenLinkerCodeSection): vLinkGenLinkerCodeSectionName=RamCodeSection, vLinkGenLinkerCodeSectionFast=false, vLinkGenLinkerCodeSectionAlignment=0
        3 x vLinkGenLinkerConstSection, all with vLinkGenLinkerConstSectionFast=false, vLinkGenLinkerConstSectionAlignment=0:
          RamConstSection: vLinkGenLinkerConstSectionName=RamConstSection
          FblHeaderSection: vLinkGenLinkerConstSectionName=FblHeaderSection
          BmHdrHeaderSection: vLinkGenLinkerConstSectionName=BmHdrHeaderSection
        brsResetLabel (vLinkGenLinkerCodeSection): vLinkGenLinkerCodeSectionName=brsResetLabel, vLinkGenLinkerCodeSectionFast=false, vLinkGenLinkerCodeSectionAlignment=0
        FblFlashDrvSection (vLinkGenLinkerVarSection): vLinkGenLinkerVarSectionName=FblFlashDrvSection, vLinkGenLinkerVarSectionFast=false, vLinkGenLinkerVarSectionAlignment=0
        7 x vLinkGenLinkerSpecSection, all with vLinkGenLinkerSpecSectionPad=0, vLinkGenLinkerSpecSectionAlignment=0:
          text: vLinkGenLinkerSpecSectionValue=[.]text*
          rodata: vLinkGenLinkerSpecSectionValue=[.]rodata*
          zrodata: vLinkGenLinkerSpecSectionValue=[.]zrodata*
          data: vLinkGenLinkerSpecSectionValue=[.]data*
          zdata: vLinkGenLinkerSpecSectionValue=[.]zdata*
          bss: vLinkGenLinkerSpecSectionValue=[.]bss*
          zbss: vLinkGenLinkerSpecSectionValue=[.]zbss*
        RamCodeSectionEth (vLinkGenLinkerCodeSection): vLinkGenLinkerCodeSectionName=RamCodeSectionEth, vLinkGenLinkerCodeSectionFast=false, vLinkGenLinkerCodeSectionAlignment=0
        MagicFlagSection (vLinkGenLinkerVarSection): vLinkGenLinkerVarSectionName=MagicFlagSection, vLinkGenLinkerVarSectionFast=false, vLinkGenLinkerVarSectionAlignment=0
        Workaround_Ramcode_ESCAN00107631 (vLinkGenLinkerSpecSection): vLinkGenLinkerSpecSectionValue=[.]text.fbl_diag*, vLinkGenLinkerSpecSectionAlignment=0, vLinkGenLinkerSpecSectionPad=0
        Workaround_Ramconst_ESCAN00107631 (vLinkGenLinkerSpecSection): vLinkGenLinkerSpecSectionValue=[.]rodata.fbl_diag*, vLinkGenLinkerSpecSectionAlignment=0, vLinkGenLinkerSpecSectionPad=0
        ApplInfoHeaderSection (vLinkGenLinkerConstSection): vLinkGenLinkerConstSectionName=ApplInfoHeaderSection, vLinkGenLinkerConstSectionFast=false, vLinkGenLinkerConstSectionAlignment=0
        vHsmIpcMemory (vLinkGenLinkerVarSection): vLinkGenLinkerVarSectionName=vHsmIpcMemory, vLinkGenLinkerVarSectionFast=false, vLinkGenLinkerVarSectionAlignment=0
        vHsmGlobalRamBuffer (vLinkGenLinkerVarSection): vLinkGenLinkerVarSectionName=vHsmGlobalRamBuffer, vLinkGenLinkerVarSectionFast=false, vLinkGenLinkerVarSectionAlignment=0
      FlashDrvGroup (vLinkGenLogicalVarGroup): vLinkGenVarGroupPosition=8, vLinkGenVarGroupRegion=FlashDrvArea
        FblFlashDrvSection (vLinkGenVarSectionGroup):
          vLinkGenVarSectionGroupPosition = 0
          vLinkGenVarSectionGroupInitStage = TWO
          vLinkGenVarSectionGroupInit = NONE
          vLinkGenVarSectionGroupAlignment = 16
          vLinkGenVarSectionGroupFlag = vLinkGenVarGroupFlags/ORDERED
          vLinkGenVarSectionGroupFlag = vLinkGenVarGroupFlags/CONTIGUOUS
          vLinkGenVarSectionGroupFlag = vLinkGenVarGroupFlags/FILL
          vLinkGenVarSectionGroupFlag = vLinkGenVarGroupFlags/READ
          vLinkGenVarSectionGroupFlag = vLinkGenVarGroupFlags/WRITE
          vLinkGenVarSectionGroupRef = vLinkGenLinkerSections/FblFlashDrvSection
      3 x vLinkGenMemoryRegion, all with vLinkGenMemoryRegionAvailable=true, vLinkGenMemoryRegionHwRegion=PFlash0_NonCached:
        Rom_BmMemoryArea: vLinkGenMemoryRegionAddrOffset=212992, vLinkGenMemoryRegionSize=81920, vLinkGenMemoryRegionAddress=2684567552
          4 x vLinkGenMemoryRegionBlock, all with vLinkGenMemoryRegionBlockBoundary=LOWER, vLinkGenMemoryRegionBlockInitStage=NONE:
            BmRomArea: vLinkGenMemoryRegionBlockPosition=3, vLinkGenMemoryRegionBlockSize=64736, vLinkGenMemoryRegionBlockAddress=2684568352
            BmHeader: vLinkGenMemoryRegionBlockPosition=2, vLinkGenMemoryRegionBlockSize=32, vLinkGenMemoryRegionBlockAddress=2684568320
            BmRom_Startup: vLinkGenMemoryRegionBlockPosition=0, vLinkGenMemoryRegionBlockSize=512, vLinkGenMemoryRegionBlockAddress=2684567552
            BmRom_ExceptionTable: vLinkGenMemoryRegionBlockPosition=1, vLinkGenMemoryRegionBlockSize=256, vLinkGenMemoryRegionBlockAddress=2684568064
        Rom_FblMemoryArea: vLinkGenMemoryRegionAddrOffset=294912, vLinkGenMemoryRegionSize=147456, vLinkGenMemoryRegionAddress=2684649472
          6 x vLinkGenMemoryRegionBlock, all with vLinkGenMemoryRegionBlockInitStage=NONE:
            FblRomArea: vLinkGenMemoryRegionBlockPosition=4, vLinkGenMemoryRegionBlockBoundary=LOWER, vLinkGenMemoryRegionBlockSize=126144, vLinkGenMemoryRegionBlockAddress=2684650304
            FblBmHdrHeader: vLinkGenMemoryRegionBlockPosition=2, vLinkGenMemoryRegionBlockSize=32, vLinkGenMemoryRegionBlockBoundary=LOWER, vLinkGenMemoryRegionBlockAddress=2684650240
            FblHeader: vLinkGenMemoryRegionBlockPosition=3, vLinkGenMemoryRegionBlockSize=32, vLinkGenMemoryRegionBlockBoundary=LOWER, vLinkGenMemoryRegionBlockAddress=2684650272
            FblRom_Startup: vLinkGenMemoryRegionBlockPosition=1, vLinkGenMemoryRegionBlockBoundary=LOWER, vLinkGenMemoryRegionBlockSize=512, vLinkGenMemoryRegionBlockAddress=2684649728
            FblRomReserved: vLinkGenMemoryRegionBlockPosition=0, vLinkGenMemoryRegionBlockBoundary=UPPER, vLinkGenMemoryRegionBlockSize=4096, vLinkGenMemoryRegionBlockAddress=2684792832
            FblRom_ExceptionTable: vLinkGenMemoryRegionBlockPosition=0, vLinkGenMemoryRegionBlockBoundary=LOWER, vLinkGenMemoryRegionBlockSize=256, vLinkGenMemoryRegionBlockAddress=2684649472
        Rom_ApplMemoryArea: vLinkGenMemoryRegionAddrOffset=442368, vLinkGenMemoryRegionSize=606208, vLinkGenMemoryRegionAddress=2684796928
          6 x vLinkGenMemoryRegionBlock, all with vLinkGenMemoryRegionBlockInitStage=NONE:
            ApplRomArea: vLinkGenMemoryRegionBlockBoundary=LOWER, vLinkGenMemoryRegionBlockPosition=4, vLinkGenMemoryRegionBlockSize=453632, vLinkGenMemoryRegionBlockAddress=2684797952
            ApplBmHdrHeader: vLinkGenMemoryRegionBlockPosition=1, vLinkGenMemoryRegionBlockSize=32, vLinkGenMemoryRegionBlockBoundary=LOWER, vLinkGenMemoryRegionBlockAddress=2684797152
            AppRomReserved: vLinkGenMemoryRegionBlockBoundary=UPPER, vLinkGenMemoryRegionBlockPosition=0, vLinkGenMemoryRegionBlockSize=4096, vLinkGenMemoryRegionBlockAddress=2685399040
            ApplRom_Startup: vLinkGenMemoryRegionBlockPosition=3, vLinkGenMemoryRegionBlockBoundary=LOWER, vLinkGenMemoryRegionBlockSize=512, vLinkGenMemoryRegionBlockAddress=2684797440
            ApplRom_ExceptionTable: vLinkGenMemoryRegionBlockPosition=2, vLinkGenMemoryRegionBlockBoundary=LOWER, vLinkGenMemoryRegionBlockSize=256, vLinkGenMemoryRegionBlockAddress=2684797184
            ApplInfoHeader: vLinkGenMemoryRegionBlockPosition=0, vLinkGenMemoryRegionBlockSize=224, vLinkGenMemoryRegionBlockAddress=2684796928, vLinkGenMemoryRegionBlockBoundary=LOWER
      TargetCompilerSpecificOptions_All (vLinkGenLogicalSymbolGroup): vLinkGenSymbolGroupPosition=4096
        OS_EXCVEC_CORE0_CODE_START (vLinkGenLinkerSymbol): vLinkGenLinkerSymbolPosition=0, vLinkGenLinkerSymbolName=_OS_EXCVEC_CORE0_CODE_START, vLinkGenLinkerSymbolValue=brsStartupEntry
        OS_INTVEC_CORE0_CODE_START (vLinkGenLinkerSymbol): vLinkGenLinkerSymbolPosition=0, vLinkGenLinkerSymbolName=_OS_INTVEC_CORE0_CODE_START, vLinkGenLinkerSymbolValue=brsStartupEntry
      4 x vLinkGenLogicalConstGroup:
        StartupGroup: vLinkGenConstGroupPosition=0, vLinkGenConstGroupRegion=ApplRom_Startup
          Upd_ApplStartup (vLinkGenConstSectionGroup):
            vLinkGenConstSectionGroupPosition = 0
            vLinkGenConstSectionGroupInit = NONE
            vLinkGenConstSectionGroupInitStage = ONE
            vLinkGenConstSectionGroupFlag = vLinkGenConstGroupFlags/ORDERED
            vLinkGenConstSectionGroupFlag = vLinkGenConstGroupFlags/CONTIGUOUS
            vLinkGenConstSectionGroupFlag = vLinkGenConstGroupFlags/FILL
            vLinkGenConstSectionGroupFlag = vLinkGenConstGroupFlags/READ
            vLinkGenConstSectionGroupFlag = vLinkGenConstGroupFlags/EXECUTE
            vLinkGenConstSectionGroupRef = brsResetLabel
            vLinkGenConstSectionGroupRef = brsStartup
            vLinkGenConstSectionGroupRef = brsStartupEntry
        RomDefaultGroup: vLinkGenConstGroupPosition=50, vLinkGenConstGroupRegion=ApplRomArea
          Upd_Rom (vLinkGenConstSectionGroup):
            vLinkGenConstSectionGroupPosition = 20
            vLinkGenConstSectionGroupInit = NONE
            vLinkGenConstSectionGroupInitStage = ONE
            vLinkGenConstSectionGroupFlag = vLinkGenConstGroupFlags/ORDERED
            vLinkGenConstSectionGroupFlag = vLinkGenConstGroupFlags/CONTIGUOUS
            vLinkGenConstSectionGroupFlag = vLinkGenConstGroupFlags/FILL
            vLinkGenConstSectionGroupFlag = vLinkGenConstGroupFlags/READ
            vLinkGenConstSectionGroupFlag = vLinkGenConstGroupFlags/EXECUTE
            vLinkGenConstSectionGroupRef = text
            vLinkGenConstSectionGroupRef = rodata
            vLinkGenConstSectionGroupRef = zrodata
        BmHdrHeaderGroup: vLinkGenConstGroupPosition=0, vLinkGenConstGroupRegion=ApplBmHdrHeader
          Upd_ApplInfoHeader (vLinkGenConstSectionGroup):
            vLinkGenConstSectionGroupPosition = 0
            vLinkGenConstSectionGroupInit = NONE
            vLinkGenConstSectionGroupInitStage = ONE
            vLinkGenConstSectionGroupFlag = vLinkGenConstGroupFlags/ORDERED
            vLinkGenConstSectionGroupFlag = vLinkGenConstGroupFlags/CONTIGUOUS
            vLinkGenConstSectionGroupFlag = vLinkGenConstGroupFlags/FILL
            vLinkGenConstSectionGroupFlag = vLinkGenConstGroupFlags/READ
            vLinkGenConstSectionGroupFlag = vLinkGenConstGroupFlags/EXECUTE
            vLinkGenConstSectionGroupRef = BmHdrHeaderSection
        RamConstGroup: vLinkGenConstGroupPosition=0, vLinkGenConstGroupInitCore=0, vLinkGenConstGroupRegion=ApplRomArea, vLinkGenConstGroupRamRegion=DefaultRamArea_DSPR0
          UpdRamConstSection (vLinkGenConstSectionGroup):
            vLinkGenConstSectionGroupPosition = 0
            vLinkGenConstSectionGroupInit = COPY_TO_RAM
            vLinkGenConstSectionGroupInitStage = ONE
            vLinkGenConstSectionGroupAlignment = 4
            vLinkGenConstSectionGroupEndAlignment = 4
            vLinkGenConstSectionGroupFlag = vLinkGenConstGroupFlags/ORDERED
            vLinkGenConstSectionGroupFlag = vLinkGenConstGroupFlags/CONTIGUOUS
            vLinkGenConstSectionGroupFlag = vLinkGenConstGroupFlags/FILL
            vLinkGenConstSectionGroupFlag = vLinkGenConstGroupFlags/READ
            vLinkGenConstSectionGroupFlag = vLinkGenConstGroupFlags/EXECUTE
            vLinkGenConstSectionGroupRef = RamConstSection
            vLinkGenConstSectionGroupRef = Workaround_Ramconst_ESCAN00107631
            vLinkGenConstSectionGroupRef = Workaround_Ramconst_ESCAN00104538
      Ram_Bss_Zbss_Group (vLinkGenLogicalVarGroup): vLinkGenVarGroupPosition=1000, vLinkGenVarGroupInitCore=0, vLinkGenVarGroupRegion=DefaultRamArea_DSPR0
        bss (vLinkGenVarSectionGroup):
          vLinkGenVarSectionGroupInit = ZERO_INIT
          vLinkGenVarSectionGroupPosition = 0
          vLinkGenVarSectionGroupInitStage = ONE
          vLinkGenVarSectionGroupAlignment = 16
          vLinkGenVarSectionGroupEndAlignment = 4
          vLinkGenVarSectionGroupFlag = vLinkGenVarGroupFlags/ORDERED
          vLinkGenVarSectionGroupFlag = vLinkGenVarGroupFlags/CONTIGUOUS
          vLinkGenVarSectionGroupFlag = vLinkGenVarGroupFlags/FILL
          vLinkGenVarSectionGroupFlag = vLinkGenVarGroupFlags/READ
          vLinkGenVarSectionGroupFlag = vLinkGenVarGroupFlags/WRITE
          vLinkGenVarSectionGroupRef = vLinkGenLinkerSections/bss
        zbss (vLinkGenVarSectionGroup):
          vLinkGenVarSectionGroupInit = ZERO_INIT
          vLinkGenVarSectionGroupPosition = 0
          vLinkGenVarSectionGroupInitStage = ONE
          vLinkGenVarSectionGroupAlignment = 16
          vLinkGenVarSectionGroupEndAlignment = 4
          vLinkGenVarSectionGroupFlag = vLinkGenVarGroupFlags/ORDERED
          vLinkGenVarSectionGroupFlag = vLinkGenVarGroupFlags/CONTIGUOUS
          vLinkGenVarSectionGroupFlag = vLinkGenVarGroupFlags/FILL
          vLinkGenVarSectionGroupFlag = vLinkGenVarGroupFlags/READ
          vLinkGenVarSectionGroupFlag = vLinkGenVarGroupFlags/WRITE
          vLinkGenVarSectionGroupRef = vLinkGenLinkerSections/zbss
      Ram_FlashDrvArea (vLinkGenMemoryRegion):
        vLinkGenMemoryRegionAddrOffset = 0
        vLinkGenMemoryRegionSize = 8192
        vLinkGenMemoryRegionAddress = 1880096768
        vLinkGenMemoryRegionAvailable = true
        vLinkGenMemoryRegionHwRegion = PSPR0
        FlashDrvArea (vLinkGenMemoryRegionBlock):
          vLinkGenMemoryRegionBlockPosition = 0
          vLinkGenMemoryRegionBlockBoundary = LOWER
          vLinkGenMemoryRegionBlockInitStage = NONE
          vLinkGenMemoryRegionBlockSize = 2048
          vLinkGenMemoryRegionBlockAddress = 1880096768
      DataDefaultGroup (vLinkGenLogicalVarGroup): vLinkGenVarGroupPosition=1, vLinkGenVarGroupInitCore=0, vLinkGenVarGroupRegion=DefaultRamArea_DSPR0, vLinkGenVarGroupRomRegion=ApplRomArea
        AppDataDefault (vLinkGenVarSectionGroup):
          vLinkGenVarSectionGroupPosition = 0
          vLinkGenVarSectionGroupInit = INIT
          vLinkGenVarSectionGroupInitStage = ONE
          vLinkGenVarSectionGroupAlignment = 16
          vLinkGenVarSectionGroupEndAlignment = 4
          vLinkGenVarSectionGroupFlag = vLinkGenVarGroupFlags/ORDERED
          vLinkGenVarSectionGroupFlag = vLinkGenVarGroupFlags/CONTIGUOUS
          vLinkGenVarSectionGroupFlag = vLinkGenVarGroupFlags/FILL
          vLinkGenVarSectionGroupFlag = vLinkGenVarGroupFlags/READ
          vLinkGenVarSectionGroupFlag = vLinkGenVarGroupFlags/WRITE
          vLinkGenVarSectionGroupRef = data
          vLinkGenVarSectionGroupRef = zdata
      brsExcVect (vLinkGenLogicalConstGroup): vLinkGenConstGroupPosition=5, vLinkGenConstGroupRegion=ApplRom_ExceptionTable
        brsExcVect (vLinkGenConstSectionGroup):
          vLinkGenConstSectionGroupPosition = 0
          vLinkGenConstSectionGroupInit = NONE
          vLinkGenConstSectionGroupInitStage = ONE
          vLinkGenConstSectionGroupFlag = vLinkGenConstGroupFlags/ORDERED
          vLinkGenConstSectionGroupFlag = vLinkGenConstGroupFlags/CONTIGUOUS
          vLinkGenConstSectionGroupFlag = vLinkGenConstGroupFlags/FILL
          vLinkGenConstSectionGroupFlag = vLinkGenConstGroupFlags/READ
          vLinkGenConstSectionGroupFlag = vLinkGenConstGroupFlags/EXECUTE
          vLinkGenConstSectionGroupRef = vLinkGenLinkerSections/brsExcVect
      RamCodeGroup_DSPR0 (vLinkGenLogicalConstGroup): vLinkGenConstGroupPosition=1, vLinkGenConstGroupInitCore=0, vLinkGenConstGroupRegion=ApplRomArea, vLinkGenConstGroupRamRegion=DefaultRamArea_DSPR0
        UpdRamCodeSection_DSPR0 (vLinkGenConstSectionGroup):
          vLinkGenConstSectionGroupPosition = 2
          vLinkGenConstSectionGroupInit = COPY_TO_RAM
          vLinkGenConstSectionGroupInitStage = ONE
          vLinkGenConstSectionGroupAlignment = 4
          vLinkGenConstSectionGroupEndAlignment = 4
          vLinkGenConstSectionGroupFlag = vLinkGenConstGroupFlags/ORDERED
          vLinkGenConstSectionGroupFlag = vLinkGenConstGroupFlags/CONTIGUOUS
          vLinkGenConstSectionGroupFlag = vLinkGenConstGroupFlags/FILL
          vLinkGenConstSectionGroupFlag = vLinkGenConstGroupFlags/READ
          vLinkGenConstSectionGroupFlag = vLinkGenConstGroupFlags/EXECUTE
          vLinkGenConstSectionGroupRef = RamCodeSection
          vLinkGenConstSectionGroupRef = Workaround_Ramcode_ESCAN00107631
          vLinkGenConstSectionGroupRef = Workaround_Ramcode_ESCAN00104538
      Ram_DefaultRamArea_DSPR0 (vLinkGenMemoryRegion):
        vLinkGenMemoryRegionAddrOffset = 0
        vLinkGenMemoryRegionSize = 98304
        vLinkGenMemoryRegionAddress = 1879048192
        vLinkGenMemoryRegionAvailable = true
        vLinkGenMemoryRegionHwRegion = DSPR0
        DefaultRamArea_DSPR0 (vLinkGenMemoryRegionBlock):
          vLinkGenMemoryRegionBlockPosition = 1
          vLinkGenMemoryRegionBlockBoundary = LOWER
          vLinkGenMemoryRegionBlockInitStage = NONE
          vLinkGenMemoryRegionBlockSize = 81920
          vLinkGenMemoryRegionBlockAddress = 1879064576
        DefaultRamArea_Stack (vLinkGenMemoryRegionBlock):
          vLinkGenMemoryRegionBlockPosition = 0
          vLinkGenMemoryRegionBlockSize = 16384
          vLinkGenMemoryRegionBlockAddress = 1879048192
          vLinkGenMemoryRegionBlockBoundary = LOWER
          vLinkGenMemoryRegionBlockInitStage = NONE
      SharedData_ReprogrammingData (vLinkGenLogicalVarGroup): vLinkGenVarGroupPosition=5, vLinkGenVarGroupRegion=RegionBlock_0_LMU0_ReprogrammingData
        ProgConditions (vLinkGenVarSectionGroup):
          vLinkGenVarSectionGroupPosition = 1
          vLinkGenVarSectionGroupInit = NONE
          vLinkGenVarSectionGroupInitStage = ONE
          vLinkGenVarSectionGroupAlignment = 0
          vLinkGenVarSectionGroupFlag = vLinkGenVarGroupFlags/ORDERED
          vLinkGenVarSectionGroupFlag = vLinkGenVarGroupFlags/CONTIGUOUS
          vLinkGenVarSectionGroupFlag = vLinkGenVarGroupFlags/FILL
          vLinkGenVarSectionGroupFlag = vLinkGenVarGroupFlags/READ
          vLinkGenVarSectionGroupFlag = vLinkGenVarGroupFlags/WRITE
          vLinkGenVarSectionGroupRef = ProgConditionSection
        MagicFlag (vLinkGenVarSectionGroup):
          vLinkGenVarSectionGroupPosition = 0
          vLinkGenVarSectionGroupInit = NONE
          vLinkGenVarSectionGroupInitStage = ONE
          vLinkGenVarSectionGroupAlignment = 16
          vLinkGenVarSectionGroupFlag = vLinkGenVarGroupFlags/ORDERED
          vLinkGenVarSectionGroupFlag = vLinkGenVarGroupFlags/CONTIGUOUS
          vLinkGenVarSectionGroupFlag = vLinkGenVarGroupFlags/FILL
          vLinkGenVarSectionGroupFlag = vLinkGenVarGroupFlags/READ
          vLinkGenVarSectionGroupFlag = vLinkGenVarGroupFlags/WRITE
          vLinkGenVarSectionGroupRef = MagicFlagSection
      ApplInfoHeaderSection (vLinkGenLogicalConstGroup): vLinkGenConstGroupPosition=0, vLinkGenConstGroupRegion=ApplInfoHeader
        Upd_ApplBmHdrHeader (vLinkGenConstSectionGroup):
          vLinkGenConstSectionGroupPosition = 0
          vLinkGenConstSectionGroupInit = NONE
          vLinkGenConstSectionGroupInitStage = ONE
          vLinkGenConstSectionGroupFlag = vLinkGenConstGroupFlags/ORDERED
          vLinkGenConstSectionGroupFlag = vLinkGenConstGroupFlags/CONTIGUOUS
          vLinkGenConstSectionGroupFlag = vLinkGenConstGroupFlags/FILL
          vLinkGenConstSectionGroupFlag = vLinkGenConstGroupFlags/READ
          vLinkGenConstSectionGroupFlag = vLinkGenConstGroupFlags/EXECUTE
          vLinkGenConstSectionGroupRef = vLinkGenLinkerSections/ApplInfoHeaderSection
      SharedData_vHsm (vLinkGenLogicalVarGroup): vLinkGenVarGroupPosition=5, vLinkGenVarGroupRegion=RegionBlock_0_LMU0_vHsm_Shared
        vHsmIpcMemory (vLinkGenVarSectionGroup):
          vLinkGenVarSectionGroupPosition = 0
          vLinkGenVarSectionGroupInit = NONE
          vLinkGenVarSectionGroupInitStage = ONE
          vLinkGenVarSectionGroupAlignment = 16
          vLinkGenVarSectionGroupFlag = vLinkGenVarGroupFlags/ORDERED
          vLinkGenVarSectionGroupFlag = vLinkGenVarGroupFlags/CONTIGUOUS
          vLinkGenVarSectionGroupFlag = vLinkGenVarGroupFlags/FILL
          vLinkGenVarSectionGroupFlag = vLinkGenVarGroupFlags/READ
          vLinkGenVarSectionGroupFlag = vLinkGenVarGroupFlags/WRITE
          vLinkGenVarSectionGroupRef = vLinkGenLinkerSections/vHsmIpcMemory
        vHsmGlobalRamBuffer (vLinkGenVarSectionGroup):
          vLinkGenVarSectionGroupPosition = 100
          vLinkGenVarSectionGroupInit = NONE
          vLinkGenVarSectionGroupInitStage = ONE
          vLinkGenVarSectionGroupAlignment = 16
          vLinkGenVarSectionGroupFlag = vLinkGenVarGroupFlags/ORDERED
          vLinkGenVarSectionGroupFlag = vLinkGenVarGroupFlags/CONTIGUOUS
          vLinkGenVarSectionGroupFlag = vLinkGenVarGroupFlags/FILL
          vLinkGenVarSectionGroupFlag = vLinkGenVarGroupFlags/READ
          vLinkGenVarSectionGroupFlag = vLinkGenVarGroupFlags/WRITE
          vLinkGenVarSectionGroupRef = vLinkGenLinkerSections/vHsmGlobalRamBuffer
    vLinkGenGeneral: vLinkGenEntrySymbol=brsStartupEntry, vLinkGenFileGeneration=STANDARD
    vLinkGenPublishedInformation: vLinkGenDefaultVarGroupAlignment=16, vLinkGenGeneration=2, vLinkGenDuplicatedLabels=false
      vLinkGenRegionBlockFlags
        RESERVED (vLinkGenRegionBlockFlag)
      vLinkGenConstGroupFlags
        7 x vLinkGenConstGroupFlag:
          ORDERED
          CONTIGUOUS
          FILL
          NOCOPY
          EXECUTE
          READ
          WRITE
      vLinkGenConstSectionFlags
        KEEP (vLinkGenConstSectionFlag)
      vLinkGenVarGroupFlags
        7 x vLinkGenVarGroupFlag:
          ORDERED
          CONTIGUOUS
          FILL
          NOCOPY
          EXECUTE
          READ
          WRITE
      vLinkGenVarSectionFlags
        KEEP (vLinkGenVarSectionFlag)
      vLinkGenLogicalConstGroupFlags
        FORCE_ZERO_OFFSET (vLinkGenLogicalConstGroupFlag)
      vLinkGenLogicalVarGroupFlags
        FORCE_ZERO_OFFSET (vLinkGenLogicalVarGroupFlag)
    vLinkGenContentTypes
      15 x vLinkGenConstContentType:
        GLOBAL_CODE: vLinkGenConstContentTypeLocal=false
        LOCAL_CODE: vLinkGenConstContentTypeLocal=true
        GLOBAL_CONST: vLinkGenConstContentTypeLocal=false
        LOCAL_CONST: vLinkGenConstContentTypeLocal=true
        GLOBAL_EXCVEC_CODE: vLinkGenConstContentTypeLocal=false
        LOCAL_EXCVEC_CODE: vLinkGenConstContentTypeLocal=true
        GLOBAL_EXCVEC_CONST: vLinkGenConstContentTypeLocal=true
        LOCAL_EXCVEC_CONST: vLinkGenConstContentTypeLocal=true
        GLOBAL_INTVEC_CODE: vLinkGenConstContentTypeLocal=false
        LOCAL_INTVEC_CODE: vLinkGenConstContentTypeLocal=true
        GLOBAL_INTVEC_CONST: vLinkGenConstContentTypeLocal=false
        LOCAL_INTVEC_CONST: vLinkGenConstContentTypeLocal=true
        STARTUP_CODE: vLinkGenConstContentTypeLocal=false
        RAM_CODE: vLinkGenConstContentTypeLocal=false
        RAM_CONST: vLinkGenConstContentTypeLocal=false
      8 x vLinkGenVarContentType:
        GLOBAL_DATA: vLinkGenVarContentTypeLocal=false
        LOCAL_DATA: vLinkGenVarContentTypeLocal=true
        RETENTION_DATA: vLinkGenVarContentTypeLocal=false
        STARTUP_STACK: vLinkGenVarContentTypeLocal=true
        STACKS: vLinkGenVarContentTypeLocal=true
        RAM_CODE_COPY: vLinkGenVarContentTypeLocal=false
        RAM_CONST_COPY: vLinkGenVarContentTypeLocal=false
        SHARED_DATA: vLinkGenVarContentTypeLocal=false
