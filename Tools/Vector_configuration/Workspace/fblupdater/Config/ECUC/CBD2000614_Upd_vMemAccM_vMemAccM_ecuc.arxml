AUTOSAR XML (schema 00046)
package /ActiveEcuC
  module config vMemAccM: implementation-config-variant=VARIANT-PRE-COMPILE, module-description=vMemAccM_Impl
    vMemAccMAddressAreaConfiguration_Partition_B (vMemAccMAddressAreaConfiguration): vMemAccMAddressAreaId=1, vMemAccMAddressAreaPriority=1, vMemAccMReadRequestLength=1024
      vMemAccMSubAddressAreaConfiguration_Bootloader (vMemAccMSubAddressAreaConfiguration):
        vMemAccMNumberOfSectors = 9
        vMemAccMVirtualStartAddress = 2684616704
        vMemAccMPhysicalStartAddress = 2690908160
        vMemAccMvMemFuncPtrTableSymbol = vMem_30_Fbl_FunctionPointerTable
        vMemAccMUseEraseBurst = false
        vMemAccMUseWriteBurst = false
        vMemAccMSectorRef = PF2_PF0_PS0_S36_S63
      vMemAccMSubAddressAreaConfiguration_Application_S1 (vMemAccMSubAddressAreaConfiguration):
        vMemAccMNumberOfSectors = 38
        vMemAccMVirtualStartAddress = 2684780544
        vMemAccMPhysicalStartAddress = 2691072000
        vMemAccMvMemFuncPtrTableSymbol = vMem_30_Fbl_FunctionPointerTable
        vMemAccMUseEraseBurst = false
        vMemAccMUseWriteBurst = false
        vMemAccMSectorRef = PF2_PF0_PS1_S64_S127
    vMemAccMAddressAreaConfiguration_Partition_A (vMemAccMAddressAreaConfiguration): vMemAccMAddressAreaId=0, vMemAccMAddressAreaPriority=0, vMemAccMReadRequestLength=1024
      vMemAccMSubAddressAreaConfiguration_Bootloader (vMemAccMSubAddressAreaConfiguration):
        vMemAccMNumberOfSectors = 9
        vMemAccMVirtualStartAddress = 2684649472
        vMemAccMPhysicalStartAddress = 2684649472
        vMemAccMvMemFuncPtrTableSymbol = vMem_30_Fbl_FunctionPointerTable
        vMemAccMUseEraseBurst = false
        vMemAccMUseWriteBurst = false
        vMemAccMSectorRef = PF0_PF2_PS0_S36_S63
      vMemAccMSubAddressAreaConfiguration_Application_S1 (vMemAccMSubAddressAreaConfiguration):
        vMemAccMNumberOfSectors = 37
        vMemAccMVirtualStartAddress = 2684796928
        vMemAccMPhysicalStartAddress = 2684796928
        vMemAccMvMemFuncPtrTableSymbol = vMem_30_Fbl_FunctionPointerTable
        vMemAccMUseEraseBurst = false
        vMemAccMUseWriteBurst = false
        vMemAccMSectorRef = PF0_PF2_PS1_S64_S127
    vMemAccMGeneral:
      vMemAccMVersionInfoApi = false
      vMemAccMMainFunctionPeriod = 0.005
      vMemAccMMainFunctionTriggering = FixedCycleTime
      vMemAccMSafeBswChecks = false
      vMemAccMDevErrorDetect = true
      vMemAccMCompareApi = true
