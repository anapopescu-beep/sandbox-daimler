AUTOSAR XML (schema 00046)
package /MICROSAR
  bsw implementation PduR_Impl: programming-language=C, sw-version=15.04.01, used-code-generator=DaVinci Configurator, vendor-id=30, ar-release-version=4.01.02
