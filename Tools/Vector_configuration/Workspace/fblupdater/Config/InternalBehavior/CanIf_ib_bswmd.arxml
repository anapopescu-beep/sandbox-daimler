AUTOSAR XML (schema 00046)
package /MICROSAR
  bsw implementation CanIf_Impl: programming-language=C, sw-version=6.25.00, used-code-generator=cMSR, vendor-id=30, ar-release-version=4.00.03
