AUTOSAR XML (schema 00046)
package /AURIX2G/EcucDefs/Smu_ib_bswmd/BswModuleDescriptions
  bsw module description Smu
    bsw internal behavior SmuBehavior
      exclusive area CmdAccess
      exclusive area DriverAccess
