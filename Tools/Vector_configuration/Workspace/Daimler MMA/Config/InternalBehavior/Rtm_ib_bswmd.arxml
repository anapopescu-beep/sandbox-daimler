AUTOSAR XML (schema 4-3-0)
standard types defined: sint32, uint32, uint8
package /MICROSAR
  bsw implementation Rtm_Impl: programming-language=C, sw-version=8.00.02, used-code-generator=DaVinci Configurator, vendor-id=30, ar-release-version=4.02.02
    mc-parameter-instances:
      4 x mc data instance:
        Rtm_Cmd: category=VALUE, resulting-properties={base-type=uint32, sw-calibration-access=READ-ONLY, range raw 0..4294967295}, variation-point=post-build-variant-condition{matching-criterion=SideAllocation, value=0}
        Rtm_MeasurementConfig: category=ARRAY, array-size=6, resulting-properties={base-type=uint8, sw-calibration-access=READ-ONLY, range raw 0..255}, variation-point=post-build-variant-condition{matching-criterion=SideAllocation, value=0}
        Rtm_Cmd: category=VALUE, resulting-properties={base-type=uint32, sw-calibration-access=READ-ONLY, range raw 0..4294967295}, variation-point=post-build-variant-condition{matching-criterion=SideAllocation, value=1}
        Rtm_MeasurementConfig: category=ARRAY, array-size=6, resulting-properties={base-type=uint8, sw-calibration-access=READ-ONLY, range raw 0..255}, variation-point=post-build-variant-condition{matching-criterion=SideAllocation, value=1}
    mc-variable-instances:
      12 x mc data instance:
        Rtm_MeasTimeCorrection: category=VALUE, resulting-properties={base-type=sint32, sw-calibration-access=READ-ONLY, range raw -2147483648..2147483647}, variation-point=post-build-variant-condition{matching-criterion=SideAllocation, value=0}
        Rtm_Resp: category=VALUE, resulting-properties={base-type=uint32, sw-calibration-access=READ-ONLY, range raw 0..4294967295}, variation-point=post-build-variant-condition{matching-criterion=SideAllocation, value=0}
        Rtm_AverageMainFunctionCycleTime: category=VALUE, resulting-properties={base-type=uint32, sw-calibration-access=READ-ONLY, range raw 0..4294967295}, variation-point=post-build-variant-condition{matching-criterion=SideAllocation, value=0}
        Rtm_MainFunctionCounter: category=VALUE, resulting-properties={base-type=uint32, sw-calibration-access=READ-ONLY, range raw 0..4294967295}, variation-point=post-build-variant-condition{matching-criterion=SideAllocation, value=0}
        Rtm_CpuLoadTime: category=VALUE, resulting-properties={base-type=uint32, sw-calibration-access=READ-ONLY, range raw 0..4294967295}, variation-point=post-build-variant-condition{matching-criterion=SideAllocation, value=0}
        Rtm_Results: category=ARRAY, array-size=48, variation-point=post-build-variant-condition{matching-criterion=SideAllocation, value=0}
          48 x mc data instance, all with category=STRUCTURE:
            Element_0: symbol=[0]
              4 x mc data instance, all with category=VALUE, resulting-properties={base-type=uint32, sw-calibration-access=READ-ONLY, range raw 0..4294967295}:
                time
                count
                max
                min
            Element_1: symbol=[1]
              4 x mc data instance, all with category=VALUE, resulting-properties={base-type=uint32, sw-calibration-access=READ-ONLY, range raw 0..4294967295}:
                time
                count
                max
                min
            Element_2: symbol=[2]
              4 x mc data instance, all with category=VALUE, resulting-properties={base-type=uint32, sw-calibration-access=READ-ONLY, range raw 0..4294967295}:
                time
                count
                max
                min
            Element_3: symbol=[3]
              4 x mc data instance, all with category=VALUE, resulting-properties={base-type=uint32, sw-calibration-access=READ-ONLY, range raw 0..4294967295}:
                time
                count
                max
                min
            Element_4: symbol=[4]
              4 x mc data instance, all with category=VALUE, resulting-properties={base-type=uint32, sw-calibration-access=READ-ONLY, range raw 0..4294967295}:
                time
                count
                max
                min
            Element_5: symbol=[5]
              4 x mc data instance, all with category=VALUE, resulting-properties={base-type=uint32, sw-calibration-access=READ-ONLY, range raw 0..4294967295}:
                time
                count
                max
                min
            Element_6: symbol=[6]
              4 x mc data instance, all with category=VALUE, resulting-properties={base-type=uint32, sw-calibration-access=READ-ONLY, range raw 0..4294967295}:
                time
                count
                max
                min
            Element_7: symbol=[7]
              4 x mc data instance, all with category=VALUE, resulting-properties={base-type=uint32, sw-calibration-access=READ-ONLY, range raw 0..4294967295}:
                time
                count
                max
                min
            Element_8: symbol=[8]
              4 x mc data instance, all with category=VALUE, resulting-properties={base-type=uint32, sw-calibration-access=READ-ONLY, range raw 0..4294967295}:
                time
                count
                max
                min
            Element_9: symbol=[9]
              4 x mc data instance, all with category=VALUE, resulting-properties={base-type=uint32, sw-calibration-access=READ-ONLY, range raw 0..4294967295}:
                time
                count
                max
                min
            Element_10: symbol=[10]
              4 x mc data instance, all with category=VALUE, resulting-properties={base-type=uint32, sw-calibration-access=READ-ONLY, range raw 0..4294967295}:
                time
                count
                max
                min
            Element_11: symbol=[11]
              4 x mc data instance, all with category=VALUE, resulting-properties={base-type=uint32, sw-calibration-access=READ-ONLY, range raw 0..4294967295}:
                time
                count
                max
                min
            Element_12: symbol=[12]
              4 x mc data instance, all with category=VALUE, resulting-properties={base-type=uint32, sw-calibration-access=READ-ONLY, range raw 0..4294967295}:
                time
                count
                max
                min
            Element_13: symbol=[13]
              4 x mc data instance, all with category=VALUE, resulting-properties={base-type=uint32, sw-calibration-access=READ-ONLY, range raw 0..4294967295}:
                time
                count
                max
                min
            Element_14: symbol=[14]
              4 x mc data instance, all with category=VALUE, resulting-properties={base-type=uint32, sw-calibration-access=READ-ONLY, range raw 0..4294967295}:
                time
                count
                max
                min
            Element_15: symbol=[15]
              4 x mc data instance, all with category=VALUE, resulting-properties={base-type=uint32, sw-calibration-access=READ-ONLY, range raw 0..4294967295}:
                time
                count
                max
                min
            Element_16: symbol=[16]
              4 x mc data instance, all with category=VALUE, resulting-properties={base-type=uint32, sw-calibration-access=READ-ONLY, range raw 0..4294967295}:
                time
                count
                max
                min
            Element_17: symbol=[17]
              4 x mc data instance, all with category=VALUE, resulting-properties={base-type=uint32, sw-calibration-access=READ-ONLY, range raw 0..4294967295}:
                time
                count
                max
                min
            Element_18: symbol=[18]
              4 x mc data instance, all with category=VALUE, resulting-properties={base-type=uint32, sw-calibration-access=READ-ONLY, range raw 0..4294967295}:
                time
                count
                max
                min
            Element_19: symbol=[19]
              4 x mc data instance, all with category=VALUE, resulting-properties={base-type=uint32, sw-calibration-access=READ-ONLY, range raw 0..4294967295}:
                time
                count
                max
                min
            Element_20: symbol=[20]
              4 x mc data instance, all with category=VALUE, resulting-properties={base-type=uint32, sw-calibration-access=READ-ONLY, range raw 0..4294967295}:
                time
                count
                max
                min
            Element_21: symbol=[21]
              4 x mc data instance, all with category=VALUE, resulting-properties={base-type=uint32, sw-calibration-access=READ-ONLY, range raw 0..4294967295}:
                time
                count
                max
                min
            Element_22: symbol=[22]
              4 x mc data instance, all with category=VALUE, resulting-properties={base-type=uint32, sw-calibration-access=READ-ONLY, range raw 0..4294967295}:
                time
                count
                max
                min
            Element_23: symbol=[23]
              4 x mc data instance, all with category=VALUE, resulting-properties={base-type=uint32, sw-calibration-access=READ-ONLY, range raw 0..4294967295}:
                time
                count
                max
                min
            Element_24: symbol=[24]
              4 x mc data instance, all with category=VALUE, resulting-properties={base-type=uint32, sw-calibration-access=READ-ONLY, range raw 0..4294967295}:
                time
                count
                max
                min
            Element_25: symbol=[25]
              4 x mc data instance, all with category=VALUE, resulting-properties={base-type=uint32, sw-calibration-access=READ-ONLY, range raw 0..4294967295}:
                time
                count
                max
                min
            Element_26: symbol=[26]
              4 x mc data instance, all with category=VALUE, resulting-properties={base-type=uint32, sw-calibration-access=READ-ONLY, range raw 0..4294967295}:
                time
                count
                max
                min
            Element_27: symbol=[27]
              4 x mc data instance, all with category=VALUE, resulting-properties={base-type=uint32, sw-calibration-access=READ-ONLY, range raw 0..4294967295}:
                time
                count
                max
                min
            Element_28: symbol=[28]
              4 x mc data instance, all with category=VALUE, resulting-properties={base-type=uint32, sw-calibration-access=READ-ONLY, range raw 0..4294967295}:
                time
                count
                max
                min
            Element_29: symbol=[29]
              4 x mc data instance, all with category=VALUE, resulting-properties={base-type=uint32, sw-calibration-access=READ-ONLY, range raw 0..4294967295}:
                time
                count
                max
                min
            Element_30: symbol=[30]
              4 x mc data instance, all with category=VALUE, resulting-properties={base-type=uint32, sw-calibration-access=READ-ONLY, range raw 0..4294967295}:
                time
                count
                max
                min
            Element_31: symbol=[31]
              4 x mc data instance, all with category=VALUE, resulting-properties={base-type=uint32, sw-calibration-access=READ-ONLY, range raw 0..4294967295}:
                time
                count
                max
                min
            Element_32: symbol=[32]
              4 x mc data instance, all with category=VALUE, resulting-properties={base-type=uint32, sw-calibration-access=READ-ONLY, range raw 0..4294967295}:
                time
                count
                max
                min
            Element_33: symbol=[33]
              4 x mc data instance, all with category=VALUE, resulting-properties={base-type=uint32, sw-calibration-access=READ-ONLY, range raw 0..4294967295}:
                time
                count
                max
                min
            Element_34: symbol=[34]
              4 x mc data instance, all with category=VALUE, resulting-properties={base-type=uint32, sw-calibration-access=READ-ONLY, range raw 0..4294967295}:
                time
                count
                max
                min
            Element_35: symbol=[35]
              4 x mc data instance, all with category=VALUE, resulting-properties={base-type=uint32, sw-calibration-access=READ-ONLY, range raw 0..4294967295}:
                time
                count
                max
                min
            Element_36: symbol=[36]
              4 x mc data instance, all with category=VALUE, resulting-properties={base-type=uint32, sw-calibration-access=READ-ONLY, range raw 0..4294967295}:
                time
                count
                max
                min
            Element_37: symbol=[37]
              4 x mc data instance, all with category=VALUE, resulting-properties={base-type=uint32, sw-calibration-access=READ-ONLY, range raw 0..4294967295}:
                time
                count
                max
                min
            Element_38: symbol=[38]
              4 x mc data instance, all with category=VALUE, resulting-properties={base-type=uint32, sw-calibration-access=READ-ONLY, range raw 0..4294967295}:
                time
                count
                max
                min
            Element_39: symbol=[39]
              4 x mc data instance, all with category=VALUE, resulting-properties={base-type=uint32, sw-calibration-access=READ-ONLY, range raw 0..4294967295}:
                time
                count
                max
                min
            Element_40: symbol=[40]
              4 x mc data instance, all with category=VALUE, resulting-properties={base-type=uint32, sw-calibration-access=READ-ONLY, range raw 0..4294967295}:
                time
                count
                max
                min
            Element_41: symbol=[41]
              4 x mc data instance, all with category=VALUE, resulting-properties={base-type=uint32, sw-calibration-access=READ-ONLY, range raw 0..4294967295}:
                time
                count
                max
                min
            Element_42: symbol=[42]
              4 x mc data instance, all with category=VALUE, resulting-properties={base-type=uint32, sw-calibration-access=READ-ONLY, range raw 0..4294967295}:
                time
                count
                max
                min
            Element_43: symbol=[43]
              4 x mc data instance, all with category=VALUE, resulting-properties={base-type=uint32, sw-calibration-access=READ-ONLY, range raw 0..4294967295}:
                time
                count
                max
                min
            Element_44: symbol=[44]
              4 x mc data instance, all with category=VALUE, resulting-properties={base-type=uint32, sw-calibration-access=READ-ONLY, range raw 0..4294967295}:
                time
                count
                max
                min
            Element_45: symbol=[45]
              4 x mc data instance, all with category=VALUE, resulting-properties={base-type=uint32, sw-calibration-access=READ-ONLY, range raw 0..4294967295}:
                time
                count
                max
                min
            Element_46: symbol=[46]
              4 x mc data instance, all with category=VALUE, resulting-properties={base-type=uint32, sw-calibration-access=READ-ONLY, range raw 0..4294967295}:
                time
                count
                max
                min
            Element_47: symbol=[47]
              4 x mc data instance, all with category=VALUE, resulting-properties={base-type=uint32, sw-calibration-access=READ-ONLY, range raw 0..4294967295}:
                time
                count
                max
                min
        Rtm_MeasTimeCorrection: category=VALUE, resulting-properties={base-type=sint32, sw-calibration-access=READ-ONLY, range raw -2147483648..2147483647}, variation-point=post-build-variant-condition{matching-criterion=SideAllocation, value=1}
        Rtm_Resp: category=VALUE, resulting-properties={base-type=uint32, sw-calibration-access=READ-ONLY, range raw 0..4294967295}, variation-point=post-build-variant-condition{matching-criterion=SideAllocation, value=1}
        Rtm_AverageMainFunctionCycleTime: category=VALUE, resulting-properties={base-type=uint32, sw-calibration-access=READ-ONLY, range raw 0..4294967295}, variation-point=post-build-variant-condition{matching-criterion=SideAllocation, value=1}
        Rtm_MainFunctionCounter: category=VALUE, resulting-properties={base-type=uint32, sw-calibration-access=READ-ONLY, range raw 0..4294967295}, variation-point=post-build-variant-condition{matching-criterion=SideAllocation, value=1}
        Rtm_CpuLoadTime: category=VALUE, resulting-properties={base-type=uint32, sw-calibration-access=READ-ONLY, range raw 0..4294967295}, variation-point=post-build-variant-condition{matching-criterion=SideAllocation, value=1}
        Rtm_Results: category=ARRAY, array-size=48, variation-point=post-build-variant-condition{matching-criterion=SideAllocation, value=1}
          48 x mc data instance, all with category=STRUCTURE:
            Element_0: symbol=[0]
              4 x mc data instance, all with category=VALUE, resulting-properties={base-type=uint32, sw-calibration-access=READ-ONLY, range raw 0..4294967295}:
                time
                count
                max
                min
            Element_1: symbol=[1]
              4 x mc data instance, all with category=VALUE, resulting-properties={base-type=uint32, sw-calibration-access=READ-ONLY, range raw 0..4294967295}:
                time
                count
                max
                min
            Element_2: symbol=[2]
              4 x mc data instance, all with category=VALUE, resulting-properties={base-type=uint32, sw-calibration-access=READ-ONLY, range raw 0..4294967295}:
                time
                count
                max
                min
            Element_3: symbol=[3]
              4 x mc data instance, all with category=VALUE, resulting-properties={base-type=uint32, sw-calibration-access=READ-ONLY, range raw 0..4294967295}:
                time
                count
                max
                min
            Element_4: symbol=[4]
              4 x mc data instance, all with category=VALUE, resulting-properties={base-type=uint32, sw-calibration-access=READ-ONLY, range raw 0..4294967295}:
                time
                count
                max
                min
            Element_5: symbol=[5]
              4 x mc data instance, all with category=VALUE, resulting-properties={base-type=uint32, sw-calibration-access=READ-ONLY, range raw 0..4294967295}:
                time
                count
                max
                min
            Element_6: symbol=[6]
              4 x mc data instance, all with category=VALUE, resulting-properties={base-type=uint32, sw-calibration-access=READ-ONLY, range raw 0..4294967295}:
                time
                count
                max
                min
            Element_7: symbol=[7]
              4 x mc data instance, all with category=VALUE, resulting-properties={base-type=uint32, sw-calibration-access=READ-ONLY, range raw 0..4294967295}:
                time
                count
                max
                min
            Element_8: symbol=[8]
              4 x mc data instance, all with category=VALUE, resulting-properties={base-type=uint32, sw-calibration-access=READ-ONLY, range raw 0..4294967295}:
                time
                count
                max
                min
            Element_9: symbol=[9]
              4 x mc data instance, all with category=VALUE, resulting-properties={base-type=uint32, sw-calibration-access=READ-ONLY, range raw 0..4294967295}:
                time
                count
                max
                min
            Element_10: symbol=[10]
              4 x mc data instance, all with category=VALUE, resulting-properties={base-type=uint32, sw-calibration-access=READ-ONLY, range raw 0..4294967295}:
                time
                count
                max
                min
            Element_11: symbol=[11]
              4 x mc data instance, all with category=VALUE, resulting-properties={base-type=uint32, sw-calibration-access=READ-ONLY, range raw 0..4294967295}:
                time
                count
                max
                min
            Element_12: symbol=[12]
              4 x mc data instance, all with category=VALUE, resulting-properties={base-type=uint32, sw-calibration-access=READ-ONLY, range raw 0..4294967295}:
                time
                count
                max
                min
            Element_13: symbol=[13]
              4 x mc data instance, all with category=VALUE, resulting-properties={base-type=uint32, sw-calibration-access=READ-ONLY, range raw 0..4294967295}:
                time
                count
                max
                min
            Element_14: symbol=[14]
              4 x mc data instance, all with category=VALUE, resulting-properties={base-type=uint32, sw-calibration-access=READ-ONLY, range raw 0..4294967295}:
                time
                count
                max
                min
            Element_15: symbol=[15]
              4 x mc data instance, all with category=VALUE, resulting-properties={base-type=uint32, sw-calibration-access=READ-ONLY, range raw 0..4294967295}:
                time
                count
                max
                min
            Element_16: symbol=[16]
              4 x mc data instance, all with category=VALUE, resulting-properties={base-type=uint32, sw-calibration-access=READ-ONLY, range raw 0..4294967295}:
                time
                count
                max
                min
            Element_17: symbol=[17]
              4 x mc data instance, all with category=VALUE, resulting-properties={base-type=uint32, sw-calibration-access=READ-ONLY, range raw 0..4294967295}:
                time
                count
                max
                min
            Element_18: symbol=[18]
              4 x mc data instance, all with category=VALUE, resulting-properties={base-type=uint32, sw-calibration-access=READ-ONLY, range raw 0..4294967295}:
                time
                count
                max
                min
            Element_19: symbol=[19]
              4 x mc data instance, all with category=VALUE, resulting-properties={base-type=uint32, sw-calibration-access=READ-ONLY, range raw 0..4294967295}:
                time
                count
                max
                min
            Element_20: symbol=[20]
              4 x mc data instance, all with category=VALUE, resulting-properties={base-type=uint32, sw-calibration-access=READ-ONLY, range raw 0..4294967295}:
                time
                count
                max
                min
            Element_21: symbol=[21]
              4 x mc data instance, all with category=VALUE, resulting-properties={base-type=uint32, sw-calibration-access=READ-ONLY, range raw 0..4294967295}:
                time
                count
                max
                min
            Element_22: symbol=[22]
              4 x mc data instance, all with category=VALUE, resulting-properties={base-type=uint32, sw-calibration-access=READ-ONLY, range raw 0..4294967295}:
                time
                count
                max
                min
            Element_23: symbol=[23]
              4 x mc data instance, all with category=VALUE, resulting-properties={base-type=uint32, sw-calibration-access=READ-ONLY, range raw 0..4294967295}:
                time
                count
                max
                min
            Element_24: symbol=[24]
              4 x mc data instance, all with category=VALUE, resulting-properties={base-type=uint32, sw-calibration-access=READ-ONLY, range raw 0..4294967295}:
                time
                count
                max
                min
            Element_25: symbol=[25]
              4 x mc data instance, all with category=VALUE, resulting-properties={base-type=uint32, sw-calibration-access=READ-ONLY, range raw 0..4294967295}:
                time
                count
                max
                min
            Element_26: symbol=[26]
              4 x mc data instance, all with category=VALUE, resulting-properties={base-type=uint32, sw-calibration-access=READ-ONLY, range raw 0..4294967295}:
                time
                count
                max
                min
            Element_27: symbol=[27]
              4 x mc data instance, all with category=VALUE, resulting-properties={base-type=uint32, sw-calibration-access=READ-ONLY, range raw 0..4294967295}:
                time
                count
                max
                min
            Element_28: symbol=[28]
              4 x mc data instance, all with category=VALUE, resulting-properties={base-type=uint32, sw-calibration-access=READ-ONLY, range raw 0..4294967295}:
                time
                count
                max
                min
            Element_29: symbol=[29]
              4 x mc data instance, all with category=VALUE, resulting-properties={base-type=uint32, sw-calibration-access=READ-ONLY, range raw 0..4294967295}:
                time
                count
                max
                min
            Element_30: symbol=[30]
              4 x mc data instance, all with category=VALUE, resulting-properties={base-type=uint32, sw-calibration-access=READ-ONLY, range raw 0..4294967295}:
                time
                count
                max
                min
            Element_31: symbol=[31]
              4 x mc data instance, all with category=VALUE, resulting-properties={base-type=uint32, sw-calibration-access=READ-ONLY, range raw 0..4294967295}:
                time
                count
                max
                min
            Element_32: symbol=[32]
              4 x mc data instance, all with category=VALUE, resulting-properties={base-type=uint32, sw-calibration-access=READ-ONLY, range raw 0..4294967295}:
                time
                count
                max
                min
            Element_33: symbol=[33]
              4 x mc data instance, all with category=VALUE, resulting-properties={base-type=uint32, sw-calibration-access=READ-ONLY, range raw 0..4294967295}:
                time
                count
                max
                min
            Element_34: symbol=[34]
              4 x mc data instance, all with category=VALUE, resulting-properties={base-type=uint32, sw-calibration-access=READ-ONLY, range raw 0..4294967295}:
                time
                count
                max
                min
            Element_35: symbol=[35]
              4 x mc data instance, all with category=VALUE, resulting-properties={base-type=uint32, sw-calibration-access=READ-ONLY, range raw 0..4294967295}:
                time
                count
                max
                min
            Element_36: symbol=[36]
              4 x mc data instance, all with category=VALUE, resulting-properties={base-type=uint32, sw-calibration-access=READ-ONLY, range raw 0..4294967295}:
                time
                count
                max
                min
            Element_37: symbol=[37]
              4 x mc data instance, all with category=VALUE, resulting-properties={base-type=uint32, sw-calibration-access=READ-ONLY, range raw 0..4294967295}:
                time
                count
                max
                min
            Element_38: symbol=[38]
              4 x mc data instance, all with category=VALUE, resulting-properties={base-type=uint32, sw-calibration-access=READ-ONLY, range raw 0..4294967295}:
                time
                count
                max
                min
            Element_39: symbol=[39]
              4 x mc data instance, all with category=VALUE, resulting-properties={base-type=uint32, sw-calibration-access=READ-ONLY, range raw 0..4294967295}:
                time
                count
                max
                min
            Element_40: symbol=[40]
              4 x mc data instance, all with category=VALUE, resulting-properties={base-type=uint32, sw-calibration-access=READ-ONLY, range raw 0..4294967295}:
                time
                count
                max
                min
            Element_41: symbol=[41]
              4 x mc data instance, all with category=VALUE, resulting-properties={base-type=uint32, sw-calibration-access=READ-ONLY, range raw 0..4294967295}:
                time
                count
                max
                min
            Element_42: symbol=[42]
              4 x mc data instance, all with category=VALUE, resulting-properties={base-type=uint32, sw-calibration-access=READ-ONLY, range raw 0..4294967295}:
                time
                count
                max
                min
            Element_43: symbol=[43]
              4 x mc data instance, all with category=VALUE, resulting-properties={base-type=uint32, sw-calibration-access=READ-ONLY, range raw 0..4294967295}:
                time
                count
                max
                min
            Element_44: symbol=[44]
              4 x mc data instance, all with category=VALUE, resulting-properties={base-type=uint32, sw-calibration-access=READ-ONLY, range raw 0..4294967295}:
                time
                count
                max
                min
            Element_45: symbol=[45]
              4 x mc data instance, all with category=VALUE, resulting-properties={base-type=uint32, sw-calibration-access=READ-ONLY, range raw 0..4294967295}:
                time
                count
                max
                min
            Element_46: symbol=[46]
              4 x mc data instance, all with category=VALUE, resulting-properties={base-type=uint32, sw-calibration-access=READ-ONLY, range raw 0..4294967295}:
                time
                count
                max
                min
            Element_47: symbol=[47]
              4 x mc data instance, all with category=VALUE, resulting-properties={base-type=uint32, sw-calibration-access=READ-ONLY, range raw 0..4294967295}:
                time
                count
                max
                min
    resource consumption ResourceConsumption
      62 x memory section:
        VAR_NOCACHE_CLEARED_UNSPECIFIED: alignment=UNSPECIFIED, sw-addrmethod=VAR_NOCACHE_CLEARED
        VAR_FAST_INIT_64: alignment=64, sw-addrmethod=VAR_FAST_INIT
        VAR_FAST_CLEARED_UNSPECIFIED: alignment=UNSPECIFIED, sw-addrmethod=VAR_FAST_CLEARED
        VAR_NOCACHE_CLEARED_16: alignment=16, sw-addrmethod=VAR_NOCACHE_CLEARED
        VAR_NO_INIT_16: alignment=16, sw-addrmethod=VAR_NO_INIT
        CONST_16: alignment=16, sw-addrmethod=CONST
        VAR_FAST_CLEARED_8: alignment=8, sw-addrmethod=VAR_FAST_CLEARED
        CODE: sw-addrmethod=CODE
        VAR_CLEARED_16: alignment=16, sw-addrmethod=VAR_CLEARED
        VAR_FAST_NO_INIT_16: alignment=16, sw-addrmethod=VAR_FAST_NO_INIT
        VAR_NOCACHE_INIT_32: alignment=32, sw-addrmethod=VAR_NOCACHE_INIT
        VAR_INIT_UNSPECIFIED_SAFE: sw-addrmethod=VAR_INIT_UNSPECIFIED_SAFE
        VAR_CLEARED_8: alignment=8, sw-addrmethod=VAR_CLEARED
        VAR_FAST_CLEARED_16: alignment=16, sw-addrmethod=VAR_FAST_CLEARED
        CONST_32: alignment=32, sw-addrmethod=CONST
        VAR_INIT_32: alignment=32, sw-addrmethod=VAR_INIT
        VAR_NO_INIT_32: alignment=32, sw-addrmethod=VAR_NO_INIT
        VAR_NOCACHE_INIT_BOOLEAN: alignment=BOOLEAN, sw-addrmethod=VAR_NOCACHE_INIT
        VAR_FAST_NO_INIT_BOOLEAN: alignment=BOOLEAN, sw-addrmethod=VAR_FAST_NO_INIT
        VAR_FAST_CLEARED_BOOLEAN: alignment=BOOLEAN, sw-addrmethod=VAR_FAST_CLEARED
        VAR_CLEARED_UNSPECIFIED: alignment=UNSPECIFIED, sw-addrmethod=VAR_CLEARED
        VAR_CLEARED_32: alignment=32, sw-addrmethod=VAR_CLEARED
        VAR_INIT_BOOLEAN: alignment=BOOLEAN, sw-addrmethod=VAR_INIT
        VAR_NOCACHE_INIT_UNSPECIFIED: alignment=UNSPECIFIED, sw-addrmethod=VAR_NOCACHE_INIT
        VAR_FAST_INIT_8: alignment=8, sw-addrmethod=VAR_FAST_INIT
        VAR_NOCACHE_INIT_16: alignment=16, sw-addrmethod=VAR_NOCACHE_INIT
        CONST_BOOLEAN: alignment=BOOLEAN, sw-addrmethod=CONST
        VAR_INIT_16: alignment=16, sw-addrmethod=VAR_INIT
        VAR_NOCACHE_NO_INIT_16: alignment=16, sw-addrmethod=VAR_NOCACHE_NO_INIT
        VAR_NO_INIT_8: alignment=8, sw-addrmethod=VAR_NO_INIT
        CONST_64: alignment=64, sw-addrmethod=CONST
        VAR_NOCACHE_CLEARED_8: alignment=8, sw-addrmethod=VAR_NOCACHE_CLEARED
        VAR_NOCACHE_CLEARED_BOOLEAN: alignment=BOOLEAN, sw-addrmethod=VAR_NOCACHE_CLEARED
        VAR_NO_INIT_64: alignment=64, sw-addrmethod=VAR_NO_INIT
        VAR_NOCACHE_CLEARED_64: alignment=64, sw-addrmethod=VAR_NOCACHE_CLEARED
        VAR_FAST_INIT_32: alignment=32, sw-addrmethod=VAR_FAST_INIT
        VAR_NO_INIT_UNSPECIFIED: alignment=UNSPECIFIED, sw-addrmethod=VAR_NO_INIT
        VAR_NOCACHE_INIT_8: alignment=8, sw-addrmethod=VAR_NOCACHE_INIT
        CONST_UNSPECIFIED: alignment=UNSPECIFIED, sw-addrmethod=CONST
        VAR_NOCACHE_NO_INIT_32: alignment=32, sw-addrmethod=VAR_NOCACHE_NO_INIT
        VAR_FAST_CLEARED_64: alignment=64, sw-addrmethod=VAR_FAST_CLEARED
        VAR_FAST_NO_INIT_64: alignment=64, sw-addrmethod=VAR_FAST_NO_INIT
        VAR_INIT_8: alignment=8, sw-addrmethod=VAR_INIT
        VAR_CLEARED_64: alignment=64, sw-addrmethod=VAR_CLEARED
        VAR_NOCACHE_INIT_64: alignment=64, sw-addrmethod=VAR_NOCACHE_INIT
        VAR_NOCACHE_CLEARED_32: alignment=32, sw-addrmethod=VAR_NOCACHE_CLEARED
        VAR_CLEARED_BOOLEAN: alignment=BOOLEAN, sw-addrmethod=VAR_CLEARED
        VAR_NO_INIT_BOOLEAN: alignment=BOOLEAN, sw-addrmethod=VAR_NO_INIT
        VAR_NOCACHE_NO_INIT_64: alignment=64, sw-addrmethod=VAR_NOCACHE_NO_INIT
        VAR_FAST_CLEARED_32: alignment=32, sw-addrmethod=VAR_FAST_CLEARED
        VAR_NOCACHE_NO_INIT_UNSPECIFIED: alignment=UNSPECIFIED, sw-addrmethod=VAR_NOCACHE_NO_INIT
        VAR_INIT_64: alignment=64, sw-addrmethod=VAR_INIT
        VAR_INIT_UNSPECIFIED: alignment=UNSPECIFIED, sw-addrmethod=VAR_INIT
        CONST_8: alignment=8, sw-addrmethod=CONST
        VAR_FAST_NO_INIT_32: alignment=32, sw-addrmethod=VAR_FAST_NO_INIT
        VAR_NOCACHE_NO_INIT_BOOLEAN: alignment=BOOLEAN, sw-addrmethod=VAR_NOCACHE_NO_INIT
        VAR_FAST_INIT_UNSPECIFIED: alignment=UNSPECIFIED, sw-addrmethod=VAR_FAST_INIT
        VAR_FAST_NO_INIT_8: alignment=8, sw-addrmethod=VAR_FAST_NO_INIT
        VAR_FAST_NO_INIT_UNSPECIFIED: alignment=UNSPECIFIED, sw-addrmethod=VAR_FAST_NO_INIT
        VAR_FAST_INIT_BOOLEAN: alignment=BOOLEAN, sw-addrmethod=VAR_FAST_INIT
        VAR_FAST_INIT_16: alignment=16, sw-addrmethod=VAR_FAST_INIT
        VAR_NOCACHE_NO_INIT_8: alignment=8, sw-addrmethod=VAR_NOCACHE_NO_INIT
package /MICROSAR/Rtm_ib_bswmd/BswModuleDescriptions
  bsw module description Rtm: provided-entrys=Rtm_MainFunction
    bsw internal behavior RtmBehavior
      exclusive area RTM_EXCLUSIVE_AREA_{0..2}
      bsw schedulable entity Rtm_MainFunction: implemented-entry=Rtm_MainFunction
      bsw timing event Rtm_MainFunctionTimingEvent0: starts-on-event=Rtm_MainFunction, period=0.01
  bsw module entry Rtm_MainFunction: call-type=SCHEDULED, execution-context=TASK
package /MICROSAR/Rtm_ib_bswmd/SwAddrMethods
  sw addr method VAR_INIT_UNSPECIFIED_SAFE
