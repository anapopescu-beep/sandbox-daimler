AUTOSAR XML (schema 4-3-0)
package /MICROSAR/WdgM_ib_bswmd/BswModuleDescriptions
  bsw module description WdgM: provided-entrys=WdgM_MainFunction
    bsw internal behavior WdgMBehavior
      exclusive area WDGM_EXCLUSIVE_AREA_0
      bsw schedulable entity WdgM_MainFunction: implemented-entry=WdgM_MainFunction
      bsw timing event WdgM_MainFunctionTimingEvent0: starts-on-event=WdgM_MainFunction, period=0.003
  bsw module entry WdgM_MainFunction: call-type=SCHEDULED, execution-context=TASK
