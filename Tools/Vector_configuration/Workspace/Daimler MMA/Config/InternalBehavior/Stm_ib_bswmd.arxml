AUTOSAR XML (schema 4-3-0)
package /AURIX2G/EcucDefs/Stm_ib_bswmd/BswModuleDescriptions
  bsw module description Stm
    bsw internal behavior StmBehavior
