AUTOSAR XML (schema 00049)
package /MICROSAR
  bsw implementation StbM_Impl: programming-language=C, sw-version=9.05.01, used-code-generator=DaVinci Configurator, vendor-id=30, ar-release-version=4.07.00
    resource consumption ResourceConsumption
      182 x memory section:
        OsApplication_Trusted_Core0_VAR_NOCACHE_CLEARED_BOOLEAN: alignment=BOOLEAN, sw-addrmethod=OsApplication_Trusted_Core0_VAR_NOCACHE_CLEARED
        CommonSharedMemory_VAR_FAST_NO_INIT_64: alignment=64, sw-addrmethod=GLOBALSHARED_VAR_FAST_NO_INIT
        VAR_NOCACHE_CLEARED_UNSPECIFIED: alignment=UNSPECIFIED, sw-addrmethod=VAR_NOCACHE_CLEARED
        CommonSharedMemory_VAR_CLEARED_16: alignment=16, sw-addrmethod=GLOBALSHARED_VAR_CLEARED
        OsApplication_Trusted_Core0_VAR_NO_INIT_UNSPECIFIED: alignment=UNSPECIFIED, sw-addrmethod=OsApplication_Trusted_Core0_VAR_NO_INIT
        CommonSharedMemory_VAR_NOCACHE_NO_INIT_BOOLEAN: alignment=BOOLEAN, sw-addrmethod=GLOBALSHARED_VAR_NOCACHE_NO_INIT
        VAR_FAST_INIT_64: alignment=64, sw-addrmethod=VAR_FAST_INIT
        VAR_FAST_CLEARED_UNSPECIFIED: alignment=UNSPECIFIED, sw-addrmethod=VAR_FAST_CLEARED
        VAR_NOCACHE_CLEARED_16: alignment=16, sw-addrmethod=VAR_NOCACHE_CLEARED
        VAR_NO_INIT_16: alignment=16, sw-addrmethod=VAR_NO_INIT
        OsApplication_Trusted_Core0_VAR_FAST_CLEARED_BOOLEAN: alignment=BOOLEAN, sw-addrmethod=OsApplication_Trusted_Core0_VAR_FAST_CLEARED
        CommonSharedMemory_CONST_8: alignment=8, sw-addrmethod=GLOBALSHARED_CONST
        CONST_16: alignment=16, sw-addrmethod=CONST
        VAR_FAST_CLEARED_8: alignment=8, sw-addrmethod=VAR_FAST_CLEARED
        OsApplication_Trusted_Core0_VAR_NOCACHE_INIT_BOOLEAN: alignment=BOOLEAN, sw-addrmethod=OsApplication_Trusted_Core0_VAR_NOCACHE_INIT
        CommonSharedMemory_VAR_NO_INIT_16: alignment=16, sw-addrmethod=GLOBALSHARED_VAR_NO_INIT
        CommonSharedMemory_VAR_NOCACHE_INIT_16: alignment=16, sw-addrmethod=GLOBALSHARED_VAR_NOCACHE_INIT
        CommonSharedMemory_VAR_INIT_BOOLEAN: alignment=BOOLEAN, sw-addrmethod=GLOBALSHARED_VAR_INIT
        CODE: sw-addrmethod=CODE
        OsApplication_Trusted_Core0_VAR_NOCACHE_NO_INIT_UNSPECIFIED: alignment=UNSPECIFIED, sw-addrmethod=OsApplication_Trusted_Core0_VAR_NOCACHE_NO_INIT
        CommonSharedMemory_VAR_FAST_CLEARED_64: alignment=64, sw-addrmethod=GLOBALSHARED_VAR_FAST_CLEARED
        OsApplication_Trusted_Core0_VAR_NOCACHE_CLEARED_16: alignment=16, sw-addrmethod=OsApplication_Trusted_Core0_VAR_NOCACHE_CLEARED
        VAR_CLEARED_16: alignment=16, sw-addrmethod=VAR_CLEARED
        OsApplication_Trusted_Core0_CONST_BOOLEAN: alignment=BOOLEAN, sw-addrmethod=OsApplication_Trusted_Core0_CONST
        CommonSharedMemory_VAR_INIT_16: alignment=16, sw-addrmethod=GLOBALSHARED_VAR_INIT
        VAR_FAST_NO_INIT_16: alignment=16, sw-addrmethod=VAR_FAST_NO_INIT
        OsApplication_Trusted_Core0_VAR_CLEARED_64: alignment=64, sw-addrmethod=OsApplication_Trusted_Core0_VAR_CLEARED
        OsApplication_Trusted_Core0_CONST_32: alignment=32, sw-addrmethod=OsApplication_Trusted_Core0_CONST
        VAR_NOCACHE_INIT_32: alignment=32, sw-addrmethod=VAR_NOCACHE_INIT
        CommonSharedMemory_CONST_UNSPECIFIED: alignment=UNSPECIFIED, sw-addrmethod=GLOBALSHARED_CONST
        OsApplication_Trusted_Core0_VAR_FAST_CLEARED_8: alignment=8, sw-addrmethod=OsApplication_Trusted_Core0_VAR_FAST_CLEARED
        CommonSharedMemory_VAR_NO_INIT_BOOLEAN: alignment=BOOLEAN, sw-addrmethod=GLOBALSHARED_VAR_NO_INIT
        CommonSharedMemory_VAR_NOCACHE_NO_INIT_32: alignment=32, sw-addrmethod=GLOBALSHARED_VAR_NOCACHE_NO_INIT
        CommonSharedMemory_VAR_NO_INIT_UNSPECIFIED: alignment=UNSPECIFIED, sw-addrmethod=GLOBALSHARED_VAR_NO_INIT
        OsApplication_Trusted_Core0_VAR_FAST_CLEARED_UNSPECIFIED: alignment=UNSPECIFIED, sw-addrmethod=OsApplication_Trusted_Core0_VAR_FAST_CLEARED
        VAR_CLEARED_8: alignment=8, sw-addrmethod=VAR_CLEARED
        VAR_FAST_CLEARED_16: alignment=16, sw-addrmethod=VAR_FAST_CLEARED
        OsApplication_Trusted_Core0_VAR_FAST_INIT_32: alignment=32, sw-addrmethod=OsApplication_Trusted_Core0_VAR_FAST_INIT
        OsApplication_Trusted_Core0_VAR_NO_INIT_64: alignment=64, sw-addrmethod=OsApplication_Trusted_Core0_VAR_NO_INIT
        CONST_32: alignment=32, sw-addrmethod=CONST
        VAR_INIT_32: alignment=32, sw-addrmethod=VAR_INIT
        OsApplication_Trusted_Core0_VAR_NOCACHE_INIT_16: alignment=16, sw-addrmethod=OsApplication_Trusted_Core0_VAR_NOCACHE_INIT
        CommonSharedMemory_VAR_NOCACHE_CLEARED_64: alignment=64, sw-addrmethod=GLOBALSHARED_VAR_NOCACHE_CLEARED
        VAR_NO_INIT_32: alignment=32, sw-addrmethod=VAR_NO_INIT
        OsApplication_Trusted_Core0_CONST_64: alignment=64, sw-addrmethod=OsApplication_Trusted_Core0_CONST
        OsApplication_Trusted_Core0_VAR_INIT_UNSPECIFIED: alignment=UNSPECIFIED, sw-addrmethod=OsApplication_Trusted_Core0_VAR_INIT
        OsApplication_Trusted_Core0_VAR_CLEARED_32: alignment=32, sw-addrmethod=OsApplication_Trusted_Core0_VAR_CLEARED
        OsApplication_Trusted_Core0_VAR_FAST_NO_INIT_64: alignment=64, sw-addrmethod=OsApplication_Trusted_Core0_VAR_FAST_NO_INIT
        OsApplication_Trusted_Core0_VAR_NOCACHE_CLEARED_UNSPECIFIED: alignment=UNSPECIFIED, sw-addrmethod=OsApplication_Trusted_Core0_VAR_NOCACHE_CLEARED
        OsApplication_Trusted_Core0_VAR_NOCACHE_INIT_64: alignment=64, sw-addrmethod=OsApplication_Trusted_Core0_VAR_NOCACHE_INIT
        VAR_NOCACHE_INIT_BOOLEAN: alignment=BOOLEAN, sw-addrmethod=VAR_NOCACHE_INIT
        CommonSharedMemory_VAR_NOCACHE_NO_INIT_64: alignment=64, sw-addrmethod=GLOBALSHARED_VAR_NOCACHE_NO_INIT
        VAR_FAST_NO_INIT_BOOLEAN: alignment=BOOLEAN, sw-addrmethod=VAR_FAST_NO_INIT
        VAR_FAST_CLEARED_BOOLEAN: alignment=BOOLEAN, sw-addrmethod=VAR_FAST_CLEARED
        OsApplication_Trusted_Core0_VAR_NOCACHE_CLEARED_8: alignment=8, sw-addrmethod=OsApplication_Trusted_Core0_VAR_NOCACHE_CLEARED
        CommonSharedMemory_VAR_CLEARED_32: alignment=32, sw-addrmethod=GLOBALSHARED_VAR_CLEARED
        OsApplication_Trusted_Core0_VAR_CLEARED_8: alignment=8, sw-addrmethod=OsApplication_Trusted_Core0_VAR_CLEARED
        OsApplication_Trusted_Core0_VAR_NOCACHE_CLEARED_32: alignment=32, sw-addrmethod=OsApplication_Trusted_Core0_VAR_NOCACHE_CLEARED
        OsApplication_Trusted_Core0_VAR_NO_INIT_32: alignment=32, sw-addrmethod=OsApplication_Trusted_Core0_VAR_NO_INIT
        CommonSharedMemory_VAR_FAST_INIT_64: alignment=64, sw-addrmethod=GLOBALSHARED_VAR_FAST_INIT
        OsApplication_Trusted_Core0_VAR_CLEARED_BOOLEAN: alignment=BOOLEAN, sw-addrmethod=OsApplication_Trusted_Core0_VAR_CLEARED
        OsApplication_Trusted_Core0_VAR_NO_INIT_BOOLEAN: alignment=BOOLEAN, sw-addrmethod=OsApplication_Trusted_Core0_VAR_NO_INIT
        VAR_CLEARED_UNSPECIFIED: alignment=UNSPECIFIED, sw-addrmethod=VAR_CLEARED
        VAR_CLEARED_32: alignment=32, sw-addrmethod=VAR_CLEARED
        CommonSharedMemory_VAR_NOCACHE_CLEARED_32: alignment=32, sw-addrmethod=GLOBALSHARED_VAR_NOCACHE_CLEARED
        CommonSharedMemory_VAR_NO_INIT_32: alignment=32, sw-addrmethod=GLOBALSHARED_VAR_NO_INIT
        OsApplication_Trusted_Core0_VAR_NOCACHE_NO_INIT_64: alignment=64, sw-addrmethod=OsApplication_Trusted_Core0_VAR_NOCACHE_NO_INIT
        CommonSharedMemory_CONST_16: alignment=16, sw-addrmethod=GLOBALSHARED_CONST
        CommonSharedMemory_CONST_BOOLEAN: alignment=BOOLEAN, sw-addrmethod=GLOBALSHARED_CONST
        OsApplication_Trusted_Core0_VAR_INIT_32: alignment=32, sw-addrmethod=OsApplication_Trusted_Core0_VAR_INIT
        CommonSharedMemory_VAR_FAST_NO_INIT_UNSPECIFIED: alignment=UNSPECIFIED, sw-addrmethod=GLOBALSHARED_VAR_FAST_NO_INIT
        VAR_INIT_BOOLEAN: alignment=BOOLEAN, sw-addrmethod=VAR_INIT
        VAR_NOCACHE_INIT_UNSPECIFIED: alignment=UNSPECIFIED, sw-addrmethod=VAR_NOCACHE_INIT
        VAR_FAST_INIT_8: alignment=8, sw-addrmethod=VAR_FAST_INIT
        OsApplication_Trusted_Core0_VAR_NOCACHE_NO_INIT_8: alignment=8, sw-addrmethod=OsApplication_Trusted_Core0_VAR_NOCACHE_NO_INIT
        VAR_NOCACHE_INIT_16: alignment=16, sw-addrmethod=VAR_NOCACHE_INIT
        CommonSharedMemory_VAR_FAST_INIT_UNSPECIFIED: alignment=UNSPECIFIED, sw-addrmethod=GLOBALSHARED_VAR_FAST_INIT
        CONST_BOOLEAN: alignment=BOOLEAN, sw-addrmethod=CONST
        OsApplication_Trusted_Core0_VAR_FAST_CLEARED_64: alignment=64, sw-addrmethod=OsApplication_Trusted_Core0_VAR_FAST_CLEARED
        CommonSharedMemory_VAR_NOCACHE_NO_INIT_UNSPECIFIED: alignment=UNSPECIFIED, sw-addrmethod=GLOBALSHARED_VAR_NOCACHE_NO_INIT
        OsApplication_Trusted_Core0_VAR_CLEARED_UNSPECIFIED: alignment=UNSPECIFIED, sw-addrmethod=OsApplication_Trusted_Core0_VAR_CLEARED
        CommonSharedMemory_VAR_INIT_8: alignment=8, sw-addrmethod=GLOBALSHARED_VAR_INIT
        OsApplication_Trusted_Core0_VAR_FAST_INIT_16: alignment=16, sw-addrmethod=OsApplication_Trusted_Core0_VAR_FAST_INIT
        VAR_INIT_16: alignment=16, sw-addrmethod=VAR_INIT
        CommonSharedMemory_VAR_INIT_UNSPECIFIED: alignment=UNSPECIFIED, sw-addrmethod=GLOBALSHARED_VAR_INIT
        OsApplication_Trusted_Core0_VAR_NO_INIT_8: alignment=8, sw-addrmethod=OsApplication_Trusted_Core0_VAR_NO_INIT
        VAR_NOCACHE_NO_INIT_16: alignment=16, sw-addrmethod=VAR_NOCACHE_NO_INIT
        CommonSharedMemory_VAR_NOCACHE_NO_INIT_8: alignment=8, sw-addrmethod=GLOBALSHARED_VAR_NOCACHE_NO_INIT
        CommonSharedMemory_VAR_NO_INIT_8: alignment=8, sw-addrmethod=GLOBALSHARED_VAR_NO_INIT
        OsApplication_Trusted_Core0_VAR_FAST_NO_INIT_BOOLEAN: alignment=BOOLEAN, sw-addrmethod=OsApplication_Trusted_Core0_VAR_FAST_NO_INIT
        OsApplication_Trusted_Core0_VAR_NOCACHE_INIT_UNSPECIFIED: alignment=UNSPECIFIED, sw-addrmethod=OsApplication_Trusted_Core0_VAR_NOCACHE_INIT
        OsApplication_Trusted_Core0_VAR_NOCACHE_NO_INIT_BOOLEAN: alignment=BOOLEAN, sw-addrmethod=OsApplication_Trusted_Core0_VAR_NOCACHE_NO_INIT
        CommonSharedMemory_VAR_NOCACHE_CLEARED_BOOLEAN: alignment=BOOLEAN, sw-addrmethod=GLOBALSHARED_VAR_NOCACHE_CLEARED
        OsApplication_Trusted_Core0_VAR_CLEARED_16: alignment=16, sw-addrmethod=OsApplication_Trusted_Core0_VAR_CLEARED
        VAR_NO_INIT_8: alignment=8, sw-addrmethod=VAR_NO_INIT
        OsApplication_Trusted_Core0_VAR_FAST_INIT_64: alignment=64, sw-addrmethod=OsApplication_Trusted_Core0_VAR_FAST_INIT
        CommonSharedMemory_VAR_FAST_INIT_BOOLEAN: alignment=BOOLEAN, sw-addrmethod=GLOBALSHARED_VAR_FAST_INIT
        CommonSharedMemory_VAR_NOCACHE_CLEARED_16: alignment=16, sw-addrmethod=GLOBALSHARED_VAR_NOCACHE_CLEARED
        CommonSharedMemory_VAR_NOCACHE_CLEARED_8: alignment=8, sw-addrmethod=GLOBALSHARED_VAR_NOCACHE_CLEARED
        CommonSharedMemory_VAR_FAST_CLEARED_BOOLEAN: alignment=BOOLEAN, sw-addrmethod=GLOBALSHARED_VAR_FAST_CLEARED
        CONST_64: alignment=64, sw-addrmethod=CONST
        OsApplication_Trusted_Core0_VAR_NO_INIT_16: alignment=16, sw-addrmethod=OsApplication_Trusted_Core0_VAR_NO_INIT
        VAR_NOCACHE_CLEARED_8: alignment=8, sw-addrmethod=VAR_NOCACHE_CLEARED
        CommonSharedMemory_CONST_32: alignment=32, sw-addrmethod=GLOBALSHARED_CONST
        OsApplication_Trusted_Core0_VAR_FAST_CLEARED_16: alignment=16, sw-addrmethod=OsApplication_Trusted_Core0_VAR_FAST_CLEARED
        OsApplication_Trusted_Core0_CONST_8: alignment=8, sw-addrmethod=OsApplication_Trusted_Core0_CONST
        CommonSharedMemory_VAR_NOCACHE_INIT_BOOLEAN: alignment=BOOLEAN, sw-addrmethod=GLOBALSHARED_VAR_NOCACHE_INIT
        VAR_NOCACHE_CLEARED_BOOLEAN: alignment=BOOLEAN, sw-addrmethod=VAR_NOCACHE_CLEARED
        VAR_NO_INIT_64: alignment=64, sw-addrmethod=VAR_NO_INIT
        CommonSharedMemory_VAR_NOCACHE_INIT_8: alignment=8, sw-addrmethod=GLOBALSHARED_VAR_NOCACHE_INIT
        VAR_NOCACHE_CLEARED_64: alignment=64, sw-addrmethod=VAR_NOCACHE_CLEARED
        OsApplication_Trusted_Core0_VAR_FAST_INIT_BOOLEAN: alignment=BOOLEAN, sw-addrmethod=OsApplication_Trusted_Core0_VAR_FAST_INIT
        VAR_FAST_INIT_32: alignment=32, sw-addrmethod=VAR_FAST_INIT
        OsApplication_Trusted_Core0_VAR_FAST_NO_INIT_16: alignment=16, sw-addrmethod=OsApplication_Trusted_Core0_VAR_FAST_NO_INIT
        CommonSharedMemory_VAR_CLEARED_8: alignment=8, sw-addrmethod=GLOBALSHARED_VAR_CLEARED
        CommonSharedMemory_VAR_FAST_INIT_16: alignment=16, sw-addrmethod=GLOBALSHARED_VAR_FAST_INIT
        VAR_NO_INIT_UNSPECIFIED: alignment=UNSPECIFIED, sw-addrmethod=VAR_NO_INIT
        CommonSharedMemory_VAR_FAST_CLEARED_16: alignment=16, sw-addrmethod=GLOBALSHARED_VAR_FAST_CLEARED
        VAR_NOCACHE_INIT_8: alignment=8, sw-addrmethod=VAR_NOCACHE_INIT
        OsApplication_Trusted_Core0_VAR_NOCACHE_CLEARED_64: alignment=64, sw-addrmethod=OsApplication_Trusted_Core0_VAR_NOCACHE_CLEARED
        CommonSharedMemory_VAR_CLEARED_64: alignment=64, sw-addrmethod=GLOBALSHARED_VAR_CLEARED
        CONST_UNSPECIFIED: alignment=UNSPECIFIED, sw-addrmethod=CONST
        CommonSharedMemory_VAR_CLEARED_BOOLEAN: alignment=BOOLEAN, sw-addrmethod=GLOBALSHARED_VAR_CLEARED
        VAR_NOCACHE_NO_INIT_32: alignment=32, sw-addrmethod=VAR_NOCACHE_NO_INIT
        OsApplication_Trusted_Core0_VAR_INIT_8: alignment=8, sw-addrmethod=OsApplication_Trusted_Core0_VAR_INIT
        CommonSharedMemory_VAR_INIT_64: alignment=64, sw-addrmethod=GLOBALSHARED_VAR_INIT
        VAR_FAST_CLEARED_64: alignment=64, sw-addrmethod=VAR_FAST_CLEARED
        CommonSharedMemory_VAR_NOCACHE_INIT_64: alignment=64, sw-addrmethod=GLOBALSHARED_VAR_NOCACHE_INIT
        CommonSharedMemory_VAR_FAST_NO_INIT_16: alignment=16, sw-addrmethod=GLOBALSHARED_VAR_FAST_NO_INIT
        VAR_INIT_CONFIGPTR: sw-addrmethod=VAR_INIT
        VAR_FAST_NO_INIT_64: alignment=64, sw-addrmethod=VAR_FAST_NO_INIT
        VAR_INIT_8: alignment=8, sw-addrmethod=VAR_INIT
        OsApplication_Trusted_Core0_VAR_NOCACHE_NO_INIT_32: alignment=32, sw-addrmethod=OsApplication_Trusted_Core0_VAR_NOCACHE_NO_INIT
        CommonSharedMemory_VAR_FAST_INIT_8: alignment=8, sw-addrmethod=GLOBALSHARED_VAR_FAST_INIT
        VAR_CLEARED_64: alignment=64, sw-addrmethod=VAR_CLEARED
        OsApplication_Trusted_Core0_VAR_INIT_16: alignment=16, sw-addrmethod=OsApplication_Trusted_Core0_VAR_INIT
        OsApplication_Trusted_Core0_CONST_UNSPECIFIED: alignment=UNSPECIFIED, sw-addrmethod=OsApplication_Trusted_Core0_CONST
        CommonSharedMemory_VAR_NO_INIT_64: alignment=64, sw-addrmethod=GLOBALSHARED_VAR_NO_INIT
        VAR_NOCACHE_INIT_64: alignment=64, sw-addrmethod=VAR_NOCACHE_INIT
        VAR_NOCACHE_CLEARED_32: alignment=32, sw-addrmethod=VAR_NOCACHE_CLEARED
        OsApplication_Trusted_Core0_VAR_NOCACHE_INIT_8: alignment=8, sw-addrmethod=OsApplication_Trusted_Core0_VAR_NOCACHE_INIT
        OsApplication_Trusted_Core0_VAR_INIT_64: alignment=64, sw-addrmethod=OsApplication_Trusted_Core0_VAR_INIT
        VAR_CLEARED_BOOLEAN: alignment=BOOLEAN, sw-addrmethod=VAR_CLEARED
        OsApplication_Trusted_Core0_VAR_FAST_NO_INIT_8: alignment=8, sw-addrmethod=OsApplication_Trusted_Core0_VAR_FAST_NO_INIT
        VAR_NO_INIT_BOOLEAN: alignment=BOOLEAN, sw-addrmethod=VAR_NO_INIT
        OsApplication_Trusted_Core0_VAR_FAST_CLEARED_32: alignment=32, sw-addrmethod=OsApplication_Trusted_Core0_VAR_FAST_CLEARED
        VAR_NOCACHE_NO_INIT_64: alignment=64, sw-addrmethod=VAR_NOCACHE_NO_INIT
        VAR_FAST_CLEARED_32: alignment=32, sw-addrmethod=VAR_FAST_CLEARED
        VAR_NOCACHE_NO_INIT_UNSPECIFIED: alignment=UNSPECIFIED, sw-addrmethod=VAR_NOCACHE_NO_INIT
        CommonSharedMemory_VAR_INIT_32: alignment=32, sw-addrmethod=GLOBALSHARED_VAR_INIT
        VAR_INIT_64: alignment=64, sw-addrmethod=VAR_INIT
        CommonSharedMemory_VAR_NOCACHE_INIT_32: alignment=32, sw-addrmethod=GLOBALSHARED_VAR_NOCACHE_INIT
        CommonSharedMemory_VAR_FAST_CLEARED_8: alignment=8, sw-addrmethod=GLOBALSHARED_VAR_FAST_CLEARED
        VAR_INIT_UNSPECIFIED: alignment=UNSPECIFIED, sw-addrmethod=VAR_INIT
        CONST_8: alignment=8, sw-addrmethod=CONST
        OsApplication_Trusted_Core0_VAR_FAST_INIT_UNSPECIFIED: alignment=UNSPECIFIED, sw-addrmethod=OsApplication_Trusted_Core0_VAR_FAST_INIT
        VAR_FAST_NO_INIT_32: alignment=32, sw-addrmethod=VAR_FAST_NO_INIT
        VAR_NOCACHE_NO_INIT_BOOLEAN: alignment=BOOLEAN, sw-addrmethod=VAR_NOCACHE_NO_INIT
        CommonSharedMemory_VAR_FAST_CLEARED_UNSPECIFIED: alignment=UNSPECIFIED, sw-addrmethod=GLOBALSHARED_VAR_FAST_CLEARED
        CommonSharedMemory_VAR_NOCACHE_CLEARED_UNSPECIFIED: alignment=UNSPECIFIED, sw-addrmethod=GLOBALSHARED_VAR_NOCACHE_CLEARED
        OsApplication_Trusted_Core0_VAR_FAST_NO_INIT_32: alignment=32, sw-addrmethod=OsApplication_Trusted_Core0_VAR_FAST_NO_INIT
        CommonSharedMemory_VAR_NOCACHE_NO_INIT_16: alignment=16, sw-addrmethod=GLOBALSHARED_VAR_NOCACHE_NO_INIT
        VAR_FAST_INIT_UNSPECIFIED: alignment=UNSPECIFIED, sw-addrmethod=VAR_FAST_INIT
        OsApplication_Trusted_Core0_VAR_NOCACHE_INIT_32: alignment=32, sw-addrmethod=OsApplication_Trusted_Core0_VAR_NOCACHE_INIT
        OsApplication_Trusted_Core0_VAR_NOCACHE_NO_INIT_16: alignment=16, sw-addrmethod=OsApplication_Trusted_Core0_VAR_NOCACHE_NO_INIT
        CommonSharedMemory_VAR_FAST_NO_INIT_32: alignment=32, sw-addrmethod=GLOBALSHARED_VAR_FAST_NO_INIT
        VAR_FAST_NO_INIT_8: alignment=8, sw-addrmethod=VAR_FAST_NO_INIT
        CommonSharedMemory_VAR_FAST_NO_INIT_BOOLEAN: alignment=BOOLEAN, sw-addrmethod=GLOBALSHARED_VAR_FAST_NO_INIT
        VAR_FAST_NO_INIT_UNSPECIFIED: alignment=UNSPECIFIED, sw-addrmethod=VAR_FAST_NO_INIT
        VAR_FAST_INIT_BOOLEAN: alignment=BOOLEAN, sw-addrmethod=VAR_FAST_INIT
        OsApplication_Trusted_Core0_VAR_INIT_BOOLEAN: alignment=BOOLEAN, sw-addrmethod=OsApplication_Trusted_Core0_VAR_INIT
        OsApplication_Trusted_Core0_CONST_16: alignment=16, sw-addrmethod=OsApplication_Trusted_Core0_CONST
        VAR_FAST_INIT_16: alignment=16, sw-addrmethod=VAR_FAST_INIT
        VAR_NOCACHE_NO_INIT_8: alignment=8, sw-addrmethod=VAR_NOCACHE_NO_INIT
        CommonSharedMemory_VAR_FAST_INIT_32: alignment=32, sw-addrmethod=GLOBALSHARED_VAR_FAST_INIT
        CommonSharedMemory_VAR_FAST_CLEARED_32: alignment=32, sw-addrmethod=GLOBALSHARED_VAR_FAST_CLEARED
        CommonSharedMemory_CONST_64: alignment=64, sw-addrmethod=GLOBALSHARED_CONST
        OsApplication_Trusted_Core0_VAR_FAST_NO_INIT_UNSPECIFIED: alignment=UNSPECIFIED, sw-addrmethod=OsApplication_Trusted_Core0_VAR_FAST_NO_INIT
        CommonSharedMemory_VAR_NOCACHE_INIT_UNSPECIFIED: alignment=UNSPECIFIED, sw-addrmethod=GLOBALSHARED_VAR_NOCACHE_INIT
        OsApplication_Trusted_Core0_VAR_FAST_INIT_8: alignment=8, sw-addrmethod=OsApplication_Trusted_Core0_VAR_FAST_INIT
        CommonSharedMemory_VAR_CLEARED_UNSPECIFIED: alignment=UNSPECIFIED, sw-addrmethod=GLOBALSHARED_VAR_CLEARED
        CommonSharedMemory_VAR_FAST_NO_INIT_8: alignment=8, sw-addrmethod=GLOBALSHARED_VAR_FAST_NO_INIT
package /MICROSAR/StbM_ib_bswmd/BswModuleDescriptions
  bsw module description StbM: provided-entrys=StbM_MainFunction_OsApplication_Trusted_Core0
    bsw internal behavior StbMBehavior
      exclusive area STBM_EXCLUSIVE_AREA_0
      exclusive area STBM_EXCLUSIVE_AREA_1
      bsw schedulable entity StbM_MainFunction_OsApplication_Trusted_Core0: implemented-entry=StbM_MainFunction_OsApplication_Trusted_Core0
      bsw timing event StbM_MainFunction_OsApplication_Trusted_Core0TimingEvent0: starts-on-event=StbM_MainFunction_OsApplication_Trusted_Core0, period=0.005
  bsw module entry StbM_MainFunction_OsApplication_Trusted_Core0: call-type=SCHEDULED, execution-context=TASK
