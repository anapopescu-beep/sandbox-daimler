AUTOSAR XML (schema 00049)
package /MICROSAR
  bsw implementation DiagXf_Impl: programming-language=C, sw-version=1.16.00, used-code-generator=DaVinci Configurator, vendor-id=30, ar-release-version=4.03.01
