AUTOSAR XML (schema 4-3-0)
package /MICROSAR
  bsw implementation SecOC_Impl: programming-language=C, sw-version=12.00.01, used-code-generator=DaVinci Configurator, vendor-id=30, ar-release-version=4.03.00
    resource consumption ResourceConsumption
      122 x memory section:
        CRYPTO_DRV_ALIGNED_VAR_NOCACHE_INIT_32: alignment=32, sw-addrmethod=VAR_NOCACHE_INIT
        VAR_NOCACHE_CLEARED_UNSPECIFIED: alignment=UNSPECIFIED, sw-addrmethod=VAR_NOCACHE_CLEARED
        CRYPTO_DRV_ALIGNED_VAR_FAST_INIT_BOOLEAN: alignment=BOOLEAN, sw-addrmethod=VAR_FAST_INIT
        VAR_FAST_INIT_64: alignment=64, sw-addrmethod=VAR_FAST_INIT
        VAR_FAST_CLEARED_UNSPECIFIED: alignment=UNSPECIFIED, sw-addrmethod=VAR_FAST_CLEARED
        VAR_NOCACHE_CLEARED_16: alignment=16, sw-addrmethod=VAR_NOCACHE_CLEARED
        VAR_NO_INIT_16: alignment=16, sw-addrmethod=VAR_NO_INIT
        CRYPTO_DRV_ALIGNED_VAR_FAST_CLEARED_8: alignment=8, sw-addrmethod=VAR_FAST_CLEARED
        CRYPTO_DRV_ALIGNED_VAR_NOCACHE_NO_INIT_32: alignment=32, sw-addrmethod=VAR_NOCACHE_NO_INIT
        CONST_16: alignment=16, sw-addrmethod=CONST
        VAR_FAST_CLEARED_8: alignment=8, sw-addrmethod=VAR_FAST_CLEARED
        CRYPTO_DRV_ALIGNED_CONST_BOOLEAN: alignment=BOOLEAN, sw-addrmethod=CONST
        CODE: sw-addrmethod=CODE
        CRYPTO_DRV_ALIGNED_VAR_FAST_INIT_UNSPECIFIED: alignment=UNSPECIFIED, sw-addrmethod=VAR_FAST_INIT
        CRYPTO_DRV_ALIGNED_VAR_INIT_8: alignment=8, sw-addrmethod=VAR_INIT
        CRYPTO_DRV_ALIGNED_VAR_INIT_32: alignment=32, sw-addrmethod=VAR_INIT
        VAR_CLEARED_16: alignment=16, sw-addrmethod=VAR_CLEARED
        VAR_FAST_NO_INIT_16: alignment=16, sw-addrmethod=VAR_FAST_NO_INIT
        VAR_NOCACHE_INIT_32: alignment=32, sw-addrmethod=VAR_NOCACHE_INIT
        CRYPTO_DRV_ALIGNED_VAR_CLEARED_64: alignment=64, sw-addrmethod=VAR_CLEARED
        CRYPTO_DRV_ALIGNED_VAR_NOCACHE_INIT_BOOLEAN: alignment=BOOLEAN, sw-addrmethod=VAR_NOCACHE_INIT
        VAR_CLEARED_8: alignment=8, sw-addrmethod=VAR_CLEARED
        VAR_FAST_CLEARED_16: alignment=16, sw-addrmethod=VAR_FAST_CLEARED
        CRYPTO_DRV_ALIGNED_VAR_NO_INIT_BOOLEAN: alignment=BOOLEAN, sw-addrmethod=VAR_NO_INIT
        CRYPTO_DRV_ALIGNED_VAR_INIT_UNSPECIFIED: alignment=UNSPECIFIED, sw-addrmethod=VAR_INIT
        CONST_32: alignment=32, sw-addrmethod=CONST
        CRYPTO_DRV_ALIGNED_VAR_FAST_CLEARED_64: alignment=64, sw-addrmethod=VAR_FAST_CLEARED
        VAR_INIT_32: alignment=32, sw-addrmethod=VAR_INIT
        CRYPTO_DRV_ALIGNED_VAR_NO_INIT_64: alignment=64, sw-addrmethod=VAR_NO_INIT
        CRYPTO_DRV_ALIGNED_VAR_FAST_NO_INIT_64: alignment=64, sw-addrmethod=VAR_FAST_NO_INIT
        SecOC_CODE: prefix=SecOC, sw-addrmethod=CODE, symbol=CODE
        VAR_NO_INIT_32: alignment=32, sw-addrmethod=VAR_NO_INIT
        VAR_NOCACHE_INIT_BOOLEAN: alignment=BOOLEAN, sw-addrmethod=VAR_NOCACHE_INIT
        VAR_FAST_NO_INIT_BOOLEAN: alignment=BOOLEAN, sw-addrmethod=VAR_FAST_NO_INIT
        VAR_FAST_CLEARED_BOOLEAN: alignment=BOOLEAN, sw-addrmethod=VAR_FAST_CLEARED
        CRYPTO_DRV_ALIGNED_VAR_NOCACHE_NO_INIT_8: alignment=8, sw-addrmethod=VAR_NOCACHE_NO_INIT
        CRYPTO_DRV_ALIGNED_CONST_UNSPECIFIED: alignment=UNSPECIFIED, sw-addrmethod=CONST
        VAR_CLEARED_UNSPECIFIED: alignment=UNSPECIFIED, sw-addrmethod=VAR_CLEARED
        CRYPTO_DRV_ALIGNED_VAR_CLEARED_8: alignment=8, sw-addrmethod=VAR_CLEARED
        VAR_CLEARED_32: alignment=32, sw-addrmethod=VAR_CLEARED
        CRYPTO_DRV_ALIGNED_VAR_FAST_NO_INIT_8: alignment=8, sw-addrmethod=VAR_FAST_NO_INIT
        VAR_INIT_BOOLEAN: alignment=BOOLEAN, sw-addrmethod=VAR_INIT
        CRYPTO_DRV_ALIGNED_VAR_NOCACHE_INIT_UNSPECIFIED: alignment=UNSPECIFIED, sw-addrmethod=VAR_NOCACHE_INIT
        VAR_NOCACHE_INIT_UNSPECIFIED: alignment=UNSPECIFIED, sw-addrmethod=VAR_NOCACHE_INIT
        CRYPTO_DRV_ALIGNED_VAR_FAST_INIT_8: alignment=8, sw-addrmethod=VAR_FAST_INIT
        VAR_FAST_INIT_8: alignment=8, sw-addrmethod=VAR_FAST_INIT
        VAR_NOCACHE_INIT_16: alignment=16, sw-addrmethod=VAR_NOCACHE_INIT
        CRYPTO_DRV_ALIGNED_CONST_32: alignment=32, sw-addrmethod=CONST
        CONST_BOOLEAN: alignment=BOOLEAN, sw-addrmethod=CONST
        CRYPTO_DRV_ALIGNED_VAR_NOCACHE_CLEARED_32: alignment=32, sw-addrmethod=VAR_NOCACHE_CLEARED
        CRYPTO_DRV_ALIGNED_VAR_FAST_INIT_16: alignment=16, sw-addrmethod=VAR_FAST_INIT
        VAR_INIT_16: alignment=16, sw-addrmethod=VAR_INIT
        VAR_NOCACHE_NO_INIT_16: alignment=16, sw-addrmethod=VAR_NOCACHE_NO_INIT
        CRYPTO_DRV_ALIGNED_VAR_CLEARED_32: alignment=32, sw-addrmethod=VAR_CLEARED
        VAR_NO_INIT_8: alignment=8, sw-addrmethod=VAR_NO_INIT
        CRYPTO_DRV_ALIGNED_VAR_FAST_CLEARED_32: alignment=32, sw-addrmethod=VAR_FAST_CLEARED
        CONST_64: alignment=64, sw-addrmethod=CONST
        VAR_NOCACHE_CLEARED_8: alignment=8, sw-addrmethod=VAR_NOCACHE_CLEARED
        CRYPTO_DRV_ALIGNED_VAR_NO_INIT_32: alignment=32, sw-addrmethod=VAR_NO_INIT
        CRYPTO_DRV_ALIGNED_VAR_FAST_NO_INIT_32: alignment=32, sw-addrmethod=VAR_FAST_NO_INIT
        CRYPTO_DRV_ALIGNED_VAR_FAST_CLEARED_UNSPECIFIED: alignment=UNSPECIFIED, sw-addrmethod=VAR_FAST_CLEARED
        VAR_NOCACHE_CLEARED_BOOLEAN: alignment=BOOLEAN, sw-addrmethod=VAR_NOCACHE_CLEARED
        VAR_NO_INIT_64: alignment=64, sw-addrmethod=VAR_NO_INIT
        VAR_NOCACHE_CLEARED_64: alignment=64, sw-addrmethod=VAR_NOCACHE_CLEARED
        CRYPTO_DRV_ALIGNED_VAR_NOCACHE_INIT_64: alignment=64, sw-addrmethod=VAR_NOCACHE_INIT
        VAR_FAST_INIT_32: alignment=32, sw-addrmethod=VAR_FAST_INIT
        CRYPTO_DRV_ALIGNED_VAR_CLEARED_BOOLEAN: alignment=BOOLEAN, sw-addrmethod=VAR_CLEARED
        VAR_NO_INIT_UNSPECIFIED: alignment=UNSPECIFIED, sw-addrmethod=VAR_NO_INIT
        CRYPTO_DRV_ALIGNED_VAR_NOCACHE_INIT_8: alignment=8, sw-addrmethod=VAR_NOCACHE_INIT
        CRYPTO_DRV_ALIGNED_VAR_NOCACHE_NO_INIT_64: alignment=64, sw-addrmethod=VAR_NOCACHE_NO_INIT
        VAR_NOCACHE_INIT_8: alignment=8, sw-addrmethod=VAR_NOCACHE_INIT
        CONST_UNSPECIFIED: alignment=UNSPECIFIED, sw-addrmethod=CONST
        CRYPTO_DRV_ALIGNED_CONST_16: alignment=16, sw-addrmethod=CONST
        CRYPTO_DRV_ALIGNED_VAR_NO_INIT_UNSPECIFIED: alignment=UNSPECIFIED, sw-addrmethod=VAR_NO_INIT
        VAR_NOCACHE_NO_INIT_32: alignment=32, sw-addrmethod=VAR_NOCACHE_NO_INIT
        CRYPTO_DRV_ALIGNED_CONST_8: alignment=8, sw-addrmethod=CONST
        VAR_FAST_CLEARED_64: alignment=64, sw-addrmethod=VAR_FAST_CLEARED
        CRYPTO_DRV_ALIGNED_VAR_NO_INIT_8: alignment=8, sw-addrmethod=VAR_NO_INIT
        CRYPTO_DRV_ALIGNED_VAR_INIT_64: alignment=64, sw-addrmethod=VAR_INIT
        VAR_FAST_NO_INIT_64: alignment=64, sw-addrmethod=VAR_FAST_NO_INIT
        CRYPTO_DRV_ALIGNED_VAR_NOCACHE_CLEARED_16: alignment=16, sw-addrmethod=VAR_NOCACHE_CLEARED
        VAR_INIT_8: alignment=8, sw-addrmethod=VAR_INIT
        VAR_CLEARED_64: alignment=64, sw-addrmethod=VAR_CLEARED
        CRYPTO_DRV_ALIGNED_VAR_FAST_INIT_32: alignment=32, sw-addrmethod=VAR_FAST_INIT
        CRYPTO_DRV_ALIGNED_VAR_NOCACHE_CLEARED_UNSPECIFIED: alignment=UNSPECIFIED, sw-addrmethod=VAR_NOCACHE_CLEARED
        CRYPTO_DRV_ALIGNED_VAR_FAST_NO_INIT_16: alignment=16, sw-addrmethod=VAR_FAST_NO_INIT
        VAR_NOCACHE_INIT_64: alignment=64, sw-addrmethod=VAR_NOCACHE_INIT
        CRYPTO_DRV_ALIGNED_VAR_CLEARED_16: alignment=16, sw-addrmethod=VAR_CLEARED
        VAR_NOCACHE_CLEARED_32: alignment=32, sw-addrmethod=VAR_NOCACHE_CLEARED
        CRYPTO_DRV_ALIGNED_VAR_NOCACHE_NO_INIT_16: alignment=16, sw-addrmethod=VAR_NOCACHE_NO_INIT
        CRYPTO_DRV_ALIGNED_VAR_CLEARED_UNSPECIFIED: alignment=UNSPECIFIED, sw-addrmethod=VAR_CLEARED
        CRYPTO_DRV_ALIGNED_VAR_NOCACHE_INIT_16: alignment=16, sw-addrmethod=VAR_NOCACHE_INIT
        CRYPTO_DRV_ALIGNED_CONST_64: alignment=64, sw-addrmethod=CONST
        CRYPTO_DRV_ALIGNED_VAR_FAST_CLEARED_16: alignment=16, sw-addrmethod=VAR_FAST_CLEARED
        VAR_CLEARED_BOOLEAN: alignment=BOOLEAN, sw-addrmethod=VAR_CLEARED
        VAR_NO_INIT_BOOLEAN: alignment=BOOLEAN, sw-addrmethod=VAR_NO_INIT
        CRYPTO_DRV_ALIGNED_VAR_NOCACHE_CLEARED_64: alignment=64, sw-addrmethod=VAR_NOCACHE_CLEARED
        VAR_NOCACHE_NO_INIT_64: alignment=64, sw-addrmethod=VAR_NOCACHE_NO_INIT
        VAR_FAST_CLEARED_32: alignment=32, sw-addrmethod=VAR_FAST_CLEARED
        CRYPTO_DRV_ALIGNED_VAR_NO_INIT_16: alignment=16, sw-addrmethod=VAR_NO_INIT
        VAR_NOCACHE_NO_INIT_UNSPECIFIED: alignment=UNSPECIFIED, sw-addrmethod=VAR_NOCACHE_NO_INIT
        VAR_INIT_64: alignment=64, sw-addrmethod=VAR_INIT
        CRYPTO_DRV_ALIGNED_VAR_INIT_16: alignment=16, sw-addrmethod=VAR_INIT
        VAR_INIT_UNSPECIFIED: alignment=UNSPECIFIED, sw-addrmethod=VAR_INIT
        CONST_8: alignment=8, sw-addrmethod=CONST
        CRYPTO_DRV_ALIGNED_VAR_NOCACHE_CLEARED_8: alignment=8, sw-addrmethod=VAR_NOCACHE_CLEARED
        VAR_FAST_NO_INIT_32: alignment=32, sw-addrmethod=VAR_FAST_NO_INIT
        CRYPTO_DRV_ALIGNED_VAR_INIT_BOOLEAN: alignment=BOOLEAN, sw-addrmethod=VAR_INIT
        VAR_NOCACHE_NO_INIT_BOOLEAN: alignment=BOOLEAN, sw-addrmethod=VAR_NOCACHE_NO_INIT
        CRYPTO_DRV_ALIGNED_VAR_FAST_INIT_64: alignment=64, sw-addrmethod=VAR_FAST_INIT
        VAR_FAST_INIT_UNSPECIFIED: alignment=UNSPECIFIED, sw-addrmethod=VAR_FAST_INIT
        VAR_FAST_NO_INIT_8: alignment=8, sw-addrmethod=VAR_FAST_NO_INIT
        CRYPTO_DRV_ALIGNED_VAR_NOCACHE_NO_INIT_BOOLEAN: alignment=BOOLEAN, sw-addrmethod=VAR_NOCACHE_NO_INIT
        CRYPTO_DRV_ALIGNED_VAR_FAST_NO_INIT_BOOLEAN: alignment=BOOLEAN, sw-addrmethod=VAR_FAST_NO_INIT
        VAR_FAST_NO_INIT_UNSPECIFIED: alignment=UNSPECIFIED, sw-addrmethod=VAR_FAST_NO_INIT
        CRYPTO_DRV_ALIGNED_VAR_NOCACHE_NO_INIT_UNSPECIFIED: alignment=UNSPECIFIED, sw-addrmethod=VAR_NOCACHE_NO_INIT
        VAR_FAST_INIT_BOOLEAN: alignment=BOOLEAN, sw-addrmethod=VAR_FAST_INIT
        CRYPTO_DRV_ALIGNED_VAR_FAST_NO_INIT_UNSPECIFIED: alignment=UNSPECIFIED, sw-addrmethod=VAR_FAST_NO_INIT
        VAR_FAST_INIT_16: alignment=16, sw-addrmethod=VAR_FAST_INIT
        VAR_NOCACHE_NO_INIT_8: alignment=8, sw-addrmethod=VAR_NOCACHE_NO_INIT
        CRYPTO_DRV_ALIGNED_VAR_FAST_CLEARED_BOOLEAN: alignment=BOOLEAN, sw-addrmethod=VAR_FAST_CLEARED
        CRYPTO_DRV_ALIGNED_VAR_NOCACHE_CLEARED_BOOLEAN: alignment=BOOLEAN, sw-addrmethod=VAR_NOCACHE_CLEARED
      section name prefix SecOC
package /MICROSAR/SecOC_ib_bswmd/BswModuleDescriptions
  bsw module description SecOC: provided-entrys=[SecOC_MainFunctionRx, SecOC_MainFunctionTx]
    bsw internal behavior SecOCBehavior
      exclusive area SECOC_EXCLUSIVE_AREA_RXSTATE
      exclusive area SECOC_EXCLUSIVE_AREA_TXSTATE
      bsw schedulable entity SecOC_MainFunctionRx: implemented-entry=SecOC_MainFunctionRx
      bsw schedulable entity SecOC_MainFunctionTx: implemented-entry=SecOC_MainFunctionTx
      bsw timing event SecOC_MainFunctionRxTimingEvent0: starts-on-event=SecOC_MainFunctionRx, period=0.005
      bsw timing event SecOC_MainFunctionTxTimingEvent0: starts-on-event=SecOC_MainFunctionTx, period=0.005
  bsw module entry SecOC_MainFunctionRx: call-type=SCHEDULED, execution-context=TASK
  bsw module entry SecOC_MainFunctionTx: call-type=SCHEDULED, execution-context=TASK
