AUTOSAR XML (schema 00046)
package /AURIX2G/EcucDefs/Gpt_ib_bswmd/BswModuleDescriptions
  bsw module description Gpt
    bsw internal behavior GptBehavior
      4 x exclusive area:
        Get1UsPredefTimerValue
        Get100UsPredefTimerValue
        GtmStartTimer
        Gpt12StartTimer
