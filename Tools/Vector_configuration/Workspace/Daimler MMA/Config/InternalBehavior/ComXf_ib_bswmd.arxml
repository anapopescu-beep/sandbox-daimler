AUTOSAR XML (schema 00049)
package /MICROSAR
  bsw implementation ComXf_Impl: programming-language=C, sw-version=1.18.00, used-code-generator=DaVinci Configurator, vendor-id=30, ar-release-version=4.03.01
    resource consumption ResourceConsumption
      memory section CODE: sw-addrmethod=CODE
package /MICROSAR/ComXf_ib_bswmd/BswModuleDescriptions
  bsw module description ComXf
    bsw internal behavior ComXfBehavior
