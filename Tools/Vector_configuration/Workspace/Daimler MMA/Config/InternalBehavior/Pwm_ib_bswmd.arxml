AUTOSAR XML (schema 00046)
package /AURIX2G/EcucDefs/Pwm_ib_bswmd/BswModuleDescriptions
  bsw module description Pwm
    bsw internal behavior PwmBehavior
      exclusive area HandleNotification
      exclusive area PeriodAndDutyUpdate
