AUTOSAR XML (schema 00046)
package /MICROSAR/KeyM_ib_bswmd/BswModuleDescriptions
  bsw module description KeyM: provided-entrys=[KeyM_MainFunction, KeyM_MainBackgroundFunction]
    bsw internal behavior Behavior
      exclusive area KEYM_EXCLUSIVE_AREA_0  # This critical section protects workspace locking resources and global RAM variables. Therefore the critical section enclosed with KEYM_EXCLUSIVE_AREA_0 should never be interrupted by any other API. For more details, see DocTechRef or module header (KeyM.h).
      exclusive area KEYM_EXCLUSIVE_AREA_1  # This critical section protects write accesses to Certificates, e.g. its copy operation, and its NvM Handling. Therefore the critical section enclosed with KEYM_EXCLUSIVE_AREA_1 should never be interrupted by any other KeyM API bringing in new certificate data or NvM callbacks. For more details, see DocTechRef or module header (KeyM.h).
      bsw schedulable entity KeyM_MainFunction: implemented-entry=KeyM_MainFunction
      bsw schedulable entity KeyM_MainBackgroundFunction: implemented-entry=KeyM_MainBackgroundFunction
      bsw timing event KeyM_MainFunctionTimingEvent0: starts-on-event=KeyM_MainFunction, period=0.01
      bsw background event KeyM_MainBackgroundFunctionBackgroundEvent0: starts-on-event=KeyM_MainBackgroundFunction
  bsw module entry KeyM_MainFunction: call-type=SCHEDULED, execution-context=TASK
  bsw module entry KeyM_MainBackgroundFunction: call-type=SCHEDULED, execution-context=TASK
