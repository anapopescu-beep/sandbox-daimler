AUTOSAR XML (schema 4-3-0)
package /MICROSAR
  bsw implementation Rte_Impl: programming-language=C, sw-version=4.32.00, used-code-generator=DaVinci Configurator, vendor-id=30, ar-release-version=4.03.01
    resource consumption ResourceConsumption
      81 x memory section:
        CODE: sw-addrmethod=CODE
        VAR_NOINIT_UNSPECIFIED: sw-addrmethod=VAR_NO_INIT
        VAR_ZERO_INIT_UNSPECIFIED: sw-addrmethod=VAR_CLEARED
        VAR_ZERO_INIT_8BIT: sw-addrmethod=VAR_CLEARED
        VAR_INIT_UNSPECIFIED: sw-addrmethod=VAR_INIT
        CONST_UNSPECIFIED: sw-addrmethod=CONST
        APPL_CODE: sw-addrmethod=CODE
        ADCIF_APPL_CODE: sw-addrmethod=CODE
        BASEFUNCTION_APPL_CODE: sw-addrmethod=CODE
        BELTADJFUNCTION_APPL_CODE: sw-addrmethod=CODE
        BELTTENSIONERFUNCTION_APPL_CODE: sw-addrmethod=CODE
        BFE_AC_BELTFUNCTIONEXECUTION_APPL_CODE: sw-addrmethod=CODE
        BFS_AC_BELTFUNCTIONSELECTION_APPL_CODE: sw-addrmethod=CODE
        BSWM_APPL_CODE: sw-addrmethod=CODE
        CDD_MBBL_ECUSTATHANDLER_APPL_CODE: sw-addrmethod=CODE
        CDD_MBBL_RESETEXECUTOR_APPL_CODE: sw-addrmethod=CODE
        CIL_AC_COMMUNICATIONINTERACTIONLAYER_APPL_CODE: sw-addrmethod=CODE
        COMM_APPL_CODE: sw-addrmethod=CODE
        CSM_APPL_CODE: sw-addrmethod=CODE
        CT_MBBL_RESETMANAGER_APPL_CODE: sw-addrmethod=CODE
        CT_MBBL_RESETPRECONDITIONCHECKER_APPL_CODE: sw-addrmethod=CODE
        CT_MBBL_SSAAPPL_CODING_APPL_CODE: sw-addrmethod=CODE
        CT_MBBL_SSAAPPL_GENERAL_APPL_CODE: sw-addrmethod=CODE
        CT_MBBL_SSAAPPL_PROJECTSPECIFIC_APPL_CODE: sw-addrmethod=CODE
        CT_MBBL_SSAAPPL_TRUSTMODEL_APPL_CODE: sw-addrmethod=CODE
        CT_PROJECTINFORMATION_APPL_CODE: sw-addrmethod=CODE
        DCM_APPL_CODE: sw-addrmethod=CODE
        DEMMASTER_0_APPL_CODE: sw-addrmethod=CODE
        DEMSATELLITE_0_APPL_CODE: sw-addrmethod=CODE
        DET_APPL_CODE: sw-addrmethod=CODE
        DIAGFUNCTION_APPL_CODE: sw-addrmethod=CODE
        DIA_AC_DIAGONCAN_APPL_CODE: sw-addrmethod=CODE
        ECUM_APPL_CODE: sw-addrmethod=CODE
        KEYM_APPL_CODE: sw-addrmethod=CODE
        MMG_AC_MODEMANAGEMENT_APPL_CODE: sw-addrmethod=CODE
        NVM_APPL_CODE: sw-addrmethod=CODE
        OS_OSCORE0_SWC_APPL_CODE: sw-addrmethod=CODE
        PAL_AC_POWERABSTRACTIONLAYER_APPL_CODE: sw-addrmethod=CODE
        PMP_AC_PHYSICALMEASURESPROVIDER_APPL_CODE: sw-addrmethod=CODE
        PRE_AC_PRETENSIONING_APPL_CODE: sw-addrmethod=CODE
        PWMIF_APPL_CODE: sw-addrmethod=CODE
        SBC_APPL_CODE: sw-addrmethod=CODE
        SECOC_APPL_CODE: sw-addrmethod=CODE
        SFR_AC_STANDARDFUNCTIONRECOVERY_APPL_CODE: sw-addrmethod=CODE
        SSA_BCTP_APPL_CODE: sw-addrmethod=CODE
        SSA_CDD_APPL_CODE: sw-addrmethod=CODE
        SSA_CERTP_APPL_CODE: sw-addrmethod=CODE
        SSA_CODING_APPL_CODE: sw-addrmethod=CODE
        SSA_FVM_APPL_CODE: sw-addrmethod=CODE
        SSA_KEYM_APPL_CODE: sw-addrmethod=CODE
        SSA_PROCCTRL_APPL_CODE: sw-addrmethod=CODE
        SSA_RIGHTSM_APPL_CODE: sw-addrmethod=CODE
        SSA_SECLOG_APPL_CODE: sw-addrmethod=CODE
        SSA_TIMEM_APPL_CODE: sw-addrmethod=CODE
        WDGM_APPL_CODE: sw-addrmethod=CODE
        CONST_DEFAULT_RTE_CALPRM_GROUP_UNSPECIFIED: sw-addrmethod=CONST
        CONST_DEFAULT_RTE_CDATA_GROUP_UNSPECIFIED: sw-addrmethod=CONST
        VAR_DEFAULT_RTE_PIM_GROUP_UNSPECIFIED: sw-addrmethod=VAR_NO_INIT
        BSR_AC_BELTSLACKREDUCTION_APPL_CODE: sw-addrmethod=CODE
        EOL_AC_ENDOFLIFEMANAGEMENT_APPL_CODE: sw-addrmethod=CODE
        HWA_AC_HAPTICWARNING_APPL_CODE: sw-addrmethod=CODE
        RCM_AC_RESETCAUSEMANAGEMENT_APPL_CODE: sw-addrmethod=CODE
        ATM_AC_AUTOTESTMANAGER_APPL_CODE: sw-addrmethod=CODE
        ERH_AC_ERRORHANDLER_APPL_CODE: sw-addrmethod=CODE
        PRO_AC_PRODUCTIONCYCLES_APPL_CODE: sw-addrmethod=CODE
        BMM_AC_BELTMOVEMENTMONITORING_APPL_CODE: sw-addrmethod=CODE
        APPLBACKGROUNDTASK_CORE0_CODE: sw-addrmethod=CODE
        APPLINITTASK_CORE0_CODE: sw-addrmethod=CODE
        APPLTASK_CORE0_HIGHPRIO_CODE: sw-addrmethod=CODE
        APPLTASK_CORE0_LOWPRIO_CODE: sw-addrmethod=CODE
        BACKGROUNDTASK_CORE0_CODE: sw-addrmethod=CODE
        BSWTASK_CORE0_HIGHPRIO_CODE: sw-addrmethod=CODE
        BSWTASK_CORE0_LOWPRIO_CODE: sw-addrmethod=CODE
        DEFAULT_INIT_TASK_CODE: sw-addrmethod=CODE
        DEFAULT_INIT_TASK_TRUSTED_CODE: sw-addrmethod=CODE
        IDLETASK_OSCORE0_CODE: sw-addrmethod=CODE
        OSTASK_ALV_BELTFUNCTIONALGO_CODE: sw-addrmethod=CODE
        STBM_OSAPPLICATION_TRUSTED_CORE0_APPL_CODE: sw-addrmethod=CODE
        STBM_SYSTEMAPPLICATION_OSCORE0_APPL_CODE: sw-addrmethod=CODE
        CT_RESOURCEMEASUREMENT_APPL_CODE: sw-addrmethod=CODE
        SCM_AC_SYSTEMCONTEXTMANAGEMENT_APPL_CODE: sw-addrmethod=CODE
package /MICROSAR/Rte_ib_bswmd/BswModuleDescriptions
  bsw module description Rte: provided-entrys=Rte_ComSendSignalProxyPeriodic
    bsw internal behavior RteBehavior
      bsw schedulable entity Rte_ComSendSignalProxyPeriodic: implemented-entry=Rte_ComSendSignalProxyPeriodic
      bsw timing event Rte_ComSendSignalProxyPeriodicTimingEvent0: starts-on-event=Rte_ComSendSignalProxyPeriodic, period=0.005
  bsw module entry Rte_ComSendSignalProxyPeriodic: call-type=SCHEDULED, execution-context=TASK
