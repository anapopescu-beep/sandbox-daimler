AUTOSAR XML (schema 4-3-0)
package /MICROSAR
  bsw implementation E2EXf_Impl: programming-language=C, sw-version=4.32.00, used-code-generator=DaVinci Configurator, vendor-id=30, ar-release-version=4.03.01
    resource consumption ResourceConsumption
      7 x memory section:
        CODE: sw-addrmethod=CODE
        CONST_UNSPECIFIED: sw-addrmethod=CONST
        VAR_INIT_UNSPECIFIED: sw-addrmethod=VAR_INIT
        VAR_NOINIT_UNSPECIFIED: sw-addrmethod=VAR_NO_INIT
        VAR_ZERO_INIT_8BIT: sw-addrmethod=VAR_CLEARED
        VAR_NOCACHE_ZERO_INIT_8BIT: sw-addrmethod=VAR_CLEARED
        VAR_ZERO_INIT_UNSPECIFIED: sw-addrmethod=VAR_CLEARED
package /MICROSAR/E2EXf_ib_bswmd/BswModuleDescriptions
  bsw module description E2EXf
    bsw internal behavior E2EXfBehavior
