AUTOSAR XML (schema 4-3-0)
package /MICROSAR
  bsw implementation CanTp_Impl: programming-language=C, sw-version=4.00.00, used-code-generator=DaVinci Configurator, vendor-id=30, ar-release-version=4.00.03
package /MICROSAR/CanTp_ib_bswmd/BswModuleDescriptions
  bsw module description CanTp: provided-entrys=[CanTp_MainFunctionRx, CanTp_MainFunctionTx]
    bsw internal behavior CanTpBehavior
      exclusive area CANTP_EXCLUSIVE_AREA_0
      bsw schedulable entity CanTp_MainFunctionRx: implemented-entry=CanTp_MainFunctionRx
      bsw schedulable entity CanTp_MainFunctionTx: implemented-entry=CanTp_MainFunctionTx
      bsw timing event CanTp_MainFunctionRxTimingEvent0: starts-on-event=CanTp_MainFunctionRx, period=0.01
      bsw timing event CanTp_MainFunctionTxTimingEvent0: starts-on-event=CanTp_MainFunctionTx, period=0.01
  bsw module entry CanTp_MainFunctionRx: call-type=SCHEDULED, execution-context=TASK
  bsw module entry CanTp_MainFunctionTx: call-type=SCHEDULED, execution-context=TASK
