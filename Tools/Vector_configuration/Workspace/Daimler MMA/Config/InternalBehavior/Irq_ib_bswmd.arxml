AUTOSAR XML (schema 4-3-0)
package /AURIX2G/EcucDefs/Irq_ib_bswmd/BswModuleDescriptions
  bsw module description Irq
    bsw internal behavior IrqBehavior
