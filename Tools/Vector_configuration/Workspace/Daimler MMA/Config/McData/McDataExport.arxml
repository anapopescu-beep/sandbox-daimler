AUTOSAR XML (schema 4-3-1)
package /MICROSAR
  12 x bsw implementation, all with programming-language=C, vendor-id=30:
    BswM_Impl: sw-version=14.00.00, used-code-generator=DaVinci Configurator, ar-release-version=4.00.03, behavior=BswMBehavior
    CanIf_Impl: sw-version=8.01.00, used-code-generator=cMSR, ar-release-version=4.00.03, behavior=CanIf_Behavior
    CanNm_Impl: sw-version=10.00.00, used-code-generator=DaVinci Configurator, ar-release-version=4.00.03, behavior=CanNmBehavior
    CanSM_Impl: sw-version=4.00.00, used-code-generator=DaVinci Configurator, ar-release-version=4.00.03, behavior=CanSMBehavior
    CanTp_Impl: sw-version=4.00.00, used-code-generator=DaVinci Configurator, ar-release-version=4.00.03, behavior=CanTpBehavior
    Com_Impl: sw-version=21.02.00, used-code-generator=DaVinci Configurator, ar-release-version=4.00.03, behavior=ComBehavior
    ComM_Impl: sw-version=13.00.01, used-code-generator=DaVinci Configurator, ar-release-version=4.00.03, behavior=ComMBehavior
    EcuM_Impl: sw-version=11.00.01, used-code-generator=DaVinci Configurator, ar-release-version=4.00.03, behavior=EcuMBehavior
    IpduM_Impl: sw-version=10.00.02, used-code-generator=DaVinci Configurator, ar-release-version=4.03.01, behavior=IpduMBehavior
    Nm_Impl: sw-version=13.00.00, used-code-generator=DaVinci Configurator, ar-release-version=4.00.03, behavior=NmBehavior
    NvM_Impl: sw-version=8.01.00, used-code-generator=DaVinci Configurator, ar-release-version=4.00.03, behavior=NvMBehavior
    PduR_Impl: sw-version=16.02.00, used-code-generator=DaVinci Configurator, ar-release-version=4.01.02, behavior=PduRBehavior
package /MICROSAR/BswM_ib_bswmd/BswModuleDescriptions
  bsw module description BswM
    bsw internal behavior BswMBehavior
      exclusive area BSWM_EXCLUSIVE_AREA_0
      bsw schedulable entity BswM_MainFunction: implemented-entry=BswM_MainFunction
      bsw timing event BswM_MainFunctionTimingEvent0: starts-on-event=BswM_MainFunction, period=0.005
  bsw module entry BswM_MainFunction: call-type=SCHEDULED, execution-context=TASK
package /MICROSAR/CanIf_ib_bswmd/BswModuleDescriptions
  bsw module description CanIf
    bsw internal behavior CanIf_Behavior
      8 x exclusive area:
        CANIF_EXCLUSIVE_AREA_{0..7}
package /MICROSAR/CanNm_ib_bswmd/BswModuleDescriptions
  bsw module description CanNm
    bsw internal behavior CanNmBehavior
      7 x exclusive area:
        CANNM_EXCLUSIVE_AREA_0  # No interruption by any interrupt allowed (i.e. global interrupt locks).
        CANNM_EXCLUSIVE_AREA_1  # No interruption of CanNm_MainFunction or CanNm_RequestBusSynchronization by CanNm_SetUserData or CanNm_SetSleepReadyBit allowed.
        CANNM_EXCLUSIVE_AREA_2  # No interruption of CanNm_SetUserData by CanNm_MainFunction or CanNm_RequestBusSynchronization allowed.
        CANNM_EXCLUSIVE_AREA_3  # No interruption of CanNm_SetSleepReadyBit by CanNm_MainFunction or CanNm_RequestBusSynchronization allowed.
        CANNM_EXCLUSIVE_AREA_4  # No interruption of CanNm_RxIndication by CanNm_GetUserData or CanNm_GetPduData allowed.
        CANNM_EXCLUSIVE_AREA_5  # No interruption of CanNm_GetUserData or CanNm_GetPduData by CanNm_RxIndication allowed.
        CANNM_EXCLUSIVE_AREA_6  # No interruption of CanNm_MainFunction by CanNm_RequestBusSynchronization allowed. Note: This critical section can be left empty when CanNm_MainFunction and Nm_MainFunction have the same task.
      bsw schedulable entity CanNm_MainFunction: implemented-entry=CanNm_MainFunction
      bsw timing event CanNm_MainFunctionTimingEvent0: starts-on-event=CanNm_MainFunction, period=0.01
  bsw module entry CanNm_MainFunction: call-type=SCHEDULED, execution-context=TASK
package /MICROSAR/CanSM_ib_bswmd/BswModuleDescriptions
  bsw module description CanSM
    bsw internal behavior CanSMBehavior
      6 x exclusive area:
        CANSM_EXCLUSIVE_AREA_{1..6}
      bsw schedulable entity CanSM_MainFunction: implemented-entry=CanSM_MainFunction
      bsw timing event CanSM_MainFunctionTimingEvent0: starts-on-event=CanSM_MainFunction, period=0.01
  bsw module entry CanSM_MainFunction: call-type=SCHEDULED, execution-context=TASK
package /MICROSAR/CanTp_ib_bswmd/BswModuleDescriptions
  bsw module description CanTp
    bsw internal behavior CanTpBehavior
      exclusive area CANTP_EXCLUSIVE_AREA_0
      bsw schedulable entity CanTp_MainFunctionRx: implemented-entry=CanTp_MainFunctionRx
      bsw schedulable entity CanTp_MainFunctionTx: implemented-entry=CanTp_MainFunctionTx
      bsw timing event CanTp_MainFunctionRxTimingEvent0: starts-on-event=CanTp_MainFunctionRx, period=0.01
      bsw timing event CanTp_MainFunctionTxTimingEvent0: starts-on-event=CanTp_MainFunctionTx, period=0.01
  bsw module entry CanTp_MainFunctionRx: call-type=SCHEDULED, execution-context=TASK
  bsw module entry CanTp_MainFunctionTx: call-type=SCHEDULED, execution-context=TASK
package /MICROSAR/ComM_ib_bswmd/BswModuleDescriptions
  bsw module description ComM
    bsw internal behavior ComMBehavior
      exclusive area COMM_EXCLUSIVE_AREA_0
      exclusive area COMM_EXCLUSIVE_AREA_1
      bsw schedulable entity ComM_MainFunction_0: implemented-entry=ComM_MainFunction_0
      bsw timing event ComM_MainFunction_0TimingEvent0: starts-on-event=ComM_MainFunction_0, period=0.005
  bsw module entry ComM_MainFunction_0: call-type=SCHEDULED, execution-context=TASK
package /MICROSAR/Com_ib_bswmd/BswModuleDescriptions
  bsw module description Com
    bsw internal behavior ComBehavior
      exclusive area COM_EXCLUSIVE_AREA_TX  # This critical section protects Tx ressources that can be accessed from various contexts. Therefore the critical section enclosed with COM_EXCLUSIVE_AREA_TX should never be interrupted by any Com API which accesses Tx ressources. For more details, see DocTechRef.
      exclusive area COM_EXCLUSIVE_AREA_RX  # This critical section protects Rx ressources that can be accessed from various contexts.Therefore the critical section enclosed with COM_EXCLUSIVE_AREA_RX should never be interrupted by any Com API which accesses Rx ressources. For more details, see DocTechRef.
      exclusive area COM_EXCLUSIVE_AREA_BOTH  # This critical section protects Rx and Tx ressources that are being accessed in context of Com_MainFunctionRouteSignals for signal gateway routings or description routings with configured deferred description source. For more details, see DocTechRef.
      bsw schedulable entity Com_MainFunctionTx: implemented-entry=Com_MainFunctionTx
      bsw schedulable entity Com_MainFunctionRx: implemented-entry=Com_MainFunctionRx
      bsw timing event Com_MainFunctionTxTimingEvent0: starts-on-event=Com_MainFunctionTx, period=0.005
      bsw timing event Com_MainFunctionRxTimingEvent0: starts-on-event=Com_MainFunctionRx, period=0.005
  bsw module entry Com_MainFunctionTx: call-type=SCHEDULED, execution-context=TASK
  bsw module entry Com_MainFunctionRx: call-type=SCHEDULED, execution-context=TASK
package /MICROSAR/EcuM_ib_bswmd/BswModuleDescriptions
  bsw module description EcuM
    bsw internal behavior EcuMBehavior
      4 x exclusive area:
        ECUM_EXCLUSIVE_AREA_0  # This exclusive area shall disable all wake up interrupts to prevent overwriting of some global variables.
        ECUM_EXCLUSIVE_AREA_1  # This exclusive area is only used in case of multi core and if the the EcuM is configured to handle also the slave cores. It must be configured as a spinlock to allow access to some variables simultaneously from multiple cores.
        ECUM_EXCLUSIVE_AREA_2  # This exclusive area is used for accessing the clock variable. It shall disable GPT interrupts and task changes. Only necessary if 32 Bit access is not atomic and Alarm Clock is present.
        ECUM_EXCLUSIVE_AREA_3  # This This exclusive area must be configured as a spin lock to protect access on global shutdown target variables.
      bsw schedulable entity EcuM_MainFunction: implemented-entry=EcuM_MainFunction
      bsw timing event EcuM_MainFunctionTimingEvent0: starts-on-event=EcuM_MainFunction, period=0.005
  bsw module entry EcuM_MainFunction: call-type=SCHEDULED, execution-context=TASK
package /MICROSAR/IpduM_ib_bswmd/BswModuleDescriptions
  bsw module description IpduM
    bsw internal behavior IpduMBehavior
      exclusive area IPDUM_EXCLUSIVE_AREA_0  # Set SchMExclusiveAreaImplementation to AUTO to lock all interrupts.
      bsw schedulable entity IpduM_MainFunctionRx: implemented-entry=IpduM_MainFunctionRx
      bsw schedulable entity IpduM_MainFunctionTx: implemented-entry=IpduM_MainFunctionTx
      bsw timing event IpduM_MainFunctionRxTimingEvent0: starts-on-event=IpduM_MainFunctionRx, period=0.005
      bsw timing event IpduM_MainFunctionTxTimingEvent0: starts-on-event=IpduM_MainFunctionTx, period=0.005
  bsw module entry IpduM_MainFunctionRx: call-type=SCHEDULED, execution-context=TASK
  bsw module entry IpduM_MainFunctionTx: call-type=SCHEDULED, execution-context=TASK
package /MICROSAR/Nm_ib_bswmd/BswModuleDescriptions
  bsw module description Nm
    bsw internal behavior NmBehavior
      exclusive area NM_EXCLUSIVE_AREA_0  # No interruption by any interrupt allowed
      exclusive area NM_EXCLUSIVE_AREA_1  # Interrupt locks are required if any of these functions are executed in an interrupt context: Nm_NetworkMode, Nm_PrepareBusSleepMode, Nm_BusSleepMode, Nm_RemoteSleepIndication, Nm_RemoteSleepCancellation, Nm_CoordReadyToSleepIndication, Nm_CoordReadyToSleepCancellation
package /MICROSAR/NvM_ib_bswmd/BswModuleDescriptions
  bsw module description NvM
    bsw internal behavior NvMBehavior
      exclusive area NVM_EXCLUSIVE_AREA_0
      bsw schedulable entity NvM_MainFunction: implemented-entry=NvM_MainFunction
      bsw timing event NvM_MainFunctionTimingEvent0: starts-on-event=NvM_MainFunction, period=0.01
  bsw module entry NvM_MainFunction: call-type=SCHEDULED, execution-context=TASK
package /MICROSAR/PduR_ib_bswmd/BswModuleDescriptions
  bsw module description PduR
    bsw internal behavior PduRBehavior
      exclusive area PDUR_EXCLUSIVE_AREA_0
