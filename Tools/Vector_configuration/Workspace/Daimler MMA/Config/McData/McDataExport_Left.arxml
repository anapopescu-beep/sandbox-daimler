AUTOSAR XML (schema 00049)
standard types defined: sint32, uint32, uint8
package /MICROSAR
  16 x bsw implementation, all with programming-language=C, vendor-id=30:
    BswM_Impl: sw-version=16.00.00, used-code-generator=DaVinci Configurator, ar-release-version=4.00.03, behavior=BswMBehavior
    CanIf_Impl: sw-version=8.04.00, used-code-generator=cMSR, ar-release-version=4.00.03, behavior=CanIf_Behavior
    CanNm_Impl: sw-version=11.00.01, used-code-generator=DaVinci Configurator, ar-release-version=4.00.03, behavior=CanNmBehavior
    CanSM_Impl: sw-version=4.00.00, used-code-generator=DaVinci Configurator, ar-release-version=4.00.03, behavior=CanSMBehavior
    CanTSyn_Impl: sw-version=6.01.00, used-code-generator=DaVinci Configurator, ar-release-version=4.04.00, behavior=CanTSynBehavior
    CanTp_Impl: sw-version=5.00.00, used-code-generator=DaVinci Configurator, ar-release-version=4.00.03, behavior=CanTpBehavior
    Com_Impl: sw-version=23.00.03, used-code-generator=DaVinci Configurator, ar-release-version=4.00.03, behavior=ComBehavior
    ComM_Impl: sw-version=16.01.00, used-code-generator=DaVinci Configurator, ar-release-version=4.00.03, behavior=ComMBehavior
    EcuM_Impl: sw-version=12.00.00, used-code-generator=DaVinci Configurator, ar-release-version=4.00.03, behavior=EcuMBehavior
    IpduM_Impl: sw-version=11.02.01, used-code-generator=DaVinci Configurator, ar-release-version=4.03.01, behavior=IpduMBehavior
    Nm_Impl: sw-version=15.01.00, used-code-generator=DaVinci Configurator, ar-release-version=4.00.03, behavior=NmBehavior
    NvM_Impl: sw-version=10.03.00, used-code-generator=DaVinci Configurator, ar-release-version=4.00.03, behavior=NvMBehavior
    PduR_Impl: sw-version=17.02.01, used-code-generator=DaVinci Configurator, ar-release-version=4.01.02, behavior=PduRBehavior
    Rte_Impl: sw-version=4.32.00, used-code-generator=DaVinci Configurator, ar-release-version=4.03.01, behavior=RteBehavior
    Rtm_Impl: sw-version=8.00.02, used-code-generator=DaVinci Configurator, ar-release-version=4.02.02, behavior=RtmBehavior
      mc-parameter-instances:
        mc data instance Rtm_Cmd: category=VALUE, resulting-properties={base-type=uint32, sw-calibration-access=READ-ONLY, range raw 0..4294967295}, variation-point=post-build-variant-condition{matching-criterion=SideAllocation, value=0}
        mc data instance Rtm_MeasurementConfig: category=ARRAY, array-size=6, resulting-properties={base-type=uint8, sw-calibration-access=READ-ONLY, range raw 0..255}, variation-point=post-build-variant-condition{matching-criterion=SideAllocation, value=0}
      mc-variable-instances:
        6 x mc data instance, all with variation-point=post-build-variant-condition{matching-criterion=SideAllocation, value=0}:
          Rtm_MeasTimeCorrection: category=VALUE, resulting-properties={base-type=sint32, sw-calibration-access=READ-ONLY, range raw -2147483648..2147483647}
          Rtm_Resp: category=VALUE, resulting-properties={base-type=uint32, sw-calibration-access=READ-ONLY, range raw 0..4294967295}
          Rtm_AverageMainFunctionCycleTime: category=VALUE, resulting-properties={base-type=uint32, sw-calibration-access=READ-ONLY, range raw 0..4294967295}
          Rtm_MainFunctionCounter: category=VALUE, resulting-properties={base-type=uint32, sw-calibration-access=READ-ONLY, range raw 0..4294967295}
          Rtm_CpuLoadTime: category=VALUE, resulting-properties={base-type=uint32, sw-calibration-access=READ-ONLY, range raw 0..4294967295}
          Rtm_Results: category=ARRAY, array-size=48
            48 x mc data instance, all with category=STRUCTURE:
              Element_0: symbol=[0]
                4 x mc data instance, all with category=VALUE, resulting-properties={base-type=uint32, sw-calibration-access=READ-ONLY, range raw 0..4294967295}:
                  time
                  count
                  max
                  min
              Element_1: symbol=[1]
                4 x mc data instance, all with category=VALUE, resulting-properties={base-type=uint32, sw-calibration-access=READ-ONLY, range raw 0..4294967295}:
                  time
                  count
                  max
                  min
              Element_2: symbol=[2]
                4 x mc data instance, all with category=VALUE, resulting-properties={base-type=uint32, sw-calibration-access=READ-ONLY, range raw 0..4294967295}:
                  time
                  count
                  max
                  min
              Element_3: symbol=[3]
                4 x mc data instance, all with category=VALUE, resulting-properties={base-type=uint32, sw-calibration-access=READ-ONLY, range raw 0..4294967295}:
                  time
                  count
                  max
                  min
              Element_4: symbol=[4]
                4 x mc data instance, all with category=VALUE, resulting-properties={base-type=uint32, sw-calibration-access=READ-ONLY, range raw 0..4294967295}:
                  time
                  count
                  max
                  min
              Element_5: symbol=[5]
                4 x mc data instance, all with category=VALUE, resulting-properties={base-type=uint32, sw-calibration-access=READ-ONLY, range raw 0..4294967295}:
                  time
                  count
                  max
                  min
              Element_6: symbol=[6]
                4 x mc data instance, all with category=VALUE, resulting-properties={base-type=uint32, sw-calibration-access=READ-ONLY, range raw 0..4294967295}:
                  time
                  count
                  max
                  min
              Element_7: symbol=[7]
                4 x mc data instance, all with category=VALUE, resulting-properties={base-type=uint32, sw-calibration-access=READ-ONLY, range raw 0..4294967295}:
                  time
                  count
                  max
                  min
              Element_8: symbol=[8]
                4 x mc data instance, all with category=VALUE, resulting-properties={base-type=uint32, sw-calibration-access=READ-ONLY, range raw 0..4294967295}:
                  time
                  count
                  max
                  min
              Element_9: symbol=[9]
                4 x mc data instance, all with category=VALUE, resulting-properties={base-type=uint32, sw-calibration-access=READ-ONLY, range raw 0..4294967295}:
                  time
                  count
                  max
                  min
              Element_10: symbol=[10]
                4 x mc data instance, all with category=VALUE, resulting-properties={base-type=uint32, sw-calibration-access=READ-ONLY, range raw 0..4294967295}:
                  time
                  count
                  max
                  min
              Element_11: symbol=[11]
                4 x mc data instance, all with category=VALUE, resulting-properties={base-type=uint32, sw-calibration-access=READ-ONLY, range raw 0..4294967295}:
                  time
                  count
                  max
                  min
              Element_12: symbol=[12]
                4 x mc data instance, all with category=VALUE, resulting-properties={base-type=uint32, sw-calibration-access=READ-ONLY, range raw 0..4294967295}:
                  time
                  count
                  max
                  min
              Element_13: symbol=[13]
                4 x mc data instance, all with category=VALUE, resulting-properties={base-type=uint32, sw-calibration-access=READ-ONLY, range raw 0..4294967295}:
                  time
                  count
                  max
                  min
              Element_14: symbol=[14]
                4 x mc data instance, all with category=VALUE, resulting-properties={base-type=uint32, sw-calibration-access=READ-ONLY, range raw 0..4294967295}:
                  time
                  count
                  max
                  min
              Element_15: symbol=[15]
                4 x mc data instance, all with category=VALUE, resulting-properties={base-type=uint32, sw-calibration-access=READ-ONLY, range raw 0..4294967295}:
                  time
                  count
                  max
                  min
              Element_16: symbol=[16]
                4 x mc data instance, all with category=VALUE, resulting-properties={base-type=uint32, sw-calibration-access=READ-ONLY, range raw 0..4294967295}:
                  time
                  count
                  max
                  min
              Element_17: symbol=[17]
                4 x mc data instance, all with category=VALUE, resulting-properties={base-type=uint32, sw-calibration-access=READ-ONLY, range raw 0..4294967295}:
                  time
                  count
                  max
                  min
              Element_18: symbol=[18]
                4 x mc data instance, all with category=VALUE, resulting-properties={base-type=uint32, sw-calibration-access=READ-ONLY, range raw 0..4294967295}:
                  time
                  count
                  max
                  min
              Element_19: symbol=[19]
                4 x mc data instance, all with category=VALUE, resulting-properties={base-type=uint32, sw-calibration-access=READ-ONLY, range raw 0..4294967295}:
                  time
                  count
                  max
                  min
              Element_20: symbol=[20]
                4 x mc data instance, all with category=VALUE, resulting-properties={base-type=uint32, sw-calibration-access=READ-ONLY, range raw 0..4294967295}:
                  time
                  count
                  max
                  min
              Element_21: symbol=[21]
                4 x mc data instance, all with category=VALUE, resulting-properties={base-type=uint32, sw-calibration-access=READ-ONLY, range raw 0..4294967295}:
                  time
                  count
                  max
                  min
              Element_22: symbol=[22]
                4 x mc data instance, all with category=VALUE, resulting-properties={base-type=uint32, sw-calibration-access=READ-ONLY, range raw 0..4294967295}:
                  time
                  count
                  max
                  min
              Element_23: symbol=[23]
                4 x mc data instance, all with category=VALUE, resulting-properties={base-type=uint32, sw-calibration-access=READ-ONLY, range raw 0..4294967295}:
                  time
                  count
                  max
                  min
              Element_24: symbol=[24]
                4 x mc data instance, all with category=VALUE, resulting-properties={base-type=uint32, sw-calibration-access=READ-ONLY, range raw 0..4294967295}:
                  time
                  count
                  max
                  min
              Element_25: symbol=[25]
                4 x mc data instance, all with category=VALUE, resulting-properties={base-type=uint32, sw-calibration-access=READ-ONLY, range raw 0..4294967295}:
                  time
                  count
                  max
                  min
              Element_26: symbol=[26]
                4 x mc data instance, all with category=VALUE, resulting-properties={base-type=uint32, sw-calibration-access=READ-ONLY, range raw 0..4294967295}:
                  time
                  count
                  max
                  min
              Element_27: symbol=[27]
                4 x mc data instance, all with category=VALUE, resulting-properties={base-type=uint32, sw-calibration-access=READ-ONLY, range raw 0..4294967295}:
                  time
                  count
                  max
                  min
              Element_28: symbol=[28]
                4 x mc data instance, all with category=VALUE, resulting-properties={base-type=uint32, sw-calibration-access=READ-ONLY, range raw 0..4294967295}:
                  time
                  count
                  max
                  min
              Element_29: symbol=[29]
                4 x mc data instance, all with category=VALUE, resulting-properties={base-type=uint32, sw-calibration-access=READ-ONLY, range raw 0..4294967295}:
                  time
                  count
                  max
                  min
              Element_30: symbol=[30]
                4 x mc data instance, all with category=VALUE, resulting-properties={base-type=uint32, sw-calibration-access=READ-ONLY, range raw 0..4294967295}:
                  time
                  count
                  max
                  min
              Element_31: symbol=[31]
                4 x mc data instance, all with category=VALUE, resulting-properties={base-type=uint32, sw-calibration-access=READ-ONLY, range raw 0..4294967295}:
                  time
                  count
                  max
                  min
              Element_32: symbol=[32]
                4 x mc data instance, all with category=VALUE, resulting-properties={base-type=uint32, sw-calibration-access=READ-ONLY, range raw 0..4294967295}:
                  time
                  count
                  max
                  min
              Element_33: symbol=[33]
                4 x mc data instance, all with category=VALUE, resulting-properties={base-type=uint32, sw-calibration-access=READ-ONLY, range raw 0..4294967295}:
                  time
                  count
                  max
                  min
              Element_34: symbol=[34]
                4 x mc data instance, all with category=VALUE, resulting-properties={base-type=uint32, sw-calibration-access=READ-ONLY, range raw 0..4294967295}:
                  time
                  count
                  max
                  min
              Element_35: symbol=[35]
                4 x mc data instance, all with category=VALUE, resulting-properties={base-type=uint32, sw-calibration-access=READ-ONLY, range raw 0..4294967295}:
                  time
                  count
                  max
                  min
              Element_36: symbol=[36]
                4 x mc data instance, all with category=VALUE, resulting-properties={base-type=uint32, sw-calibration-access=READ-ONLY, range raw 0..4294967295}:
                  time
                  count
                  max
                  min
              Element_37: symbol=[37]
                4 x mc data instance, all with category=VALUE, resulting-properties={base-type=uint32, sw-calibration-access=READ-ONLY, range raw 0..4294967295}:
                  time
                  count
                  max
                  min
              Element_38: symbol=[38]
                4 x mc data instance, all with category=VALUE, resulting-properties={base-type=uint32, sw-calibration-access=READ-ONLY, range raw 0..4294967295}:
                  time
                  count
                  max
                  min
              Element_39: symbol=[39]
                4 x mc data instance, all with category=VALUE, resulting-properties={base-type=uint32, sw-calibration-access=READ-ONLY, range raw 0..4294967295}:
                  time
                  count
                  max
                  min
              Element_40: symbol=[40]
                4 x mc data instance, all with category=VALUE, resulting-properties={base-type=uint32, sw-calibration-access=READ-ONLY, range raw 0..4294967295}:
                  time
                  count
                  max
                  min
              Element_41: symbol=[41]
                4 x mc data instance, all with category=VALUE, resulting-properties={base-type=uint32, sw-calibration-access=READ-ONLY, range raw 0..4294967295}:
                  time
                  count
                  max
                  min
              Element_42: symbol=[42]
                4 x mc data instance, all with category=VALUE, resulting-properties={base-type=uint32, sw-calibration-access=READ-ONLY, range raw 0..4294967295}:
                  time
                  count
                  max
                  min
              Element_43: symbol=[43]
                4 x mc data instance, all with category=VALUE, resulting-properties={base-type=uint32, sw-calibration-access=READ-ONLY, range raw 0..4294967295}:
                  time
                  count
                  max
                  min
              Element_44: symbol=[44]
                4 x mc data instance, all with category=VALUE, resulting-properties={base-type=uint32, sw-calibration-access=READ-ONLY, range raw 0..4294967295}:
                  time
                  count
                  max
                  min
              Element_45: symbol=[45]
                4 x mc data instance, all with category=VALUE, resulting-properties={base-type=uint32, sw-calibration-access=READ-ONLY, range raw 0..4294967295}:
                  time
                  count
                  max
                  min
              Element_46: symbol=[46]
                4 x mc data instance, all with category=VALUE, resulting-properties={base-type=uint32, sw-calibration-access=READ-ONLY, range raw 0..4294967295}:
                  time
                  count
                  max
                  min
              Element_47: symbol=[47]
                4 x mc data instance, all with category=VALUE, resulting-properties={base-type=uint32, sw-calibration-access=READ-ONLY, range raw 0..4294967295}:
                  time
                  count
                  max
                  min
    StbM_Impl: sw-version=9.05.01, used-code-generator=DaVinci Configurator, ar-release-version=4.07.00, behavior=StbMBehavior
package /MICROSAR/BswM_ib_bswmd/BswModuleDescriptions
  bsw module description BswM
    bsw internal behavior BswMBehavior
      exclusive area BSWM_EXCLUSIVE_AREA_0
      bsw schedulable entity BswM_MainFunction: implemented-entry=BswM_MainFunction
      bsw timing event BswM_MainFunctionTimingEvent0: starts-on-event=BswM_MainFunction, period=0.005
  bsw module entry BswM_MainFunction: call-type=SCHEDULED, execution-context=TASK
package /MICROSAR/CanIf_ib_bswmd/BswModuleDescriptions
  bsw module description CanIf
    bsw internal behavior CanIf_Behavior
      8 x exclusive area:
        CANIF_EXCLUSIVE_AREA_{0..7}
package /MICROSAR/CanNm_ib_bswmd/BswModuleDescriptions
  bsw module description CanNm
    bsw internal behavior CanNmBehavior
      8 x exclusive area:
        CANNM_EXCLUSIVE_AREA_0  # No interruption by any interrupt allowed (i.e. global interrupt locks).
        CANNM_EXCLUSIVE_AREA_1  # No interruption of CanNm_MainFunction or CanNm_RequestBusSynchronization by CanNm_SetUserData or CanNm_SetSleepReadyBit allowed.
        CANNM_EXCLUSIVE_AREA_2  # No interruption of CanNm_SetUserData by CanNm_MainFunction or CanNm_RequestBusSynchronization allowed.
        CANNM_EXCLUSIVE_AREA_3  # No interruption of CanNm_SetSleepReadyBit by CanNm_MainFunction or CanNm_RequestBusSynchronization allowed.
        CANNM_EXCLUSIVE_AREA_4  # No interruption of CanNm_RxIndication by CanNm_GetUserData or CanNm_GetPduData allowed.
        CANNM_EXCLUSIVE_AREA_5  # No interruption of CanNm_GetUserData or CanNm_GetPduData by CanNm_RxIndication allowed.
        CANNM_EXCLUSIVE_AREA_6  # No interruption of CanNm_MainFunction by CanNm_RequestBusSynchronization allowed. Note: This critical section can be left empty when CanNm_MainFunction and Nm_MainFunction have the same task.
        CANNM_EXCLUSIVE_AREA_7  # No interruption of CanNm_MainFunction by CanNm_RequestSynchronizedPncShutdown allowed.
      bsw schedulable entity CanNm_MainFunction: implemented-entry=CanNm_MainFunction
      bsw timing event CanNm_MainFunctionTimingEvent0: starts-on-event=CanNm_MainFunction, period=0.01
  bsw module entry CanNm_MainFunction: call-type=SCHEDULED, execution-context=TASK
package /MICROSAR/CanSM_ib_bswmd/BswModuleDescriptions
  bsw module description CanSM
    bsw internal behavior CanSMBehavior
      6 x exclusive area:
        CANSM_EXCLUSIVE_AREA_{1..6}
      bsw schedulable entity CanSM_MainFunction: implemented-entry=CanSM_MainFunction
      bsw timing event CanSM_MainFunctionTimingEvent0: starts-on-event=CanSM_MainFunction, period=0.01
  bsw module entry CanSM_MainFunction: call-type=SCHEDULED, execution-context=TASK
package /MICROSAR/CanTSyn_ib_bswmd/BswModuleDescriptions
  bsw module description CanTSyn
    bsw internal behavior CanTSynBehavior
      exclusive area CANTSYN_EXCLUSIVE_AREA_0
      bsw schedulable entity CanTSyn_MainFunction: implemented-entry=CanTSyn_MainFunction
      bsw timing event CanTSyn_MainFunctionTimingEvent0: starts-on-event=CanTSyn_MainFunction, period=0.005
  bsw module entry CanTSyn_MainFunction: call-type=SCHEDULED, execution-context=TASK
package /MICROSAR/CanTp_ib_bswmd/BswModuleDescriptions
  bsw module description CanTp
    bsw internal behavior CanTpBehavior
      exclusive area CANTP_EXCLUSIVE_AREA_0
      bsw schedulable entity CanTp_MainFunctionRx: implemented-entry=CanTp_MainFunctionRx
      bsw schedulable entity CanTp_MainFunctionTx: implemented-entry=CanTp_MainFunctionTx
      bsw timing event CanTp_MainFunctionRxTimingEvent0: starts-on-event=CanTp_MainFunctionRx, period=0.01
      bsw timing event CanTp_MainFunctionTxTimingEvent0: starts-on-event=CanTp_MainFunctionTx, period=0.01
  bsw module entry CanTp_MainFunctionRx: call-type=SCHEDULED, execution-context=TASK
  bsw module entry CanTp_MainFunctionTx: call-type=SCHEDULED, execution-context=TASK
package /MICROSAR/ComM_ib_bswmd/BswModuleDescriptions
  bsw module description ComM
    bsw internal behavior ComMBehavior
      7 x exclusive area:
        COMM_EXCLUSIVE_AREA_0
        COMM_EXCLUSIVE_AREA_1
        COMM_EXCLUSIVE_AREA_{2..6}  # This exclusive area is only used in case of multi-partition. It must be configured as a spinlock to allow access to some variables simultaneously from multiple cores.
      bsw schedulable entity ComM_MainFunction_0: implemented-entry=ComM_MainFunction_0
      bsw schedulable entity ComM_MainFunction_1: implemented-entry=ComM_MainFunction_1
      bsw timing event ComM_MainFunction_0TimingEvent0: starts-on-event=ComM_MainFunction_0, period=0.005
      bsw timing event ComM_MainFunction_1TimingEvent0: starts-on-event=ComM_MainFunction_1, period=0.005
  bsw module entry ComM_MainFunction_0: call-type=SCHEDULED, execution-context=TASK
  bsw module entry ComM_MainFunction_1: call-type=SCHEDULED, execution-context=TASK
package /MICROSAR/Com_ib_bswmd/BswModuleDescriptions
  bsw module description Com
    bsw internal behavior ComBehavior
      exclusive area COM_EXCLUSIVE_AREA_TX  # This critical section protects Tx ressources that can be accessed from various contexts. Therefore the critical section enclosed with COM_EXCLUSIVE_AREA_TX should never be interrupted by any Com API which accesses Tx ressources. For more details, see DocTechRef.
      exclusive area COM_EXCLUSIVE_AREA_RX  # This critical section protects Rx ressources that can be accessed from various contexts.Therefore the critical section enclosed with COM_EXCLUSIVE_AREA_RX should never be interrupted by any Com API which accesses Rx ressources. For more details, see DocTechRef.
      exclusive area COM_EXCLUSIVE_AREA_BOTH  # This critical section protects Rx and Tx ressources that are being accessed in context of Com_MainFunctionRouteSignals for signal gateway routings or description routings with configured deferred description source. For more details, see DocTechRef.
      bsw schedulable entity Com_MainFunctionTx_ComMainFunctionTx: implemented-entry=Com_MainFunctionTx_ComMainFunctionTx
      bsw schedulable entity Com_MainFunctionRx_ComMainFunctionRx: implemented-entry=Com_MainFunctionRx_ComMainFunctionRx
      bsw schedulable entity Com_MainFunctionRouteSignals_ComMainFunctionRouteSignals: implemented-entry=Com_MainFunctionRouteSignals_ComMainFunctionRouteSignals
      bsw timing event Com_MainFunctionTx_ComMainFunctionTxTimingEvent0: starts-on-event=Com_MainFunctionTx_ComMainFunctionTx, period=0.005
      bsw timing event Com_MainFunctionRx_ComMainFunctionRxTimingEvent0: starts-on-event=Com_MainFunctionRx_ComMainFunctionRx, period=0.005
      bsw timing event Com_MainFunctionRouteSignals_ComMainFunctionRouteSignalsTimingEvent0: starts-on-event=Com_MainFunctionRouteSignals_ComMainFunctionRouteSignals, period=0.005
  bsw module entry Com_MainFunctionTx_ComMainFunctionTx: call-type=SCHEDULED, execution-context=TASK
  bsw module entry Com_MainFunctionRx_ComMainFunctionRx: call-type=SCHEDULED, execution-context=TASK
  bsw module entry Com_MainFunctionRouteSignals_ComMainFunctionRouteSignals: call-type=SCHEDULED, execution-context=TASK
package /MICROSAR/EcuM_ib_bswmd/BswModuleDescriptions
  bsw module description EcuM
    bsw internal behavior EcuMBehavior
      4 x exclusive area:
        ECUM_EXCLUSIVE_AREA_0  # This exclusive area shall disable all wake up interrupts to prevent overwriting of some global variables.
        ECUM_EXCLUSIVE_AREA_1  # This exclusive area is only used in case of multi core and if the the EcuM is configured to handle also the slave cores. It must be configured as a spinlock to allow access to some variables simultaneously from multiple cores.
        ECUM_EXCLUSIVE_AREA_2  # This exclusive area is used for accessing the clock variable. It shall disable GPT interrupts and task changes. Only necessary if 32 Bit access is not atomic and Alarm Clock is present.
        ECUM_EXCLUSIVE_AREA_3  # This This exclusive area must be configured as a spin lock to protect access on global shutdown target variables.
      bsw schedulable entity EcuM_MainFunction: implemented-entry=EcuM_MainFunction
      bsw timing event EcuM_MainFunctionTimingEvent0: starts-on-event=EcuM_MainFunction, period=0.005
  bsw module entry EcuM_MainFunction: call-type=SCHEDULED, execution-context=TASK
package /MICROSAR/IpduM_ib_bswmd/BswModuleDescriptions
  bsw module description IpduM
    bsw internal behavior IpduMBehavior
      exclusive area IPDUM_EXCLUSIVE_AREA_0  # Set SchMExclusiveAreaImplementation to AUTO to lock all interrupts.
      bsw schedulable entity IpduM_MainFunctionRx: implemented-entry=IpduM_MainFunctionRx
      bsw schedulable entity IpduM_MainFunctionTx: implemented-entry=IpduM_MainFunctionTx
      bsw timing event IpduM_MainFunctionRxTimingEvent0: starts-on-event=IpduM_MainFunctionRx, period=0.005
      bsw timing event IpduM_MainFunctionTxTimingEvent0: starts-on-event=IpduM_MainFunctionTx, period=0.005
  bsw module entry IpduM_MainFunctionRx: call-type=SCHEDULED, execution-context=TASK
  bsw module entry IpduM_MainFunctionTx: call-type=SCHEDULED, execution-context=TASK
package /MICROSAR/Nm_ib_bswmd/BswModuleDescriptions
  bsw module description Nm
    bsw internal behavior NmBehavior
      4 x exclusive area:
        NM_EXCLUSIVE_AREA_0  # No interruption by any interrupt allowed
        NM_EXCLUSIVE_AREA_1  # Interrupt locks are required if any of these functions are executed in an interrupt context: Nm_NetworkMode, Nm_PrepareBusSleepMode, Nm_BusSleepMode, Nm_RemoteSleepIndication, Nm_RemoteSleepCancellation, Nm_CoordReadyToSleepIndication, Nm_CoordReadyToSleepCancellation
        NM_EXCLUSIVE_AREA_2  # This exclusive area is only used in case of multi-partition. No interruption allowed by Nm_NetworkRequest, Nm_PassiveStartup, Nm_NetworkMode, Nm_RemoteSleepCancellation, Nm_CoordReadyToSleepCancellation
        NM_EXCLUSIVE_AREA_3  # This exclusive area is only used in case of multi-partition. It must be configured as a spinlock to allow access to some variables simultaneously from multiple partitions.
package /MICROSAR/NvM_ib_bswmd/BswModuleDescriptions
  bsw module description NvM
    bsw internal behavior NvMBehavior
      exclusive area NVM_EXCLUSIVE_AREA_0
      bsw schedulable entity NvM_MainFunction: implemented-entry=NvM_MainFunction
      bsw timing event NvM_MainFunctionTimingEvent0: starts-on-event=NvM_MainFunction, period=0.01
  bsw module entry NvM_MainFunction: call-type=SCHEDULED, execution-context=TASK
package /MICROSAR/PduR_ib_bswmd/BswModuleDescriptions
  bsw module description PduR
    bsw internal behavior PduRBehavior
      exclusive area PDUR_EXCLUSIVE_AREA_0
package /MICROSAR/Rte_ib_bswmd/BswModuleDescriptions
  bsw module description Rte
    bsw internal behavior RteBehavior
      bsw schedulable entity Rte_ComSendSignalProxyPeriodic: implemented-entry=Rte_ComSendSignalProxyPeriodic
      bsw timing event Rte_ComSendSignalProxyPeriodicTimingEvent0: starts-on-event=Rte_ComSendSignalProxyPeriodic, period=0.005
  bsw module entry Rte_ComSendSignalProxyPeriodic: call-type=SCHEDULED, execution-context=TASK
package /MICROSAR/Rtm_ib_bswmd/BswModuleDescriptions
  bsw module description Rtm
    bsw internal behavior RtmBehavior
      exclusive area RTM_EXCLUSIVE_AREA_{0..2}
      bsw schedulable entity Rtm_MainFunction: implemented-entry=Rtm_MainFunction
      bsw timing event Rtm_MainFunctionTimingEvent0: starts-on-event=Rtm_MainFunction, period=0.01
  bsw module entry Rtm_MainFunction: call-type=SCHEDULED, execution-context=TASK
package /MICROSAR/StbM_ib_bswmd/BswModuleDescriptions
  bsw module description StbM
    bsw internal behavior StbMBehavior
      exclusive area STBM_EXCLUSIVE_AREA_0
      exclusive area STBM_EXCLUSIVE_AREA_1
      bsw schedulable entity StbM_MainFunction_OsApplication_Trusted_Core0: implemented-entry=StbM_MainFunction_OsApplication_Trusted_Core0
      bsw timing event StbM_MainFunction_OsApplication_Trusted_Core0TimingEvent0: starts-on-event=StbM_MainFunction_OsApplication_Trusted_Core0, period=0.005
  bsw module entry StbM_MainFunction_OsApplication_Trusted_Core0: call-type=SCHEDULED, execution-context=TASK
package /VariantDefinition/Criterion
  post build variant criterion SideAllocation: compu {0=Left, 1=Right}
