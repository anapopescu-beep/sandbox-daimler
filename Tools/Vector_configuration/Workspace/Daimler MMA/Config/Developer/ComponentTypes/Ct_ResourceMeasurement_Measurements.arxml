AUTOSAR XML (schema 00048)
package /ComponentTypes
  application sw component type Ct_ResourceMeasurement_Measurements
    behavior Ct_ResourceMeasurement_Measurements_InternalBehavior: supports-multiple-instantiation=true
      background event background_event: start-on-event=Ct_ResourceMeasurement_Measurements_BackgroundEvent
      runnable Ct_ResourceMeasurement_Measurements_BackgroundEvent: can-be-invoked-concurrently=true
  swc implementation Ct_ResourceMeasurement_Measurements_Implementation: behavior=Ct_ResourceMeasurement_Measurements_InternalBehavior
