AUTOSAR XML (schema 00048)
package /ComponentTypes
  application sw component type BeltTensionerFunction
    behavior BeltTensionerFunction_InternalBehavior: data-type-mapping=DataTypeMappings_DEV
      ar-typed-per-instance-memorys:
        data IgnStatBuffer: type=REC_Ign_Stat_Pr5_ST3_bt5mk3546wsooydubq849n96
      init event BeltTensionerFunction_InitEvent: start-on-event=BeltTensionerFunction_Init
      timing event TMT_BeltTensionerFunction_Main: start-on-event=BeltTensionerFunction_Main, period=0.1
      runnable BeltTensionerFunction_Main
      runnable BeltTensionerFunction_Init
  swc implementation BeltTensionerFunction_Implementation: behavior=BeltTensionerFunction_InternalBehavior
