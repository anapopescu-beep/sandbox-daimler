AUTOSAR XML (schema 00046)
package /ComponentTypes
  swc implementation Ct_MBBL_SsaAppl_ProjectSpecific_Implementation: behavior=Ct_MBBL_SsaAppl_ProjectSpecific_InternalBehavior
    code-descriptors:
      code Default: artifact-descriptors=autosar-engineering-object=category=SWSRC
  application sw component type Ct_MBBL_SsaAppl_ProjectSpecific
    require port P_ICS_SecAccess_ST3: required-com-specs=[CompareKey, GetSeed], required-interface=SecurityAccessServices_GenericSecurityAccess
    behavior Ct_MBBL_SsaAppl_ProjectSpecific_InternalBehavior
      init event Ct_MBBL_SsaAppl_ProjectSpecific_InitEvent: start-on-event=Ct_MBBL_SsaAppl_ProjectSpecific_Init
      11 x runnable:
        SecurityAccess_SAR_Remove_CompareKey
          sync call SC_P_ICS_SecAccess_ST3_CompareKey: operation=P_ICS_SecAccess_ST3.CompareKey
        SecurityAccess_SAR_Remove_GetSeed
          sync call SC_P_ICS_SecAccess_ST3_GetSeed: operation=P_ICS_SecAccess_ST3.GetSeed
        SecurityAccess_SAR_Read_CompareKey
          sync call SC_P_ICS_SecAccess_ST3_CompareKey: operation=P_ICS_SecAccess_ST3.CompareKey
        SecurityAccess_SAR_Read_GetSeed
          sync call SC_P_ICS_SecAccess_ST3_GetSeed: operation=P_ICS_SecAccess_ST3.GetSeed
        SecurityAccess_Level_11_CompareKey
          sync call SC_P_ICS_SecAccess_ST3_CompareKey: operation=P_ICS_SecAccess_ST3.CompareKey
        SecurityAccess_Level_11_GetSeed
          sync call SC_P_ICS_SecAccess_ST3_GetSeed: operation=P_ICS_SecAccess_ST3.GetSeed
        SecurityAccess_Level_5F_CompareKey
          sync call SC_P_ICS_SecAccess_ST3_CompareKey: operation=P_ICS_SecAccess_ST3.CompareKey
        SecurityAccess_Level_5F_GetSeed
          sync call SC_P_ICS_SecAccess_ST3_GetSeed: operation=P_ICS_SecAccess_ST3.GetSeed
        SecurityAccess_Level_3_CompareKey
          sync call SC_P_ICS_SecAccess_ST3_CompareKey: operation=P_ICS_SecAccess_ST3.CompareKey
        SecurityAccess_Level_3_GetSeed
          sync call SC_P_ICS_SecAccess_ST3_GetSeed: operation=P_ICS_SecAccess_ST3.GetSeed
        Ct_MBBL_SsaAppl_ProjectSpecific_Init
