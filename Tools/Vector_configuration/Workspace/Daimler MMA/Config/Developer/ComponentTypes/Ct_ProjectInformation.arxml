AUTOSAR XML (schema 00048)
package /ComponentTypes
  parameter sw component type Ct_ProjectInformation
    provide port Pp_InputFileVersions: provided-interface=Pi_InputFileVersions
      provided-com-specs:
        init-value=constant-reference=Const_PI_DiagVariant, parameter=DiagnosticVariant
        init-value=constant-reference=Const_PI_DiagVersion, parameter=DiagnosticVersion
