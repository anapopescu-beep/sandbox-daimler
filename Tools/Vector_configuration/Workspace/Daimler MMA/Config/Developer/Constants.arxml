AUTOSAR XML (schema 00049)
package /AUTOLIV
  constant specification APPLINIT_KU8_VELOCITY_TARGET_ZERO: value-spec=0
  constant specification IMPLINIT_KU8_VELOCITY_TARGET_ZERO: value-spec=0
  constant specification APPLINIT_KB8_BUCKLE_SWITCH_CLOSED: value-spec=85
package /AUTOLIV/GlobalDictionary/Constants
  77 x constant specification:
    APPLINIT_KB8_ACTIVE_DIAG_SESSION_FALSE: value-spec=85
    APPLINIT_KB8_ALGO_FLAG_FALSE: value-spec=85
    APPLINIT_KB8_BOOLEAN_FALSE: value-spec=85
    APPLINIT_KB8_CAR_ACCEL_LOW_TRUE: value-spec=170
    APPLINIT_KB8_CAR_CRANKING_ACTIVE_TRUE: value-spec=170
    APPLINIT_KB8_CAR_CRASH_DETECTED_FALSE: value-spec=85
    APPLINIT_KB8_DEFECT_STATUS_FALSE: value-spec=85
    APPLINIT_KS16_ACCELERATION_ZERO: value-spec=0
    APPLINIT_KS16_ACCEL_PEDAL_POS_RATE_ZERO: value-spec=0
    APPLINIT_KS16_ANGLE_RATE_ZERO: value-spec=0
    APPLINIT_KS16_BRAKE_PRESSURE_RATE_ZERO: value-spec=0
    APPLINIT_KS16_HW_ANGLE_ZERO: value-spec=0
    APPLINIT_KS16_HW_RATE_ZERO: value-spec=0
    APPLINIT_KS16_MOTOR_POWER_ORDER_ZERO: value-spec=0
    APPLINIT_KS32_ORDER_VALUE_ZERO: value-spec=0
    APPLINIT_KU16_BRAKE_PRESSURE_ZERO: value-spec=0
    APPLINIT_KU16_STEP_DURATION_ZERO: value-spec=0
    APPLINIT_KU16_VEHICLE_SPEED_ZERO: value-spec=0
    APPLINIT_KU32_DEFICIENCY_LEVEL_ZERO: value-spec=0
    APPLINIT_KU32_RESET_CAUSE_UNKNOWN: value-spec=0
    APPLINIT_KU8_ACCEL_PEDAL_POS_ZERO: value-spec=0
    APPLINIT_KU8_BELT_PARKING_AUTHORIZATION_STATE_INIT: value-spec=0
    APPLINIT_KU8_BELT_SLACK_STATUS_NOT_DEFINED: value-spec=2
    APPLINIT_KU8_BUCKLE_SWITCH_STATUS_NOT_DEFINED: value-spec=255
    APPLINIT_KU8_CYCLE_NUMBER_NONE: value-spec=255
    APPLINIT_KU8_DOOR_SWITCH_STATUS_NOT_DEFINED: value-spec=255
    APPLINIT_KU8_HAPTIC_REQUEST_NO: value-spec=8
    APPLINIT_KU8_KLEMMEN_STATUS_ZERO: value-spec=0
    APPLINIT_KU8_MOTOR_STAGE_STATUS_ACTIVATION: value-spec=170
    APPLINIT_KU8_ORDERS_LIST_ZERO: value-spec=0
    APPLINIT_KU8_PRE_CRASH_REQUEST_NO_REQUEST: value-spec=255
    APPLINIT_KU8_PRE_CRASH_SEVERITY_LEVEL_NO: value-spec=255
    APPLINIT_KU8_REPETITION_COUNTER_ZERO: value-spec=0
    APPLINIT_KU8_RETRACTION_STATUS_ONGOING: value-spec=255
    APPLINIT_KU8_SEVERITY_LEVEL_ZERO: value-spec=0
    APPLINIT_KU8_STEP_NUMBER_NONE: value-spec=255
    APPLINIT_KU8_TRIGGERING_SOURCE_NO: value-spec=0
    IMPLINIT_KB8_ACTIVE_DIAG_SESSION_FALSE: value-spec=85
    IMPLINIT_KB8_ALGO_FLAG_FALSE: value-spec=85
    IMPLINIT_KB8_BOOLEAN_FALSE: value-spec=85
    IMPLINIT_KB8_CAR_ACCEL_LOW_TRUE: value-spec=170
    IMPLINIT_KB8_CAR_CRANKING_ACTIVE_TRUE: value-spec=170
    IMPLINIT_KB8_CAR_CRASH_DETECTED_FALSE: value-spec=85
    IMPLINIT_KB8_DEFECT_STATUS_FALSE: value-spec=85
    IMPLINIT_KS16_ACCELERATION_ZERO: value-spec=0
    IMPLINIT_KS16_ACCEL_PEDAL_POS_RATE_ZERO: value-spec=0
    IMPLINIT_KS16_ANGLE_RATE_ZERO: value-spec=0
    IMPLINIT_KS16_BRAKE_PRESSURE_RATE_ZERO: value-spec=0
    IMPLINIT_KS16_HW_ANGLE_ZERO: value-spec=0
    IMPLINIT_KS16_HW_RATE_ZERO: value-spec=0
    IMPLINIT_KS16_MOTOR_POWER_ORDER_ZERO: value-spec=0
    IMPLINIT_KS32_ORDER_VALUE_ZERO: value-spec=0
    IMPLINIT_KU16_BRAKE_PRESSURE_ZERO: value-spec=0
    IMPLINIT_KU16_STEP_DURATION_ZERO: value-spec=0
    IMPLINIT_KU16_VEHICLE_SPEED_ZERO: value-spec=0
    IMPLINIT_KU32_DEFICIENCY_LEVEL_ZERO: value-spec=0
    IMPLINIT_KU32_RESET_CAUSE_UNKNOWN: value-spec=0
    IMPLINIT_KU8_ACCEL_PEDAL_POS_ZERO: value-spec=0
    IMPLINIT_KU8_BELT_PARKING_AUTHORIZATION_STATE_INIT: value-spec=0
    IMPLINIT_KU8_BELT_SLACK_STATUS_NOT_DEFINED: value-spec=2
    IMPLINIT_KU8_BUCKLE_SWITCH_STATUS_NOT_DEFINED: value-spec=255
    IMPLINIT_KU8_CYCLE_NUMBER_NONE: value-spec=255
    IMPLINIT_KU8_DOOR_SWITCH_STATUS_NOT_DEFINED: value-spec=255
    IMPLINIT_KU8_HAPTIC_REQUEST_NO: value-spec=8
    IMPLINIT_KU8_KLEMMEN_STATUS_ZERO: value-spec=0
    IMPLINIT_KU8_MOTOR_STAGE_STATUS_ACTIVATION: value-spec=170
    IMPLINIT_KU8_ORDERS_LIST_ZERO: value-spec=0
    IMPLINIT_KU8_PRE_CRASH_REQUEST_NO_REQUEST: value-spec=255
    IMPLINIT_KU8_PRE_CRASH_SEVERITY_LEVEL_NO: value-spec=255
    IMPLINIT_KU8_REPETITION_COUNTER_ZERO: value-spec=0
    IMPLINIT_KU8_RETRACTION_STATUS_ONGOING: value-spec=255
    IMPLINIT_KU8_SEVERITY_LEVEL_ZERO: value-spec=0
    IMPLINIT_KU8_STEP_NUMBER_NONE: value-spec=255
    IMPLINIT_KU8_TRIGGERING_SOURCE_NO: value-spec=0
    APPLINIT_KU8_UINT8_ZERO: value-spec=0
    APPLINIT_KU8_PRESAFE_NOLVL: value-spec=0
    APPLINIT_KB8_BOOLEAN_TRUE: value-spec=170
package /SecurityArchitecture/Constants
  22 x constant specification:
    Ssa_Init_boolean_False: value-spec=0
    Ssa_Init_BusOdometerRecord: value-spec=fields=ElementConstant:16777215
    Ssa_Init_ComSignal_8Byte: value-spec=8 x 255
    Ssa_Init_IgnitionStatus: value-spec=fields=ElementConstant:7
    Ssa_Init_LocalTickCountAndSyncStatus: value-spec=fields=[LocalTickCount:0, SyncStatus:SSA_TICKCOUNT_SYNC_STATE_NOT_SYNCHRONIZED]
    Ssa_Init_PowernetMgmtState: value-spec=0
    Ssa_Init_SecOcVerificationState: value-spec=fields=[ElementConstant:0, ElementConstant_1:0, ElementConstant_2:0]
    Ssa_Init_Ssa_BswM_ComModeType_SSA_COM_OFF: value-spec=SSA_COM_OFF
    Ssa_Init_VIN: value-spec=17 x 63
    Ssa_Coding_Init_VINStorage: value-spec=fields=[{short-label=VIN, constant=Ssa_Init_VIN}, attributes:0]
    Ssa_Init_VINStatus_VIN_STATUS_VIN_CORRECT_RECEIVED: value-spec=VIN_STATUS_VIN_CORRECT_RECEIVED
    Ssa_Init_Zero_11Byte: value-spec=11 x 0
    Ssa_Init_Zero_12Byte: value-spec=12 x 0
    Ssa_Init_Zero_20Byte: value-spec=20 x 0
    Ssa_Init_Zero_32Byte: value-spec=32 x 0
    Ssa_Init_Zero_{5..7}Byte: value-spec={5..7} x 0
    Ssa_Init_Zero_uint8: value-spec=0
    Ssa_RightM_NonceInit: value-spec=fields=[{short-label=nonceData, constant=Ssa_Init_Zero_32Byte}, nonceTimestamp:0, nonceValid:0]
    Ssa_TimeM_Init_DateTime: value-spec=fields=[year:2016, month:1, day:1, hour:0, minute:0, second:0]
    Ssa_TimeM_RealTimeOffestInit: value-spec=fields=[tickCountOffset:0, {short-label=dateTimeReference, constant=Ssa_TimeM_Init_DateTime}]
package /Constants
  138 x constant specification:
    XDIS_6b75pabydagdo3iwsn1mn0uh1: value-spec={short-label=XDIS_bovl0bjib7uo985od58blbz7v, fields=I_C24_KM_0_999999K9_0K1_INVLD_SNA_SNA km}
    XDIS_6lilg5cbgknuas3w1zquxnp57: value-spec={short-label=XDIS_dzxw39vv3y93x2k7kpiqoh8vy, fields=[0 m, I_C13_M_0_8190_1_SNA m, I_C06_IDX_0_TO_63_1_UNKNOWN, I_C01_FALSETRUE_FALSE, I_C10_TO_1022_1_SNA, 0]}
    XDIS_6554p0x95xy2a2qalei22yo87: value-spec={short-label=XDIS_ee4p105ywwn9heijfmn3b3jg, fields=I_C02_TURNINDLVR_STAT_IDLE}
    XDIS_ays1a6ktv25pr5ggjl5ntdf5h: value-spec=I_C02_NDEF_FALSE_TRUE_ST3_SNA
    XDIS_dw79s45ha1z03s9jiw4xye2p4: value-spec={short-label=XDIS_dn0hnalxhx2w9dwpl0o4sy62k, fields=[0, 255, I_C04_PRESF_LVL_V2_NOLVL, I_C02_PRESF_SND_IDLE, I_C02_NDEF_FALSE_TRUE_ST3_TRUE, I_C02_FALSE_TRUE_SNA_SNA, I_C02_FALSE_TRUE_SNA_SNA, I_C03_NO_LT_RT_BOTH_SNA, 56639, 0, I_C04_PRESF_FRCT_ST3_SNA]}
    XDIS_7frhrem3wt9j2oidbosrki6rx: value-spec={short-label=XDIS_2pa9byy2m92rf3kcoup4f5x85, fields=[FALSE, FALSE, FALSE, FALSE, 11251, 0, FALSE, FALSE, FALSE, FALSE]}
    XDIS_4368a61a9qkau9z8vrv9cqte3: value-spec=I_C05_ADAS_PROFSHORT_PROFTYP_SNA
    XDIS_9fnatjo7ibmc7ug14uhxholnb: value-spec={short-label=XDIS_6isyyzebeds108o3ab34q3cxt, fields=[I_C03_ISW_STAT_SNA, I_C04_VEHOPMODE_DRV, 20886, 0, FALSE]}
    XDIS_7s3506puhms1tg6jklvb6yyln: value-spec=I_C02_OFF_STAGE1_STAGE2_SNA
    XDIS_3elhcp6tddzyll77836dfda9r: value-spec=I_C03_MSGTYP_1_TO_7_SNA
    XDIS_c2jv9ailv446i1cgbuemyned9: value-spec={short-label=XDIS_cuxmhh54637rqd3m4k9u39c14, fields=[15, I_C02_BCKL_SW_STAT_SNA, I_C02_BCKL_SW_STAT_SNA, 33522, 0]}
    XDIS_debu86gffticpkkrmn80uem90: value-spec=I_C02_BELTHDOVR_STAT_SNA
    XDIS_dnkl0ioin1fr77x6drtqgo5ow: value-spec={short-label=XDIS_29gp3gkr16d8wzky08i3yrpe4, fields=[I_C10_ADAS_COUNTRYCODE_ESC_CODE, I_C15_ADAS_REGIONCODE_SNA]}
    XDIS_bnj0uet8uxeapkk1jjo05fune: value-spec=I_C02_INACTV_SILENT_ACTV_ST3_SNA
    XDIS_1v7kbvjl3unyf4dpe0wewh2c1: value-spec={short-label=XDIS_9sadpb0o8br1anquuvdlkue1g, fields=[I_C02_EVC_STAT_SNA, I_C02_STSTYLE_SNA]}
    XDIS_mplw7kqzq1h511zsujiz4bgo: value-spec=I_C02_PRESF_DISP_RQ_IDLE
    XDIS_h5tcyk98kzbgrc5svasomeyt: value-spec=FALSE
    XDIS_3d2vkzz1dkbb4vov9xpbozuk5: value-spec={short-label=XDIS_73zfi9caggnpz2b3fv0mi7ndh, fields=[I_C09_MS_0_510_5_SNA ms, 0, I_C13_M_0_8190_1_SNA m, I_C06_IDX_0_TO_63_1_UNKNOWN, I_C09_M_P_S_M12K8_89K2_0K2_SNA m_per_s]}
    XDIS_1fl5m527mfqxrtai409n5nt6p: value-spec=I_C12_KM_P_H_0_409K4_0K1_SNA km_per_h
    XDIS_38xd6mxe7w4h211xfx307v7jd: value-spec={short-label=XDIS_45chk5c1kie5pdyiy2mtjbwzy, fields=[I_C02_BCKL_SW_STAT_SNA, I_C02_BCKL_SW_STAT_SNA]}
    XDIS_1j2e7ey8q28fsybvpbxfqeop8: value-spec={short-label=XDIS_f01vcqqh5o1hzml38cyktzy9a, fields=I_C02_PT_RDY_V2_PT_NOT_RDY}
    XDIS_ayiqyrhz0dpk9ygbqo5e5w1f7: value-spec={short-label=XDIS_cy5u8s2ehs6vion0t0nwr2doa, fields=FALSE}
    XDIS_e0p8eo65xegbkeoit2yb8bj0v: value-spec=I_C02_OFF_ON_SNA
    XDIS_klz6op2k9wci74l4e72gktkb: value-spec={short-label=XDIS_eod6s0bgmkg5hm1p11g96wo16, fields=[I_C04_PRESF_LVL_V2_NOLVL, I_C02_NDEF_FALSE_TRUE_ST3_TRUE]}
    XDIS_2akyi0yafm6v4b7rnlmtzqky2: value-spec={short-label=XDIS_9hvbkka170yl6etmcwyrh4eap, fields=I_C05_DPC_MD_PT_HU_INIT}
    XDIS_86xn4hwzmz58ui3sqboz24rhd: value-spec={short-label=XDIS_78e41cybpxnvmypt91j7w8nmy, fields=I_C03_ACCEL_MD_ST3_SNA}
    XDIS_15lbynoto8hu3um81qo7cznt0: value-spec=I_C03_PN14_TDP_SW_STAT_CLS
    XDIS_5tgkwvedu4465t8unm4y2yblo: value-spec={short-label=XDIS_45chk5c1kie5pdyiy2mtjbwzy, fields=[I_C02_DR_STAT_SNA, I_C02_DR_STAT_SNA]}
    XDIS_69fckmg12bk5g7417pzn53395: value-spec={short-label=XDIS_6g69i1lp40t4493s15rxp0nq, fields=I_C02_STSTYLE_SNA}
    XDIS_bjxptj1w89so7fpxm4dpms8ww: value-spec={short-label=XDIS_d6lrvzktu48vf7hie870x3b9k, fields=I_C04_DRVPOSN_ST3_SNA}
    XDIS_6l5b88fcuqpu2imoz1fzls07a: value-spec={short-label=XDIS_1m7dbbqmyp14d3hgxxlvd3ke6, fields=FALSE}
    XDIS_12zcafvpuxi1hcqhklsbnv4pg: value-spec=XDIS_4bvuxux36qu6oc775sxlu30hr:8 x 255
    XDIS_ac2wq8fsnomfy8b1d5s468o4x: value-spec=420
    XDIS_dx2vtxvh1csnm7x2o8c32o294: value-spec={short-label=XDIS_cfiqgomo7qh2q238pmzoagv63, fields=[0, 0, 0, 0, 0, 0, 0, 0]}
    XDIS_bggrcvuxyaw47ntt1npaw992u: value-spec=I_C10_WAKEUPRSN_ST3_SNA
    XDIS_1d3ai2d8h1n3nb7ayhambew4d: value-spec=I_C10_V_0_25K55_0K025_SNA V
    XDIS_1uf4istgprs3hvvzjvjv3yns0: value-spec={short-label=XDIS_cfiqgomo7qh2q238pmzoagv63, fields=[0, 0, 0, 0, 0, 0, 0, 0]}
    XDIS_epntk9hnintc34egvtksqi4oo: value-spec={short-label=XDIS_zrx4ogvhxq7ai48rfe46f7vu, fields=[I_C08_ROE_0_IDLE, 0, 0, 0, 0, 0, 0, 0]}
    XDIS_csegq0grcmpyfro5u6kyzxmql: value-spec=I_C02_TRANSMD_STAT_SNA
    XDIS_3jcrrl3ll1e4yr6lszlogfin7: value-spec=XDIS_3zsju2ogf1i6dqy01f694w1r6:8 x 63
    XDIS_ckvw3q385offj9s5jhb6jp6cr: value-spec={short-label=XDIS_cfiqgomo7qh2q238pmzoagv63, fields=[0, 0, 0, 0, 0, 0, 0, 0]}
    XDIS_1sbl03n5g1wzhawz3y1aoi9p4: value-spec=I_C03_PN14_PRODMD_STAT_ST3_SNA
    XDIS_5d2p5nhgnjmxoegjyc4gst32e: value-spec={short-label=XDIS_exafog8d2nk0ou45h5jel9g32, fields=[I_C02_PT_RDY_V2_PT_NOT_RDY, I_C03_ENGSTARTPN14_STAT_NO_COMBUSTIONSTART_RQ]}
    XDIS_c5svzzqmh3qk6qp7vkubgfe7m: value-spec=VIN_STATUS_VIN_NOT_RECEIVED
    XDIS_cfagkw6zyn9r952v5onwpwdur: value-spec={short-label=XDIS_cb8oq7gvxj3c8xech5q6y41sw, fields=I_C03_ISW_STAT_SNA}
    XDIS_6146w3b2vgdunnu49c413rpbf: value-spec=XDIS_7ng5kr5ou69lt38yxslnp9mv4:7 x 0
    XDIS_2kt9ss9xytkqyzr4359iyexvi: value-spec=0
    XDIS_9yh6bo4rxot1fkk0920219751: value-spec={short-label=XDIS_9snl93i21zwxbpiy4a2tsrrmm, fields=I_C03_ENGSTARTPN14_STAT_NO_COMBUSTIONSTART_RQ}
    Const_CodingDataInit: value-spec=fields=[SarDataStorageStatus:0, MaxNumberofSARWriteCycles:0, NumberofSARWriteCycles:0]
    Const_Ign_Stat_InitVal: value-spec=fields=[ISw_Stat_ST3:0, Veh_Op_Mode_ST3:0, CRC_Ign_Stat_Pr5_ST3:0, SQC_Ign_Stat_Pr5_ST3:0, KG_StartSw_Psd_ST3:0]
    Const_PI_DiagVariant: value-spec=2
    Const_PI_DiagVersion: value-spec=0
    XDIS_1czwqwie4vy3rtud2d7rlsckr: value-spec={short-label=XDIS_52sq9hudo29ib7j7iqssjcd84, fields=[I_C07_PER_0TO100_1_SNA_SNA percent, I_C10_TO_1022_1_SNA, I_C11_0_2046_1_SNA, I_C16_0_65533_1_SNA]}
    XDIS_1iem5v7ndkwhbdnvd3iw0c32a: value-spec=I_C08_PERC_0_254_1_SNA percent
    XDIS_1ro73n58nna7ivlclcwrm9xvh: value-spec={short-label=XDIS_52sq9hudo29ib7j7iqssjcd84, fields=[I_C07_PER_0TO100_1_SNA_SNA percent, I_C10_TO_1022_1_SNA, I_C11_0_2046_1_SNA, I_C16_0_65533_1_SNA]}
    XDIS_2ifmi9jurj9hq7gf07q950soq: value-spec=4
    XDIS_37u1vz1oxwgimiivpur7gcsbr: value-spec={short-label=XDIS_52sq9hudo29ib7j7iqssjcd84, fields=[I_C07_PER_0TO100_1_SNA_SNA percent, I_C10_TO_1022_1_SNA, I_C11_0_2046_1_SNA, I_C16_0_65533_1_SNA]}
    XDIS_39591keljtic2b4b13zudoeg0: value-spec=I_C02_WAKEUP_STAT_SNA
    XDIS_3x52498l7coo3oyyni2d5c5j2: value-spec=-1
    XDIS_4511s3aabcgdkpe2axjc7gzxv: value-spec=0
    XDIS_69jg6h6dhtx5icztjq3x4sq6f: value-spec=TRUE
    XDIS_6fnp3mro0uta1gwffq0bfsel0: value-spec=XDIS_7ng5kr5ou69lt38yxslnp9mv4:7 x 0
    XDIS_6jf2057vzskie1sao2lzuvwe6: value-spec={short-label=XDIS_52sq9hudo29ib7j7iqssjcd84, fields=[I_C07_PER_0TO100_1_SNA_SNA percent, I_C10_TO_1022_1_SNA, I_C11_0_2046_1_SNA, I_C16_0_65533_1_SNA]}
    XDIS_6tzpenvfivlvlq0j4xgjdh9k7: value-spec={short-label=XDIS_52sq9hudo29ib7j7iqssjcd84, fields=[I_C07_PER_0TO100_1_SNA_SNA percent, I_C10_TO_1022_1_SNA, I_C11_0_2046_1_SNA, I_C16_0_65533_1_SNA]}
    XDIS_6xfhgyu1ikjrqljmxhsy1gdbn: value-spec=65535
    XDIS_70kx5sniz2mav2x11hrmvjbpo: value-spec=I_C02_INACT_ACT_ST3_INACTIVE
    XDIS_76qrtrdtukkzs2abeyipv4tw8: value-spec=XDIS_6cyo2ajxhc1fvx5jpyykk2pos:3000 x 0
    XDIS_7m32ze473bspgglxjgcvf4996: value-spec={short-label=XDIS_52sq9hudo29ib7j7iqssjcd84, fields=[I_C07_PER_0TO100_1_SNA_SNA percent, I_C10_TO_1022_1_SNA, I_C11_0_2046_1_SNA, I_C16_0_65533_1_SNA]}
    XDIS_7szikvdwzq1b962h5gxvmrg2u: value-spec={short-label=XDIS_52sq9hudo29ib7j7iqssjcd84, fields=[I_C07_PER_0TO100_1_SNA_SNA percent, I_C10_TO_1022_1_SNA, I_C11_0_2046_1_SNA, I_C16_0_65533_1_SNA]}
    XDIS_82ba1o608pvmae4mjoh2xupug: value-spec=FALSE
    XDIS_86cgixlat1gzw7ridya4l3yvg: value-spec=32
    XDIS_8lojm7nsrlij3camx6n94jzo8: value-spec=I_COM_C04_SIG121_SNA
    XDIS_8ymqkhaj6x9epi3t7udp3cvlw: value-spec=I_C10_WU_REASON_ECUX_SNA
    XDIS_927sr7e5jercp2xdgv74pbpok: value-spec=255
    XDIS_9br2cbqn3yqyive818t7irvmp: value-spec=0
    XDIS_b7prl6oobd5u5033mtut4jwvn: value-spec={short-label=XDIS_566ibuw2rjxsau7hr8az7xzft, fields=[I_C02_NOTACTV_ACTV_SNA_SNA, I_C03_OFF_ON_CHNG_IDLE_ST3_SNA]}
    XDIS_c3mj3wt15yz2lvo6vab7ajqft: value-spec={short-label=XDIS_566ibuw2rjxsau7hr8az7xzft, fields=[I_C02_NOTACTV_ACTV_SNA_SNA, I_C03_OFF_ON_CHNG_IDLE_ST3_SNA]}
    XDIS_c5zwxf9u0v1jevpkuyek992t0: value-spec=32767
    XDIS_ce5s2juhaacvffo732sn2kms7: value-spec={short-label=XDIS_52sq9hudo29ib7j7iqssjcd84, fields=[I_C07_PER_0TO100_1_SNA_SNA percent, I_C10_TO_1022_1_SNA, I_C11_0_2046_1_SNA, I_C16_0_65533_1_SNA]}
    XDIS_ckr3lp5wr0cqe6i2oclzuasuk: value-spec=0
    XDIS_clk6954ou39yiqqejf1k65voj: value-spec={short-label=XDIS_4jr0poyznuqw4ktxf6qf96hsc, fields=[4203, I_C02_PT_RDY_V2_PT_NOT_RDY, 0, I_C03_ENGSTARTPN14_STAT_NO_COMBUSTIONSTART_RQ, I_C02_NDEF_FALSE_TRUE_ST3_SNA, 1]}
    XDIS_cynynxvcrwcjj9mh2pni0aw3f: value-spec=4294967295
    XDIS_d8ygj72mhg3r09d8kaikrluou: value-spec={short-label=XDIS_93e9rdjh1y4lzklkyrubh6c0k, fields=[4294967295, 13866, 0]}
    XDIS_df34ublxsfrlyl4twdm6pzpqv: value-spec={short-label=XDIS_52sq9hudo29ib7j7iqssjcd84, fields=[I_C07_PER_0TO100_1_SNA_SNA percent, I_C10_TO_1022_1_SNA, I_C11_0_2046_1_SNA, I_C16_0_65533_1_SNA]}
    XDIS_dj45cy8ua216iwtra2tj416zq: value-spec={short-label=XDIS_9ymmxy7m5tg4q9tbeg5hcoi71, fields=[I_C08_KM_P_H_0_254_1_SNA km_per_h, 19913, 0]}
    XDIS_eaw5br234rla8x8gro0ue6n0p: value-spec=0
    XDIS_ewn2l7a4y8reumsogphyjzww5: value-spec=3
    XDIS_ey3cre7b3cnomwxl2ccjj953u: value-spec=4
    XDIS_m223zh8cvs0ihyqs8dhx6193: value-spec=2147483647
    XDIS_yt0ngo0kc6dn4f2zwu57kafr: value-spec={short-label=XDIS_52sq9hudo29ib7j7iqssjcd84, fields=[I_C07_PER_0TO100_1_SNA_SNA percent, I_C10_TO_1022_1_SNA, I_C11_0_2046_1_SNA, I_C16_0_65533_1_SNA]}
    XDIS_6efbipe0xf9n4p1rmexr8mnnj: value-spec={short-label=XDIS_cfiqgomo7qh2q238pmzoagv63, fields=[0, 0, 0, 0, 0, 0, 0, 0]}
    XDIS_byyw7b3ki3w79jkgp9jr5allr: value-spec={short-label=XDIS_cfiqgomo7qh2q238pmzoagv63, fields=[0, 0, 0, 0, 0, 0, 0, 0]}
    XDIS_7ll3jj0kzg4pxwvhz4t7z1xms: value-spec={short-label=XDIS_cfiqgomo7qh2q238pmzoagv63, fields=[0, 0, 0, 0, 0, 0, 0, 0]}
    XDIS_b85l3m8lohhyt5iyy8nt9fl9i: value-spec=421
    XDIS_27u3muzqwjdvnos2w0sy90oxa: value-spec={short-label=XDIS_cb8oq7gvxj3c8xech5q6y41sw, fields=I_C03_ISW_STAT_SNA}
    XDIS_8ty18e89uj9dq1u10d39n5ao8: value-spec={short-label=XDIS_bovl0bjib7uo985od58blbz7v, fields=I_C24_KM_0_999999K9_0K1_INVLD_SNA_SNA km}
    XDIS_e2iocagv39mx6wej6m836yqb3: value-spec=VIN_STATUS_VIN_NOT_RECEIVED
    XDIS_c8apwmaohcx1gxigvciebloy2: value-spec=I_C03_PN14_TDP_SW_STAT_CLS
    XDIS_3jaoqj7gfnekl0vo7yq70x2ub: value-spec=I_C10_WAKEUPRSN_ST3_SNA
    XDIS_69x5rmbg27ofsxv5i93olbdcr: value-spec=420
    XDIS_2a2yz5m526fyufrfge0jdvur9: value-spec=I_C03_MSGTYP_1_TO_7_SNA
    XDIS_1k0wiwna366gg0qdmxvrmtw5q: value-spec={short-label=XDIS_9hvbkka170yl6etmcwyrh4eap, fields=I_C05_DPC_MD_PT_HU_INIT}
    XDIS_6wuj3k3qgtyyc049tu8amprma: value-spec={short-label=XDIS_ee4p105ywwn9heijfmn3b3jg, fields=I_C02_TURNINDLVR_STAT_IDLE}
    XDIS_8ptnmozvvqneybwnb1dteqblf: value-spec={short-label=XDIS_6isyyzebeds108o3ab34q3cxt, fields=[I_C03_ISW_STAT_SNA, I_C04_VEHOPMODE_DRV, 20886, 0, FALSE]}
    XDIS_4ns7wihv1xzpelli7hay25trg: value-spec={short-label=XDIS_78e41cybpxnvmypt91j7w8nmy, fields=I_C03_ACCEL_MD_ST3_SNA}
    XDIS_1vei4uht6zuq0e57z2qtds6y7: value-spec=I_C02_OFF_ON_SNA
    XDIS_5tr223jg6fys3d0tv4s093nze: value-spec=I_C05_ADAS_PROFSHORT_PROFTYP_SNA
    XDIS_e0ppmab9qlp72wzp0n595ikyr: value-spec={short-label=XDIS_29gp3gkr16d8wzky08i3yrpe4, fields=[I_C10_ADAS_COUNTRYCODE_ESC_CODE, I_C15_ADAS_REGIONCODE_SNA]}
    XDIS_9jzhpgyeg4j2n16k3jmfeesjo: value-spec=I_C10_V_0_25K55_0K025_SNA V
    XDIS_avyye5ls1y4c08a0jv466vs3h: value-spec=I_C02_OFF_STAGE1_STAGE2_SNA
    XDIS_2cviwteq6sdkb41vg3juq8qm5: value-spec={short-label=XDIS_45chk5c1kie5pdyiy2mtjbwzy, fields=[I_C02_DR_STAT_SNA, I_C02_DR_STAT_SNA]}
    XDIS_c1pv78wydh7xh2ji5cbkvskd: value-spec={short-label=XDIS_2pa9byy2m92rf3kcoup4f5x85, fields=[FALSE, FALSE, FALSE, FALSE, 11251, 0, FALSE, FALSE, FALSE, FALSE]}
    XDIS_5khg03e556s88aodw5p7cozx4: value-spec=I_C12_KM_P_H_0_409K4_0K1_SNA km_per_h
    XDIS_8ocy3iwo1ditemd6qwphg7b7i: value-spec={short-label=XDIS_d6lrvzktu48vf7hie870x3b9k, fields=I_C04_DRVPOSN_ST3_SNA}
    XDIS_95xfwhvar8lzg9cdzofn4oooa: value-spec={short-label=XDIS_zrx4ogvhxq7ai48rfe46f7vu, fields=[I_C08_ROE_0_IDLE, 0, 0, 0, 0, 0, 0, 0]}
    XDIS_cy54nb3vm043oo6et4rw4sxxi: value-spec=I_C02_PRESF_DISP_RQ_IDLE
    XDIS_7tqm5jy9oba0thvws62i3l28n: value-spec={short-label=XDIS_9sadpb0o8br1anquuvdlkue1g, fields=[I_C02_EVC_STAT_SNA, I_C02_STSTYLE_SNA]}
    XDIS_18rb2bxx4r5d75figzrcw50gp: value-spec=I_C02_TRANSMD_STAT_SNA
    XDIS_f4mtuwvd3r353o80f6rps7w7: value-spec=I_C02_NDEF_FALSE_TRUE_ST3_SNA
    XDIS_4um78o9kgep1cp3dhn51ycc2o: value-spec=I_C03_PN14_PRODMD_STAT_ST3_SNA
    XDIS_9pu33xhskzhvc3a6idhpuk7uh: value-spec=I_C02_BELTHDOVR_STAT_SNA
    XDIS_by5k2ulzqy4hav7734lki195k: value-spec={short-label=XDIS_cuxmhh54637rqd3m4k9u39c14, fields=[15, I_C02_BCKL_SW_STAT_SNA, I_C02_BCKL_SW_STAT_SNA, 33522, 0]}
    XDIS_12iby7nm3kigcbaip97m7b94m: value-spec={short-label=XDIS_73zfi9caggnpz2b3fv0mi7ndh, fields=[I_C09_MS_0_510_5_SNA ms, 0, I_C13_M_0_8190_1_SNA m, I_C06_IDX_0_TO_63_1_UNKNOWN, I_C09_M_P_S_M12K8_89K2_0K2_SNA m_per_s]}
    XDIS_1lex2znuqx5p6s5yy1dyffpdg: value-spec={short-label=XDIS_dn0hnalxhx2w9dwpl0o4sy62k, fields=[0, 255, I_C04_PRESF_LVL_V2_NOLVL, I_C02_PRESF_SND_IDLE, I_C02_NDEF_FALSE_TRUE_ST3_TRUE, I_C02_FALSE_TRUE_SNA_SNA, I_C02_FALSE_TRUE_SNA_SNA, I_C03_NO_LT_RT_BOTH_SNA, 56639, 0, I_C04_PRESF_FRCT_ST3_SNA]}
    XDIS_9h6oqehaueepowg2tijus0mir: value-spec={short-label=XDIS_exafog8d2nk0ou45h5jel9g32, fields=[I_C02_PT_RDY_V2_PT_NOT_RDY, I_C03_ENGSTARTPN14_STAT_NO_COMBUSTIONSTART_RQ]}
    XDIS_edxyn89atnnz30urbv61ma706: value-spec=I_C02_INACTV_SILENT_ACTV_ST3_SNA
    XDIS_5q6kecggtt6ixzqit96uyqmo3: value-spec={short-label=XDIS_dzxw39vv3y93x2k7kpiqoh8vy, fields=[0 m, I_C13_M_0_8190_1_SNA m, I_C06_IDX_0_TO_63_1_UNKNOWN, I_C01_FALSETRUE_FALSE, I_C10_TO_1022_1_SNA, 0]}
    XDIS_ax33oucaqs87guek1p0j7vyqa: value-spec=0
    XDIS_4wiqeqoz18rz4k73xcp12oii1: value-spec={short-label=XDIS_8v43f93fx5woul7qt69hogym6, fields=[10339, I_C06_RBTM_LVL_RQ_NONE, I_C06_RBTM_LVL_RQ_NONE, 15, 0]}
    XDIS_1ib0iwqn283njrf47me9zcot: value-spec={short-label=XDIS_45chk5c1kie5pdyiy2mtjbwzy, fields=[I_C02_BCKL_SW_STAT_SNA, I_C02_BCKL_SW_STAT_SNA]}
    XDIS_806a649zhaoqji1vpc640aqar: value-spec={short-label=XDIS_6g69i1lp40t4493s15rxp0nq, fields=I_C02_STSTYLE_SNA}
    XDIS_6ihabh6lptobki7z27hgr4m4g: value-spec={short-label=XDIS_f01vcqqh5o1hzml38cyktzy9a, fields=I_C02_PT_RDY_V2_PT_NOT_RDY}
    XDIS_8ojfkfkqplxm6o5fjyuoflsu9: value-spec={short-label=XDIS_eod6s0bgmkg5hm1p11g96wo16, fields=[I_C04_PRESF_LVL_V2_NOLVL, I_C02_NDEF_FALSE_TRUE_ST3_TRUE]}
    XDIS_chxf7btms1nmfvn0rkw64k08e: value-spec=I_C06_RBTM_LVL_STAT_NONE
    XDIS_ech1daxmjqjqyzrsfliduv3re: value-spec=I_C04_RBTM_ACTVCLIENT_NONE
    XDIS_dclbmhxy3xotv8ng3m00etq21: value-spec={short-label=XDIS_9snl93i21zwxbpiy4a2tsrrmm, fields=I_C03_ENGSTARTPN14_STAT_NO_COMBUSTIONSTART_RQ}
    XDIS_2f2k10or7fzjcnsiqkruf2jdj: value-spec=421
    APPLINIT_KB8_BUCKLE_SWITCH_OPEN: value-spec=170
package /Daimler/SwcDiag/ConstantSpecifications
  4 x constant specification:
    BusIgnitionStatusRecordInit: value-spec=fields=SWCDIAG_IGNITION_INVALID
    BusOdometerInvalid: value-spec=16777215
    BusOdometerRecordInit: value-spec=fields=constant-reference={short-label=BusOdometerValueInit, constant=BusOdometerInvalid}
    VehicleStartUpRecordInit: value-spec={short-label=XDIS_cb8oq7gvxj3c8xech5q6y41sw, fields=PT4_PTCoor_EngStartPN14_Stat_ST3:SWCDIAG_VES_SNA}
