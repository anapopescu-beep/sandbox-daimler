[part 4 of 4: packages /PortInterfaces to /Interfaces]
AUTOSAR XML (schema 00049)
package /PortInterfaces
  81 x sender receiver interface, all with category=FUNCTIONAL:
    IF_ADAS_Prediction_MsgTyp_ST3  # ADAS Prediction: Message Type
      data ADAS_Prediction_MsgTyp_ST3: category=VALUE, sw-calibration-access=READ-WRITE, type=c03_MsgTyp_1_to_7  # SHORT: ADAS Prediction: Message Type LONG: ADAS Prediction: Message Type
    IF_ADAS_ProfShort_ProfTyp_ST3  # Profile Short Message: Profiltyp / Profile Short Message: Profile Type
      data ADAS_ProfShort_ProfTyp_ST3: category=VALUE, sw-calibration-access=READ-WRITE, type=c05_ADAS_ProfShort_ProfTyp  # SHORT: Profile Short Message: Profiltyp LONG: Profile Short Message: Profiltyp / SHORT: Profile Short Message: Profile Type LONG: Profile Short Message: Profile Type
    IF_Awake_Diag_Actv_RBTM_FL_ST3  # Wachhalten für Diagnose aktiv / Stay awake for diagnostics active
      data Awake_Diag_Actv_RBTM_FL_ST3: category=BOOLEAN, sw-calibration-access=READ-WRITE, type=DC_BOOL  # SHORT: Wachhalten für Diagnose aktiv LONG: Wachhalten für Diagnose aktiv / SHORT: Stay awake for diagnostics active LONG: Stay awake for diagnostics active
    IF_Awake_Ignition_On_RBTM_FL_ST3  # Wachhalten für Zündung eingeschaltet / Stay awake for ignition on
      data Awake_Ignition_On_RBTM_FL_ST3: category=BOOLEAN, sw-calibration-access=READ-WRITE, type=DC_BOOL  # SHORT: Wachhalten für Zündung eingeschaltet LONG: Wachhalten für Zündung eingeschaltet / SHORT: Stay awake for ignition on LONG: Stay awake for ignition on
    IF_Awake_NwStart_RBTM_FL_ST3  # Wachhalten für Netzwerkstartphase / Stay awake for network startup
      data Awake_NwStart_RBTM_FL_ST3: category=BOOLEAN, sw-calibration-access=READ-WRITE, type=DC_BOOL  # SHORT: Wachhalten für Netzwerkstartphase LONG: Wachhalten für Netzwerkstartphase / SHORT: Stay awake for network startup LONG: Stay awake for network startup
    IF_BeltHdOvr_XX_Stat_ST3  # Status Gurtbringer / Belt hand over state
      data BeltHdOvr_XX_Stat_ST3: category=VALUE, sw-calibration-access=READ-WRITE, type=c02_BeltHdOvr_Stat  # SHORT: Status Gurtbringer LONG: Status Gurtbringer / SHORT: Belt hand over state LONG: Belt hand over state
    IF_BltSlckDec_Md_Rq_HU_ST3  # Anforderung Modus Gurtlosereduktion von Headunit / Belt slack decreasing mode request from Head Unit
      data BltSlckDec_Md_Rq_HU_ST3: category=VALUE, sw-calibration-access=READ-WRITE, type=c02_Off_On  # SHORT: Anforderung Modus Gurtlosereduktion von Headunit LONG: Anforderung Modus Gurtlosereduktion von Headunit / SHORT: Belt slack decreasing mode request from Head Unit LONG: Belt slack decreasing mode request from Head Unit
    IF_BltSlckDec_Md_XX_Stat_ST3  # Modus Gurtlosereduktion Status / Belt slack decreasing mode state
      data BltSlckDec_Md_XX_Stat_ST3: category=VALUE, sw-calibration-access=READ-WRITE, type=c02_Off_On  # SHORT: Modus Gurtlosereduktion Status vorne links LONG: Modus Gurtlosereduktion Status vorne links / SHORT: Belt slack decreasing mode front left state LONG: Belt slack decreasing mode front left state
    IF_DidA_ExtTest_Pres_ST3  # DidA Externer Tester erkannt / DidA external tester present
      data DidA_ExtTest_Pres_ST3: category=VALUE, sw-calibration-access=READ-WRITE, type=c02_Ndef_False_True_ST3  # SHORT: DidA Externer Tester erkannt LONG: DidA Externer Tester erkannt / SHORT: DidA external tester present LONG: DidA external tester present
    IF_ECU_Id_RBTM_FL_ST3  # ECU-Identifizierungsnummer / ECU identifier
      data ECU_Id_RBTM_FL_ST3: category=VALUE, sw-calibration-access=READ-WRITE, type=c12_0_4094_1_SNA  # SHORT: ECU-Identifizierungsnummer LONG: ECU-Identifizierungsnummer / SHORT: ECU identifier LONG: ECU identifier
    IF_Navi_RouteGuidance_Stat_ST3  # Navigation Status Zielführung / Navigation route guidance state
      data Navi_RouteGuidance_Stat_ST3: category=VALUE, sw-calibration-access=READ-WRITE, type=c02_Inactv_Silent_Actv_ST3  # SHORT: Navigation Status Zielführung LONG: Navigation Status Zielführung / SHORT: Navigation route guidance state LONG: Navigation route guidance state
    IF_PN14_DDP_Sw_Stat_ST3  # Schalterstatus Tiefentladeschutz / Deep discharge protection switch state
      data PN14_DDP_Sw_Stat_ST3: category=VALUE, sw-calibration-access=READ-WRITE, type=c03_PN14_TDP_Sw_Stat  # SHORT: Schalterstatus Tiefentladeschutz LONG: Schalterstatus Tiefentladeschutz / SHORT: Deep discharge protection switch state LONG: Deep discharge protection switch state
    IF_PN14_ProdMd_Stat_ST3  # Status des Bordnetz Produktionsmodus / Powernet production mode state
      data PN14_ProdMd_Stat_ST3: category=VALUE, sw-calibration-access=READ-WRITE, type=c03_PN14_ProdMd_Stat_ST3  # SHORT: Status des Bordnetz Produktionsmodus LONG: Status des Bordnetz Produktionsmodus / SHORT: Powernet production mode state LONG: Powernet production mode state
    IF_PN14_SupBat_Volt_ST3  # Versorgungsbatterie Istspannung / Supply battery voltage
      data PN14_SupBat_Volt_ST3: category=VALUE, sw-calibration-access=READ-WRITE, type=c10_V_0_25k55_0k025  # SHORT: Versorgungsbatterie Istspannung LONG: Versorgungsbatterie Istspannung / SHORT: Supply battery voltage LONG: Supply battery voltage
    IF_PN14_TransMd_Stat_ST3  # Bordnetz Status Transportmodus / Powernet transport mode status
      data PN14_TransMd_Stat_ST3: category=VALUE, sw-calibration-access=READ-WRITE, type=c02_TransMd_Stat  # SHORT: Bordnetz Status Transportmodus LONG: Bordnetz Status Transportmodus / SHORT: Powernet transport mode status LONG: Powernet transport mode status
    IF_PS_Curve_FL_Rq_HU_ST3  # Anforderung PreSafe Curve Modus von Headunit vorne links / PreSafe Curve mode request from headunit front left
      data PS_Curve_FL_Rq_HU_ST3: category=VALUE, sw-calibration-access=READ-WRITE, type=c02_Off_Stage1_Stage2  # SHORT: Anforderung PreSafe Curve Modus von Headunit vorne links / SHORT: PreSafe Curve mode request from headunit front left
    IF_PS_Curve_FL_Stat_ST3  # PreSafe Curve Status vorne links / PreSafe Curve mode state front left
      data PS_Curve_FL_Stat_ST3: category=VALUE, sw-calibration-access=READ-WRITE, type=c02_Off_Stage1_Stage2  # SHORT: PreSafe Curve Status vorne links / SHORT: PreSafe Curve mode state front left
    IF_RBTM_FL_Disp_Rq_ST3  # Presafe Kombimeldung vorne links anzeigen / Presafe display request front left
      data RBTM_FL_Disp_Rq_ST3: category=VALUE, sw-calibration-access=READ-WRITE, type=c02_Presf_Disp_Rq  # SHORT: Presafe Kombimeldung vorne links anzeigen LONG: Presafe Kombimeldung vorne links anzeigen / SHORT: Presafe display request front left LONG: Presafe display request front left
    IF_RBTM_FL_Tgl_ST3  # Presafe Togglebit
      data RBTM_FL_Tgl_ST3: category=BOOLEAN, sw-calibration-access=READ-WRITE, type=DC_BOOL  # SHORT: Presafe Togglebit LONG: Presafe Togglebit
    IF_RevBltTns_FL_ComCyc_Actv_ST3  # Reversibler Gurtstraffer vorne links Komfort-Straffzyklus aktiv / Reversible belt tensioner front left comfort tensioning cycle active
      data RevBltTns_FL_ComCyc_Actv_ST3: category=VALUE, sw-calibration-access=READ-WRITE, type=c02_Ndef_False_True_ST3  # SHORT: Reversibler Gurtstraffer vorne links Komfort-Straffzyklus aktiv LONG: Reversibler Gurtstraffer vorne links Komfort-Straffzyklus aktiv / SHORT: Reversible belt tensioner front left comfort tensioning cycle active LONG: Reversible belt tensioner front left comfort tensioning cycle active
    IF_RevBltTns_FL_SafeCyc_Actv_ST3  # Reversibler Gurtstraffer vorne links Sicherheits-Straffzyklus aktiv / Reversible belt tensioner front left safety tensioning cycle active
      data RevBltTns_FL_SafeCyc_Actv_ST3: category=VALUE, sw-calibration-access=READ-WRITE, type=c02_Ndef_False_True_ST3  # SHORT: Reversibler Gurtstraffer vorne links Sicherheits-Straffzyklus aktiv LONG: Reversibler Gurtstraffer vorne links Sicherheits-Straffzyklus aktiv / SHORT: Reversible belt tensioner front left safety tensioning cycle active LONG: Reversible belt tensioner front left safety tensioning cycle active
    IF_RevBltTns_FR_ComCyc_Actv_ST3  # Reversibler Gurtstraffer vorne rechts Komfort-Straffzyklus aktiv / Reversible belt tensioner front right comfort tensioning cycle active
      data RevBltTns_FR_ComCyc_Actv_ST3: category=VALUE, sw-calibration-access=READ-WRITE, type=c02_Ndef_False_True_ST3  # SHORT: Reversibler Gurtstraffer vorne rechts Komfort-Straffzyklus aktiv LONG: Reversibler Gurtstraffer vorne rechts Komfort-Straffzyklus aktiv / SHORT: Reversible belt tensioner front right comfort tensioning cycle active LONG: Reversible belt tensioner front right comfort tensioning cycle active
    IF_RevBltTns_FR_SafeCyc_Actv_ST3  # Reversibler Gurtstraffer vorne rechts Sicherheits-Straffzyklus aktiv / Reversible belt tensioner front right safety tensioning cycle active
      data RevBltTns_FR_SafeCyc_Actv_ST3: category=VALUE, sw-calibration-access=READ-WRITE, type=c02_Ndef_False_True_ST3  # SHORT: Reversibler Gurtstraffer vorne rechts Sicherheits-Straffzyklus aktiv LONG: Reversibler Gurtstraffer vorne rechts Sicherheits-Straffzyklus aktiv / SHORT: Reversible belt tensioner front right safety tensioning cycle active LONG: Reversible belt tensioner front right safety tensioning cycle active
    IF_RootCert_Stat_ST3  # Status Root Certificate / Root certificate state
      data isProductive: category=BOOLEAN, sw-calibration-access=READ-WRITE, type=DC_BOOL  # SHORT: Status Root Certificate LONG: Status Root Certificate / SHORT: Root certificate state LONG: Root certificate state
    IF_Sec_Event_ST3  # Security-Ereignis / Security event
      data Data: category=ARRAY, sw-calibration-access=READ-WRITE, type=ARR_08_UInt_noSNA_7  # SHORT: Security-Ereignis LONG: Security-Ereignis / SHORT: Security event LONG: Security event
    IF_SecLvl_Stat_ST3  # Status Security-Level / Security level state
      data currentLevel: category=VALUE, sw-calibration-access=READ-WRITE, type=c08_UInt_SNA_na  # SHORT: Status Security-Level LONG: Status Security-Level / SHORT: Security level state LONG: Security level state
    IF_VehSpd_Disp_ST3  # Angezeigte Geschwindigkeit (ohne Zeigerdämpfung) / Displayed vehicle speed (without attenuation)
      data VehSpd_Disp_ST3: category=VALUE, sw-calibration-access=READ-WRITE, type=c12_km_p_h_0_409k4_0k1  # SHORT: Angezeigte Geschwindigkeit (ohne Zeigerdämpfung) LONG: Angezeigte Geschwindigkeit (ohne Zeigerdämpfung) / SHORT: Displayed vehicle speed (without attenuation) LONG: Displayed vehicle speed (without attenuation)
    IF_VIN_Stat_ST3  # Status Fahrzeugidentifikationsnummer / Vehicle Indentification Number state
      data status: category=VALUE, sw-calibration-access=READ-WRITE, type=c_DC_VIN_Stat_ST3  # SHORT: Status Fahrzeugidentifikationsnummer LONG: Status Fahrzeugidentifikationsnummer / SHORT: Vehicle Indentification Number state LONG: Vehicle Indentification Number state
    IF_WakeupRsn_RBTM_FL_ST3  # Weckgrund / Wakeup reason
      data WakeupRsn_RBTM_FL_ST3: category=VALUE, sw-calibration-access=READ-WRITE, type=c10_WakeupRsn_ST3  # SHORT: Weckgrund LONG: Weckgrund / SHORT: Wakeup reason LONG: Wakeup reason
    IG_ADAS_Meta_ST3  # ADAS Metadaten / ADAS meta data
      data ADAS_Meta_ST3: category=STRUCTURE, sw-calibration-access=READ-WRITE, type=REC_ADAS_Meta_ST3  # SHORT: ADAS Metadaten LONG: ADAS Metadaten / SHORT: ADAS meta data LONG: ADAS meta data
    IG_ADAS_Meta_ST3_5t037gwmf9dl2hvml0jpnv9dy  # ADAS Metadaten (degraded) / ADAS meta data (degraded)
      data ADAS_Meta_ST3: category=STRUCTURE, sw-calibration-access=READ-WRITE, type=REC_ADAS_Meta_ST3_b2mk60164reg2lw3ivnikdnou  # SHORT: ADAS Metadaten LONG: ADAS Metadaten (degraded) / SHORT: ADAS meta data LONG: ADAS meta data (degraded)
    IG_ADAS_Posn_ST3  # ADAS Position
      data ADAS_Posn_ST3: category=STRUCTURE, sw-calibration-access=READ-WRITE, type=REC_ADAS_Posn_ST3  # SHORT: ADAS Position LONG: ADAS Position
    IG_ADAS_Posn_ST3_7s6pzau51nozrnxlccvr1dqvq  # ADAS Position (degraded)
      data ADAS_Posn_ST3: category=STRUCTURE, sw-calibration-access=READ-WRITE, type=REC_ADAS_Posn_ST3_7tu0j7cag3wthixhamscgyjyr  # SHORT: ADAS Position LONG: ADAS Position (degraded)
    IG_ADAS_Profile_Short_CurvLn_ST3  # ADAS Kurzcharakteristik Curvature Linear / ADAS short profile Curvature Linear
      data ADAS_Profile_Short_CurvLn_ST3: category=STRUCTURE, sw-calibration-access=READ-WRITE, type=REC_ADAS_Profile_Short_CurvLn_ST3  # SHORT: ADAS Kurzcharakteristik Curvature Linear LONG: ADAS Kurzcharakteristik Curvature Linear / SHORT: ADAS short profile Curvature Linear LONG: ADAS short profile Curvature Linear
    IG_ADAS_Profile_Short_CurvLn_ST3_81w1wno7bbxberhwp2jcfr8tz  # ADAS Kurzcharakteristik Curvature Linear (degraded) / ADAS short profile Curvature Linear (degraded)
      data ADAS_Profile_Short_CurvLn_ST3: category=STRUCTURE, sw-calibration-access=READ-WRITE, type=REC_ADAS_Profile_Short_CurvLn_ST3_490g5rtcnid4ivawivkcosvcg  # SHORT: ADAS Kurzcharakteristik Curvature Linear LONG: ADAS Kurzcharakteristik Curvature Linear (degraded) / SHORT: ADAS short profile Curvature Linear LONG: ADAS short profile Curvature Linear (degraded)
    IG_Bckl_Sw_Fx_Stat_Pr5_ST3  # Bckl Sw Fx Status ST3 / Bckl Sw Fx state ST3
      data Bckl_Sw_Fx_Stat_Pr5_ST3: category=STRUCTURE, sw-calibration-access=READ-WRITE, type=REC_Bckl_Sw_Fx_Stat_Pr5_ST3  # SHORT: Bckl Sw Fx Status ST3 LONG: Bckl Sw Fx Status ST3 / SHORT: Bckl Sw Fx state ST3 LONG: Bckl Sw Fx state ST3
    IG_Bckl_Sw_Fx_Stat_Pr5_ST3_17uc3mdc2gwtci163emdxcwq  # Bckl Sw Fx Status ST3 (degraded) / Bckl Sw Fx state ST3 (degraded)
      data Bckl_Sw_Fx_Stat_Pr5_ST3: category=STRUCTURE, sw-calibration-access=READ-WRITE, type=REC_Bckl_Sw_Fx_Stat_Pr5_ST3_42w45002bze5mo286svxxsdbx  # SHORT: Bckl Sw Fx Status ST3 LONG: Bckl Sw Fx Status ST3 (degraded) / SHORT: Bckl Sw Fx state ST3 LONG: Bckl Sw Fx state ST3 (degraded)
    IG_Bckl_Sw_Fx_Stat_Pr5_ST3_6ckxfn8j26ez9slws8s7zuact  # Bckl Sw Fx Status ST3 (degraded) / Bckl Sw Fx state ST3 (degraded)
      data Bckl_Sw_Fx_Stat_Pr5_ST3: category=STRUCTURE, sw-calibration-access=READ-WRITE, type=REC_Bckl_Sw_Fx_Stat_Pr5_ST3_cp6wyrd9cg7ec7y2w3khz1gyt  # SHORT: Bckl Sw Fx Status ST3 LONG: Bckl Sw Fx Status ST3 (degraded) / SHORT: Bckl Sw Fx state ST3 LONG: Bckl Sw Fx state ST3 (degraded)
    IG_CLkS_DrRltch_Stat_Pr5_ST3  # Zentralverriegelung Status Drehfalle Türen / Central Locking System Rotary latch doors state
      data CLkS_DrRltch_Stat_Pr5_ST3: category=STRUCTURE, sw-calibration-access=READ-WRITE, type=REC_CLkS_DrRltch_Stat_Pr5_ST3  # SHORT: Zentralverriegelung Status Drehfalle Türen LONG: Zentralverriegelung Status Drehfalle Türen / SHORT: Central Locking System Rotary latch doors state LONG: Central Locking System Rotary latch doors state
    IG_CLkS_DrRltch_Stat_Pr5_ST3_9cjfjqoxzg8myue62zdg7b3ws  # Zentralverriegelung Status Drehfalle Türen (degraded) / Central Locking System Rotary latch doors state (degraded)
      data CLkS_DrRltch_Stat_Pr5_ST3: category=STRUCTURE, sw-calibration-access=READ-WRITE, type=REC_CLkS_DrRltch_Stat_Pr5_ST3_42w45002bze5mo286svxxsdbx  # SHORT: Zentralverriegelung Status Drehfalle Türen LONG: Zentralverriegelung Status Drehfalle Türen (degraded) / SHORT: Central Locking System Rotary latch doors state LONG: Central Locking System Rotary latch doors state (degraded)
    IG_Develop8_Rq_RBTM_FL_ST3  # Development Request
      data Develop8_Rq_RBTM_FL_ST3: category=STRUCTURE, sw-calibration-access=READ-WRITE, type=REC_Develop8_Rq_RBTM_FL_ST3  # SHORT: Development Request LONG: Development Request
    IG_Develop8_Rq_RBTM_FL_ST3_38ed4c8igp8xxzbei3a6bgrm1  # Development Request (degraded)
      data Develop8_Rq_RBTM_FL_ST3: category=STRUCTURE, sw-calibration-access=READ-WRITE, type=REC_Develop8_Rq_RBTM_FL_ST3_dgfi1nrxtb0voy6rb7ybeonmv  # SHORT: Development Request LONG: Development Request (degraded)
    IG_Develop8_Rs_RBTM_FL_ST3  # Development Response
      data Develop8_Rs_RBTM_FL_ST3: category=STRUCTURE, sw-calibration-access=READ-WRITE, type=REC_Develop8_Rs_RBTM_FL_ST3  # SHORT: Development Response LONG: Development Response
    IG_Develop8_Rs_RBTM_FL_ST3_25obewk81wuyc38kk70ol6f0x  # Development Response (degraded)
      data Develop8_Rs_RBTM_FL_ST3: category=STRUCTURE, sw-calibration-access=READ-WRITE, type=REC_Develop8_Rs_RBTM_FL_ST3_dgfi1nrxtb0voy6rb7ybeonmv  # SHORT: Development Response LONG: Development Response (degraded)
    IG_DI_Odo_Pr5_ST3  # DriverInformation Odometer
      data DI_Odo_Pr5_ST3: category=STRUCTURE, sw-calibration-access=READ-WRITE, type=REC_DI_Odo_Pr5_ST3  # SHORT: DriverInformation Odometer LONG: DriverInformation Odometer
    IG_DI_Odo_Pr5_ST3_dqmkbik4b90gceqe8t96kp3yd  # DriverInformation Odometer (degraded)
      data DI_Odo_Pr5_ST3: category=STRUCTURE, sw-calibration-access=READ-WRITE, type=REC_DI_Odo_Pr5_ST3_9t50popkpz30is106xpis1iyh  # SHORT: DriverInformation Odometer LONG: DriverInformation Odometer (degraded)
    IG_DPC_Md_Rq_ESP_Pr5_ST3  # Dynamic select Anforderung Pr 5 ST3 / Dynamic select request Pr 5 ST3
      data DPC_Md_Rq_ESP_Pr5_ST3: category=STRUCTURE, sw-calibration-access=READ-WRITE, type=REC_DPC_Md_Rq_ESP_Pr5_ST3  # SHORT: Dynamic select Anforderung Pr 5 ST3 LONG: Dynamic select Anforderung Pr 5 ST3 / SHORT: Dynamic select request Pr 5 ST3 LONG: Dynamic select request Pr 5 ST3
    IG_DPC_Md_Rq_ESP_Pr5_ST3_f0hx0tjzowsztgrknro9jwuwh  # Dynamic select Anforderung Pr 5 ST3 (degraded) / Dynamic select request Pr 5 ST3 (degraded)
      data DPC_Md_Rq_ESP_Pr5_ST3: category=STRUCTURE, sw-calibration-access=READ-WRITE, type=REC_DPC_Md_Rq_ESP_Pr5_ST3_18cj3r9lb95cc7w4q3mwqkn86  # SHORT: Dynamic select Anforderung Pr 5 ST3 LONG: Dynamic select Anforderung Pr 5 ST3 (degraded) / SHORT: Dynamic select request Pr 5 ST3 LONG: Dynamic select request Pr 5 ST3 (degraded)
    IG_ELC_Lvr_Stat_Pr5_ST3  # Status Bedienhebel Außenlicht / Exterior light lever state
      data ELC_Lvr_Stat_Pr5_ST3: category=STRUCTURE, sw-calibration-access=READ-WRITE, type=REC_ELC_Lvr_Stat_Pr5_ST3  # SHORT: Status Bedienhebel Außenlicht LONG: Status Bedienhebel Außenlicht / SHORT: Exterior light lever state LONG: Exterior light lever state
    IG_ELC_Lvr_Stat_Pr5_ST3_7k1u3p95ebi3423irpcsvtgpy  # Status Bedienhebel Außenlicht (degraded) / Exterior light lever state (degraded)
      data ELC_Lvr_Stat_Pr5_ST3: category=STRUCTURE, sw-calibration-access=READ-WRITE, type=REC_ELC_Lvr_Stat_Pr5_ST3_9t50popkpz30is106xpis1iyh  # SHORT: Status Bedienhebel Außenlicht LONG: Status Bedienhebel Außenlicht (degraded) / SHORT: Exterior light lever state LONG: Exterior light lever state (degraded)
    IG_EVC_CfgList_01_08_Pr5_ST3  # EVC Cfg List 01 08 Pr 5 ST3
      data EVC_CfgList_01_08_Pr5_ST3: category=STRUCTURE, sw-calibration-access=READ-WRITE, type=REC_EVC_CfgList_01_08_Pr5_ST3  # SHORT: EVC Cfg List 01 08 Pr 5 ST3
    IG_EVC_CfgList_01_08_Pr5_ST3_40zxqtxkwyhasb66rr3qexjf2  # EVC Cfg List 01 08 Pr 5 ST3 (degraded)
      data EVC_CfgList_01_08_Pr5_ST3: category=STRUCTURE, sw-calibration-access=READ-WRITE, type=REC_EVC_CfgList_01_08_Pr5_ST3_ezyv7tcqxjqun5qfzxokvhqqw  # SHORT: EVC Cfg List 01 08 Pr 5 ST3 LONG: (degraded)
    IG_EVC_CfgList_01_08_Pr5_ST3_c4dxipryk2cdf6g3u376iowg4  # EVC Cfg List 01 08 Pr 5 ST3 (degraded)
      data EVC_CfgList_01_08_Pr5_ST3: category=STRUCTURE, sw-calibration-access=READ-WRITE, type=REC_EVC_CfgList_01_08_Pr5_ST3_6v3sj55wsjghho72slblc9pby  # SHORT: EVC Cfg List 01 08 Pr 5 ST3 LONG: (degraded)
    IG_Ign_Stat_Pr5_ST3  # Zuendungsstatus / Ignition state
      data Ign_Stat_Pr5_ST3: category=STRUCTURE, sw-calibration-access=READ-WRITE, type=REC_Ign_Stat_Pr5_ST3  # SHORT: Zuendungsstatus / SHORT: Ignition state
    IG_Ign_Stat_Pr5_ST3_46s203zrl2qg54zbkbmirlx2b  # Zuendungsstatus (degraded) / Ignition state (degraded)
      data Ign_Stat_Pr5_ST3: category=STRUCTURE, sw-calibration-access=READ-WRITE, type=REC_Ign_Stat_Pr5_ST3_bt5mk3546wsooydubq849n96  # SHORT: Zuendungsstatus LONG: (degraded) / SHORT: Ignition state LONG: (degraded)
    IG_Ign_Stat_Pr5_ST3_8qpxphk9meu9oryi6bfj0x04b  # Zuendungsstatus (degraded) / Ignition state (degraded)
      data Ign_Stat_Pr5_ST3: category=STRUCTURE, sw-calibration-access=READ-WRITE, type=REC_Ign_Stat_Pr5_ST3_b0ko81o0x5jgvwtduf99gvzi0  # SHORT: Zuendungsstatus LONG: (degraded) / SHORT: Ignition state LONG: (degraded)
    IG_Meas8_RBTM_FL_ST3  # Messbotschaft / Measurement
      data Meas8_RBTM_FL_ST3: category=STRUCTURE, sw-calibration-access=READ-WRITE, type=REC_Meas_RBTM_FL_ST3  # SHORT: Messbotschaft LONG: Messbotschaft / SHORT: Measurement LONG: Measurement
    IG_Meas8_RBTM_FL_ST3_dcsffxmk4lebax14ae8jyr2nd  # Messbotschaft (degraded) / Measurement (degraded)
      data Meas8_RBTM_FL_ST3: category=STRUCTURE, sw-calibration-access=READ-WRITE, type=REC_Meas_RBTM_FL_ST3_dgfi1nrxtb0voy6rb7ybeonmv  # SHORT: Messbotschaft LONG: Messbotschaft (degraded) / SHORT: Measurement LONG: Measurement (degraded)
    IG_ORC_Impact2_Pr5_ST3  # ORC Impact 2 ST3
      data ORC_Impact2_Pr5_ST3: category=STRUCTURE, sw-calibration-access=READ-WRITE, type=REC_ORC_Impact2_Pr5_ST3  # SHORT: ORC Impact 2 ST3 LONG: ORC Impact 2 ST3
    IG_ORC_Impact2_Pr5_ST3_9ccpksmbwqz15ty9t9jr7ps1e  # ORC Impact 2 ST3 (degraded)
      data ORC_Impact2_Pr5_ST3: category=STRUCTURE, sw-calibration-access=READ-WRITE, type=REC_ORC_Impact2_Pr5_ST3_9t50popkpz30is106xpis1iyh  # SHORT: ORC Impact 2 ST3 LONG: ORC Impact 2 ST3 (degraded)
    IG_ORC_Impact3_Pr5_ST3  # ORC Impact 3 ST3
      data ORC_Impact3_Pr5_ST3: category=STRUCTURE, sw-calibration-access=READ-WRITE, type=REC_ORC_Impact3_Pr5_ST3  # SHORT: ORC Impact 3 ST3 LONG: ORC Impact 3 ST3
    IG_ORC_Impact3_Pr5_ST3_35qgq57bw73eamvx4gelk7iiv  # ORC Impact 3 ST3 (degraded)
      data ORC_Impact3_Pr5_ST3: category=STRUCTURE, sw-calibration-access=READ-WRITE, type=REC_ORC_Impact3_Pr5_ST3_8q27fswita0fglxxeoewe0y19  # SHORT: ORC Impact 3 ST3 LONG: ORC Impact 3 ST3 (degraded)
    IG_ORC_Impact3_Pr5_ST3_boka15h37szrnh5alpfk2b7or  # ORC Impact 3 ST3 (degraded)
      data ORC_Impact3_Pr5_ST3: category=STRUCTURE, sw-calibration-access=READ-WRITE, type=REC_ORC_Impact3_Pr5_ST3_b4auermbjwizt3ufwg8j8br58  # SHORT: ORC Impact 3 ST3 LONG: ORC Impact 3 ST3 (degraded)
    IG_PresfAct_Adj_Pr5_ST3  # Presf Aktor Steuerung ST3 / Presf Actuator adjustment ST3
      data PresfAct_Adj_Pr5_ST3: category=STRUCTURE, sw-calibration-access=READ-WRITE, type=REC_PresfAct_Adj_Pr5_ST3  # SHORT: Presf Aktor Steuerung ST3 LONG: Presf Aktor Steuerung ST3 / SHORT: Presf Actuator adjustment ST3 LONG: Presf Actuator adjustment ST3
    IG_PresfAct_Adj_Pr5_ST3_863uuptg5wch3t7i31c8crpa2  # Presf Aktor Steuerung ST3 (degraded) / Presf Actuator adjustment ST3 (degraded)
      data PresfAct_Adj_Pr5_ST3: category=STRUCTURE, sw-calibration-access=READ-WRITE, type=REC_PresfAct_Adj_Pr5_ST3_14lojwgkcazelrb438elf5h0j  # SHORT: Presf Aktor Steuerung ST3 LONG: Presf Aktor Steuerung ST3 (degraded) / SHORT: Presf Actuator adjustment ST3 LONG: Presf Actuator adjustment ST3 (degraded)
    IG_PresfAct_Adj_Pr5_ST3_eyis6oex84f0bgtf7tp8d31fv  # Presf Aktor Steuerung ST3 (degraded) / Presf Actuator adjustment ST3 (degraded)
      data PresfAct_Adj_Pr5_ST3: category=STRUCTURE, sw-calibration-access=READ-WRITE, type=REC_PresfAct_Adj_Pr5_ST3_1fn392wedbq10w68dtk77u1sr  # SHORT: Presf Aktor Steuerung ST3 LONG: Presf Aktor Steuerung ST3 (degraded) / SHORT: Presf Actuator adjustment ST3 LONG: Presf Actuator adjustment ST3 (degraded)
    IG_PT4_PTCoor4_Pr5_ST3  # PT4_PTCoor4_Pr5_ST3
      data PT4_PTCoor4_Pr5_ST3: category=STRUCTURE, sw-calibration-access=READ-WRITE, type=REC_PT4_PTCoor4_Pr5_ST3  # SHORT: PT4_PTCoor4_Pr5_ST3 LONG: PT4_PTCoor4_Pr5_ST3
    IG_PT4_PTCoor4_Pr5_ST3_3rxtipq9xm5agzf69e8usehmj  # PT4_PTCoor4_Pr5_ST3 (degraded)
      data PT4_PTCoor4_Pr5_ST3: category=STRUCTURE, sw-calibration-access=READ-WRITE, type=REC_PT4_PTCoor4_Pr5_ST3_ezyv7tcqxjqun5qfzxokvhqqw  # SHORT: PT4_PTCoor4_Pr5_ST3 LONG: PT4_PTCoor4_Pr5_ST3 (degraded)
    IG_PT4_PTCoor4_Pr5_ST3_4jqmw0h0uwztlkj3fjsj9fpfe  # PT4_PTCoor4_Pr5_ST3 (degraded)
      data PT4_PTCoor4_Pr5_ST3: category=STRUCTURE, sw-calibration-access=READ-WRITE, type=REC_PT4_PTCoor4_Pr5_ST3_6v3sj55wsjghho72slblc9pby  # SHORT: PT4_PTCoor4_Pr5_ST3 LONG: PT4_PTCoor4_Pr5_ST3 (degraded)
    IG_PT4_PTCoor4_Pr5_ST3_druj0u2sr9nv67kbxk0u6ab4e  # PT4_PTCoor4_Pr5_ST3 (degraded)
      data PT4_PTCoor4_Pr5_ST3: category=STRUCTURE, sw-calibration-access=READ-WRITE, type=REC_PT4_PTCoor4_Pr5_ST3_9t50popkpz30is106xpis1iyh  # SHORT: PT4_PTCoor4_Pr5_ST3 LONG: PT4_PTCoor4_Pr5_ST3 (degraded)
    IG_PT4_PTCoor9_Pr5_ST3  # PT4 PT Coor 9 Pr 5 ST3
      data PT4_PTCoor9_Pr5_ST3: category=STRUCTURE, sw-calibration-access=READ-WRITE, type=REC_PT4_PTCoor9_Pr5_ST3  # SHORT: PT4 PT Coor 9 Pr 5 ST3
    IG_PT4_PTCoor9_Pr5_ST3_a7spavm295u68551d0tj6tl4v  # PT4 PT Coor 9 Pr 5 ST3 (degraded)
      data PT4_PTCoor9_Pr5_ST3: category=STRUCTURE, sw-calibration-access=READ-WRITE, type=REC_PT4_PTCoor9_Pr5_ST3_cl82h0erzy2xfmj19jwk97p4u  # SHORT: PT4 PT Coor 9 Pr 5 ST3 LONG: (degraded)
    IG_PT4_PTCoor_DrvPosn_Gear_Pr5_ST3  # PT4 PT Coor Drv Position Gear Pr 5 ST3 / PT4 PT Coor Drv position Gear Pr 5 ST3
      data PT4_PTCoor_DrvPosn_Gear_Pr5_ST3: category=STRUCTURE, sw-calibration-access=READ-WRITE, type=REC_PT4_PTCoor_DrvPosn_Gear_Pr5_ST3  # SHORT: PT4 PT Coor Drv Position Gear Pr 5 ST3 LONG: PT4 PT Coor Drv Position Gear Pr 5 ST3 / SHORT: PT4 PT Coor Drv position Gear Pr 5 ST3 LONG: PT4 PT Coor Drv position Gear Pr 5 ST3
    IG_PT4_PTCoor_DrvPosn_Gear_Pr5_ST3_c8lirmw9wm5odas0h648yyd4w  # PT4 PT Coor Drv Position Gear Pr 5 ST3 (degraded) / PT4 PT Coor Drv position Gear Pr 5 ST3 (degraded)
      data PT4_PTCoor_DrvPosn_Gear_Pr5_ST3: category=STRUCTURE, sw-calibration-access=READ-WRITE, type=REC_PT4_PTCoor_DrvPosn_Gear_Pr5_ST3_9t50popkpz30is106xpis1iyh  # SHORT: PT4 PT Coor Drv Position Gear Pr 5 ST3 LONG: PT4 PT Coor Drv Position Gear Pr 5 ST3 (degraded) / SHORT: PT4 PT Coor Drv position Gear Pr 5 ST3 LONG: PT4 PT Coor Drv position Gear Pr 5 ST3 (degraded)
    IG_ROE_XX_ST3  # Ereignis-Antwort / Response on Event
      data ROE_XX_ST3: category=STRUCTURE, sw-calibration-access=READ-WRITE, type=REC_ROE_XX_ST3  # SHORT: Ereignis-Antwort LONG: Ereignis-Antwort / SHORT: Response on Event LONG: Response on Event
    IG_ROE_XX_ST3_4ewk6hdthg4k2abg4vkvktubw  # Ereignis-Antwort (degraded) / Response on Event (degraded)
      data ROE_XX_ST3: category=STRUCTURE, sw-calibration-access=READ-WRITE, type=REC_ROE_XX_ST3_dgfi1nrxtb0voy6rb7ybeonmv  # SHORT: Ereignis-Antwort LONG: Ereignis-Antwort (degraded) / SHORT: Response on Event LONG: Response on Event (degraded)
    IG_VSS_TP_Auth_ST3  # VSS-Transportprotokoll für Authentifizierung / Vehicle Security System Transport Protocol for authentication broadcast
      data VSS_TP_Auth_ST3: category=ARRAY, sw-calibration-access=READ-WRITE, type=ARR_08_UInt_noSNA_8  # SHORT: VSS-Transportprotokoll für Authentifizierung LONG: VSS-Transportprotokoll für Authentifizierung / SHORT: Vehicle Security System Transport Protocol for authentication broadcast LONG: Vehicle Security System Transport Protocol for authentication broadcast
    IG_VSS_TP_RealTmOffset_ST3  # VSS-Transportprotokoll für Echtzeit-Offset / Vehicle Security System Transport Protocol for real time offset broadcast
      data VSS_TP_RealTmOffset_ST3: category=ARRAY, sw-calibration-access=READ-WRITE, type=ARR_08_UInt_noSNA_8  # SHORT: VSS-Transportprotokoll für Fahrzeugidentifikationsnummer LONG: VSS-Transportprotokoll für Fahrzeugidentifikationsnummer / SHORT: Vehicle Security System Transport Protocol for Vehicle Identification Number LONG: Vehicle Security System Transport Protocol for Vehicle Identification Number
    IG_VSS_TP_SecTickCount_ST3  # VSS-Transportprotokoll für sichere Zeit / Vehicle Security System Transport Protocol for secure tick count
      data VSS_TP_SecTickCount_ST3: category=ARRAY, sw-calibration-access=READ-WRITE, type=ARR_08_UInt_noSNA_8  # SHORT: VSS-Transportprotokoll für sichere Zeit LONG: VSS-Transportprotokoll für Fahrzeugidentifikationsnummer / SHORT: Vehicle Security System Transport Protocol for secure tick count LONG: Vehicle Security System Transport Protocol for Vehicle Identification Number
    IG_VSS_TP_SharedSecret_ST3  # VSS-Transportprotokoll für gemeinsames Geheimnis / Vehicle Security System Transport Protocol for shared secret broadcast
      data VSS_TP_SharedSecret_ST3: category=ARRAY, sw-calibration-access=READ-WRITE, type=ARR_08_UInt_noSNA_8  # SHORT: VSS-Transportprotokoll für Fahrzeugidentifikationsnummer LONG: VSS-Transportprotokoll für Fahrzeugidentifikationsnummer / SHORT: Vehicle Security System Transport Protocol for Vehicle Identification Number LONG: Vehicle Security System Transport Protocol for Vehicle Identification Number
    IG_VSS_TP_VIN_ST3  # VSS-Transportprotokoll für Fahrzeugidentifikationsnummer / Vehicle Security System Transport Protocol for Vehicle Identification Number
      data VSS_TP_VIN_ST3: category=ARRAY, sw-calibration-access=READ-WRITE, type=ARR_08_UInt_noSNA_8  # SHORT: VSS-Transportprotokoll für Fahrzeugidentifikationsnummer LONG: VSS-Transportprotokoll für Fahrzeugidentifikationsnummer / SHORT: Vehicle Security System Transport Protocol for Vehicle Identification Number LONG: Vehicle Security System Transport Protocol for Vehicle Identification Number
  8 x client server interface, all with category=FUNCTIONAL:
    ICS_DiagInfo_ST3  # Diagnose-Information / Diagnostic information
      operation Get: possible-error=ICS_DiagInfo_ST3/E_NOT_OK  # SHORT: Get LONG: Get
        arg diagVersion: type=c08_UInt_SNA_na, direction=OUT, server-argument-impl-policy=USE-ARGUMENT-TYPE  # Diagnostic version
        arg diagVariant: type=c08_UInt_SNA_na, direction=OUT, server-argument-impl-policy=USE-ARGUMENT-TYPE  # Diagnostic variant
      error E_NOT_OK: category=FUNCTIONAL, error-code=1  # Not ok
    ICS_KeyStorage_ST3  # Schlüssel-Speicher / Key storage
      operation StorePermanently: possible-error=[ICS_KeyStorage_ST3/E_NOT_OK, ICS_KeyStorage_ST3/E_PENDING]
        arg keyStorageUseCase: type=cDC_keyStorageUseCase_ST3, direction=IN, server-argument-impl-policy=USE-ARGUMENT-TYPE
        arg keyStorageTask: type=cDC_keyStorageTask_ST3, direction=IN, server-argument-impl-policy=USE-ARGUMENT-TYPE
      error E_NOT_OK: category=FUNCTIONAL, error-code=1  # Not ok
      error E_PENDING: category=FUNCTIONAL, error-code=2  # Pending
    ICS_LocTickCount_ST3  # Lokale Zeit / Local tick count
      operation Get: possible-error=ICS_LocTickCount_ST3/E_NOT_OK  # SHORT: Get LONG: Get
        arg tickCount: type=cDC_tickCount_ST3, direction=OUT, server-argument-impl-policy=USE-ARGUMENT-TYPE  # Tick count
      error E_NOT_OK: category=FUNCTIONAL, error-code=1  # Not ok
    ICS_LocTickCountSync_Stat_ST3  # Synchronisations-Status lokale Zeit / Local tick count synchronisation state
      operation Get: possible-error=ICS_LocTickCountSync_Stat_ST3/E_NOT_OK  # SHORT: Get LONG: Get
        arg syncState: type=cDC_syncState_ST3, direction=OUT, server-argument-impl-policy=USE-ARGUMENT-TYPE  # Tick count
      error E_NOT_OK: category=FUNCTIONAL, error-code=1  # Not ok
    ICS_LogSecBoot_Event_ST3  # Security Boot-Ereignis aufzeichnen / Log security boot event
      operation LogSecBootEvent: possible-error=ICS_LogSecBoot_Event_ST3/E_NOT_OK  # SHORT: Log security boot event LONG: Log security boot event
      error E_NOT_OK: category=FUNCTIONAL, error-code=1  # Not ok
    ICS_SecAccess_ST3  # Security-Zugriff / Security access
      operation CompareKey: possible-error=ICS_SecAccess_ST3/E_NOT_OK  # SHORT: Compare key LONG: Compare key
        arg secLevel: type=c08_UInt_SNA_na, direction=IN, server-argument-impl-policy=USE-ARGUMENT-TYPE  # Security level
        arg key: type=ARR_08_UInt_noSNA_64, direction=IN, server-argument-impl-policy=USE-ARGUMENT-TYPE  # Key
        arg errorCode: type=cDC_errorCode_ST3, direction=OUT, server-argument-impl-policy=USE-ARGUMENT-TYPE  # Error code
      operation GetSeed: possible-error=ICS_SecAccess_ST3/E_NOT_OK  # SHORT: Get seed LONG: Get seed
        arg secLevel: type=c08_UInt_SNA_na, direction=IN, server-argument-impl-policy=USE-ARGUMENT-TYPE  # Security level
        arg seed: type=ARR_08_UInt_noSNA_32, direction=OUT, server-argument-impl-policy=USE-ARGUMENT-TYPE  # Seed
        arg errorCode: type=cDC_errorCode_ST3, direction=OUT, server-argument-impl-policy=USE-ARGUMENT-TYPE  # Error code
      error E_NOT_OK: category=FUNCTIONAL, error-code=1  # Not ok
    ICS_VIN_Ctrl_ST3  # Steuerung Fahrzeugidentifikationsnummer / Vehicle Identification Number control
      operation Lock: possible-error=ICS_VIN_Ctrl_ST3/E_NOT_OK  # SHORT: Lock VIN LONG: Lock VIN
        arg Locked: type=DC_BOOL, direction=IN, server-argument-impl-policy=USE-ARGUMENT-TYPE  # Vehicle Identification Number is locked
      operation Set: possible-error=ICS_VIN_Ctrl_ST3/E_NOT_OK  # SHORT: Set VIN LONG: Set VIN
        arg VIN: type=ARR_08_UInt_noSNA_17, direction=IN, server-argument-impl-policy=USE-ARGUMENT-TYPE  # Vehicle Identification Number
      error E_NOT_OK: category=FUNCTIONAL, error-code=1  # Error: not ok
    ICS_VIN_ST3  # Fahrzeugidentifikationsnummer / Vehicle Identification Number
      operation Get: possible-error=ICS_VIN_ST3/E_NOT_OK  # SHORT: Get VIN LONG: Get VIN
        arg VIN: type=ARR_08_UInt_noSNA_17, direction=OUT, server-argument-impl-policy=USE-ARGUMENT-TYPE  # Vehicle Identification Number
      error E_NOT_OK: category=FUNCTIONAL, error-code=1  # Error: not ok
  mode switch interface P_MDG_Coding_Stat_ST3: category=FUNCTIONAL  # Kodierungs-Status / Coding state
    mode group Coding_Status: category=FUNCTIONAL, type=ModeDeclarationGroups/Coding_Mode  # P_MDG_Coding_Stat_ST3 | Kodierungs-Status / Coding state
  5 x client server interface:
    AppDcm_Ssa_KeyStorage  # Ssa Key Storage
      operation StorePermanently: possible-error=[AppDcm_Ssa_KeyStorage/E_NOT_OK, AppDcm_Ssa_KeyStorage/E_PENDING]  # Storing the Key permanently
        arg keyStorageUseCase: type=Ssa_KeyStorageUseCaseType, direction=IN, server-argument-impl-policy=USE-ARGUMENT-TYPE
        arg keyStorageTask: type=Ssa_KeyStorageTaskType, direction=IN, server-argument-impl-policy=USE-ARGUMENT-TYPE
      error E_NOT_OK: error-code=1
      error E_PENDING: error-code=2
    ICS_COM_C04_Sig002  # ICS COM C04 Sig 002
      operation CS_Operation_C04_Sig002: possible-error=[ICS_COM_C04_Sig002/E_NOT_OK, ICS_COM_C04_Sig002/E_OK]  # Operation crated for CTP-11414
        arg InParameters: type=c08_perc_0_254_1, direction=IN, server-argument-impl-policy=USE-ARGUMENT-TYPE
        arg outParameters: type=c16_0_65533_1, direction=OUT, server-argument-impl-policy=USE-ARGUMENT-TYPE
      error E_NOT_OK: error-code=1
      error E_OK: error-code=0
    Pi_MBBL_ApplicationShutdown
      operation ShutdownAppl_HardReset
      operation ShutdownAppl_SoftReset
    Pi_MBBL_ResetPreconditions
      operation CheckConditions
        arg resetAllowed: type=boolean, direction=OUT, server-argument-impl-policy=USE-ARGUMENT-TYPE
        arg errorCode: type=Dcm_NegativeResponseCodeType, direction=OUT, server-argument-impl-policy=USE-ARGUMENT-TYPE
    Pi_ResetExecution
      operation HardReset
        arg prepareWatchdog: type=boolean, direction=IN, server-argument-impl-policy=USE-ARGUMENT-TYPE
      operation SoftReset: possible-error=EXECUTION_FAILED
      error EXECUTION_FAILED: error-code=1
  mode switch interface Pi_ApplResetPermission
    mode group Mode: type=Mdcl_MBBL_ApplicationResetPermission
  mode switch interface Pi_ApplResetRequest
    mode group Mode: type=Mdcl_MBBL_ApplicationResetRequest
  parameter interface Pi_InputFileVersions
    parameter data prototype DiagnosticVariant: sw-calibration-access=READ-WRITE, type=uint8
    parameter data prototype DiagnosticVersion: sw-calibration-access=READ-WRITE, type=uint8
  108 x sender receiver interface:
    IF_Actv_Line_Stat_ST3  # Activation Line state
      data Actv_Line_Stat_ST3: sw-calibration-access=READ-WRITE, type=c02_Inact_Act_ST3  # SHORT: Activation Line state LONG: Activation Line state
    IF_Awake_Diag_Actv  # Awake_Diag_Actv
      data Awake_Diag_Actv: sw-calibration-access=READ-WRITE, type=DC_BOOL  # SHORT: Awake_Diag_Actv LONG: Awake_Diag_Actv
    IF_Awake_Diag_Actv_ECU4  # Awake_Diag_Actv_ECU4
      data Awake_Diag_Actv_ECU4: sw-calibration-access=READ-WRITE, type=DC_BOOL  # SHORT: Awake_Diag_Actv_ECU4 LONG: Network mangement mode
    IF_Awake_Ignition_On  # Awake_Ignition_On
      data Awake_Ignition_On: sw-calibration-access=READ-WRITE, type=DC_BOOL  # SHORT: Awake_Ignition_On LONG: Awake_Ignition_On
    IF_Awake_Ignition_On_C04  # Awake_Ignition_On_C04
      data Awake_Ignition_On_C04: sw-calibration-access=READ-WRITE, type=DC_BOOL  # SHORT: Awake_Ignition_On_C04 LONG: Network mangement mode
    IF_Awake_NwStart_Cluster_ECU4  # Awake_NwStart_Cluster_ECU4
      data Awake_NwStart_Cluster_ECU4: sw-calibration-access=READ-WRITE, type=DC_BOOL  # SHORT: Awake_NwStart_Cluster_ECU4 LONG: Network mangement mode
    IF_Awake_NwStart_Cluster_ECU4_1  # Awake_NwStart_Cluster_ECU4
      data Awake_NwStart_Cluster_ECU4: sw-calibration-access=READ-WRITE, type=DC_BOOL  # SHORT: Awake_NwStart_Cluster_ECU4 LONG: Network mangement mode
    IF_Awake_NwStart_Cluster_ECU4_2  # Awake_NwStart_Cluster_ECU4
      data Awake_NwStart_Cluster_ECU4: sw-calibration-access=READ-WRITE, type=DC_BOOL  # SHORT: Awake_NwStart_Cluster_ECU4 LONG: Network mangement mode
    IF_Awake_NwStart_Cluster_ECU4_3  # Awake_NwStart_Cluster_ECU4
      data Awake_NwStart_Cluster_ECU4: sw-calibration-access=READ-WRITE, type=DC_BOOL  # SHORT: Awake_NwStart_Cluster_ECU4 LONG: Network mangement mode
    IF_Awake_NwStart_Cluster_ECU4_4  # Awake_NwStart_Cluster_ECU4
      data Awake_NwStart_Cluster_ECU4: sw-calibration-access=READ-WRITE, type=DC_BOOL  # SHORT: Awake_NwStart_Cluster_ECU4 LONG: Network mangement mode
    IF_COM_C01_Sig01_PN08  # COM_C01_Sig01_PN08
      data COM_C01_Sig01_PN08: sw-calibration-access=READ-WRITE, type=DT_uint8  # SHORT: COM_C01_Sig01_PN08 LONG: Communication Application signal for the PN-8 specific to ECU01.
    IF_COM_C01_Sig01_PN17  # COM_C01_Sig01_PN17
      data COM_C01_Sig01_PN17: sw-calibration-access=READ-WRITE, type=DT_uint8  # SHORT: COM_C01_Sig01_PN17 LONG: Communication Application signal for the PN 17(ECU01).
    IF_COM_C01_Sig01_PN44  # COM_C01_Sig01_PN44
      data COM_C01_Sig01_PN44: sw-calibration-access=READ-WRITE, type=DT_uint8  # SHORT: COM_C01_Sig01_PN44 LONG: Communication Application signal for the PN 44(ECU01).
    IF_COM_C01_Sig01_PN53  # COM_C01_Sig01_PN53
      data COM_C01_Sig01_PN53: sw-calibration-access=READ-WRITE, type=DT_uint8  # SHORT: COM_C01_Sig01_PN53 LONG: Communication Application signal for the PN 53(ECU01).
    IF_COM_C01_Sig01_PN62  # COM_C01_Sig01_PN62
      data COM_C01_Sig01_PN62: sw-calibration-access=READ-WRITE, type=DT_uint8  # SHORT: COM_C01_Sig01_PN62 LONG: Communication Application signal for the PN 62(ECU01).
    IF_COM_C04_Sig005  # COM C04 Sig 005
      data COM_C04_Sig005: sw-calibration-access=READ-WRITE, type=DT_SInt32  # SHORT: COM C04 Sig 005 LONG: Signal Created for ECU04. to be sent over CANFD using Container (example created for MMA project)
    IF_COM_C04_Sig006  # COM C04 Sig 006
      data COM_C04_Sig006: sw-calibration-access=READ-WRITE, type=DT_Uint16  # SHORT: COM C04 Sig 006 LONG: Signal Created for ECU04. to be sent over CANFD using Container (example created for MMA project)
    IF_COM_C04_Sig007  # COM C04 Sig 007
      data COM_C04_Sig007: sw-calibration-access=READ-WRITE, type=sint16_s16  # SHORT: COM C04 Sig 007 LONG: Signal Created for ECU04. to be sent over CANFD using Container (example created for MMA project)
    IF_COM_C04_Sig008  # replicated from COM C04 Sig 008
      data COM_C04_Sig008: sw-calibration-access=READ-WRITE, type=DT_SInt32  # SHORT: replicated from COM C04 Sig 008 LONG: CTP_MMA: Signal Created for ECU04. to be sent over CANFD using Container (example created for MMA project)
    IF_COM_C04_Sig01_PN08  # COM_C04_Sig01_PN08
      data COM_C04_Sig01_PN08: sw-calibration-access=READ-WRITE, type=DT_uint8  # SHORT: COM_C04_Sig01_PN08 LONG: Communication Application signal for the PN-8 specific to ECU04
    IF_COM_C04_Sig01_PN17  # COM_C04_Sig01_PN17
      data COM_C04_Sig01_PN17: sw-calibration-access=READ-WRITE, type=DT_uint8  # SHORT: COM_C04_Sig01_PN17 LONG: Communication Application signal for the PN 17(ECU04).
    IF_COM_C04_Sig01_PN44  # COM_C04_Sig01_PN44
      data COM_C04_Sig01_PN44: sw-calibration-access=READ-WRITE, type=DT_uint8  # SHORT: COM_C04_Sig01_PN44 LONG: Communication Application signal for the PN 44(ECU01).
    IF_COM_C04_Sig01_PN53  # COM_C04_Sig01_PN53
      data COM_C04_Sig01_PN53: sw-calibration-access=READ-WRITE, type=DT_uint8  # SHORT: COM_C04_Sig01_PN53 LONG: Communication Application signal for the PN 53(ECU04).
    IF_COM_C04_Sig01_PN62  # COM_C04_Sig01_PN62
      data COM_C04_Sig01_PN62: sw-calibration-access=READ-WRITE, type=DT_uint8  # SHORT: COM_C04_Sig01_PN62 LONG: Communication Application signal for the PN 62(ECU04).
    IF_COM_C04_Sig121  # IF COM C04 Sig 121
      data COM_C04_Sig121: sw-calibration-access=READ-WRITE, type=COM_C04_Sig121
    IF_COM_C04_Sig1Cyc_1  # 1 Bit cyclic Signal
      data COM_C04_Sig1Cyc_1: sw-calibration-access=READ-WRITE, type=DAI_boolean  # SHORT: 1 Bit cyclic Signal LONG: 1 Bit cyclic Signal Source Signal: "SIG_1Ch_Einf_125k_A01_0001_06"
    IF_COM_C04_Sig221  # COM C04 Sig 121
      data COM_C04_Sig221: sw-calibration-access=READ-WRITE, type=c08_perc_0_254_1  # SHORT: COM C04 Sig 121
    IF_COM_C04_Sig2Cyc_7  # 7 Bit Cyclic Signal
      data COM_C04_Sig2Cyc_7: sw-calibration-access=READ-WRITE, type=c07_na_0_to_127_1  # SHORT: 7 Bit Cyclic Signal LONG: 7 Bit Cyclic Signal Source Signal: SIG_1Ch_Einf_125k_A01_0001_06
    IF_COM_C04_Sig3Cyc_9  # 9 Bit Cyclic Signal
      data COM_C04_Sig3Cyc_9: sw-calibration-access=READ-WRITE, type=c09_na_0_to_511_1  # SHORT: 9 Bit Cyclic Signal LONG: 9 Bit Cyclic Signal Source Signal: SIG_1Ch_Einf_125k_A01_0016_04
    IF_COM_C04_Sig4Cyc_24  # 24 bit cyclic signal
      data COM_C04_Sig4Cyc_24: sw-calibration-access=READ-WRITE, type=c24_na_0_to_16777215_1  # SHORT: 24 bit cyclic signal LONG: 24 bit cyclic signal Source Signal: ECU_1Ch_Einf_DefUnEqSNA_Grp_Si1
    IF_COM_C07_Sig01_PN08  # COM_C07_Sig01_PN08
      data COM_C07_Sig01_PN08: sw-calibration-access=READ-WRITE, type=DT_uint8  # SHORT: COM_C07_Sig01_PN08 LONG: Communication Application signal for the PN-8 specific to ECU01.
    IF_COM_C07_Sig01_PN44  # COM_C07_Sig01_PN44
      data COM_C07_Sig01_PN44: sw-calibration-access=READ-WRITE, type=DT_uint8  # SHORT: COM_C07_Sig01_PN44 LONG: Communication Application signal for the PN 44(ECU01).
    IF_COM_C07_Sig01_PN53  # COM_C07_Sig01_PN53
      data COM_C07_Sig01_PN53: sw-calibration-access=READ-WRITE, type=DT_uint8  # SHORT: COM_C07_Sig01_PN53 LONG: Communication Application signal for the PN 53(ECU01).
    IF_COM_C0X_Sig121  # IF COM C0X Sig 121
      data COM_C0X_Sig121: sw-calibration-access=READ-WRITE, type=COM_C04_Sig121
    IF_COM_C0X_Sig221  # COM C0X Sig 121
      data COM_C0X_Sig221: sw-calibration-access=READ-WRITE, type=c08_perc_0_254_1  # SHORT: COM C04 Sig 121
    IF_COM_C10_Sig01_PN08  # COM_C10_Sig01_PN08
      data COM_C10_Sig01_PN08: sw-calibration-access=READ-WRITE, type=DT_uint8  # SHORT: COM_C10_Sig01_PN08 LONG: Communication Application signal for the PN-8 specific to ECU01.
    IF_COM_C10_Sig01_PN17  # COM_C10_Sig01_PN17
      data COM_C10_Sig01_PN17: sw-calibration-access=READ-WRITE, type=DT_uint8  # SHORT: COM_C10_Sig01_PN17 LONG: Communication Application signal for the PN 17(ECU10).
    IF_COM_C19_Sig002  # COM_C19_Sig002
      data COM_C19_Sig002: sw-calibration-access=READ-WRITE, type=DT_SInt32  # SHORT: COM_C19_Sig002 LONG: Signal Created for ECU04. to be received over CANFD using Container (example created for MMA project)
    IF_COM_C19_Sig003  # COM_C19_Sig003
      data COM_C19_Sig003: sw-calibration-access=READ-WRITE, type=DT_Uint32  # SHORT: COM_C19_Sig003 LONG: CTP_MMA: Signal Created for ECU04. to be received over CANFD using Container (example created for MMA project)
    IF_COM_C19_Sig004  # COM_C19_Sig004
      data COM_C19_Sig004: sw-calibration-access=READ-WRITE, type=DT_SInt32  # SHORT: COM_C19_Sig004 LONG: CTP_MMA: Signal Created for ECU04. to be received over CANFD using Container (example created for MMA project)
    IF_COM_C19_Sig005  # COM_C19_Sig005
      data COM_C19_Sig005: sw-calibration-access=READ-WRITE, type=sint16_s16  # SHORT: COM_C19_Sig005 LONG: Signal Created for ECU04. to be received over CANFD using Container (example created for MMA project)
    IF_COM_C19_Sig006  # COM_C19_Sig006
      data COM_C19_Sig006: sw-calibration-access=READ-WRITE, type=DT_Uint16  # SHORT: COM_C19_Sig006 LONG: Signal Created for ECU04. to be recevied over CANFD using Container (example created for MMA project)
    IF_COM_C19_Sig01_PN08  # COM_C19_Sig01_PN08
      data COM_C19_Sig01_PN08: sw-calibration-access=READ-WRITE, type=DT_uint8  # SHORT: COM_C19_Sig01_PN08 LONG: Communication Application signal for the PN-8 specific to ECU19
    IF_COM_C19_Sig01_PN44  # COM_C19_Sig01_PN44
      data COM_C19_Sig01_PN44: sw-calibration-access=READ-WRITE, type=DT_uint8  # SHORT: COM_C19_Sig01_PN44 LONG: Communication Application signal for the PN 44(ECU19).
    IF_COM_SL05_Sig001  # -
      data COM_SL05_Sig001: sw-calibration-access=READ-WRITE, type=c01_bit_dummy  # SHORT: - LONG: Dummy für event triggered frame.
    IF_ECU_ID_C04  # ECU_ID_C04
      data ECU_ID_C04: sw-calibration-access=READ-WRITE, type=c12_na_0_to_4095_1  # SHORT: ECU_ID_C04
    IF_NwId_C04_CAN1  # NwId_C04_CAN1
      data NwId_C04_CAN1: sw-calibration-access=READ-WRITE, type=c08_na_0_to_255_1  # SHORT: NwId_C04_CAN1
    IF_NwId_C04_CANFD1  # NwId_C04_CANFD1
      data NwId_C04_CANFD1: sw-calibration-access=READ-WRITE, type=c08_na_0_to_255_1  # SHORT: NwId_C04_CANFD1
    IF_NwId_C04_ETH_ECU4  # Nw Id C04 ETH ECU4
      data NwId_C04_ETH_ECU4: sw-calibration-access=READ-WRITE, type=c08_na_0_to_255_1  # SHORT: Nw Id C04 ETH ECU4
    IF_RsErr_LIN5_SL05  # RsErr_LIN5_SL05
      data RsErr_LIN5_SL05: sw-calibration-access=READ-WRITE, type=DC_BOOL  # SHORT: RsErr_LIN5_SL05
    IF_WakeupRsn_C04_ECU04  # WakeupRsn_C04_ECU04
      data WakeupRsn_C04_ECU04: sw-calibration-access=READ-WRITE, type=c10_WU_REASON_ECUx  # SHORT: WakeupRsn_C04_ECU04
    IF_WakeupStat_Cluster4_LIN_S5  # Wakeup reason - LIN Slave 5 Cluster 4
      data WakeupStat_Cluster4_LIN_S5: sw-calibration-access=READ-WRITE, type=c02_WakeUp_Stat  # SHORT: Wakeup reason - LIN Slave 5 Cluster 4
    IG_COM_C04_SGR01_P05  # COM_C04_SGR01_P05
      data COM_C04_SGR01_P05: sw-calibration-access=READ-WRITE, type=REC_COM_C04_SGR01_P05  # SHORT: COM_C04_SGR01_P05 LONG: CTP_MMA: Transmission of E2E protected Signalgroup
    IG_COM_C04_SGR01_P05_c6hsbgi3c4px4g6584yndbcpa  # COM_C04_SGR01_P05 (degraded)
      data COM_C04_SGR01_P05: sw-calibration-access=READ-WRITE, type=REC_COM_C04_SGR01_P05_a8oh4dpz9at39a7d7s3b6v4b3  # SHORT: COM_C04_SGR01_P05 LONG: CTP_MMA: Transmission of E2E protected Signalgroup (degraded)
    IG_COM_C04_Sig003  # IG COM C04 Sig 003
      data COM_C04_Sig003: sw-calibration-access=READ-WRITE, type=DT_U8N_3k
    IG_COM_C04_Sig110  # IG COM C04 Sig 110
      data COM_C04_Sig110: sw-calibration-access=READ-WRITE, type=REC_COM_C04_Sig110
    IG_COM_C04_Sig110_7b3u0wokhcir5t9ojho803jlo  # IG COM C04 Sig 110 (degraded)
      data COM_C04_Sig110: sw-calibration-access=READ-WRITE, type=REC_COM_C04_Sig110_71njeubj9ico1p8v4pmslfcno  # LONG: (degraded)
    IG_COM_C04_Sig111  # IG COM C04 Sig 111
      data COM_C04_Sig111: sw-calibration-access=READ-WRITE, type=REC_COM_C04_Sig111
    IG_COM_C04_Sig111_ewu0dq3nt3qeusr2edldyl316  # IG COM C04 Sig 111 (degraded)
      data COM_C04_Sig111: sw-calibration-access=READ-WRITE, type=REC_COM_C04_Sig111_euk2owpx15avykqntci714wbp  # LONG: (degraded)
    IG_COM_C04_Sig112  # IG COM C04 Sig 112
      data COM_C04_Sig112: sw-calibration-access=READ-WRITE, type=REC_COM_C04_Sig112
    IG_COM_C04_Sig112_ahijhd7q72w8d9mdf1ig2jqsk  # IG COM C04 Sig 112 (degraded)
      data COM_C04_Sig112: sw-calibration-access=READ-WRITE, type=REC_COM_C04_Sig112_euk2owpx15avykqntci714wbp  # LONG: (degraded)
    IG_COM_C04_Sig113  # IG COM C04 Sig 113
      data COM_C04_Sig113: sw-calibration-access=READ-WRITE, type=REC_COM_C04_Sig113
    IG_COM_C04_Sig113_51v7mvbom6jtmbd07sdwjz9ef  # IG COM C04 Sig 113 (degraded)
      data COM_C04_Sig113: sw-calibration-access=READ-WRITE, type=REC_COM_C04_Sig113_euk2owpx15avykqntci714wbp  # LONG: (degraded)
    IG_COM_C04_Sig114  # IG COM C04 Sig 114
      data COM_C04_Sig114: sw-calibration-access=READ-WRITE, type=REC_E_COM_C04_Sig114_0
    IG_COM_C04_Sig114_7slo68e3ke0vntpu5ixubs915  # IG COM C04 Sig 114 (degraded)
      data COM_C04_Sig114: sw-calibration-access=READ-WRITE, type=REC_E_COM_C04_Sig114_0_euk2owpx15avykqntci714wbp  # LONG: (degraded)
    IG_COM_C04_Sig115  # IG COM C04 Sig 115
      data COM_C04_Sig115: sw-calibration-access=READ-WRITE, type=REC_COM_C04_Sig115
    IG_COM_C04_Sig115_uj5tgjee02v0jofjb80wozkr  # IG COM C04 Sig 115 (degraded)
      data COM_C04_Sig115: sw-calibration-access=READ-WRITE, type=REC_COM_C04_Sig115_euk2owpx15avykqntci714wbp  # LONG: (degraded)
    IG_COM_C04_Sig116  # IG COM C04 Sig 116
      data COM_C04_Sig116: sw-calibration-access=READ-WRITE, type=REC_REC_COM_C04_Sig116
    IG_COM_C04_Sig116_83oj1gj61smy5awbwq2t4xrgg  # IG COM C04 Sig 116 (degraded)
      data COM_C04_Sig116: sw-calibration-access=READ-WRITE, type=REC_REC_COM_C04_Sig116_euk2owpx15avykqntci714wbp  # LONG: (degraded)
    IG_COM_C04_Sig117  # IG COM C04 Sig 117
      data COM_C04_Sig117: sw-calibration-access=READ-WRITE, type=REC_COM_C04_Sig117
    IG_COM_C04_Sig117_bjp7aiwsqyilfoszjp3qz6jpf  # IG COM C04 Sig 117 (degraded)
      data COM_C04_Sig117: sw-calibration-access=READ-WRITE, type=REC_COM_C04_Sig117_euk2owpx15avykqntci714wbp  # LONG: (degraded)
    IG_COM_C04_Sig118  # IG COM C04 Sig 118
      data COM_C04_Sig118: sw-calibration-access=READ-WRITE, type=REC_COM_C04_Sig118
    IG_COM_C04_Sig118_bz3mia4p4tufd71vbsswaof99  # IG COM C04 Sig 118 (degraded)
      data COM_C04_Sig118: sw-calibration-access=READ-WRITE, type=REC_COM_C04_Sig118_euk2owpx15avykqntci714wbp  # LONG: (degraded)
    IG_COM_C04_Sig119  # IG COM C04 Sig 119
      data COM_C04_Sig119: sw-calibration-access=READ-WRITE, type=REC_COM_C04_Sig119
    IG_COM_C04_Sig119_2k9qo1is8o6w1d2mmkhag3lad  # IG COM C04 Sig 119 (degraded)
      data COM_C04_Sig119: sw-calibration-access=READ-WRITE, type=REC_COM_C04_Sig119_euk2owpx15avykqntci714wbp  # LONG: (degraded)
    IG_COM_C04_Sig120  # IG COM C04 Sig 120
      data COM_C04_Sig120: sw-calibration-access=READ-WRITE, type=REC_COM_C04_Sig120
    IG_COM_C04_Sig120_58xvj9bp1izbowjj6j5xdfirv  # IG COM C04 Sig 120 (degraded)
      data COM_C04_Sig120: sw-calibration-access=READ-WRITE, type=REC_COM_C04_Sig120_euk2owpx15avykqntci714wbp  # LONG: (degraded)
    IG_COM_C0X_Sig110  # IG COM C0X Sig 110
      data COM_C0X_Sig110: sw-calibration-access=READ-WRITE, type=REC_COM_C0X_Sig110
    IG_COM_C0X_Sig110_7om6v3ujiy4kcn42sh03xr6tk  # IG COM C0X Sig 110 (degraded)
      data COM_C0X_Sig110: sw-calibration-access=READ-WRITE, type=REC_COM_C0X_Sig110_71njeubj9ico1p8v4pmslfcno  # LONG: (degraded)
    IG_COM_C0X_Sig110_aew2czq5m7adwnbw854p20yxo  # IG COM C0X Sig 110 (degraded)
      data COM_C0X_Sig110: sw-calibration-access=READ-WRITE, type=REC_COM_C04_Sig110_71njeubj9ico1p8v4pmslfcno  # LONG: (degraded)
    IG_COM_C0X_Sig111  # IG COM C0X Sig 111
      data COM_C0X_Sig111: sw-calibration-access=READ-WRITE, type=REC_COM_C04_Sig111
    IG_COM_C0X_Sig111_849asct3r1b9lmkp8h3zmtqt4  # IG COM C0X Sig 111 (degraded)
      data COM_C0X_Sig111: sw-calibration-access=READ-WRITE, type=REC_COM_C04_Sig111_euk2owpx15avykqntci714wbp  # LONG: (degraded)
    IG_COM_C0X_Sig112  # IG COM C0X Sig 112
      data COM_C0X_Sig112: sw-calibration-access=READ-WRITE, type=REC_COM_C04_Sig112
    IG_COM_C0X_Sig112_8dcjqezupq5hc39mydr3z3vjf  # IG COM C0X Sig 112 (degraded)
      data COM_C0X_Sig112: sw-calibration-access=READ-WRITE, type=REC_COM_C04_Sig112_euk2owpx15avykqntci714wbp  # LONG: (degraded)
    IG_COM_C0X_Sig113  # IG COM C0X Sig 113
      data COM_C0X_Sig113: sw-calibration-access=READ-WRITE, type=REC_COM_C04_Sig113
    IG_COM_C0X_Sig113_1dhxnrrq9b2mgdc5afczbe32i  # IG COM C0X Sig 113 (degraded)
      data COM_C0X_Sig113: sw-calibration-access=READ-WRITE, type=REC_COM_C04_Sig113_euk2owpx15avykqntci714wbp  # LONG: (degraded)
    IG_COM_C0X_Sig114  # IG COM C0X Sig 114
      data COM_C0X_Sig114: sw-calibration-access=READ-WRITE, type=REC_E_COM_C04_Sig114_0
    IG_COM_C0X_Sig114_41jeph0k8sz7i99itgs0jrlff  # IG COM C0X Sig 114 (degraded)
      data COM_C0X_Sig114: sw-calibration-access=READ-WRITE, type=REC_E_COM_C04_Sig114_0_euk2owpx15avykqntci714wbp  # LONG: (degraded)
    IG_COM_C0X_Sig115  # IG COM C0X Sig 115
      data COM_C0X_Sig115: sw-calibration-access=READ-WRITE, type=REC_COM_C04_Sig115
    IG_COM_C0X_Sig115_2kygvblzvr68h5ylizzzjxr93  # IG COM C0X Sig 115 (degraded)
      data COM_C0X_Sig115: sw-calibration-access=READ-WRITE, type=REC_COM_C04_Sig115_euk2owpx15avykqntci714wbp  # LONG: (degraded)
    IG_COM_C0X_Sig116  # IG COM C0X Sig 116
      data COM_C0X_Sig116: sw-calibration-access=READ-WRITE, type=REC_REC_COM_C04_Sig116
    IG_COM_C0X_Sig116_3gq1deafc68ovpungd8x9fomz  # IG COM C0X Sig 116 (degraded)
      data COM_C0X_Sig116: sw-calibration-access=READ-WRITE, type=REC_REC_COM_C04_Sig116_euk2owpx15avykqntci714wbp  # LONG: (degraded)
    IG_COM_C0X_Sig117  # IG COM C0X Sig 117
      data COM_C0X_Sig117: sw-calibration-access=READ-WRITE, type=REC_COM_C04_Sig117
    IG_COM_C0X_Sig117_3pt0ch7aapuke7rwql58ebado  # IG COM C0X Sig 117 (degraded)
      data COM_C0X_Sig117: sw-calibration-access=READ-WRITE, type=REC_COM_C04_Sig117_euk2owpx15avykqntci714wbp  # LONG: (degraded)
    IG_COM_C0X_Sig118  # IG COM C0X Sig 118
      data COM_C0X_Sig118: sw-calibration-access=READ-WRITE, type=REC_COM_C04_Sig118
    IG_COM_C0X_Sig118_d334xwn7cbw64umkn5tc1ka0x  # IG COM C0X Sig 118 (degraded)
      data COM_C0X_Sig118: sw-calibration-access=READ-WRITE, type=REC_COM_C04_Sig118_euk2owpx15avykqntci714wbp  # LONG: (degraded)
    IG_COM_C0X_Sig119  # IG COM C0X Sig 119
      data COM_C0X_Sig119: sw-calibration-access=READ-WRITE, type=REC_COM_C04_Sig119
    IG_COM_C0X_Sig119_bwvfv5mamsjbygo6j4n97r5bt  # IG COM C0X Sig 119 (degraded)
      data COM_C0X_Sig119: sw-calibration-access=READ-WRITE, type=REC_COM_C04_Sig119_euk2owpx15avykqntci714wbp  # LONG: (degraded)
    IG_COM_C0X_Sig120  # IG COM C0X Sig 120
      data COM_C0X_Sig120: sw-calibration-access=READ-WRITE, type=REC_COM_C04_Sig120
    IG_COM_C0X_Sig120_ahr3pw8unw1powayrggilkj6y  # IG COM C0X Sig 120 (degraded)
      data COM_C0X_Sig120: sw-calibration-access=READ-WRITE, type=REC_COM_C04_Sig120_euk2owpx15avykqntci714wbp  # LONG: (degraded)
    IG_PT4_PTCoor4_Pr5_ST3_ca2s46eormi424s6cen48bry3  # PT4_PTCoor4_Pr5_ST3 (degraded)
      data PT4_PTCoor4_Pr5_ST3: sw-calibration-access=READ-WRITE, type=REC_PT4_PTCoor4_Pr5_ST3_a1o7mhv0xy8ny0vccjf09ttgc  # SHORT: PT4_PTCoor4_Pr5_ST3 LONG: PT4_PTCoor4_Pr5_ST3 (degraded)
    IG_SecLog_EventNotification  # IG Sec Log Event Notification
      data Data: sw-calibration-access=READ-WRITE, type=DT_Ssa_Data7ByteType
    IG_VehSpd8_Pr5_ST3  # vehicle Spd 8 ST3
      data VehSpd8_Pr5_ST3: sw-calibration-access=READ-WRITE, type=REC_VehSpd8_Pr5_ST3  # SHORT: vehicle Spd 8 ST3
    IG_VehSpd8_Pr5_ST3_atci5a3rslji054k0igvxyzqz  # vehicle Spd 8 ST3 (degraded)
      data VehSpd8_Pr5_ST3: sw-calibration-access=READ-WRITE, type=REC_VehSpd8_Pr5_ST3_4y11fh5xzvk3axiqy3atn5wk4  # SHORT: vehicle Spd 8 ST3 LONG: (degraded)
    Pi_AwakeReason  # Awake_NwStart_Cluster_ECU4
      data Awake_Reason: sw-calibration-access=READ-WRITE, type=DC_BOOL  # SHORT: Awake_NwStart_Cluster_ECU4 LONG: Network mangement mode
    Pi_Ign_Stat_Pr5_ST3  # Ignition state (degraded)
      data Ign_Stat_Pr5_ST3: sw-calibration-access=READ-WRITE, type=REC_Ign_Stat_Pr5_ST3_b0ko81o0x5jgvwtduf99gvzi0  # SHORT: Ignition state LONG: Ignition state (degraded)
    Pi_IndividualWakeupReasons
      14 x data, all with type=boolean:
        WakeupReason_{1..8}
        WakeupReason_DataExchange
        WakeupReason_EcuX
        WakeupReason_Network
        WakeupReason_Overload
        WakeupReason_SNA
        WakeupReason_VoltageLow
    Pi_WakeupRsn  # WakeupRsn_C04_ECU04
      data WakeupRsn: sw-calibration-access=READ-WRITE, type=c10_WU_REASON_ECUx  # SHORT: WakeupRsn_C04_ECU04
  14 x client server interface:
    IfPwmIfPAL_PwmServices: is-service=true
      operation DisablePWM
        arg arg: type=u8PwmChannelIdType, direction=IN, server-argument-impl-policy=USE-ARGUMENT-TYPE
      operation EnablePWM
        arg arg: type=u8PwmChannelIdType, direction=IN, server-argument-impl-policy=USE-ARGUMENT-TYPE
      operation SetDutyCycle
        arg arg: type=u8PwmChannelIdType, direction=IN, server-argument-impl-policy=USE-ARGUMENT-TYPE
        arg arg_1: type=UInt16, direction=IN, server-argument-impl-policy=USE-ARGUMENT-TYPE
    AdcIf_PMP_SurveyBatteryVoltage: is-service=true
      operation Monitor
    PMP_AdcIf_KL30_V_raw: is-service=true
      5 x operation:
        Get
          arg pu16SampledSignal: type=u16SampledSignalType, direction=INOUT, server-argument-impl-policy=USE-ARGUMENT-TYPE
        Get_100ms
          arg pu16SampledSignal: type=u16SampledSignalType, direction=INOUT, server-argument-impl-policy=USE-ARGUMENT-TYPE
        Get_10ms
          arg pu16SampledSignal: type=u16SampledSignalType, direction=INOUT, server-argument-impl-policy=USE-ARGUMENT-TYPE
        Get_20ms
          arg pu16SampledSignal: type=u16SampledSignalType, direction=INOUT, server-argument-impl-policy=USE-ARGUMENT-TYPE
        Get_2ms
          arg pu16SampledSignal: type=u16SampledSignalType, direction=INOUT, server-argument-impl-policy=USE-ARGUMENT-TYPE
    PMP_AdcIf_Mcu_T_raw: is-service=true
      operation Get_10ms
        arg pu16SampledSignal: type=u16SampledSignalType, direction=INOUT, server-argument-impl-policy=USE-ARGUMENT-TYPE
    CheckPowerSupplyOV
      operation AutotestCallback
        arg pu8TestResult: type=u8TestResultType, direction=INOUT, server-argument-impl-policy=USE-ARGUMENT-TYPE
    CheckPowerSupplyUV
      operation AutotestCallback
        arg pu8TestResult: type=u8TestResultType, direction=INOUT, server-argument-impl-policy=USE-ARGUMENT-TYPE
    CheckHWSelfProtection
      operation AutotestCallback
        arg pu8TestResult: type=u8TestResultType, direction=INOUT, server-argument-impl-policy=USE-ARGUMENT-TYPE
    CheckMotorCurrent
      operation AutotestCallback
        arg pu8TestResult: type=u8TestResultType, direction=INOUT, server-argument-impl-policy=USE-ARGUMENT-TYPE
    CheckMotorThermalProctection
      operation AutotestCallback
        arg pu8TestResult: type=u8TestResultType, direction=INOUT, server-argument-impl-policy=USE-ARGUMENT-TYPE
    pcsMotor_T
      operation GetDeficiencyLevel
        arg pu32DeficiencyLevel: type=u32DeficiencyLevelType, direction=INOUT, server-argument-impl-policy=USE-ARGUMENT-TYPE
      operation InitializeDeficiencyLevel
        arg u32DeficiencyLevel: type=u32DeficiencyLevelType, direction=IN, server-argument-impl-policy=USE-ARGUMENT-TYPE
    pcsMotor_I
      operation Get_A
        arg ps8MotorCurrentInA: type=s8MotorCurrentInAType, direction=INOUT, server-argument-impl-policy=USE-ARGUMENT-TYPE
    pcsMotor_In: is-service=true
      operation raw_Get
        arg pu16SampledSignal: type=u16SampledSignalType, direction=INOUT, server-argument-impl-policy=USE-ARGUMENT-TYPE
      operation raw_Get_10ms
        arg pu16SampledSignal: type=u16SampledSignalType, direction=INOUT, server-argument-impl-policy=USE-ARGUMENT-TYPE
    pcsMotor_Ip: is-service=true
      operation raw_Get
        arg pu16SampledSignal: type=u16SampledSignalType, direction=INOUT, server-argument-impl-policy=USE-ARGUMENT-TYPE
      operation raw_Get_10ms
        arg pu16SampledSignal: type=u16SampledSignalType, direction=INOUT, server-argument-impl-policy=USE-ARGUMENT-TYPE
    pcsAutotestServices
      operation GetTestResult
        arg u8AutotestId: type=u8AutoTestIdType, direction=IN, server-argument-impl-policy=USE-ARGUMENT-TYPE
        arg pu8TestResult: type=u8TestResultType, direction=OUT, server-argument-impl-policy=USE-ARGUMENT-TYPE
  28 x sender receiver interface:
    IF_Awake_Diag_Actv_RBTM_FR_ST3: category=FUNCTIONAL  # Wachhalten für Diagnose aktiv / Stay awake for diagnostics active
      data Awake_Diag_Actv_RBTM_FR_ST3: category=BOOLEAN, sw-calibration-access=READ-WRITE, type=DC_BOOL  # SHORT: Wachhalten für Diagnose aktiv LONG: Wachhalten für Diagnose aktiv / SHORT: Stay awake for diagnostics active LONG: Stay awake for diagnostics active
    IF_Awake_Ignition_On_RBTM_FR_ST3: category=FUNCTIONAL  # Wachhalten für Zündung eingeschaltet / Stay awake for ignition on
      data Awake_Ignition_On_RBTM_FR_ST3: category=BOOLEAN, sw-calibration-access=READ-WRITE, type=DC_BOOL  # SHORT: Wachhalten für Zündung eingeschaltet LONG: Wachhalten für Zündung eingeschaltet / SHORT: Stay awake for ignition on LONG: Stay awake for ignition on
    IF_Awake_NwStart_RBTM_FR_ST3: category=FUNCTIONAL  # Wachhalten für Netzwerkstartphase / Stay awake for network startup
      data Awake_NwStart_RBTM_FR_ST3: category=BOOLEAN, sw-calibration-access=READ-WRITE, type=DC_BOOL  # SHORT: Wachhalten für Netzwerkstartphase LONG: Wachhalten für Netzwerkstartphase / SHORT: Stay awake for network startup LONG: Stay awake for network startup
    IF_ECU_Id_RBTM_FR_ST3: category=FUNCTIONAL  # ECU-Identifizierungsnummer / ECU identifier
      data ECU_Id_RBTM_FR_ST3: category=VALUE, sw-calibration-access=READ-WRITE, type=c12_0_4094_1_SNA  # SHORT: ECU-Identifizierungsnummer LONG: ECU-Identifizierungsnummer / SHORT: ECU identifier LONG: ECU identifier
    IF_PS_Curve_FR_Rq_HU_ST3: category=FUNCTIONAL  # IF PS Curve vorne rechts Anforderung HU ST3 / IF PS Curve front right Request(ed) HU ST3
      data PS_Curve_FR_Rq_HU_ST3: category=VALUE, sw-calibration-access=READ-WRITE, type=c02_Off_Stage1_Stage2  # SHORT: Anforderung PreSafe Curve Modus von Headunit vorne rechts / SHORT: 02_Off_Stage1_Stage2 [0]
    IF_PS_Curve_FR_Stat_ST3: category=FUNCTIONAL  # PreSafe Curve Status vorne rechts / PreSafe Curve mode state front right
      data PS_Curve_FR_Stat_ST3: category=VALUE, sw-calibration-access=READ-WRITE, type=c02_Off_Stage1_Stage2  # SHORT: PreSafe Curve Status vorne rechts / SHORT: PreSafe Curve mode state front right
    IF_RBTM_FR_Disp_Rq_ST3: category=FUNCTIONAL  # Presafe Kombimeldung vorne rechts anzeigen / Presafe display request front right
      data RBTM_FR_Disp_Rq_ST3: category=VALUE, sw-calibration-access=READ-WRITE, type=c02_Presf_Disp_Rq  # SHORT: Presafe Kombimeldung vorne rechts anzeigen LONG: Presafe Kombimeldung vorne rechts anzeigen / SHORT: Presafe display request front right LONG: Presafe display request front right
    IF_RBTM_FR_Tgl_ST3: category=FUNCTIONAL  # Presafe Togglebit
      data RBTM_FR_Tgl_ST3: category=BOOLEAN, sw-calibration-access=READ-WRITE, type=DC_BOOL  # SHORT: Presafe Togglebit LONG: Presafe Togglebit
    IF_RevBltTns_FL_ComCyc_Actv_ST3_001: category=FUNCTIONAL  # Reversibler Gurtstraffer vorne links Komfort-Straffzyklus aktiv / Reversible belt tensioner front left comfort tensioning cycle active
      data RevBltTns_FL_ComCyc_Actv_ST3: category=VALUE, sw-calibration-access=READ-WRITE, type=c02_Ndef_False_True_ST3  # SHORT: Reversibler Gurtstraffer vorne links Komfort-Straffzyklus aktiv LONG: Reversibler Gurtstraffer vorne links Komfort-Straffzyklus aktiv / SHORT: Reversible belt tensioner front left comfort tensioning cycle active LONG: Reversible belt tensioner front left comfort tensioning cycle active
    IF_RevBltTns_FL_SafeCyc_Actv_ST3_001: category=FUNCTIONAL  # Reversibler Gurtstraffer vorne links Sicherheits-Straffzyklus aktiv / Reversible belt tensioner front left safety tensioning cycle active
      data RevBltTns_FL_SafeCyc_Actv_ST3: category=VALUE, sw-calibration-access=READ-WRITE, type=c02_Ndef_False_True_ST3  # SHORT: Reversibler Gurtstraffer vorne links Sicherheits-Straffzyklus aktiv LONG: Reversibler Gurtstraffer vorne links Sicherheits-Straffzyklus aktiv / SHORT: Reversible belt tensioner front left safety tensioning cycle active LONG: Reversible belt tensioner front left safety tensioning cycle active
    IF_RevBltTns_FR_ComCyc_Actv_ST3_001: category=FUNCTIONAL  # Reversibler Gurtstraffer vorne rechts Komfort-Straffzyklus aktiv / Reversible belt tensioner front right comfort tensioning cycle active
      data RevBltTns_FR_ComCyc_Actv_ST3: category=VALUE, sw-calibration-access=READ-WRITE, type=c02_Ndef_False_True_ST3  # SHORT: Reversibler Gurtstraffer vorne rechts Komfort-Straffzyklus aktiv LONG: Reversibler Gurtstraffer vorne rechts Komfort-Straffzyklus aktiv / SHORT: Reversible belt tensioner front right comfort tensioning cycle active LONG: Reversible belt tensioner front right comfort tensioning cycle active
    IF_RevBltTns_FR_SafeCyc_Actv_ST3_001: category=FUNCTIONAL  # Reversibler Gurtstraffer vorne rechts Sicherheits-Straffzyklus aktiv / Reversible belt tensioner front right safety tensioning cycle active
      data RevBltTns_FR_SafeCyc_Actv_ST3: category=VALUE, sw-calibration-access=READ-WRITE, type=c02_Ndef_False_True_ST3  # SHORT: Reversibler Gurtstraffer vorne rechts Sicherheits-Straffzyklus aktiv LONG: Reversibler Gurtstraffer vorne rechts Sicherheits-Straffzyklus aktiv / SHORT: Reversible belt tensioner front right safety tensioning cycle active LONG: Reversible belt tensioner front right safety tensioning cycle active
    IF_WakeupRsn_RBTM_FR_ST3: category=FUNCTIONAL  # Weckgrund / Wakeup reason
      data WakeupRsn_RBTM_FR_ST3: category=VALUE, sw-calibration-access=READ-WRITE, type=c10_WakeupRsn_ST3  # SHORT: Weckgrund LONG: Weckgrund / SHORT: Wakeup reason LONG: Wakeup reason
    IG_Develop8_Rq_RBTM_FR_ST3: category=FUNCTIONAL  # Development Request
      data Develop8_Rq_RBTM_FR_ST3: category=STRUCTURE, sw-calibration-access=READ-WRITE, type=REC_Develop8_Rq_RBTM_FR_ST3  # SHORT: Development Request LONG: Development Request
    IG_Develop8_Rq_RBTM_FR_ST3_972r28igpapvdp6ireogwrkb1: category=FUNCTIONAL  # Development Request (degraded)
      data Develop8_Rq_RBTM_FR_ST3: category=STRUCTURE, sw-calibration-access=READ-WRITE, type=REC_Develop8_Rq_RBTM_FR_ST3_dgfi1nrxtb0voy6rb7ybeonmv  # SHORT: Development Request LONG: Development Request (degraded)
    IG_Develop8_Rs_RBTM_FR_ST3: category=FUNCTIONAL  # Development Response
      data Develop8_Rs_RBTM_FR_ST3: category=STRUCTURE, sw-calibration-access=READ-WRITE, type=REC_Develop8_Rs_RBTM_FR_ST3  # SHORT: Development Response LONG: Development Response
    IG_Develop8_Rs_RBTM_FR_ST3_1bgznsxvbko9nyo78yin9nalx: category=FUNCTIONAL  # Development Response (degraded)
      data Develop8_Rs_RBTM_FR_ST3: category=STRUCTURE, sw-calibration-access=READ-WRITE, type=REC_Develop8_Rs_RBTM_FR_ST3_dgfi1nrxtb0voy6rb7ybeonmv  # SHORT: Development Response LONG: Development Response (degraded)
    IG_Meas8_RBTM_FR_ST3: category=FUNCTIONAL  # Messbotschaft / Measurement
      data Meas8_RBTM_FR_ST3: category=STRUCTURE, sw-calibration-access=READ-WRITE, type=REC_Meas_RBTM_FR_ST3  # SHORT: Messbotschaft LONG: Messbotschaft / SHORT: Measurement LONG: Measurement
    IG_Meas8_RBTM_FR_ST3_3bo6gxw4jc1o7t5aoxk3awdcy: category=FUNCTIONAL  # Messbotschaft (degraded) / Measurement (degraded)
      data Meas8_RBTM_FR_ST3: category=STRUCTURE, sw-calibration-access=READ-WRITE, type=REC_Meas_RBTM_FR_ST3_dgfi1nrxtb0voy6rb7ybeonmv  # SHORT: Messbotschaft LONG: Messbotschaft (degraded) / SHORT: Measurement LONG: Measurement (degraded)
    isrCycleValidity
      data b8CycleValidity: sw-calibration-access=READ-WRITE, type=b8BooleanType
    IF_RBTMFL_Actv_Lvl_ST35: category=FUNCTIONAL  # aktives Straffprofil vorne links / active seatbelt tensioning profile front left
      data RBTMFL_Actv_Lvl_ST35: category=VALUE, sw-calibration-access=READ-WRITE, type=c06_RBTM_Lvl_Stat  # SHORT: aktives Straffprofil vorne links / SHORT: active seatbelt tensioning profile front left
    IF_RBTMFL_SP_ActvClient_ST35: category=FUNCTIONAL  # Anforderungsquelle aktive Gurtstraffung vorne links / Active seatbelt tensioning request source front left
      data RBTMFL_SP_ActvClient_ST35: category=VALUE, sw-calibration-access=READ-WRITE, type=c04_RBTM_ActvClient  # SHORT: Anforderungsquelle aktive Gurtstraffung vorne links / SHORT: Active seatbelt tensioning request source front left
    IF_RBTMFL_SP_FctPrecond_Stat_ST35: category=FUNCTIONAL  # Nicht erfüllten Funktionsbedingungen für rev. Gurtstraffung vorne links / List of unfulfilled preconditions for rev. seatbelt tensioning front left
      data RBTMFL_SP_FctPrecond_Stat_ST35: category=BIT, sw-calibration-access=READ-WRITE, type=c10_RBTM_Fct_Precond  # SHORT: Nicht erfüllten Funktionsbedingungen für rev. Gurtstraffung vorne links / SHORT: List of unfulfilled preconditions for rev. seatbelt tensioning front left
    IG_SBeltTens_SP_Lvl_Pr5_ST3: category=FUNCTIONAL  # Seat Belt Tensioner SP Lvl ST3
      data SBeltTens_SP_Lvl_Pr5_ST3: category=STRUCTURE, sw-calibration-access=READ-WRITE, type=REC_SBeltTens_SP_Lvl_Pr5_ST3  # SHORT: Seat Belt Tensioner SP Lvl ST3
    IG_SBeltTens_SP_Lvl_Pr5_ST3_aljrkz9re372o0jtum2i5lh8w: category=FUNCTIONAL  # Seat Belt Tensioner SP Lvl ST3 (degraded)
      data SBeltTens_SP_Lvl_Pr5_ST3: category=STRUCTURE, sw-calibration-access=READ-WRITE, type=REC_SBeltTens_SP_Lvl_Pr5_ST3_cp6wyrd9cg7ec7y2w3khz1gyt  # SHORT: Seat Belt Tensioner SP Lvl ST3 LONG: (degraded)
    IF_RBTMFR_Actv_Lvl_ST35: category=FUNCTIONAL  # aktives Straffprofil vorne rechts / active seatbelt tensioning profile front right
      data RBTMFR_Actv_Lvl_ST35: category=VALUE, sw-calibration-access=READ-WRITE, type=c06_RBTM_Lvl_Stat  # SHORT: aktives Straffprofil vorne rechts / SHORT: active seatbelt tensioning profile front right
    IF_RBTMFR_SP_ActvClient_ST35: category=FUNCTIONAL  # Anforderungsquelle aktive Gurtstraffung vorne rechts / Active seatbelt tensioning request source front right
      data RBTMFR_SP_ActvClient_ST35: category=VALUE, sw-calibration-access=READ-WRITE, type=c04_RBTM_ActvClient  # SHORT: Anforderungsquelle aktive Gurtstraffung vorne rechts / SHORT: Active seatbelt tensioning request source front right
    IF_RBTMFR_SP_FctPrecond_Stat_ST35: category=FUNCTIONAL  # Nicht erfüllten Funktionsbedingungen für rev. Gurtstraffung vorne rechts / List of unfulfilled preconditions for rev. seatbelt tensioning front right
      data RBTMFR_SP_FctPrecond_Stat_ST35: category=BIT, sw-calibration-access=READ-WRITE, type=c10_RBTM_Fct_Precond  # SHORT: Nicht erfüllten Funktionsbedingungen für rev. Gurtstraffung vorne rechts / SHORT: List of unfulfilled preconditions for rev. seatbelt tensioning front right
  client server interface icsExtWdgTest
    operation GetWdgTestResult
      arg pu8WdgTestResult: sw-calibration-access=READ-WRITE, type=u8WdgTestResultType, direction=OUT, server-argument-impl-policy=USE-ARGUMENT-TYPE
    operation LaunchWdgTest
  client server interface CheckPowerSupplyOVDuringActivation
    operation AutotestCallback
      arg puTestResult: type=u8TestResultType, direction=INOUT, server-argument-impl-policy=USE-ARGUMENT-TYPE
  client server interface CheckPowerSupplyUVDuringActivation
    operation AutotestCallback
      arg puTestResult: type=u8TestResultType, direction=INOUT, server-argument-impl-policy=USE-ARGUMENT-TYPE
  sender receiver interface isrPresafeDisplay
    data b8TriggerPreSafeRequestStatus: type=b8BooleanType_Appl
  client server interface icsPreSafeRecSignals
    operation GetInputSignals
      arg pustPreSafeRecInput: type=REC_PreSafeRecInput, direction=INOUT, server-argument-impl-policy=USE-ARGUMENT-TYPE
  client server interface If_Obsolescence_Data
    operation Get_Data
      arg pObsData: type=Obsolescence_Data, direction=IN, server-argument-impl-policy=USE-ARGUMENT-TYPE
    operation Write_Data
      arg pObsData: type=Obsolescence_Data, direction=OUT, server-argument-impl-policy=USE-ARGUMENT-TYPE
  10 x sender receiver interface:
    isrPreSafeLvl
      data u8PreSafeLvl: type=c04_Presf_Lvl_V2
    AvailabilityDataHandler
      data AvailabilityDataCategory: type=UInt8
    ObsolescenceDataBlockNumber
      data BlockNumber: type=UInt8
    isrIgnitionStatus
      data b8TriggerIgnitionStatus: type=b8BooleanType_Appl
      data b8TriggerIgnitionStatusEnableStorageCondition: type=b8BooleanType_Appl
    isrProdModeStatus
      data b8TriggerProdModeStatus: type=b8BooleanType_Appl
    isrTransportationModeStatus
      data b8TransportationModeStatus: type=b8BooleanType_Appl
    isrEngStartStatus
      data b8EngStartStatus: type=b8BooleanType_Appl
    isrSupBatStatus
      data b8SupBatStatus: type=b8BooleanType_Appl
    isrExtTestPres
      data b8ExtTesterPresent: type=b8BooleanType_Appl
      data b8DTCConfirmed: type=b8BooleanType_Appl
    isrSnapshotData
      data u8SnapshotAecId: type=uint8
package /ModeDeclarationGroups
  mode declaration group Coding_Mode: category=ALPHABETIC_ORDER, initial-mode=Coding_Mode/CODING_OK  # P_MDG_Coding_Stat_ST3 | Kodierungs-Status / Coding state
    mode CODING_ACTIVE  # Active
    mode CODING_FAILED  # Failed
    mode CODING_OK  # Ok
package /Interfaces
  sender receiver interface isrBeltStack
    data b8BeltStack: type=b8BooleanType_Appl
