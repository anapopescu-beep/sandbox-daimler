[part 2 of 4: packages /SecurityArchitecture/extSwc/Dcm_swc/Interfaces to /SecurityArchitecture/extSwc/KeyM_swc/Interfaces]
AUTOSAR XML (schema 00049)
package /SecurityArchitecture/extSwc/Dcm_swc/Interfaces
  61 x client server interface, all with is-service=true, service-kind=DIAGNOSTIC-COMMUNICATION-MANAGER:
    DataServices_DID_0185_Basic_ACL_Version_Generation_Time_GTC
      operation ConditionCheckRead: possible-error=[DataServices_DID_0185_Basic_ACL_Version_Generation_Time_GTC/DCM_E_PENDING, DataServices_DID_0185_Basic_ACL_Version_Generation_Time_GTC/E_NOT_OK]
        arg OpStatus: type=Dcm_OpStatusType, direction=IN, server-argument-impl-policy=USE-ARGUMENT-TYPE
        arg ErrorCode: type=Dcm_NegativeResponseCodeType, direction=OUT, server-argument-impl-policy=USE-ARGUMENT-TYPE
      operation ReadData: possible-error=[DataServices_DID_0185_Basic_ACL_Version_Generation_Time_GTC/DCM_E_PENDING, DataServices_DID_0185_Basic_ACL_Version_Generation_Time_GTC/E_NOT_OK]
        arg OpStatus: type=Dcm_OpStatusType, direction=IN, server-argument-impl-policy=USE-ARGUMENT-TYPE
        arg Data: type=Dcm_Data15ByteType, direction=OUT, server-argument-impl-policy=USE-ARRAY-BASE-TYPE
      error DCM_E_PENDING: error-code=10
      error E_NOT_OK: error-code=1
    DataServices_DID_018D_Real_Time_Offset
      operation ConditionCheckRead: possible-error=[DataServices_DID_018D_Real_Time_Offset/DCM_E_PENDING, DataServices_DID_018D_Real_Time_Offset/E_NOT_OK]
        arg OpStatus: type=Dcm_OpStatusType, direction=IN, server-argument-impl-policy=USE-ARGUMENT-TYPE
        arg ErrorCode: type=Dcm_NegativeResponseCodeType, direction=OUT, server-argument-impl-policy=USE-ARGUMENT-TYPE
      operation ReadData: possible-error=[DataServices_DID_018D_Real_Time_Offset/DCM_E_PENDING, DataServices_DID_018D_Real_Time_Offset/E_NOT_OK]
        arg OpStatus: type=Dcm_OpStatusType, direction=IN, server-argument-impl-policy=USE-ARGUMENT-TYPE
        arg Data: type=Dcm_Data15ByteType, direction=OUT, server-argument-impl-policy=USE-ARGUMENT-TYPE
      error DCM_E_PENDING: error-code=10
      error E_NOT_OK: error-code=1
    DataServices_DID_0185_Basic_ACL_Hash
      operation ConditionCheckRead: possible-error=[DataServices_DID_0185_Basic_ACL_Hash/DCM_E_PENDING, DataServices_DID_0185_Basic_ACL_Hash/E_NOT_OK]
        arg OpStatus: type=Dcm_OpStatusType, direction=IN, server-argument-impl-policy=USE-ARGUMENT-TYPE
        arg ErrorCode: type=Dcm_NegativeResponseCodeType, direction=OUT, server-argument-impl-policy=USE-ARGUMENT-TYPE
      operation ReadData: possible-error=[DataServices_DID_0185_Basic_ACL_Hash/DCM_E_PENDING, DataServices_DID_0185_Basic_ACL_Hash/E_NOT_OK]
        arg OpStatus: type=Dcm_OpStatusType, direction=IN, server-argument-impl-policy=USE-ARGUMENT-TYPE
        arg Data: type=Dcm_Data64ByteType, direction=OUT, server-argument-impl-policy=USE-ARRAY-BASE-TYPE
      error DCM_E_PENDING: error-code=10
      error E_NOT_OK: error-code=1
    DataServices_DID_0199_Data_Signature
      operation ConditionCheckRead: possible-error=[DataServices_DID_0199_Data_Signature/DCM_E_PENDING, DataServices_DID_0199_Data_Signature/E_NOT_OK]
        arg OpStatus: type=Dcm_OpStatusType, direction=IN, server-argument-impl-policy=USE-ARGUMENT-TYPE
        arg ErrorCode: type=Dcm_NegativeResponseCodeType, direction=OUT, server-argument-impl-policy=USE-ARGUMENT-TYPE
      operation ReadData: possible-error=[DataServices_DID_0199_Data_Signature/DCM_E_PENDING, DataServices_DID_0199_Data_Signature/E_NOT_OK]
        arg OpStatus: type=Dcm_OpStatusType, direction=IN, server-argument-impl-policy=USE-ARGUMENT-TYPE
        arg Data: type=Dcm_Data64ByteType, direction=OUT, server-argument-impl-policy=USE-ARGUMENT-TYPE
      error DCM_E_PENDING: error-code=10
      error E_NOT_OK: error-code=1
    DataServices_DID_0185_Basic_ACL_Version_Candela_File_Version_Major
      operation ConditionCheckRead: possible-error=[DataServices_DID_0185_Basic_ACL_Version_Candela_File_Version_Major/DCM_E_PENDING, DataServices_DID_0185_Basic_ACL_Version_Candela_File_Version_Major/E_NOT_OK]
        arg OpStatus: type=Dcm_OpStatusType, direction=IN, server-argument-impl-policy=USE-ARGUMENT-TYPE
        arg ErrorCode: type=Dcm_NegativeResponseCodeType, direction=OUT, server-argument-impl-policy=USE-ARGUMENT-TYPE
      operation ReadData: possible-error=[DataServices_DID_0185_Basic_ACL_Version_Candela_File_Version_Major/DCM_E_PENDING, DataServices_DID_0185_Basic_ACL_Version_Candela_File_Version_Major/E_NOT_OK]
        arg OpStatus: type=Dcm_OpStatusType, direction=IN, server-argument-impl-policy=USE-ARGUMENT-TYPE
        arg Data: type=Dcm_Data1ByteType, direction=OUT, server-argument-impl-policy=USE-ARRAY-BASE-TYPE
      error DCM_E_PENDING: error-code=10
      error E_NOT_OK: error-code=1
    DataServices_Root_CA_Certificate_Read
      operation ConditionCheckRead: possible-error=[DataServices_Root_CA_Certificate_Read/DCM_E_PENDING, DataServices_Root_CA_Certificate_Read/E_NOT_OK]
        arg OpStatus: type=Dcm_OpStatusType, direction=IN, server-argument-impl-policy=USE-ARGUMENT-TYPE
        arg ErrorCode: type=Dcm_NegativeResponseCodeType, direction=OUT, server-argument-impl-policy=USE-ARGUMENT-TYPE
      operation ReadData: possible-error=[DataServices_Root_CA_Certificate_Read/DCM_E_PENDING, DataServices_Root_CA_Certificate_Read/E_NOT_OK]
        arg OpStatus: type=Dcm_OpStatusType, direction=IN, server-argument-impl-policy=USE-ARGUMENT-TYPE
        arg Data: type=Dcm_Data1002ByteType, direction=OUT, server-argument-impl-policy=USE-ARRAY-BASE-TYPE
      operation ReadDataLength: possible-error=[DataServices_Root_CA_Certificate_Read/DCM_E_PENDING, DataServices_Root_CA_Certificate_Read/E_NOT_OK]
        arg OpStatus: type=Dcm_OpStatusType, direction=IN, server-argument-impl-policy=USE-ARGUMENT-TYPE
        arg DataLength: type=uint16, direction=OUT, server-argument-impl-policy=USE-ARGUMENT-TYPE
      error DCM_E_PENDING: error-code=10
      error E_NOT_OK: error-code=1
    DataServices_Backend_CA_Certificate_Identification_Read_Backend_CA_SubjectKeyIdentifier
      operation ConditionCheckRead: possible-error=[DataServices_Backend_CA_Certificate_Identification_Read_Backend_CA_SubjectKeyIdentifier/DCM_E_PENDING, DataServices_Backend_CA_Certificate_Identification_Read_Backend_CA_SubjectKeyIdentifier/E_NOT_OK]
        arg OpStatus: type=Dcm_OpStatusType, direction=IN, server-argument-impl-policy=USE-ARGUMENT-TYPE
        arg ErrorCode: type=Dcm_NegativeResponseCodeType, direction=OUT, server-argument-impl-policy=USE-ARGUMENT-TYPE
      operation ReadData: possible-error=[DataServices_Backend_CA_Certificate_Identification_Read_Backend_CA_SubjectKeyIdentifier/DCM_E_PENDING, DataServices_Backend_CA_Certificate_Identification_Read_Backend_CA_SubjectKeyIdentifier/E_NOT_OK]
        arg OpStatus: type=Dcm_OpStatusType, direction=IN, server-argument-impl-policy=USE-ARGUMENT-TYPE
        arg Data: type=Dcm_Data20ByteType, direction=OUT, server-argument-impl-policy=USE-ARRAY-BASE-TYPE
      error DCM_E_PENDING: error-code=10
      error E_NOT_OK: error-code=1
    DataServices_SecOC_Vehicle_Shared_Secret_Hash_Read_SecOC_Vehicle_Shared_Secret_Hash
      operation ConditionCheckRead: possible-error=[DataServices_SecOC_Vehicle_Shared_Secret_Hash_Read_SecOC_Vehicle_Shared_Secret_Hash/DCM_E_PENDING, DataServices_SecOC_Vehicle_Shared_Secret_Hash_Read_SecOC_Vehicle_Shared_Secret_Hash/E_NOT_OK]
        arg OpStatus: type=Dcm_OpStatusType, direction=IN, server-argument-impl-policy=USE-ARGUMENT-TYPE
        arg ErrorCode: type=Dcm_NegativeResponseCodeType, direction=OUT, server-argument-impl-policy=USE-ARGUMENT-TYPE
      operation ReadData: possible-error=[DataServices_SecOC_Vehicle_Shared_Secret_Hash_Read_SecOC_Vehicle_Shared_Secret_Hash/DCM_E_PENDING, DataServices_SecOC_Vehicle_Shared_Secret_Hash_Read_SecOC_Vehicle_Shared_Secret_Hash/E_NOT_OK]
        arg OpStatus: type=Dcm_OpStatusType, direction=IN, server-argument-impl-policy=USE-ARGUMENT-TYPE
        arg Data: type=Dcm_Data4ByteType, direction=OUT, server-argument-impl-policy=USE-ARRAY-BASE-TYPE
      error DCM_E_PENDING: error-code=10
      error E_NOT_OK: error-code=1
    DataServices_DID_018D_TickCount
      operation ConditionCheckRead: possible-error=[DataServices_DID_018D_TickCount/DCM_E_PENDING, DataServices_DID_018D_TickCount/E_NOT_OK]
        arg OpStatus: type=Dcm_OpStatusType, direction=IN, server-argument-impl-policy=USE-ARGUMENT-TYPE
        arg ErrorCode: type=Dcm_NegativeResponseCodeType, direction=OUT, server-argument-impl-policy=USE-ARGUMENT-TYPE
      operation ReadData: possible-error=[DataServices_DID_018D_TickCount/DCM_E_PENDING, DataServices_DID_018D_TickCount/E_NOT_OK]
        arg OpStatus: type=Dcm_OpStatusType, direction=IN, server-argument-impl-policy=USE-ARGUMENT-TYPE
        arg Data: type=Dcm_Data5ByteType, direction=OUT, server-argument-impl-policy=USE-ARGUMENT-TYPE
      error DCM_E_PENDING: error-code=10
      error E_NOT_OK: error-code=1
    DataServices_DID_0185_Basic_ACL_Version_Candela_File_Version_Minor
      operation ConditionCheckRead: possible-error=[DataServices_DID_0185_Basic_ACL_Version_Candela_File_Version_Minor/DCM_E_PENDING, DataServices_DID_0185_Basic_ACL_Version_Candela_File_Version_Minor/E_NOT_OK]
        arg OpStatus: type=Dcm_OpStatusType, direction=IN, server-argument-impl-policy=USE-ARGUMENT-TYPE
        arg ErrorCode: type=Dcm_NegativeResponseCodeType, direction=OUT, server-argument-impl-policy=USE-ARGUMENT-TYPE
      operation ReadData: possible-error=[DataServices_DID_0185_Basic_ACL_Version_Candela_File_Version_Minor/DCM_E_PENDING, DataServices_DID_0185_Basic_ACL_Version_Candela_File_Version_Minor/E_NOT_OK]
        arg OpStatus: type=Dcm_OpStatusType, direction=IN, server-argument-impl-policy=USE-ARGUMENT-TYPE
        arg Data: type=Dcm_Data1ByteType, direction=OUT, server-argument-impl-policy=USE-ARRAY-BASE-TYPE
      error DCM_E_PENDING: error-code=10
      error E_NOT_OK: error-code=1
    DataServices_DID_0198_Root_Replacement_Key
      operation ConditionCheckRead: possible-error=[DataServices_DID_0198_Root_Replacement_Key/DCM_E_PENDING, DataServices_DID_0198_Root_Replacement_Key/E_NOT_OK]
        arg OpStatus: type=Dcm_OpStatusType, direction=IN, server-argument-impl-policy=USE-ARGUMENT-TYPE
        arg ErrorCode: type=Dcm_NegativeResponseCodeType, direction=OUT, server-argument-impl-policy=USE-ARGUMENT-TYPE
      operation ReadData: possible-error=[DataServices_DID_0198_Root_Replacement_Key/DCM_E_PENDING, DataServices_DID_0198_Root_Replacement_Key/E_NOT_OK]
        arg OpStatus: type=Dcm_OpStatusType, direction=IN, server-argument-impl-policy=USE-ARGUMENT-TYPE
        arg Data: type=Dcm_Data32ByteType, direction=OUT, server-argument-impl-policy=USE-ARGUMENT-TYPE
      error DCM_E_PENDING: error-code=10
      error E_NOT_OK: error-code=1
    DataServices_SecOC_PDU_Data_IDs_and_Key_Checksum_Read_Secured_PDU_Data_IDs_and_Key_Checksum
      operation ConditionCheckRead: possible-error=[DataServices_SecOC_PDU_Data_IDs_and_Key_Checksum_Read_Secured_PDU_Data_IDs_and_Key_Checksum/DCM_E_PENDING, DataServices_SecOC_PDU_Data_IDs_and_Key_Checksum_Read_Secured_PDU_Data_IDs_and_Key_Checksum/E_NOT_OK]
        arg OpStatus: type=Dcm_OpStatusType, direction=IN, server-argument-impl-policy=USE-ARGUMENT-TYPE
        arg ErrorCode: type=Dcm_NegativeResponseCodeType, direction=OUT, server-argument-impl-policy=USE-ARGUMENT-TYPE
      operation ReadData: possible-error=[DataServices_SecOC_PDU_Data_IDs_and_Key_Checksum_Read_Secured_PDU_Data_IDs_and_Key_Checksum/DCM_E_PENDING, DataServices_SecOC_PDU_Data_IDs_and_Key_Checksum_Read_Secured_PDU_Data_IDs_and_Key_Checksum/E_NOT_OK]
        arg OpStatus: type=Dcm_OpStatusType, direction=IN, server-argument-impl-policy=USE-ARGUMENT-TYPE
        arg Data: type=Dcm_Data4092ByteType, direction=OUT, server-argument-impl-policy=USE-ARRAY-BASE-TYPE
      operation ReadDataLength: possible-error=[DataServices_SecOC_PDU_Data_IDs_and_Key_Checksum_Read_Secured_PDU_Data_IDs_and_Key_Checksum/DCM_E_PENDING, DataServices_SecOC_PDU_Data_IDs_and_Key_Checksum_Read_Secured_PDU_Data_IDs_and_Key_Checksum/E_NOT_OK]
        arg OpStatus: type=Dcm_OpStatusType, direction=IN, server-argument-impl-policy=USE-ARGUMENT-TYPE
        arg DataLength: type=uint16, direction=OUT, server-argument-impl-policy=USE-ARGUMENT-TYPE
      error DCM_E_PENDING: error-code=10
      error E_NOT_OK: error-code=1
    DataServices_Backend_CA_Certificate_Read
      operation ConditionCheckRead: possible-error=[DataServices_Backend_CA_Certificate_Read/DCM_E_PENDING, DataServices_Backend_CA_Certificate_Read/E_NOT_OK]
        arg OpStatus: type=Dcm_OpStatusType, direction=IN, server-argument-impl-policy=USE-ARGUMENT-TYPE
        arg ErrorCode: type=Dcm_NegativeResponseCodeType, direction=OUT, server-argument-impl-policy=USE-ARGUMENT-TYPE
      operation ReadData: possible-error=[DataServices_Backend_CA_Certificate_Read/DCM_E_PENDING, DataServices_Backend_CA_Certificate_Read/E_NOT_OK]
        arg OpStatus: type=Dcm_OpStatusType, direction=IN, server-argument-impl-policy=USE-ARGUMENT-TYPE
        arg Data: type=Dcm_Data1002ByteType, direction=OUT, server-argument-impl-policy=USE-ARRAY-BASE-TYPE
      operation ReadDataLength: possible-error=[DataServices_Backend_CA_Certificate_Read/DCM_E_PENDING, DataServices_Backend_CA_Certificate_Read/E_NOT_OK]
        arg OpStatus: type=Dcm_OpStatusType, direction=IN, server-argument-impl-policy=USE-ARGUMENT-TYPE
        arg DataLength: type=uint16, direction=OUT, server-argument-impl-policy=USE-ARGUMENT-TYPE
      error DCM_E_PENDING: error-code=10
      error E_NOT_OK: error-code=1
    DataServices_DID_018E_VIN_Lock_Status
      operation ConditionCheckRead: possible-error=[DataServices_DID_018E_VIN_Lock_Status/DCM_E_PENDING, DataServices_DID_018E_VIN_Lock_Status/E_NOT_OK]
        arg OpStatus: type=Dcm_OpStatusType, direction=IN, server-argument-impl-policy=USE-ARGUMENT-TYPE
        arg ErrorCode: type=Dcm_NegativeResponseCodeType, direction=OUT, server-argument-impl-policy=USE-ARGUMENT-TYPE
      operation ReadData: possible-error=[DataServices_DID_018E_VIN_Lock_Status/DCM_E_PENDING, DataServices_DID_018E_VIN_Lock_Status/E_NOT_OK]
        arg OpStatus: type=Dcm_OpStatusType, direction=IN, server-argument-impl-policy=USE-ARGUMENT-TYPE
        arg Data: type=Dcm_Data1ByteType, direction=OUT, server-argument-impl-policy=USE-ARGUMENT-TYPE
      error DCM_E_PENDING: error-code=10
      error E_NOT_OK: error-code=1
    DataServices_DID_0199_Ephemeral_ECU_Public_Key
      operation ConditionCheckRead: possible-error=[DataServices_DID_0199_Ephemeral_ECU_Public_Key/DCM_E_PENDING, DataServices_DID_0199_Ephemeral_ECU_Public_Key/E_NOT_OK]
        arg OpStatus: type=Dcm_OpStatusType, direction=IN, server-argument-impl-policy=USE-ARGUMENT-TYPE
        arg ErrorCode: type=Dcm_NegativeResponseCodeType, direction=OUT, server-argument-impl-policy=USE-ARGUMENT-TYPE
      operation ReadData: possible-error=[DataServices_DID_0199_Ephemeral_ECU_Public_Key/DCM_E_PENDING, DataServices_DID_0199_Ephemeral_ECU_Public_Key/E_NOT_OK]
        arg OpStatus: type=Dcm_OpStatusType, direction=IN, server-argument-impl-policy=USE-ARGUMENT-TYPE
        arg Data: type=Dcm_Data32ByteType, direction=OUT, server-argument-impl-policy=USE-ARGUMENT-TYPE
      error DCM_E_PENDING: error-code=10
      error E_NOT_OK: error-code=1
    DataServices_DID_0185_Basic_ACL_Version_Candela_File_Version_Patch
      operation ConditionCheckRead: possible-error=[DataServices_DID_0185_Basic_ACL_Version_Candela_File_Version_Patch/DCM_E_PENDING, DataServices_DID_0185_Basic_ACL_Version_Candela_File_Version_Patch/E_NOT_OK]
        arg OpStatus: type=Dcm_OpStatusType, direction=IN, server-argument-impl-policy=USE-ARGUMENT-TYPE
        arg ErrorCode: type=Dcm_NegativeResponseCodeType, direction=OUT, server-argument-impl-policy=USE-ARGUMENT-TYPE
      operation ReadData: possible-error=[DataServices_DID_0185_Basic_ACL_Version_Candela_File_Version_Patch/DCM_E_PENDING, DataServices_DID_0185_Basic_ACL_Version_Candela_File_Version_Patch/E_NOT_OK]
        arg OpStatus: type=Dcm_OpStatusType, direction=IN, server-argument-impl-policy=USE-ARGUMENT-TYPE
        arg Data: type=Dcm_Data1ByteType, direction=OUT, server-argument-impl-policy=USE-ARRAY-BASE-TYPE
      error DCM_E_PENDING: error-code=10
      error E_NOT_OK: error-code=1
    DataServices_Security_Event_Log_Current_Counter_Values_Read_Security_Event_Log_Current_Counter_Values
      operation ConditionCheckRead: possible-error=[DataServices_Security_Event_Log_Current_Counter_Values_Read_Security_Event_Log_Current_Counter_Values/DCM_E_PENDING, DataServices_Security_Event_Log_Current_Counter_Values_Read_Security_Event_Log_Current_Counter_Values/E_NOT_OK]
        arg OpStatus: type=Dcm_OpStatusType, direction=IN, server-argument-impl-policy=USE-ARGUMENT-TYPE
        arg ErrorCode: type=Dcm_NegativeResponseCodeType, direction=OUT, server-argument-impl-policy=USE-ARGUMENT-TYPE
      operation ReadData: possible-error=[DataServices_Security_Event_Log_Current_Counter_Values_Read_Security_Event_Log_Current_Counter_Values/DCM_E_PENDING, DataServices_Security_Event_Log_Current_Counter_Values_Read_Security_Event_Log_Current_Counter_Values/E_NOT_OK]
        arg OpStatus: type=Dcm_OpStatusType, direction=IN, server-argument-impl-policy=USE-ARGUMENT-TYPE
        arg Data: type=Dcm_Data1024ByteType, direction=OUT, server-argument-impl-policy=USE-ARRAY-BASE-TYPE
      operation ReadDataLength: possible-error=[DataServices_Security_Event_Log_Current_Counter_Values_Read_Security_Event_Log_Current_Counter_Values/DCM_E_PENDING, DataServices_Security_Event_Log_Current_Counter_Values_Read_Security_Event_Log_Current_Counter_Values/E_NOT_OK]
        arg OpStatus: type=Dcm_OpStatusType, direction=IN, server-argument-impl-policy=USE-ARGUMENT-TYPE
        arg DataLength: type=uint16, direction=OUT, server-argument-impl-policy=USE-ARGUMENT-TYPE
      error DCM_E_PENDING: error-code=10
      error E_NOT_OK: error-code=1
    DataServices_DID_0199_Certificates
      operation ConditionCheckRead: possible-error=[DataServices_DID_0199_Certificates/DCM_E_PENDING, DataServices_DID_0199_Certificates/E_NOT_OK]
        arg OpStatus: type=Dcm_OpStatusType, direction=IN, server-argument-impl-policy=USE-ARGUMENT-TYPE
        arg ErrorCode: type=Dcm_NegativeResponseCodeType, direction=OUT, server-argument-impl-policy=USE-ARGUMENT-TYPE
      operation ReadData: possible-error=[DataServices_DID_0199_Certificates/DCM_E_PENDING, DataServices_DID_0199_Certificates/E_NOT_OK]
        arg OpStatus: type=Dcm_OpStatusType, direction=IN, server-argument-impl-policy=USE-ARGUMENT-TYPE
        arg Data: type=Dcm_Data3006ByteType, direction=OUT, server-argument-impl-policy=USE-ARGUMENT-TYPE
      operation ReadDataLength: possible-error=[DataServices_DID_0199_Certificates/DCM_E_PENDING, DataServices_DID_0199_Certificates/E_NOT_OK]
        arg OpStatus: type=Dcm_OpStatusType, direction=IN, server-argument-impl-policy=USE-ARGUMENT-TYPE
        arg DataLength: type=uint16, direction=OUT, server-argument-impl-policy=USE-ARGUMENT-TYPE
      error DCM_E_PENDING: error-code=10
      error E_NOT_OK: error-code=1
    RoutineServices_Inject_Seed
      operation Start: possible-error=[RoutineServices_Inject_Seed/DCM_E_FORCE_RCRRP, RoutineServices_Inject_Seed/DCM_E_PENDING, RoutineServices_Inject_Seed/E_NOT_OK]
        8 x arg, all with server-argument-impl-policy=USE-ARGUMENT-TYPE:
          Ephemeral_Backend_Public_Key_In: type=Dcm_Data32ByteType, direction=IN
          Data_Signature_In: type=Dcm_Data64ByteType, direction=IN
          Encrypted_Seed_In: type=Dcm_Data1058ByteType, direction=IN
          OpStatus: type=Dcm_OpStatusType, direction=IN
          routineInfo_Out: type=uint8, direction=OUT
          Verification_Result_Out: type=uint8, direction=OUT
          DataLength: type=uint16, direction=IN
          ErrorCode: type=Dcm_NegativeResponseCodeType, direction=OUT
      error DCM_E_FORCE_RCRRP: error-code=12
      error DCM_E_PENDING: error-code=10
      error E_NOT_OK: error-code=1
    DataServices_DID_0185_ECU_individual_ACL_Hash
      operation ConditionCheckRead: possible-error=[DataServices_DID_0185_ECU_individual_ACL_Hash/DCM_E_PENDING, DataServices_DID_0185_ECU_individual_ACL_Hash/E_NOT_OK]
        arg OpStatus: type=Dcm_OpStatusType, direction=IN, server-argument-impl-policy=USE-ARGUMENT-TYPE
        arg ErrorCode: type=Dcm_NegativeResponseCodeType, direction=OUT, server-argument-impl-policy=USE-ARGUMENT-TYPE
      operation ReadData: possible-error=[DataServices_DID_0185_ECU_individual_ACL_Hash/DCM_E_PENDING, DataServices_DID_0185_ECU_individual_ACL_Hash/E_NOT_OK]
        arg OpStatus: type=Dcm_OpStatusType, direction=IN, server-argument-impl-policy=USE-ARGUMENT-TYPE
        arg Data: type=Dcm_Data64ByteType, direction=OUT, server-argument-impl-policy=USE-ARRAY-BASE-TYPE
      error DCM_E_PENDING: error-code=10
      error E_NOT_OK: error-code=1
    DataServices_DID_0199_Nonce
      operation ConditionCheckRead: possible-error=[DataServices_DID_0199_Nonce/DCM_E_PENDING, DataServices_DID_0199_Nonce/E_NOT_OK]
        arg OpStatus: type=Dcm_OpStatusType, direction=IN, server-argument-impl-policy=USE-ARGUMENT-TYPE
        arg ErrorCode: type=Dcm_NegativeResponseCodeType, direction=OUT, server-argument-impl-policy=USE-ARGUMENT-TYPE
      operation ReadData: possible-error=[DataServices_DID_0199_Nonce/DCM_E_PENDING, DataServices_DID_0199_Nonce/E_NOT_OK]
        arg OpStatus: type=Dcm_OpStatusType, direction=IN, server-argument-impl-policy=USE-ARGUMENT-TYPE
        arg Data: type=Dcm_Data32ByteType, direction=OUT, server-argument-impl-policy=USE-ARGUMENT-TYPE
      error DCM_E_PENDING: error-code=10
      error E_NOT_OK: error-code=1
    RoutineServices_Routine_Reset_VIN_Values
      operation Start: possible-error=[RoutineServices_Routine_Reset_VIN_Values/DCM_E_FORCE_RCRRP, RoutineServices_Routine_Reset_VIN_Values/DCM_E_PENDING, RoutineServices_Routine_Reset_VIN_Values/E_NOT_OK]
        arg OpStatus: type=Dcm_OpStatusType, direction=IN, server-argument-impl-policy=USE-ARGUMENT-TYPE
        arg routineInfo: type=uint8, direction=OUT, server-argument-impl-policy=USE-ARGUMENT-TYPE
        arg ErrorCode: type=Dcm_NegativeResponseCodeType, direction=OUT, server-argument-impl-policy=USE-ARGUMENT-TYPE
      error DCM_E_FORCE_RCRRP: error-code=12
      error DCM_E_PENDING: error-code=10
      error E_NOT_OK: error-code=1
    RoutineServices_Routine_Certificate_Self_Check
      operation Start: possible-error=[RoutineServices_Routine_Certificate_Self_Check/DCM_E_FORCE_RCRRP, RoutineServices_Routine_Certificate_Self_Check/DCM_E_PENDING, RoutineServices_Routine_Certificate_Self_Check/E_NOT_OK]
        5 x arg, all with server-argument-impl-policy=USE-ARGUMENT-TYPE:
          OpStatus: type=Dcm_OpStatusType, direction=IN
          routineInfo: type=uint8, direction=OUT
          Verification_Result: type=Dcm_Data18ByteType, direction=OUT
          DataLength: type=uint16, direction=OUT
          ErrorCode: type=Dcm_NegativeResponseCodeType, direction=OUT
      error DCM_E_FORCE_RCRRP: error-code=12
      error DCM_E_PENDING: error-code=10
      error E_NOT_OK: error-code=1
    RoutineServices_Replace_Trust_model_Certificates
      operation Start: possible-error=[RoutineServices_Replace_Trust_model_Certificates/DCM_E_FORCE_RCRRP, RoutineServices_Replace_Trust_model_Certificates/DCM_E_PENDING, RoutineServices_Replace_Trust_model_Certificates/E_NOT_OK]
        6 x arg, all with server-argument-impl-policy=USE-ARGUMENT-TYPE:
          Trust_Certificates_In: type=Dcm_Data3006ByteType, direction=IN
          OpStatus: type=Dcm_OpStatusType, direction=IN
          routineInfo_Out: type=uint8, direction=OUT
          Verification_Result_Out: type=uint8, direction=OUT
          DataLength: type=uint16, direction=IN
          ErrorCode: type=Dcm_NegativeResponseCodeType, direction=OUT
      error DCM_E_FORCE_RCRRP: error-code=12
      error DCM_E_PENDING: error-code=10
      error E_NOT_OK: error-code=1
    DataServices_DID_019F_Trust_model_certificates
      operation ConditionCheckRead: possible-error=[DataServices_DID_019F_Trust_model_certificates/DCM_E_PENDING, DataServices_DID_019F_Trust_model_certificates/E_NOT_OK]
        arg OpStatus: type=Dcm_OpStatusType, direction=IN, server-argument-impl-policy=USE-ARGUMENT-TYPE
        arg ErrorCode: type=Dcm_NegativeResponseCodeType, direction=OUT, server-argument-impl-policy=USE-ARGUMENT-TYPE
      operation ReadData: possible-error=[DataServices_DID_019F_Trust_model_certificates/DCM_E_PENDING, DataServices_DID_019F_Trust_model_certificates/E_NOT_OK]
        arg OpStatus: type=Dcm_OpStatusType, direction=IN, server-argument-impl-policy=USE-ARGUMENT-TYPE
        arg Data: type=Dcm_Data4008ByteType, direction=OUT, server-argument-impl-policy=USE-ARGUMENT-TYPE
      operation ReadDataLength: possible-error=[DataServices_DID_019F_Trust_model_certificates/DCM_E_PENDING, DataServices_DID_019F_Trust_model_certificates/E_NOT_OK]
        arg OpStatus: type=Dcm_OpStatusType, direction=IN, server-argument-impl-policy=USE-ARGUMENT-TYPE
        arg DataLength: type=uint16, direction=OUT, server-argument-impl-policy=USE-ARGUMENT-TYPE
      error DCM_E_PENDING: error-code=10
      error E_NOT_OK: error-code=1
    DataServices_DID_0185_ECU_individual_ACL_Version_Candela_File_Version_Major
      operation ConditionCheckRead: possible-error=[DataServices_DID_0185_ECU_individual_ACL_Version_Candela_File_Version_Major/DCM_E_PENDING, DataServices_DID_0185_ECU_individual_ACL_Version_Candela_File_Version_Major/E_NOT_OK]
        arg OpStatus: type=Dcm_OpStatusType, direction=IN, server-argument-impl-policy=USE-ARGUMENT-TYPE
        arg ErrorCode: type=Dcm_NegativeResponseCodeType, direction=OUT, server-argument-impl-policy=USE-ARGUMENT-TYPE
      operation ReadData: possible-error=[DataServices_DID_0185_ECU_individual_ACL_Version_Candela_File_Version_Major/DCM_E_PENDING, DataServices_DID_0185_ECU_individual_ACL_Version_Candela_File_Version_Major/E_NOT_OK]
        arg OpStatus: type=Dcm_OpStatusType, direction=IN, server-argument-impl-policy=USE-ARGUMENT-TYPE
        arg Data: type=Dcm_Data1ByteType, direction=OUT, server-argument-impl-policy=USE-ARRAY-BASE-TYPE
      error DCM_E_PENDING: error-code=10
      error E_NOT_OK: error-code=1
    DataServices_DID_018E_VIN_Status
      operation ConditionCheckRead: possible-error=[DataServices_DID_018E_VIN_Status/DCM_E_PENDING, DataServices_DID_018E_VIN_Status/E_NOT_OK]
        arg OpStatus: type=Dcm_OpStatusType, direction=IN, server-argument-impl-policy=USE-ARGUMENT-TYPE
        arg ErrorCode: type=Dcm_NegativeResponseCodeType, direction=OUT, server-argument-impl-policy=USE-ARGUMENT-TYPE
      operation ReadData: possible-error=[DataServices_DID_018E_VIN_Status/DCM_E_PENDING, DataServices_DID_018E_VIN_Status/E_NOT_OK]
        arg OpStatus: type=Dcm_OpStatusType, direction=IN, server-argument-impl-policy=USE-ARGUMENT-TYPE
        arg Data: type=Dcm_Data1ByteType, direction=OUT, server-argument-impl-policy=USE-ARGUMENT-TYPE
      error DCM_E_PENDING: error-code=10
      error E_NOT_OK: error-code=1
    RoutineServices_Routine_Synchronize_Secured_System_Date_and_Time
      operation Start: possible-error=[RoutineServices_Routine_Synchronize_Secured_System_Date_and_Time/DCM_E_FORCE_RCRRP, RoutineServices_Routine_Synchronize_Secured_System_Date_and_Time/DCM_E_PENDING, RoutineServices_Routine_Synchronize_Secured_System_Date_and_Time/E_NOT_OK]
        4 x arg:
          OpStatus: type=Dcm_OpStatusType, direction=IN, server-argument-impl-policy=USE-ARGUMENT-TYPE
          routineInfo: type=uint8, direction=OUT, server-argument-impl-policy=USE-ARGUMENT-TYPE
          Nonce: type=Dcm_Data32ByteType, direction=OUT, server-argument-impl-policy=USE-ARRAY-BASE-TYPE
          ErrorCode: type=Dcm_NegativeResponseCodeType, direction=OUT, server-argument-impl-policy=USE-ARGUMENT-TYPE
      error DCM_E_FORCE_RCRRP: error-code=12
      error DCM_E_PENDING: error-code=10
      error E_NOT_OK: error-code=1
    DataServices_DID_019A_Trust_model_ECU_CSR
      operation ConditionCheckRead: possible-error=[DataServices_DID_019A_Trust_model_ECU_CSR/DCM_E_PENDING, DataServices_DID_019A_Trust_model_ECU_CSR/E_NOT_OK]
        arg OpStatus: type=Dcm_OpStatusType, direction=IN, server-argument-impl-policy=USE-ARGUMENT-TYPE
        arg ErrorCode: type=Dcm_NegativeResponseCodeType, direction=OUT, server-argument-impl-policy=USE-ARGUMENT-TYPE
      operation ReadData: possible-error=[DataServices_DID_019A_Trust_model_ECU_CSR/DCM_E_PENDING, DataServices_DID_019A_Trust_model_ECU_CSR/E_NOT_OK]
        arg OpStatus: type=Dcm_OpStatusType, direction=IN, server-argument-impl-policy=USE-ARGUMENT-TYPE
        arg Data: type=Dcm_Data1002ByteType, direction=OUT, server-argument-impl-policy=USE-ARGUMENT-TYPE
      operation ReadDataLength: possible-error=[DataServices_DID_019A_Trust_model_ECU_CSR/DCM_E_PENDING, DataServices_DID_019A_Trust_model_ECU_CSR/E_NOT_OK]
        arg OpStatus: type=Dcm_OpStatusType, direction=IN, server-argument-impl-policy=USE-ARGUMENT-TYPE
        arg DataLength: type=uint16, direction=OUT, server-argument-impl-policy=USE-ARGUMENT-TYPE
      error DCM_E_PENDING: error-code=10
      error E_NOT_OK: error-code=1
    RoutineServices_Replace_Trust_model_Root_Certificate
      operation Start: possible-error=[RoutineServices_Replace_Trust_model_Root_Certificate/DCM_E_FORCE_RCRRP, RoutineServices_Replace_Trust_model_Root_Certificate/DCM_E_PENDING, RoutineServices_Replace_Trust_model_Root_Certificate/E_NOT_OK]
        8 x arg, all with server-argument-impl-policy=USE-ARGUMENT-TYPE:
          signature_new_Root_In: type=Dcm_Data64ByteType, direction=IN
          signature_In: type=Dcm_Data64ByteType, direction=IN
          Certificates_In: type=Dcm_Data2004ByteType, direction=IN
          OpStatus: type=Dcm_OpStatusType, direction=IN
          routineInfo_Out: type=uint8, direction=OUT
          Verification_Result_Out: type=uint8, direction=OUT
          DataLength: type=uint16, direction=IN
          ErrorCode: type=Dcm_NegativeResponseCodeType, direction=OUT
      error DCM_E_FORCE_RCRRP: error-code=12
      error DCM_E_PENDING: error-code=10
      error E_NOT_OK: error-code=1
    DataServices_DID_EF04_SSA_Major_Version
      operation ConditionCheckRead: possible-error=[DataServices_DID_EF04_SSA_Major_Version/DCM_E_PENDING, DataServices_DID_EF04_SSA_Major_Version/E_NOT_OK]
        arg OpStatus: type=Dcm_OpStatusType, direction=IN, server-argument-impl-policy=USE-ARGUMENT-TYPE
        arg ErrorCode: type=Dcm_NegativeResponseCodeType, direction=OUT, server-argument-impl-policy=USE-ARGUMENT-TYPE
      operation ReadData: possible-error=[DataServices_DID_EF04_SSA_Major_Version/DCM_E_PENDING, DataServices_DID_EF04_SSA_Major_Version/E_NOT_OK]
        arg OpStatus: type=Dcm_OpStatusType, direction=IN, server-argument-impl-policy=USE-ARGUMENT-TYPE
        arg Data: type=Dcm_Data1ByteType, direction=OUT, server-argument-impl-policy=USE-ARRAY-BASE-TYPE
      error DCM_E_PENDING: error-code=10
      error E_NOT_OK: error-code=1
    RoutineServices_Routine_Verify_Signature
      operation Start: possible-error=[RoutineServices_Routine_Verify_Signature/DCM_E_FORCE_RCRRP, RoutineServices_Routine_Verify_Signature/DCM_E_PENDING, RoutineServices_Routine_Verify_Signature/E_NOT_OK]
        6 x arg:
          Data_to_be_checked: type=uint8, direction=IN, server-argument-impl-policy=USE-ARGUMENT-TYPE
          Signature_Value: type=Dcm_Data64ByteType, direction=IN, server-argument-impl-policy=USE-ARRAY-BASE-TYPE
          OpStatus: type=Dcm_OpStatusType, direction=IN, server-argument-impl-policy=USE-ARGUMENT-TYPE
          routineInfo: type=uint8, direction=OUT, server-argument-impl-policy=USE-ARGUMENT-TYPE
          Verification_Result: type=uint8, direction=OUT, server-argument-impl-policy=USE-ARGUMENT-TYPE
          ErrorCode: type=Dcm_NegativeResponseCodeType, direction=OUT, server-argument-impl-policy=USE-ARGUMENT-TYPE
      error DCM_E_FORCE_RCRRP: error-code=12
      error DCM_E_PENDING: error-code=10
      error E_NOT_OK: error-code=1
    DataServices_Secured_System_Date_and_Time_Read_GeneralizedTime
      operation ConditionCheckRead: possible-error=[DataServices_Secured_System_Date_and_Time_Read_GeneralizedTime/DCM_E_PENDING, DataServices_Secured_System_Date_and_Time_Read_GeneralizedTime/E_NOT_OK]
        arg OpStatus: type=Dcm_OpStatusType, direction=IN, server-argument-impl-policy=USE-ARGUMENT-TYPE
        arg ErrorCode: type=Dcm_NegativeResponseCodeType, direction=OUT, server-argument-impl-policy=USE-ARGUMENT-TYPE
      operation ReadData: possible-error=[DataServices_Secured_System_Date_and_Time_Read_GeneralizedTime/DCM_E_PENDING, DataServices_Secured_System_Date_and_Time_Read_GeneralizedTime/E_NOT_OK]
        arg OpStatus: type=Dcm_OpStatusType, direction=IN, server-argument-impl-policy=USE-ARGUMENT-TYPE
        arg Data: type=Dcm_Data15ByteType, direction=OUT, server-argument-impl-policy=USE-ARRAY-BASE-TYPE
      error DCM_E_PENDING: error-code=10
      error E_NOT_OK: error-code=1
    DataServices_DID_018F_Secured_PDU_Data_IDs_and_Key_CMACs
      operation ConditionCheckRead: possible-error=[DataServices_DID_018F_Secured_PDU_Data_IDs_and_Key_CMACs/DCM_E_PENDING, DataServices_DID_018F_Secured_PDU_Data_IDs_and_Key_CMACs/E_NOT_OK]
        arg OpStatus: type=Dcm_OpStatusType, direction=IN, server-argument-impl-policy=USE-ARGUMENT-TYPE
        arg ErrorCode: type=Dcm_NegativeResponseCodeType, direction=OUT, server-argument-impl-policy=USE-ARGUMENT-TYPE
      operation ReadData: possible-error=[DataServices_DID_018F_Secured_PDU_Data_IDs_and_Key_CMACs/DCM_E_PENDING, DataServices_DID_018F_Secured_PDU_Data_IDs_and_Key_CMACs/E_NOT_OK]
        arg OpStatus: type=Dcm_OpStatusType, direction=IN, server-argument-impl-policy=USE-ARGUMENT-TYPE
        arg Data: type=Dcm_Data4092ByteType, direction=OUT, server-argument-impl-policy=USE-ARGUMENT-TYPE
      operation ReadDataLength: possible-error=[DataServices_DID_018F_Secured_PDU_Data_IDs_and_Key_CMACs/DCM_E_PENDING, DataServices_DID_018F_Secured_PDU_Data_IDs_and_Key_CMACs/E_NOT_OK]
        arg OpStatus: type=Dcm_OpStatusType, direction=IN, server-argument-impl-policy=USE-ARGUMENT-TYPE
        arg DataLength: type=uint16, direction=OUT, server-argument-impl-policy=USE-ARGUMENT-TYPE
      error DCM_E_PENDING: error-code=10
      error E_NOT_OK: error-code=1
    RoutineServices_Routine_Authenticate_Diagnostic_User_or_Tester
      operation Start: possible-error=[RoutineServices_Routine_Authenticate_Diagnostic_User_or_Tester/DCM_E_FORCE_RCRRP, RoutineServices_Routine_Authenticate_Diagnostic_User_or_Tester/DCM_E_PENDING, RoutineServices_Routine_Authenticate_Diagnostic_User_or_Tester/E_NOT_OK]
        9 x arg:
          Configuration: type=uint8, direction=IN, server-argument-impl-policy=USE-ARGUMENT-TYPE
          Task: type=uint8, direction=IN, server-argument-impl-policy=USE-ARGUMENT-TYPE
          Challenge_Certificate_Proof_of_Ownership: type=Dcm_Data4004ByteType, direction=IN, server-argument-impl-policy=USE-ARRAY-BASE-TYPE
          OpStatus: type=Dcm_OpStatusType, direction=IN, server-argument-impl-policy=USE-ARGUMENT-TYPE
          routineInfo: type=uint8, direction=OUT, server-argument-impl-policy=USE-ARGUMENT-TYPE
          Verification_Result: type=uint8, direction=OUT, server-argument-impl-policy=USE-ARGUMENT-TYPE
          Authentication_Result: type=Dcm_Data3006ByteType, direction=OUT, server-argument-impl-policy=USE-ARRAY-BASE-TYPE
          DataLength: type=uint16, direction=INOUT, server-argument-impl-policy=USE-ARGUMENT-TYPE
          ErrorCode: type=Dcm_NegativeResponseCodeType, direction=OUT, server-argument-impl-policy=USE-ARGUMENT-TYPE
      error DCM_E_FORCE_RCRRP: error-code=12
      error DCM_E_PENDING: error-code=10
      error E_NOT_OK: error-code=1
    RoutineServices_Routine_Enhance_Access_Rights
      operation Start: possible-error=[RoutineServices_Routine_Enhance_Access_Rights/DCM_E_FORCE_RCRRP, RoutineServices_Routine_Enhance_Access_Rights/DCM_E_PENDING, RoutineServices_Routine_Enhance_Access_Rights/E_NOT_OK]
        6 x arg:
          Enhanced_Rights_Certificate: type=Dcm_Data2002ByteType, direction=IN, server-argument-impl-policy=USE-ARRAY-BASE-TYPE
          OpStatus: type=Dcm_OpStatusType, direction=IN, server-argument-impl-policy=USE-ARGUMENT-TYPE
          routineInfo: type=uint8, direction=OUT, server-argument-impl-policy=USE-ARGUMENT-TYPE
          Verification_Result: type=uint8, direction=OUT, server-argument-impl-policy=USE-ARGUMENT-TYPE
          DataLength: type=uint16, direction=IN, server-argument-impl-policy=USE-ARGUMENT-TYPE
          ErrorCode: type=Dcm_NegativeResponseCodeType, direction=OUT, server-argument-impl-policy=USE-ARGUMENT-TYPE
      error DCM_E_FORCE_RCRRP: error-code=12
      error DCM_E_PENDING: error-code=10
      error E_NOT_OK: error-code=1
    DataServices_DID_0191_Generated_Random_Number
      operation ConditionCheckRead: possible-error=[DataServices_DID_0191_Generated_Random_Number/DCM_E_PENDING, DataServices_DID_0191_Generated_Random_Number/E_NOT_OK]
        arg OpStatus: type=Dcm_OpStatusType, direction=IN, server-argument-impl-policy=USE-ARGUMENT-TYPE
        arg ErrorCode: type=Dcm_NegativeResponseCodeType, direction=OUT, server-argument-impl-policy=USE-ARGUMENT-TYPE
      operation ReadData: possible-error=[DataServices_DID_0191_Generated_Random_Number/DCM_E_PENDING, DataServices_DID_0191_Generated_Random_Number/E_NOT_OK]
        arg OpStatus: type=Dcm_OpStatusType, direction=IN, server-argument-impl-policy=USE-ARGUMENT-TYPE
        arg Data: type=Dcm_Data32ByteType, direction=OUT, server-argument-impl-policy=USE-ARGUMENT-TYPE
      error DCM_E_PENDING: error-code=10
      error E_NOT_OK: error-code=1
    RoutineServices_Routine_Evaluate_Data_Verification_Certificate
      operation Start: possible-error=[RoutineServices_Routine_Evaluate_Data_Verification_Certificate/DCM_E_FORCE_RCRRP, RoutineServices_Routine_Evaluate_Data_Verification_Certificate/DCM_E_PENDING, RoutineServices_Routine_Evaluate_Data_Verification_Certificate/E_NOT_OK]
        6 x arg:
          Data_Verification_Certificate: type=Dcm_Data2002ByteType, direction=IN, server-argument-impl-policy=USE-ARRAY-BASE-TYPE
          OpStatus: type=Dcm_OpStatusType, direction=IN, server-argument-impl-policy=USE-ARGUMENT-TYPE
          routineInfo: type=uint8, direction=OUT, server-argument-impl-policy=USE-ARGUMENT-TYPE
          Verification_Result: type=uint8, direction=OUT, server-argument-impl-policy=USE-ARGUMENT-TYPE
          DataLength: type=uint16, direction=IN, server-argument-impl-policy=USE-ARGUMENT-TYPE
          ErrorCode: type=Dcm_NegativeResponseCodeType, direction=OUT, server-argument-impl-policy=USE-ARGUMENT-TYPE
      error DCM_E_FORCE_RCRRP: error-code=12
      error DCM_E_PENDING: error-code=10
      error E_NOT_OK: error-code=1
    DataServices_DID_0191_Generated_Random_Number_Result
      operation ConditionCheckRead: possible-error=[DataServices_DID_0191_Generated_Random_Number_Result/DCM_E_PENDING, DataServices_DID_0191_Generated_Random_Number_Result/E_NOT_OK]
        arg OpStatus: type=Dcm_OpStatusType, direction=IN, server-argument-impl-policy=USE-ARGUMENT-TYPE
        arg ErrorCode: type=Dcm_NegativeResponseCodeType, direction=OUT, server-argument-impl-policy=USE-ARGUMENT-TYPE
      operation ReadData: possible-error=[DataServices_DID_0191_Generated_Random_Number_Result/DCM_E_PENDING, DataServices_DID_0191_Generated_Random_Number_Result/E_NOT_OK]
        arg OpStatus: type=Dcm_OpStatusType, direction=IN, server-argument-impl-policy=USE-ARGUMENT-TYPE
        arg Data: type=Dcm_Data1ByteType, direction=OUT, server-argument-impl-policy=USE-ARGUMENT-TYPE
      error DCM_E_PENDING: error-code=10
      error E_NOT_OK: error-code=1
    DataServices_Diagnostic_Authentication_Certificate_Identification_Read_Diagnostic_Authentication_Certificate_Issuer
      operation ConditionCheckRead: possible-error=[DataServices_Diagnostic_Authentication_Certificate_Identification_Read_Diagnostic_Authentication_Certificate_Issuer/DCM_E_PENDING, DataServices_Diagnostic_Authentication_Certificate_Identification_Read_Diagnostic_Authentication_Certificate_Issuer/E_NOT_OK]
        arg OpStatus: type=Dcm_OpStatusType, direction=IN, server-argument-impl-policy=USE-ARGUMENT-TYPE
        arg ErrorCode: type=Dcm_NegativeResponseCodeType, direction=OUT, server-argument-impl-policy=USE-ARGUMENT-TYPE
      operation ReadData: possible-error=[DataServices_Diagnostic_Authentication_Certificate_Identification_Read_Diagnostic_Authentication_Certificate_Issuer/DCM_E_PENDING, DataServices_Diagnostic_Authentication_Certificate_Identification_Read_Diagnostic_Authentication_Certificate_Issuer/E_NOT_OK]
        arg OpStatus: type=Dcm_OpStatusType, direction=IN, server-argument-impl-policy=USE-ARGUMENT-TYPE
        arg Data: type=Dcm_Data15ByteType, direction=OUT, server-argument-impl-policy=USE-ARRAY-BASE-TYPE
      error DCM_E_PENDING: error-code=10
      error E_NOT_OK: error-code=1
    DataServices_DID_0185_ECU_individual_ACL_Version_Candela_File_Version_Minor
      operation ConditionCheckRead: possible-error=[DataServices_DID_0185_ECU_individual_ACL_Version_Candela_File_Version_Minor/DCM_E_PENDING, DataServices_DID_0185_ECU_individual_ACL_Version_Candela_File_Version_Minor/E_NOT_OK]
        arg OpStatus: type=Dcm_OpStatusType, direction=IN, server-argument-impl-policy=USE-ARGUMENT-TYPE
        arg ErrorCode: type=Dcm_NegativeResponseCodeType, direction=OUT, server-argument-impl-policy=USE-ARGUMENT-TYPE
      operation ReadData: possible-error=[DataServices_DID_0185_ECU_individual_ACL_Version_Candela_File_Version_Minor/DCM_E_PENDING, DataServices_DID_0185_ECU_individual_ACL_Version_Candela_File_Version_Minor/E_NOT_OK]
        arg OpStatus: type=Dcm_OpStatusType, direction=IN, server-argument-impl-policy=USE-ARGUMENT-TYPE
        arg Data: type=Dcm_Data1ByteType, direction=OUT, server-argument-impl-policy=USE-ARRAY-BASE-TYPE
      error DCM_E_PENDING: error-code=10
      error E_NOT_OK: error-code=1
    DataServices_DID_EF04_SSA_Minor_Version
      operation ConditionCheckRead: possible-error=[DataServices_DID_EF04_SSA_Minor_Version/DCM_E_PENDING, DataServices_DID_EF04_SSA_Minor_Version/E_NOT_OK]
        arg OpStatus: type=Dcm_OpStatusType, direction=IN, server-argument-impl-policy=USE-ARGUMENT-TYPE
        arg ErrorCode: type=Dcm_NegativeResponseCodeType, direction=OUT, server-argument-impl-policy=USE-ARGUMENT-TYPE
      operation ReadData: possible-error=[DataServices_DID_EF04_SSA_Minor_Version/DCM_E_PENDING, DataServices_DID_EF04_SSA_Minor_Version/E_NOT_OK]
        arg OpStatus: type=Dcm_OpStatusType, direction=IN, server-argument-impl-policy=USE-ARGUMENT-TYPE
        arg Data: type=Dcm_Data1ByteType, direction=OUT, server-argument-impl-policy=USE-ARRAY-BASE-TYPE
      error DCM_E_PENDING: error-code=10
      error E_NOT_OK: error-code=1
    DataServices_Diagnostic_Authentication_Certificate_Identification_Read_Diagnostic_Authentication_Certificate_Serial_Number
      operation ConditionCheckRead: possible-error=[DataServices_Diagnostic_Authentication_Certificate_Identification_Read_Diagnostic_Authentication_Certificate_Serial_Number/DCM_E_PENDING, DataServices_Diagnostic_Authentication_Certificate_Identification_Read_Diagnostic_Authentication_Certificate_Serial_Number/E_NOT_OK]
        arg OpStatus: type=Dcm_OpStatusType, direction=IN, server-argument-impl-policy=USE-ARGUMENT-TYPE
        arg ErrorCode: type=Dcm_NegativeResponseCodeType, direction=OUT, server-argument-impl-policy=USE-ARGUMENT-TYPE
      operation ReadData: possible-error=[DataServices_Diagnostic_Authentication_Certificate_Identification_Read_Diagnostic_Authentication_Certificate_Serial_Number/DCM_E_PENDING, DataServices_Diagnostic_Authentication_Certificate_Identification_Read_Diagnostic_Authentication_Certificate_Serial_Number/E_NOT_OK]
        arg OpStatus: type=Dcm_OpStatusType, direction=IN, server-argument-impl-policy=USE-ARGUMENT-TYPE
        arg Data: type=Dcm_Data16ByteType, direction=OUT, server-argument-impl-policy=USE-ARRAY-BASE-TYPE
      operation ReadDataLength: possible-error=[DataServices_Diagnostic_Authentication_Certificate_Identification_Read_Diagnostic_Authentication_Certificate_Serial_Number/DCM_E_PENDING, DataServices_Diagnostic_Authentication_Certificate_Identification_Read_Diagnostic_Authentication_Certificate_Serial_Number/E_NOT_OK]
        arg OpStatus: type=Dcm_OpStatusType, direction=IN, server-argument-impl-policy=USE-ARGUMENT-TYPE
        arg DataLength: type=uint16, direction=OUT, server-argument-impl-policy=USE-ARGUMENT-TYPE
      error DCM_E_PENDING: error-code=10
      error E_NOT_OK: error-code=1
    DataServices_DID_EF04_SSA_Patch_Level
      operation ConditionCheckRead: possible-error=[DataServices_DID_EF04_SSA_Patch_Level/DCM_E_PENDING, DataServices_DID_EF04_SSA_Patch_Level/E_NOT_OK]
        arg OpStatus: type=Dcm_OpStatusType, direction=IN, server-argument-impl-policy=USE-ARGUMENT-TYPE
        arg ErrorCode: type=Dcm_NegativeResponseCodeType, direction=OUT, server-argument-impl-policy=USE-ARGUMENT-TYPE
      operation ReadData: possible-error=[DataServices_DID_EF04_SSA_Patch_Level/DCM_E_PENDING, DataServices_DID_EF04_SSA_Patch_Level/E_NOT_OK]
        arg OpStatus: type=Dcm_OpStatusType, direction=IN, server-argument-impl-policy=USE-ARGUMENT-TYPE
        arg Data: type=Dcm_Data1ByteType, direction=OUT, server-argument-impl-policy=USE-ARRAY-BASE-TYPE
      error DCM_E_PENDING: error-code=10
      error E_NOT_OK: error-code=1
    DataServices_DID_0185_ECU_individual_ACL_Version_Candela_File_Version_Patch
      operation ConditionCheckRead: possible-error=[DataServices_DID_0185_ECU_individual_ACL_Version_Candela_File_Version_Patch/DCM_E_PENDING, DataServices_DID_0185_ECU_individual_ACL_Version_Candela_File_Version_Patch/E_NOT_OK]
        arg OpStatus: type=Dcm_OpStatusType, direction=IN, server-argument-impl-policy=USE-ARGUMENT-TYPE
        arg ErrorCode: type=Dcm_NegativeResponseCodeType, direction=OUT, server-argument-impl-policy=USE-ARGUMENT-TYPE
      operation ReadData: possible-error=[DataServices_DID_0185_ECU_individual_ACL_Version_Candela_File_Version_Patch/DCM_E_PENDING, DataServices_DID_0185_ECU_individual_ACL_Version_Candela_File_Version_Patch/E_NOT_OK]
        arg OpStatus: type=Dcm_OpStatusType, direction=IN, server-argument-impl-policy=USE-ARGUMENT-TYPE
        arg Data: type=Dcm_Data1ByteType, direction=OUT, server-argument-impl-policy=USE-ARRAY-BASE-TYPE
      error DCM_E_PENDING: error-code=10
      error E_NOT_OK: error-code=1
    DataServices_DID_019B_Trust_model_ECU_Certificate
      operation ConditionCheckRead: possible-error=[DataServices_DID_019B_Trust_model_ECU_Certificate/DCM_E_PENDING, DataServices_DID_019B_Trust_model_ECU_Certificate/E_NOT_OK]
        arg OpStatus: type=Dcm_OpStatusType, direction=IN, server-argument-impl-policy=USE-ARGUMENT-TYPE
        arg ErrorCode: type=Dcm_NegativeResponseCodeType, direction=OUT, server-argument-impl-policy=USE-ARGUMENT-TYPE
      operation ReadData: possible-error=[DataServices_DID_019B_Trust_model_ECU_Certificate/DCM_E_PENDING, DataServices_DID_019B_Trust_model_ECU_Certificate/E_NOT_OK]
        arg OpStatus: type=Dcm_OpStatusType, direction=IN, server-argument-impl-policy=USE-ARGUMENT-TYPE
        arg Data: type=Dcm_Data1002ByteType, direction=OUT, server-argument-impl-policy=USE-ARGUMENT-TYPE
      operation ReadDataLength: possible-error=[DataServices_DID_019B_Trust_model_ECU_Certificate/DCM_E_PENDING, DataServices_DID_019B_Trust_model_ECU_Certificate/E_NOT_OK]
        arg OpStatus: type=Dcm_OpStatusType, direction=IN, server-argument-impl-policy=USE-ARGUMENT-TYPE
        arg DataLength: type=uint16, direction=OUT, server-argument-impl-policy=USE-ARGUMENT-TYPE
      error DCM_E_PENDING: error-code=10
      error E_NOT_OK: error-code=1
    DataServices_DID_0185_ECU_individual_ACL_Version_Generation_Time_GTC
      operation ConditionCheckRead: possible-error=[DataServices_DID_0185_ECU_individual_ACL_Version_Generation_Time_GTC/DCM_E_PENDING, DataServices_DID_0185_ECU_individual_ACL_Version_Generation_Time_GTC/E_NOT_OK]
        arg OpStatus: type=Dcm_OpStatusType, direction=IN, server-argument-impl-policy=USE-ARGUMENT-TYPE
        arg ErrorCode: type=Dcm_NegativeResponseCodeType, direction=OUT, server-argument-impl-policy=USE-ARGUMENT-TYPE
      operation ReadData: possible-error=[DataServices_DID_0185_ECU_individual_ACL_Version_Generation_Time_GTC/DCM_E_PENDING, DataServices_DID_0185_ECU_individual_ACL_Version_Generation_Time_GTC/E_NOT_OK]
        arg OpStatus: type=Dcm_OpStatusType, direction=IN, server-argument-impl-policy=USE-ARGUMENT-TYPE
        arg Data: type=Dcm_Data15ByteType, direction=OUT, server-argument-impl-policy=USE-ARRAY-BASE-TYPE
      error DCM_E_PENDING: error-code=10
      error E_NOT_OK: error-code=1
    DataServices_DID_019C_Trust_model_Intermediate_CA_Certificate
      operation ConditionCheckRead: possible-error=[DataServices_DID_019C_Trust_model_Intermediate_CA_Certificate/DCM_E_PENDING, DataServices_DID_019C_Trust_model_Intermediate_CA_Certificate/E_NOT_OK]
        arg OpStatus: type=Dcm_OpStatusType, direction=IN, server-argument-impl-policy=USE-ARGUMENT-TYPE
        arg ErrorCode: type=Dcm_NegativeResponseCodeType, direction=OUT, server-argument-impl-policy=USE-ARGUMENT-TYPE
      operation ReadData: possible-error=[DataServices_DID_019C_Trust_model_Intermediate_CA_Certificate/DCM_E_PENDING, DataServices_DID_019C_Trust_model_Intermediate_CA_Certificate/E_NOT_OK]
        arg OpStatus: type=Dcm_OpStatusType, direction=IN, server-argument-impl-policy=USE-ARGUMENT-TYPE
        arg Data: type=Dcm_Data1002ByteType, direction=OUT, server-argument-impl-policy=USE-ARGUMENT-TYPE
      operation ReadDataLength: possible-error=[DataServices_DID_019C_Trust_model_Intermediate_CA_Certificate/DCM_E_PENDING, DataServices_DID_019C_Trust_model_Intermediate_CA_Certificate/E_NOT_OK]
        arg OpStatus: type=Dcm_OpStatusType, direction=IN, server-argument-impl-policy=USE-ARGUMENT-TYPE
        arg DataLength: type=uint16, direction=OUT, server-argument-impl-policy=USE-ARGUMENT-TYPE
      error DCM_E_PENDING: error-code=10
      error E_NOT_OK: error-code=1
    RoutineServices_Routine_Replace_Certificates
      operation Start: possible-error=[RoutineServices_Routine_Replace_Certificates/DCM_E_FORCE_RCRRP, RoutineServices_Routine_Replace_Certificates/DCM_E_PENDING, RoutineServices_Routine_Replace_Certificates/E_NOT_OK]
        6 x arg:
          Certificates: type=Dcm_Data4008ByteType, direction=IN, server-argument-impl-policy=USE-ARRAY-BASE-TYPE
          OpStatus: type=Dcm_OpStatusType, direction=IN, server-argument-impl-policy=USE-ARGUMENT-TYPE
          routineInfo: type=uint8, direction=OUT, server-argument-impl-policy=USE-ARGUMENT-TYPE
          Verification_Result: type=uint8, direction=OUT, server-argument-impl-policy=USE-ARGUMENT-TYPE
          DataLength: type=uint16, direction=IN, server-argument-impl-policy=USE-ARGUMENT-TYPE
          ErrorCode: type=Dcm_NegativeResponseCodeType, direction=OUT, server-argument-impl-policy=USE-ARGUMENT-TYPE
      error DCM_E_FORCE_RCRRP: error-code=12
      error DCM_E_PENDING: error-code=10
      error E_NOT_OK: error-code=1
    DataServices_DID_018A_TickCount
      operation ConditionCheckRead: possible-error=[DataServices_DID_018A_TickCount/DCM_E_PENDING, DataServices_DID_018A_TickCount/E_NOT_OK]
        arg OpStatus: type=Dcm_OpStatusType, direction=IN, server-argument-impl-policy=USE-ARGUMENT-TYPE
        arg ErrorCode: type=Dcm_NegativeResponseCodeType, direction=OUT, server-argument-impl-policy=USE-ARGUMENT-TYPE
      operation ReadData: possible-error=[DataServices_DID_018A_TickCount/DCM_E_PENDING, DataServices_DID_018A_TickCount/E_NOT_OK]
        arg OpStatus: type=Dcm_OpStatusType, direction=IN, server-argument-impl-policy=USE-ARGUMENT-TYPE
        arg Data: type=Dcm_Data6ByteType, direction=OUT, server-argument-impl-policy=USE-ARRAY-BASE-TYPE
      error DCM_E_PENDING: error-code=10
      error E_NOT_OK: error-code=1
    DataServices_DID_0197_Precompile_switch
      operation ConditionCheckRead: possible-error=[DataServices_DID_0197_Precompile_switch/DCM_E_PENDING, DataServices_DID_0197_Precompile_switch/E_NOT_OK]
        arg OpStatus: type=Dcm_OpStatusType, direction=IN, server-argument-impl-policy=USE-ARGUMENT-TYPE
        arg ErrorCode: type=Dcm_NegativeResponseCodeType, direction=OUT, server-argument-impl-policy=USE-ARGUMENT-TYPE
      operation ReadData: possible-error=[DataServices_DID_0197_Precompile_switch/DCM_E_PENDING, DataServices_DID_0197_Precompile_switch/E_NOT_OK]
        arg OpStatus: type=Dcm_OpStatusType, direction=IN, server-argument-impl-policy=USE-ARGUMENT-TYPE
        arg Data: type=Dcm_Data4ByteType, direction=OUT, server-argument-impl-policy=USE-ARGUMENT-TYPE
      error DCM_E_PENDING: error-code=10
      error E_NOT_OK: error-code=1
    RoutineServices_Status_of_Post_Production_Flag
      operation RequestResults: possible-error=[RoutineServices_Status_of_Post_Production_Flag/DCM_E_FORCE_RCRRP, RoutineServices_Status_of_Post_Production_Flag/DCM_E_PENDING, RoutineServices_Status_of_Post_Production_Flag/E_NOT_OK]
        4 x arg, all with server-argument-impl-policy=USE-ARGUMENT-TYPE:
          OpStatus: type=Dcm_OpStatusType, direction=IN
          routineInfo_Out: type=uint8, direction=OUT
          Post_Production_Flag_Out: type=uint8, direction=OUT
          ErrorCode: type=Dcm_NegativeResponseCodeType, direction=OUT
      operation Start: possible-error=[RoutineServices_Status_of_Post_Production_Flag/DCM_E_FORCE_RCRRP, RoutineServices_Status_of_Post_Production_Flag/DCM_E_PENDING, RoutineServices_Status_of_Post_Production_Flag/E_NOT_OK]
        5 x arg, all with server-argument-impl-policy=USE-ARGUMENT-TYPE:
          In_Post_Production_Flag_In: type=uint8, direction=IN
          OpStatus: type=Dcm_OpStatusType, direction=IN
          routineInfo_Out: type=uint8, direction=OUT
          Out_Post_Production_Flag_Out: type=uint8, direction=OUT
          ErrorCode: type=Dcm_NegativeResponseCodeType, direction=OUT
      operation Stop: possible-error=[RoutineServices_Status_of_Post_Production_Flag/DCM_E_FORCE_RCRRP, RoutineServices_Status_of_Post_Production_Flag/DCM_E_PENDING, RoutineServices_Status_of_Post_Production_Flag/E_NOT_OK]
        5 x arg, all with server-argument-impl-policy=USE-ARGUMENT-TYPE:
          In_Post_Production_Flag_In: type=uint8, direction=IN
          OpStatus: type=Dcm_OpStatusType, direction=IN
          routineInfo_Out: type=uint8, direction=OUT
          Out_Post_Production_Flag_Out: type=uint8, direction=OUT
          ErrorCode: type=Dcm_NegativeResponseCodeType, direction=OUT
      error DCM_E_FORCE_RCRRP: error-code=12
      error DCM_E_PENDING: error-code=10
      error E_NOT_OK: error-code=1
    DataServices_DID_018C_Cebas_UserRole
      operation ConditionCheckRead: possible-error=[DataServices_DID_018C_Cebas_UserRole/DCM_E_PENDING, DataServices_DID_018C_Cebas_UserRole/E_NOT_OK]
        arg OpStatus: type=Dcm_OpStatusType, direction=IN, server-argument-impl-policy=USE-ARGUMENT-TYPE
        arg ErrorCode: type=Dcm_NegativeResponseCodeType, direction=OUT, server-argument-impl-policy=USE-ARGUMENT-TYPE
      operation ReadData: possible-error=[DataServices_DID_018C_Cebas_UserRole/DCM_E_PENDING, DataServices_DID_018C_Cebas_UserRole/E_NOT_OK]
        arg OpStatus: type=Dcm_OpStatusType, direction=IN, server-argument-impl-policy=USE-ARGUMENT-TYPE
        arg Data: type=Dcm_Data1ByteType, direction=OUT, server-argument-impl-policy=USE-ARGUMENT-TYPE
      error DCM_E_PENDING: error-code=10
      error E_NOT_OK: error-code=1
    DataServices_Security_Event_Log_Read_Security_Event_Log_Entry
      operation ConditionCheckRead: possible-error=[DataServices_Security_Event_Log_Read_Security_Event_Log_Entry/DCM_E_PENDING, DataServices_Security_Event_Log_Read_Security_Event_Log_Entry/E_NOT_OK]
        arg OpStatus: type=Dcm_OpStatusType, direction=IN, server-argument-impl-policy=USE-ARGUMENT-TYPE
        arg ErrorCode: type=Dcm_NegativeResponseCodeType, direction=OUT, server-argument-impl-policy=USE-ARGUMENT-TYPE
      operation ReadData: possible-error=[DataServices_Security_Event_Log_Read_Security_Event_Log_Entry/DCM_E_PENDING, DataServices_Security_Event_Log_Read_Security_Event_Log_Entry/E_NOT_OK]
        arg OpStatus: type=Dcm_OpStatusType, direction=IN, server-argument-impl-policy=USE-ARGUMENT-TYPE
        arg Data: type=Dcm_Data4092ByteType, direction=OUT, server-argument-impl-policy=USE-ARRAY-BASE-TYPE
      operation ReadDataLength: possible-error=[DataServices_Security_Event_Log_Read_Security_Event_Log_Entry/DCM_E_PENDING, DataServices_Security_Event_Log_Read_Security_Event_Log_Entry/E_NOT_OK]
        arg OpStatus: type=Dcm_OpStatusType, direction=IN, server-argument-impl-policy=USE-ARGUMENT-TYPE
        arg DataLength: type=uint16, direction=OUT, server-argument-impl-policy=USE-ARGUMENT-TYPE
      error DCM_E_PENDING: error-code=10
      error E_NOT_OK: error-code=1
    DataServices_DID_019D_Trust_model_Backend_CA_certificate
      operation ConditionCheckRead: possible-error=[DataServices_DID_019D_Trust_model_Backend_CA_certificate/DCM_E_PENDING, DataServices_DID_019D_Trust_model_Backend_CA_certificate/E_NOT_OK]
        arg OpStatus: type=Dcm_OpStatusType, direction=IN, server-argument-impl-policy=USE-ARGUMENT-TYPE
        arg ErrorCode: type=Dcm_NegativeResponseCodeType, direction=OUT, server-argument-impl-policy=USE-ARGUMENT-TYPE
      operation ReadData: possible-error=[DataServices_DID_019D_Trust_model_Backend_CA_certificate/DCM_E_PENDING, DataServices_DID_019D_Trust_model_Backend_CA_certificate/E_NOT_OK]
        arg OpStatus: type=Dcm_OpStatusType, direction=IN, server-argument-impl-policy=USE-ARGUMENT-TYPE
        arg Data: type=Dcm_Data1002ByteType, direction=OUT, server-argument-impl-policy=USE-ARGUMENT-TYPE
      operation ReadDataLength: possible-error=[DataServices_DID_019D_Trust_model_Backend_CA_certificate/DCM_E_PENDING, DataServices_DID_019D_Trust_model_Backend_CA_certificate/E_NOT_OK]
        arg OpStatus: type=Dcm_OpStatusType, direction=IN, server-argument-impl-policy=USE-ARGUMENT-TYPE
        arg DataLength: type=uint16, direction=OUT, server-argument-impl-policy=USE-ARGUMENT-TYPE
      error DCM_E_PENDING: error-code=10
      error E_NOT_OK: error-code=1
    DataServices_DID_019E_Trust_model_Root_CA_certificate
      operation ConditionCheckRead: possible-error=[DataServices_DID_019E_Trust_model_Root_CA_certificate/DCM_E_PENDING, DataServices_DID_019E_Trust_model_Root_CA_certificate/E_NOT_OK]
        arg OpStatus: type=Dcm_OpStatusType, direction=IN, server-argument-impl-policy=USE-ARGUMENT-TYPE
        arg ErrorCode: type=Dcm_NegativeResponseCodeType, direction=OUT, server-argument-impl-policy=USE-ARGUMENT-TYPE
      operation ReadData: possible-error=[DataServices_DID_019E_Trust_model_Root_CA_certificate/DCM_E_PENDING, DataServices_DID_019E_Trust_model_Root_CA_certificate/E_NOT_OK]
        arg OpStatus: type=Dcm_OpStatusType, direction=IN, server-argument-impl-policy=USE-ARGUMENT-TYPE
        arg Data: type=Dcm_Data1002ByteType, direction=OUT, server-argument-impl-policy=USE-ARGUMENT-TYPE
      operation ReadDataLength: possible-error=[DataServices_DID_019E_Trust_model_Root_CA_certificate/DCM_E_PENDING, DataServices_DID_019E_Trust_model_Root_CA_certificate/E_NOT_OK]
        arg OpStatus: type=Dcm_OpStatusType, direction=IN, server-argument-impl-policy=USE-ARGUMENT-TYPE
        arg DataLength: type=uint16, direction=OUT, server-argument-impl-policy=USE-ARGUMENT-TYPE
      error DCM_E_PENDING: error-code=10
      error E_NOT_OK: error-code=1
    DataServices_VINDataIdentifier
      operation ConditionCheckRead: possible-error=[DataServices_VINDataIdentifier/DCM_E_PENDING, DataServices_VINDataIdentifier/E_NOT_OK]
        arg OpStatus: type=Dcm_OpStatusType, direction=IN, server-argument-impl-policy=USE-ARGUMENT-TYPE
        arg ErrorCode: type=Dcm_NegativeResponseCodeType, direction=OUT, server-argument-impl-policy=USE-ARGUMENT-TYPE
      operation ReadData: possible-error=[DataServices_VINDataIdentifier/DCM_E_PENDING, DataServices_VINDataIdentifier/E_NOT_OK]
        arg OpStatus: type=Dcm_OpStatusType, direction=IN, server-argument-impl-policy=USE-ARGUMENT-TYPE
        arg Data: type=Dcm_Data17ByteType, direction=OUT, server-argument-impl-policy=USE-ARRAY-BASE-TYPE
      operation WriteData: possible-error=[DataServices_VINDataIdentifier/DCM_E_PENDING, DataServices_VINDataIdentifier/E_NOT_OK]
        arg Data: type=Dcm_Data17ByteType, direction=IN, server-argument-impl-policy=USE-ARRAY-BASE-TYPE
        arg OpStatus: type=Dcm_OpStatusType, direction=IN, server-argument-impl-policy=USE-ARGUMENT-TYPE
        arg ErrorCode: type=Dcm_NegativeResponseCodeType, direction=OUT, server-argument-impl-policy=USE-ARGUMENT-TYPE
      error DCM_E_PENDING: error-code=10
      error E_NOT_OK: error-code=1
    RoutineServices_Get_Certificate_Entry
      operation Start: possible-error=[RoutineServices_Get_Certificate_Entry/DCM_E_FORCE_RCRRP, RoutineServices_Get_Certificate_Entry/DCM_E_PENDING, RoutineServices_Get_Certificate_Entry/E_NOT_OK]
        10 x arg, all with server-argument-impl-policy=USE-ARGUMENT-TYPE:
          Certificate_Identification_In: type=uint8, direction=IN
          In_Certificate_Entry_In: type=uint8, direction=IN
          OpStatus: type=Dcm_OpStatusType, direction=IN
          routineInfo_Out: type=uint8, direction=OUT
          Verification_Result_Out: type=uint8, direction=OUT
          Certificate_identification_Out: type=uint8, direction=OUT
          Out_Certificate_Entry_Out: type=uint8, direction=OUT
          Certificate_Content_Out: type=Dcm_Data64ByteType, direction=OUT
          DataLength: type=uint16, direction=OUT
          ErrorCode: type=Dcm_NegativeResponseCodeType, direction=OUT
      error DCM_E_FORCE_RCRRP: error-code=12
      error DCM_E_PENDING: error-code=10
      error E_NOT_OK: error-code=1
    RoutineServices_Trust_Model_Generate_Key_Pair
      operation Start: possible-error=[RoutineServices_Trust_Model_Generate_Key_Pair/DCM_E_FORCE_RCRRP, RoutineServices_Trust_Model_Generate_Key_Pair/DCM_E_PENDING, RoutineServices_Trust_Model_Generate_Key_Pair/E_NOT_OK]
        7 x arg, all with server-argument-impl-policy=USE-ARGUMENT-TYPE:
          OpStatus: type=Dcm_OpStatusType, direction=IN
          routineInfo_Out: type=uint8, direction=OUT
          Verification_Result_Out: type=uint8, direction=OUT
          CSR_Signature_Out: type=Dcm_Data64ByteType, direction=OUT
          Trust_Model_ECU_CSR_Out: type=Dcm_Data1002ByteType, direction=OUT
          DataLength: type=uint16, direction=OUT
          ErrorCode: type=Dcm_NegativeResponseCodeType, direction=OUT
      error DCM_E_FORCE_RCRRP: error-code=12
      error DCM_E_PENDING: error-code=10
      error E_NOT_OK: error-code=1
    RoutineServices_Trust_Model_SecOC_ECU_Shared_Secret_Distribution
      operation Start: possible-error=[RoutineServices_Trust_Model_SecOC_ECU_Shared_Secret_Distribution/DCM_E_FORCE_RCRRP, RoutineServices_Trust_Model_SecOC_ECU_Shared_Secret_Distribution/DCM_E_PENDING, RoutineServices_Trust_Model_SecOC_ECU_Shared_Secret_Distribution/E_NOT_OK]
        12 x arg, all with server-argument-impl-policy=USE-ARGUMENT-TYPE:
          Date_and_Time_In: type=Dcm_Data7ByteType, direction=IN
          Tick_Count_In: type=Dcm_Data5ByteType, direction=IN
          Tick_Count_Offset_In: type=Dcm_Data5ByteType, direction=IN
          Encrypted_Nonce_and_Shared_Secret_In: type=Dcm_Data80ByteType, direction=IN
          Ephemeral_VSM_Public_Key_In: type=Dcm_Data32ByteType, direction=IN
          Data_Signature_In: type=Dcm_Data64ByteType, direction=IN
          Certificates_In: type=Dcm_Data3006ByteType, direction=IN
          OpStatus: type=Dcm_OpStatusType, direction=IN
          routineInfo_Out: type=uint8, direction=OUT
          Verification_Result_Out: type=uint8, direction=OUT
          DataLength: type=uint16, direction=IN
          ErrorCode: type=Dcm_NegativeResponseCodeType, direction=OUT
      error DCM_E_FORCE_RCRRP: error-code=12
      error DCM_E_PENDING: error-code=10
      error E_NOT_OK: error-code=1
    ServiceRequestNotification
      operation Confirmation: possible-error=ServiceRequestNotification/E_NOT_OK
        4 x arg, all with direction=IN, server-argument-impl-policy=USE-ARGUMENT-TYPE:
          SID: type=uint8
          ReqType: type=uint8
          SourceAddress: type=uint16
          ConfirmationStatus: type=Dcm_ConfirmationStatusType
      operation Indication: possible-error=[ServiceRequestNotification/E_NOT_OK, E_REQUEST_NOT_ACCEPTED]
        6 x arg:
          SID: type=uint8, direction=IN, server-argument-impl-policy=USE-ARGUMENT-TYPE
          RequestData: type=Dcm_SsaDslBufferType, direction=IN, server-argument-impl-policy=USE-ARRAY-BASE-TYPE
          DataSize: type=uint16, direction=IN, server-argument-impl-policy=USE-ARGUMENT-TYPE
          ReqType: type=uint8, direction=IN, server-argument-impl-policy=USE-ARGUMENT-TYPE
          SourceAddress: type=uint16, direction=IN, server-argument-impl-policy=USE-ARGUMENT-TYPE
          ErrorCode: type=Dcm_NegativeResponseCodeType, direction=OUT, server-argument-impl-policy=USE-ARGUMENT-TYPE
      error E_NOT_OK: error-code=1
      error E_REQUEST_NOT_ACCEPTED: error-code=8
  mode switch interface DcmDiagnosticSessionControl: is-service=true, service-kind=DIAGNOSTIC-COMMUNICATION-MANAGER
    mode group DcmDiagnosticSessionControl: type=DcmDiagnosticSessionControl
package /SecurityArchitecture/extSwc/Dem_swc/Interfaces
  client server interface CallbackInitMonitorForEvent: is-service=true, service-kind=DIAGNOSTIC-EVENT-MANAGER
    operation InitMonitorForEvent: possible-error=CallbackInitMonitorForEvent/E_NOT_OK
      arg InitMonitorReason: type=Dem_InitMonitorReasonType, direction=IN, server-argument-impl-policy=USE-ARGUMENT-TYPE
    error E_NOT_OK: error-code=1
  client server interface CSDataServices_DID_018B_SecOcDataID: is-service=true, service-kind=DIAGNOSTIC-EVENT-MANAGER
    operation ReadData: possible-error=CSDataServices_DID_018B_SecOcDataID/E_NOT_OK
      arg Data: type=DataArrayType_uint8_2, direction=OUT, server-argument-impl-policy=USE-ARRAY-BASE-TYPE
    error E_NOT_OK: error-code=1
  client server interface DiagnosticMonitor: is-service=true, service-kind=DIAGNOSTIC-EVENT-MANAGER
    operation ResetEventDebounceStatus: possible-error=DiagnosticMonitor/E_NOT_OK
      arg DebounceResetStatus: type=Dem_DebounceResetStatusType, direction=IN, server-argument-impl-policy=USE-ARGUMENT-TYPE
    operation ResetEventStatus: possible-error=DiagnosticMonitor/E_NOT_OK
    operation SetEventStatus: possible-error=DiagnosticMonitor/E_NOT_OK
      arg EventStatus: type=Dem_EventStatusType, direction=IN, server-argument-impl-policy=USE-ARGUMENT-TYPE
    6 x error:
      DEM_E_NO_DTC_AVAILABLE: error-code=2
      DEM_E_NO_FDC_AVAILABLE: error-code=3
      DEM_E_NODATAAVAILABLE: error-code=48
      DEM_E_WRONG_DIDNUMBER: error-code=50
      DEM_E_WRONG_RECORDNUMBER: error-code=49
      E_NOT_OK: error-code=1
package /SecurityArchitecture/extSwc/NvM_swc/PortInterfaces
  client server interface NvMService_AC2_SRBS: is-service=true
    4 x operation, all with possible-error=NvMService_AC2_SRBS/E_NOT_OK:
      GetErrorStatus
        arg ErrorStatus: type=NvM_RequestResultType, direction=OUT, server-argument-impl-policy=USE-ARGUMENT-TYPE
      ReadBlock
        arg DstPtr: type=dtRef_VOID, direction=IN, server-argument-impl-policy=USE-ARGUMENT-TYPE
      SetRamBlockStatus
        arg RamBlockStatus: type=boolean, direction=IN, server-argument-impl-policy=USE-ARGUMENT-TYPE
      WriteBlock
        arg SrcPtr: type=dtRef_const_VOID, direction=IN, server-argument-impl-policy=USE-ARGUMENT-TYPE
    error E_NOT_OK: error-code=1
package /SecurityArchitecture/extSwc/KeyM_swc/Interfaces
  64 x client server interface, all with is-service=true, service-kind=VENDOR-SPECIFIC:
    KeyMCertificate_Ssa_TrustModelBackendCert  # Service of Certificate sub module
      operation GetStatus: possible-error=KeyMCertificate_Ssa_TrustModelBackendCert/E_NOT_OK  # Provides the status of a certificate.
        arg Status: type=KeyM_CertificateStatusType, direction=OUT, server-argument-impl-policy=USE-ARGUMENT-TYPE
      operation VerifyCertificate: possible-error=[KeyMCertificate_Ssa_TrustModelBackendCert/E_NOT_OK, KeyMCertificate_Ssa_TrustModelBackendCert/KEYM_E_BUSY, KeyMCertificate_Ssa_TrustModelBackendCert/KEYM_E_CERT_INVALID_CHAIN_OF_TRUST, KeyMCertificate_Ssa_TrustModelBackendCert/KEYM_E_KEY_CERT_EMPTY, KeyMCertificate_Ssa_TrustModelBackendCert/KEYM_E_KEY_CERT_SIZE_MISMATCH, KeyMCertificate_Ssa_TrustModelBackendCert/KEYM_E_PARAMETER_MISMATCH]  # Verify certificate data from the certificate sub module .
      8 x error:
        E_NOT_OK: error-code=1  # The service request failed.
        KEYM_E_BUSY: error-code=2  # The service request failed. Key management is busy with other operations.
        KEYM_E_CERT_INVALID_CHAIN_OF_TRUST: error-code=11  # The service request failed. Certificate verification failed - Invalid Chain of Trust.
        KEYM_E_KEY_CERT_EMPTY: error-code=10  # The service request failed. The requested key or certificate is not available, slot is empty.
        KEYM_E_KEY_CERT_READ_FAIL: error-code=9  # The service request failed. Certificate or key could not be provided due to a read or permission failure.
        KEYM_E_KEY_CERT_SIZE_MISMATCH: error-code=4  # The service request failed. Parameter size does not match the expected value.
        KEYM_E_KEY_CERT_WRITE_FAIL: error-code=7  # The service request failed. Certificate or key could not be provided due to a write or permission failure.
        KEYM_E_PARAMETER_MISMATCH: error-code=5  # The service request failed. Parameter to function does not provide the expected value.
    KeyMCertificateElement_Ssa_TrustModelBackendCert_subject  # Service of the certificate sub module to access certificate elements.
      operation CertificateElementGet: possible-error=[KeyMCertificateElement_Ssa_TrustModelBackendCert_subject/E_NOT_OK, KeyMCertificateElement_Ssa_TrustModelBackendCert_subject/KEYM_E_KEY_CERT_EMPTY, KeyMCertificateElement_Ssa_TrustModelBackendCert_subject/KEYM_E_KEY_CERT_INVALID, KeyMCertificateElement_Ssa_TrustModelBackendCert_subject/KEYM_E_KEY_CERT_SIZE_MISMATCH, KeyMCertificateElement_Ssa_TrustModelBackendCert_subject/KEYM_E_PARAMETER_MISMATCH]  # Provides the content of a specific certificate element. The certificate configuration defines how the certificate submodule can find the element, e.g. by providing the object identifier (OID). This function is used to retrieve this information if only one element is assigned to the respective OID.
        arg CertificateElementData: type=KeyM_CertificateElementType_Ssa_TrustModelBackendCert_subject, direction=OUT, server-argument-impl-policy=USE-ARRAY-BASE-TYPE
        arg CertificateDataLength: type=uint32, direction=OUT, server-argument-impl-policy=USE-ARGUMENT-TYPE
      5 x error:
        E_NOT_OK: error-code=1  # The service request failed.
        KEYM_E_KEY_CERT_EMPTY: error-code=10  # The service request failed. The requested key or certificate is not available, slot is empty.
        KEYM_E_KEY_CERT_INVALID: error-code=6  # The service request failed. Key or certificate is invalid and cannot be used for the operation.
        KEYM_E_KEY_CERT_SIZE_MISMATCH: error-code=4  # The service request failed. Parameter size does not match the expected value.
        KEYM_E_PARAMETER_MISMATCH: error-code=5  # The service request failed. Parameter to function does not provide the expected value.
    KeyMCertificate_Ssa_TrustModelIntermediateCert  # Service of Certificate sub module
      operation GetStatus: possible-error=KeyMCertificate_Ssa_TrustModelIntermediateCert/E_NOT_OK  # Provides the status of a certificate.
        arg Status: type=KeyM_CertificateStatusType, direction=OUT, server-argument-impl-policy=USE-ARGUMENT-TYPE
      operation VerifyCertificate: possible-error=[KeyMCertificate_Ssa_TrustModelIntermediateCert/E_NOT_OK, KeyMCertificate_Ssa_TrustModelIntermediateCert/KEYM_E_BUSY, KeyMCertificate_Ssa_TrustModelIntermediateCert/KEYM_E_CERT_INVALID_CHAIN_OF_TRUST, KeyMCertificate_Ssa_TrustModelIntermediateCert/KEYM_E_KEY_CERT_EMPTY, KeyMCertificate_Ssa_TrustModelIntermediateCert/KEYM_E_KEY_CERT_SIZE_MISMATCH, KeyMCertificate_Ssa_TrustModelIntermediateCert/KEYM_E_PARAMETER_MISMATCH]  # Verify certificate data from the certificate sub module .
      8 x error:
        E_NOT_OK: error-code=1  # The service request failed.
        KEYM_E_BUSY: error-code=2  # The service request failed. Key management is busy with other operations.
        KEYM_E_CERT_INVALID_CHAIN_OF_TRUST: error-code=11  # The service request failed. Certificate verification failed - Invalid Chain of Trust.
        KEYM_E_KEY_CERT_EMPTY: error-code=10  # The service request failed. The requested key or certificate is not available, slot is empty.
        KEYM_E_KEY_CERT_READ_FAIL: error-code=9  # The service request failed. Certificate or key could not be provided due to a read or permission failure.
        KEYM_E_KEY_CERT_SIZE_MISMATCH: error-code=4  # The service request failed. Parameter size does not match the expected value.
        KEYM_E_KEY_CERT_WRITE_FAIL: error-code=7  # The service request failed. Certificate or key could not be provided due to a write or permission failure.
        KEYM_E_PARAMETER_MISMATCH: error-code=5  # The service request failed. Parameter to function does not provide the expected value.
    KeyMCertificateElement_Ssa_TrustModelEcuCert_subject  # Service of the certificate sub module to access certificate elements.
      operation CertificateElementGet: possible-error=[KeyMCertificateElement_Ssa_TrustModelEcuCert_subject/E_NOT_OK, KeyMCertificateElement_Ssa_TrustModelEcuCert_subject/KEYM_E_KEY_CERT_EMPTY, KeyMCertificateElement_Ssa_TrustModelEcuCert_subject/KEYM_E_KEY_CERT_INVALID, KeyMCertificateElement_Ssa_TrustModelEcuCert_subject/KEYM_E_KEY_CERT_SIZE_MISMATCH, KeyMCertificateElement_Ssa_TrustModelEcuCert_subject/KEYM_E_PARAMETER_MISMATCH]  # Provides the content of a specific certificate element. The certificate configuration defines how the certificate submodule can find the element, e.g. by providing the object identifier (OID). This function is used to retrieve this information if only one element is assigned to the respective OID.
        arg CertificateElementData: type=KeyM_CertificateElementType_Ssa_TrustModelEcuCert_subject, direction=OUT, server-argument-impl-policy=USE-ARRAY-BASE-TYPE
        arg CertificateDataLength: type=uint32, direction=OUT, server-argument-impl-policy=USE-ARGUMENT-TYPE
      5 x error:
        E_NOT_OK: error-code=1  # The service request failed.
        KEYM_E_KEY_CERT_EMPTY: error-code=10  # The service request failed. The requested key or certificate is not available, slot is empty.
        KEYM_E_KEY_CERT_INVALID: error-code=6  # The service request failed. Key or certificate is invalid and cannot be used for the operation.
        KEYM_E_KEY_CERT_SIZE_MISMATCH: error-code=4  # The service request failed. Parameter size does not match the expected value.
        KEYM_E_PARAMETER_MISMATCH: error-code=5  # The service request failed. Parameter to function does not provide the expected value.
    KeyMCertificate_Ssa_TrustModelBackendPeerCert  # Service of Certificate sub module
      operation GetStatus: possible-error=KeyMCertificate_Ssa_TrustModelBackendPeerCert/E_NOT_OK  # Provides the status of a certificate.
        arg Status: type=KeyM_CertificateStatusType, direction=OUT, server-argument-impl-policy=USE-ARGUMENT-TYPE
      operation VerifyCertificate: possible-error=[KeyMCertificate_Ssa_TrustModelBackendPeerCert/E_NOT_OK, KeyMCertificate_Ssa_TrustModelBackendPeerCert/KEYM_E_BUSY, KeyMCertificate_Ssa_TrustModelBackendPeerCert/KEYM_E_CERT_INVALID_CHAIN_OF_TRUST, KeyMCertificate_Ssa_TrustModelBackendPeerCert/KEYM_E_KEY_CERT_EMPTY, KeyMCertificate_Ssa_TrustModelBackendPeerCert/KEYM_E_KEY_CERT_SIZE_MISMATCH, KeyMCertificate_Ssa_TrustModelBackendPeerCert/KEYM_E_PARAMETER_MISMATCH]  # Verify certificate data from the certificate sub module .
      8 x error:
        E_NOT_OK: error-code=1  # The service request failed.
        KEYM_E_BUSY: error-code=2  # The service request failed. Key management is busy with other operations.
        KEYM_E_CERT_INVALID_CHAIN_OF_TRUST: error-code=11  # The service request failed. Certificate verification failed - Invalid Chain of Trust.
        KEYM_E_KEY_CERT_EMPTY: error-code=10  # The service request failed. The requested key or certificate is not available, slot is empty.
        KEYM_E_KEY_CERT_READ_FAIL: error-code=9  # The service request failed. Certificate or key could not be provided due to a read or permission failure.
        KEYM_E_KEY_CERT_SIZE_MISMATCH: error-code=4  # The service request failed. Parameter size does not match the expected value.
        KEYM_E_KEY_CERT_WRITE_FAIL: error-code=7  # The service request failed. Certificate or key could not be provided due to a write or permission failure.
        KEYM_E_PARAMETER_MISMATCH: error-code=5  # The service request failed. Parameter to function does not provide the expected value.
    KeyMCertificate_Ssa_TrustModelIntermediatePeerCert  # Service of Certificate sub module
      operation GetStatus: possible-error=KeyMCertificate_Ssa_TrustModelIntermediatePeerCert/E_NOT_OK  # Provides the status of a certificate.
        arg Status: type=KeyM_CertificateStatusType, direction=OUT, server-argument-impl-policy=USE-ARGUMENT-TYPE
      operation VerifyCertificate: possible-error=[KeyMCertificate_Ssa_TrustModelIntermediatePeerCert/E_NOT_OK, KeyMCertificate_Ssa_TrustModelIntermediatePeerCert/KEYM_E_BUSY, KeyMCertificate_Ssa_TrustModelIntermediatePeerCert/KEYM_E_CERT_INVALID_CHAIN_OF_TRUST, KeyMCertificate_Ssa_TrustModelIntermediatePeerCert/KEYM_E_KEY_CERT_EMPTY, KeyMCertificate_Ssa_TrustModelIntermediatePeerCert/KEYM_E_KEY_CERT_SIZE_MISMATCH, KeyMCertificate_Ssa_TrustModelIntermediatePeerCert/KEYM_E_PARAMETER_MISMATCH]  # Verify certificate data from the certificate sub module .
      8 x error:
        E_NOT_OK: error-code=1  # The service request failed.
        KEYM_E_BUSY: error-code=2  # The service request failed. Key management is busy with other operations.
        KEYM_E_CERT_INVALID_CHAIN_OF_TRUST: error-code=11  # The service request failed. Certificate verification failed - Invalid Chain of Trust.
        KEYM_E_KEY_CERT_EMPTY: error-code=10  # The service request failed. The requested key or certificate is not available, slot is empty.
        KEYM_E_KEY_CERT_READ_FAIL: error-code=9  # The service request failed. Certificate or key could not be provided due to a read or permission failure.
        KEYM_E_KEY_CERT_SIZE_MISMATCH: error-code=4  # The service request failed. Parameter size does not match the expected value.
        KEYM_E_KEY_CERT_WRITE_FAIL: error-code=7  # The service request failed. Certificate or key could not be provided due to a write or permission failure.
        KEYM_E_PARAMETER_MISMATCH: error-code=5  # The service request failed. Parameter to function does not provide the expected value.
    KeyMCertificateElement_Ssa_TrustModelBackendCert_SubjectPublicKeyInfoKey  # Service of the certificate sub module to access certificate elements.
      operation CertificateElementGet: possible-error=[KeyMCertificateElement_Ssa_TrustModelBackendCert_SubjectPublicKeyInfoKey/E_NOT_OK, KeyMCertificateElement_Ssa_TrustModelBackendCert_SubjectPublicKeyInfoKey/KEYM_E_KEY_CERT_EMPTY, KeyMCertificateElement_Ssa_TrustModelBackendCert_SubjectPublicKeyInfoKey/KEYM_E_KEY_CERT_INVALID, KeyMCertificateElement_Ssa_TrustModelBackendCert_SubjectPublicKeyInfoKey/KEYM_E_KEY_CERT_SIZE_MISMATCH, KeyMCertificateElement_Ssa_TrustModelBackendCert_SubjectPublicKeyInfoKey/KEYM_E_PARAMETER_MISMATCH]  # Provides the content of a specific certificate element. The certificate configuration defines how the certificate submodule can find the element, e.g. by providing the object identifier (OID). This function is used to retrieve this information if only one element is assigned to the respective OID.
        arg CertificateElementData: type=KeyM_CertificateElementType_Ssa_TrustModelBackendCert_SubjectPublicKeyInfoKey, direction=OUT, server-argument-impl-policy=USE-ARRAY-BASE-TYPE
        arg CertificateDataLength: type=uint32, direction=OUT, server-argument-impl-policy=USE-ARGUMENT-TYPE
      5 x error:
        E_NOT_OK: error-code=1  # The service request failed.
        KEYM_E_KEY_CERT_EMPTY: error-code=10  # The service request failed. The requested key or certificate is not available, slot is empty.
        KEYM_E_KEY_CERT_INVALID: error-code=6  # The service request failed. Key or certificate is invalid and cannot be used for the operation.
        KEYM_E_KEY_CERT_SIZE_MISMATCH: error-code=4  # The service request failed. Parameter size does not match the expected value.
        KEYM_E_PARAMETER_MISMATCH: error-code=5  # The service request failed. Parameter to function does not provide the expected value.
    KeyMCertificate_Ssa_TrustModelEcuCert  # Service of Certificate sub module
      operation GetStatus: possible-error=KeyMCertificate_Ssa_TrustModelEcuCert/E_NOT_OK  # Provides the status of a certificate.
        arg Status: type=KeyM_CertificateStatusType, direction=OUT, server-argument-impl-policy=USE-ARGUMENT-TYPE
      operation VerifyCertificate: possible-error=[KeyMCertificate_Ssa_TrustModelEcuCert/E_NOT_OK, KeyMCertificate_Ssa_TrustModelEcuCert/KEYM_E_BUSY, KeyMCertificate_Ssa_TrustModelEcuCert/KEYM_E_CERT_INVALID_CHAIN_OF_TRUST, KeyMCertificate_Ssa_TrustModelEcuCert/KEYM_E_KEY_CERT_EMPTY, KeyMCertificate_Ssa_TrustModelEcuCert/KEYM_E_KEY_CERT_SIZE_MISMATCH, KeyMCertificate_Ssa_TrustModelEcuCert/KEYM_E_PARAMETER_MISMATCH]  # Verify certificate data from the certificate sub module .
      8 x error:
        E_NOT_OK: error-code=1  # The service request failed.
        KEYM_E_BUSY: error-code=2  # The service request failed. Key management is busy with other operations.
        KEYM_E_CERT_INVALID_CHAIN_OF_TRUST: error-code=11  # The service request failed. Certificate verification failed - Invalid Chain of Trust.
        KEYM_E_KEY_CERT_EMPTY: error-code=10  # The service request failed. The requested key or certificate is not available, slot is empty.
        KEYM_E_KEY_CERT_READ_FAIL: error-code=9  # The service request failed. Certificate or key could not be provided due to a read or permission failure.
        KEYM_E_KEY_CERT_SIZE_MISMATCH: error-code=4  # The service request failed. Parameter size does not match the expected value.
        KEYM_E_KEY_CERT_WRITE_FAIL: error-code=7  # The service request failed. Certificate or key could not be provided due to a write or permission failure.
        KEYM_E_PARAMETER_MISMATCH: error-code=5  # The service request failed. Parameter to function does not provide the expected value.
    KeyMCertificateElement_Ssa_TrustModelBackendCert_validityNotAfter  # Service of the certificate sub module to access certificate elements.
      operation CertificateElementGet: possible-error=[KeyMCertificateElement_Ssa_TrustModelBackendCert_validityNotAfter/E_NOT_OK, KeyMCertificateElement_Ssa_TrustModelBackendCert_validityNotAfter/KEYM_E_KEY_CERT_EMPTY, KeyMCertificateElement_Ssa_TrustModelBackendCert_validityNotAfter/KEYM_E_KEY_CERT_INVALID, KeyMCertificateElement_Ssa_TrustModelBackendCert_validityNotAfter/KEYM_E_KEY_CERT_SIZE_MISMATCH, KeyMCertificateElement_Ssa_TrustModelBackendCert_validityNotAfter/KEYM_E_PARAMETER_MISMATCH]  # Provides the content of a specific certificate element. The certificate configuration defines how the certificate submodule can find the element, e.g. by providing the object identifier (OID). This function is used to retrieve this information if only one element is assigned to the respective OID.
        arg CertificateElementData: type=KeyM_CertificateElementType_Ssa_TrustModelBackendCert_validityNotAfter, direction=OUT, server-argument-impl-policy=USE-ARRAY-BASE-TYPE
        arg CertificateDataLength: type=uint32, direction=OUT, server-argument-impl-policy=USE-ARGUMENT-TYPE
      5 x error:
        E_NOT_OK: error-code=1  # The service request failed.
        KEYM_E_KEY_CERT_EMPTY: error-code=10  # The service request failed. The requested key or certificate is not available, slot is empty.
        KEYM_E_KEY_CERT_INVALID: error-code=6  # The service request failed. Key or certificate is invalid and cannot be used for the operation.
        KEYM_E_KEY_CERT_SIZE_MISMATCH: error-code=4  # The service request failed. Parameter size does not match the expected value.
        KEYM_E_PARAMETER_MISMATCH: error-code=5  # The service request failed. Parameter to function does not provide the expected value.
    KeyMCertificateElement_Ssa_TrustModelEcuPeerCert_validityNotAfter  # Service of the certificate sub module to access certificate elements.
      operation CertificateElementGet: possible-error=[KeyMCertificateElement_Ssa_TrustModelEcuPeerCert_validityNotAfter/E_NOT_OK, KeyMCertificateElement_Ssa_TrustModelEcuPeerCert_validityNotAfter/KEYM_E_KEY_CERT_EMPTY, KeyMCertificateElement_Ssa_TrustModelEcuPeerCert_validityNotAfter/KEYM_E_KEY_CERT_INVALID, KeyMCertificateElement_Ssa_TrustModelEcuPeerCert_validityNotAfter/KEYM_E_KEY_CERT_SIZE_MISMATCH, KeyMCertificateElement_Ssa_TrustModelEcuPeerCert_validityNotAfter/KEYM_E_PARAMETER_MISMATCH]  # Provides the content of a specific certificate element. The certificate configuration defines how the certificate submodule can find the element, e.g. by providing the object identifier (OID). This function is used to retrieve this information if only one element is assigned to the respective OID.
        arg CertificateElementData: type=KeyM_CertificateElementType_Ssa_TrustModelEcuPeerCert_validityNotAfter, direction=OUT, server-argument-impl-policy=USE-ARRAY-BASE-TYPE
        arg CertificateDataLength: type=uint32, direction=OUT, server-argument-impl-policy=USE-ARGUMENT-TYPE
      5 x error:
        E_NOT_OK: error-code=1  # The service request failed.
        KEYM_E_KEY_CERT_EMPTY: error-code=10  # The service request failed. The requested key or certificate is not available, slot is empty.
        KEYM_E_KEY_CERT_INVALID: error-code=6  # The service request failed. Key or certificate is invalid and cannot be used for the operation.
        KEYM_E_KEY_CERT_SIZE_MISMATCH: error-code=4  # The service request failed. Parameter size does not match the expected value.
        KEYM_E_PARAMETER_MISMATCH: error-code=5  # The service request failed. Parameter to function does not provide the expected value.
    KeyMCertificate_Ssa_TrustModelRootCert  # Service of Certificate sub module
      operation GetStatus: possible-error=KeyMCertificate_Ssa_TrustModelRootCert/E_NOT_OK  # Provides the status of a certificate.
        arg Status: type=KeyM_CertificateStatusType, direction=OUT, server-argument-impl-policy=USE-ARGUMENT-TYPE
      operation VerifyCertificate: possible-error=[KeyMCertificate_Ssa_TrustModelRootCert/E_NOT_OK, KeyMCertificate_Ssa_TrustModelRootCert/KEYM_E_BUSY, KeyMCertificate_Ssa_TrustModelRootCert/KEYM_E_CERT_INVALID_CHAIN_OF_TRUST, KeyMCertificate_Ssa_TrustModelRootCert/KEYM_E_KEY_CERT_EMPTY, KeyMCertificate_Ssa_TrustModelRootCert/KEYM_E_KEY_CERT_SIZE_MISMATCH, KeyMCertificate_Ssa_TrustModelRootCert/KEYM_E_PARAMETER_MISMATCH]  # Verify certificate data from the certificate sub module .
      8 x error:
        E_NOT_OK: error-code=1  # The service request failed.
        KEYM_E_BUSY: error-code=2  # The service request failed. Key management is busy with other operations.
        KEYM_E_CERT_INVALID_CHAIN_OF_TRUST: error-code=11  # The service request failed. Certificate verification failed - Invalid Chain of Trust.
        KEYM_E_KEY_CERT_EMPTY: error-code=10  # The service request failed. The requested key or certificate is not available, slot is empty.
        KEYM_E_KEY_CERT_READ_FAIL: error-code=9  # The service request failed. Certificate or key could not be provided due to a read or permission failure.
        KEYM_E_KEY_CERT_SIZE_MISMATCH: error-code=4  # The service request failed. Parameter size does not match the expected value.
        KEYM_E_KEY_CERT_WRITE_FAIL: error-code=7  # The service request failed. Certificate or key could not be provided due to a write or permission failure.
        KEYM_E_PARAMETER_MISMATCH: error-code=5  # The service request failed. Parameter to function does not provide the expected value.
    KeyMCertificate_Ssa_TrustModelEcuCsr  # Service of Certificate sub module
      operation GetStatus: possible-error=KeyMCertificate_Ssa_TrustModelEcuCsr/E_NOT_OK  # Provides the status of a certificate.
        arg Status: type=KeyM_CertificateStatusType, direction=OUT, server-argument-impl-policy=USE-ARGUMENT-TYPE
      operation VerifyCertificate: possible-error=[KeyMCertificate_Ssa_TrustModelEcuCsr/E_NOT_OK, KeyMCertificate_Ssa_TrustModelEcuCsr/KEYM_E_BUSY, KeyMCertificate_Ssa_TrustModelEcuCsr/KEYM_E_CERT_INVALID_CHAIN_OF_TRUST, KeyMCertificate_Ssa_TrustModelEcuCsr/KEYM_E_KEY_CERT_EMPTY, KeyMCertificate_Ssa_TrustModelEcuCsr/KEYM_E_KEY_CERT_SIZE_MISMATCH, KeyMCertificate_Ssa_TrustModelEcuCsr/KEYM_E_PARAMETER_MISMATCH]  # Verify certificate data from the certificate sub module .
      8 x error:
        E_NOT_OK: error-code=1  # The service request failed.
        KEYM_E_BUSY: error-code=2  # The service request failed. Key management is busy with other operations.
        KEYM_E_CERT_INVALID_CHAIN_OF_TRUST: error-code=11  # The service request failed. Certificate verification failed - Invalid Chain of Trust.
        KEYM_E_KEY_CERT_EMPTY: error-code=10  # The service request failed. The requested key or certificate is not available, slot is empty.
        KEYM_E_KEY_CERT_READ_FAIL: error-code=9  # The service request failed. Certificate or key could not be provided due to a read or permission failure.
        KEYM_E_KEY_CERT_SIZE_MISMATCH: error-code=4  # The service request failed. Parameter size does not match the expected value.
        KEYM_E_KEY_CERT_WRITE_FAIL: error-code=7  # The service request failed. Certificate or key could not be provided due to a write or permission failure.
        KEYM_E_PARAMETER_MISMATCH: error-code=5  # The service request failed. Parameter to function does not provide the expected value.
    KeyMCertificateElement_Ssa_TrustModelBackendCert_Version  # Service of the certificate sub module to access certificate elements.
      operation CertificateElementGet: possible-error=[KeyMCertificateElement_Ssa_TrustModelBackendCert_Version/E_NOT_OK, KeyMCertificateElement_Ssa_TrustModelBackendCert_Version/KEYM_E_KEY_CERT_EMPTY, KeyMCertificateElement_Ssa_TrustModelBackendCert_Version/KEYM_E_KEY_CERT_INVALID, KeyMCertificateElement_Ssa_TrustModelBackendCert_Version/KEYM_E_KEY_CERT_SIZE_MISMATCH, KeyMCertificateElement_Ssa_TrustModelBackendCert_Version/KEYM_E_PARAMETER_MISMATCH]  # Provides the content of a specific certificate element. The certificate configuration defines how the certificate submodule can find the element, e.g. by providing the object identifier (OID). This function is used to retrieve this information if only one element is assigned to the respective OID.
        arg CertificateElementData: type=KeyM_CertificateElementType_Ssa_TrustModelBackendCert_Version, direction=OUT, server-argument-impl-policy=USE-ARRAY-BASE-TYPE
        arg CertificateDataLength: type=uint32, direction=OUT, server-argument-impl-policy=USE-ARGUMENT-TYPE
      5 x error:
        E_NOT_OK: error-code=1  # The service request failed.
        KEYM_E_KEY_CERT_EMPTY: error-code=10  # The service request failed. The requested key or certificate is not available, slot is empty.
        KEYM_E_KEY_CERT_INVALID: error-code=6  # The service request failed. Key or certificate is invalid and cannot be used for the operation.
        KEYM_E_KEY_CERT_SIZE_MISMATCH: error-code=4  # The service request failed. Parameter size does not match the expected value.
        KEYM_E_PARAMETER_MISMATCH: error-code=5  # The service request failed. Parameter to function does not provide the expected value.
    KeyMCertificateElement_Ssa_TrustModelIntermediateCert_SubjectPublicKeyInfoKey  # Service of the certificate sub module to access certificate elements.
      operation CertificateElementGet: possible-error=[KeyMCertificateElement_Ssa_TrustModelIntermediateCert_SubjectPublicKeyInfoKey/E_NOT_OK, KeyMCertificateElement_Ssa_TrustModelIntermediateCert_SubjectPublicKeyInfoKey/KEYM_E_KEY_CERT_EMPTY, KeyMCertificateElement_Ssa_TrustModelIntermediateCert_SubjectPublicKeyInfoKey/KEYM_E_KEY_CERT_INVALID, KeyMCertificateElement_Ssa_TrustModelIntermediateCert_SubjectPublicKeyInfoKey/KEYM_E_KEY_CERT_SIZE_MISMATCH, KeyMCertificateElement_Ssa_TrustModelIntermediateCert_SubjectPublicKeyInfoKey/KEYM_E_PARAMETER_MISMATCH]  # Provides the content of a specific certificate element. The certificate configuration defines how the certificate submodule can find the element, e.g. by providing the object identifier (OID). This function is used to retrieve this information if only one element is assigned to the respective OID.
        arg CertificateElementData: type=KeyM_CertificateElementType_Ssa_TrustModelIntermediateCert_SubjectPublicKeyInfoKey, direction=OUT, server-argument-impl-policy=USE-ARRAY-BASE-TYPE
        arg CertificateDataLength: type=uint32, direction=OUT, server-argument-impl-policy=USE-ARGUMENT-TYPE
      5 x error:
        E_NOT_OK: error-code=1  # The service request failed.
        KEYM_E_KEY_CERT_EMPTY: error-code=10  # The service request failed. The requested key or certificate is not available, slot is empty.
        KEYM_E_KEY_CERT_INVALID: error-code=6  # The service request failed. Key or certificate is invalid and cannot be used for the operation.
        KEYM_E_KEY_CERT_SIZE_MISMATCH: error-code=4  # The service request failed. Parameter size does not match the expected value.
        KEYM_E_PARAMETER_MISMATCH: error-code=5  # The service request failed. Parameter to function does not provide the expected value.
    KeyMCertificateElement_Ssa_TrustModelBackendCert_ext_authKeyId  # Service of the certificate sub module to access certificate elements.
      operation CertificateElementGet: possible-error=[KeyMCertificateElement_Ssa_TrustModelBackendCert_ext_authKeyId/E_NOT_OK, KeyMCertificateElement_Ssa_TrustModelBackendCert_ext_authKeyId/KEYM_E_KEY_CERT_EMPTY, KeyMCertificateElement_Ssa_TrustModelBackendCert_ext_authKeyId/KEYM_E_KEY_CERT_INVALID, KeyMCertificateElement_Ssa_TrustModelBackendCert_ext_authKeyId/KEYM_E_KEY_CERT_SIZE_MISMATCH, KeyMCertificateElement_Ssa_TrustModelBackendCert_ext_authKeyId/KEYM_E_PARAMETER_MISMATCH]  # Provides the content of a specific certificate element. The certificate configuration defines how the certificate submodule can find the element, e.g. by providing the object identifier (OID). This function is used to retrieve this information if only one element is assigned to the respective OID.
        arg CertificateElementData: type=KeyM_CertificateElementType_Ssa_TrustModelBackendCert_ext_authKeyId, direction=OUT, server-argument-impl-policy=USE-ARRAY-BASE-TYPE
        arg CertificateDataLength: type=uint32, direction=OUT, server-argument-impl-policy=USE-ARGUMENT-TYPE
      5 x error:
        E_NOT_OK: error-code=1  # The service request failed.
        KEYM_E_KEY_CERT_EMPTY: error-code=10  # The service request failed. The requested key or certificate is not available, slot is empty.
        KEYM_E_KEY_CERT_INVALID: error-code=6  # The service request failed. Key or certificate is invalid and cannot be used for the operation.
        KEYM_E_KEY_CERT_SIZE_MISMATCH: error-code=4  # The service request failed. Parameter size does not match the expected value.
        KEYM_E_PARAMETER_MISMATCH: error-code=5  # The service request failed. Parameter to function does not provide the expected value.
    KeyMCertificateElement_Ssa_TrustModelBackendPeerCert_ext_authKeyId  # Service of the certificate sub module to access certificate elements.
      operation CertificateElementGet: possible-error=[KeyMCertificateElement_Ssa_TrustModelBackendPeerCert_ext_authKeyId/E_NOT_OK, KeyMCertificateElement_Ssa_TrustModelBackendPeerCert_ext_authKeyId/KEYM_E_KEY_CERT_EMPTY, KeyMCertificateElement_Ssa_TrustModelBackendPeerCert_ext_authKeyId/KEYM_E_KEY_CERT_INVALID, KeyMCertificateElement_Ssa_TrustModelBackendPeerCert_ext_authKeyId/KEYM_E_KEY_CERT_SIZE_MISMATCH, KeyMCertificateElement_Ssa_TrustModelBackendPeerCert_ext_authKeyId/KEYM_E_PARAMETER_MISMATCH]  # Provides the content of a specific certificate element. The certificate configuration defines how the certificate submodule can find the element, e.g. by providing the object identifier (OID). This function is used to retrieve this information if only one element is assigned to the respective OID.
        arg CertificateElementData: type=KeyM_CertificateElementType_Ssa_TrustModelBackendPeerCert_ext_authKeyId, direction=OUT, server-argument-impl-policy=USE-ARRAY-BASE-TYPE
        arg CertificateDataLength: type=uint32, direction=OUT, server-argument-impl-policy=USE-ARGUMENT-TYPE
      5 x error:
        E_NOT_OK: error-code=1  # The service request failed.
        KEYM_E_KEY_CERT_EMPTY: error-code=10  # The service request failed. The requested key or certificate is not available, slot is empty.
        KEYM_E_KEY_CERT_INVALID: error-code=6  # The service request failed. Key or certificate is invalid and cannot be used for the operation.
        KEYM_E_KEY_CERT_SIZE_MISMATCH: error-code=4  # The service request failed. Parameter size does not match the expected value.
        KEYM_E_PARAMETER_MISMATCH: error-code=5  # The service request failed. Parameter to function does not provide the expected value.
    KeyMCertificateElement_Ssa_TrustModelIntermediateCert_validityNotAfter  # Service of the certificate sub module to access certificate elements.
      operation CertificateElementGet: possible-error=[KeyMCertificateElement_Ssa_TrustModelIntermediateCert_validityNotAfter/E_NOT_OK, KeyMCertificateElement_Ssa_TrustModelIntermediateCert_validityNotAfter/KEYM_E_KEY_CERT_EMPTY, KeyMCertificateElement_Ssa_TrustModelIntermediateCert_validityNotAfter/KEYM_E_KEY_CERT_INVALID, KeyMCertificateElement_Ssa_TrustModelIntermediateCert_validityNotAfter/KEYM_E_KEY_CERT_SIZE_MISMATCH, KeyMCertificateElement_Ssa_TrustModelIntermediateCert_validityNotAfter/KEYM_E_PARAMETER_MISMATCH]  # Provides the content of a specific certificate element. The certificate configuration defines how the certificate submodule can find the element, e.g. by providing the object identifier (OID). This function is used to retrieve this information if only one element is assigned to the respective OID.
        arg CertificateElementData: type=KeyM_CertificateElementType_Ssa_TrustModelIntermediateCert_validityNotAfter, direction=OUT, server-argument-impl-policy=USE-ARRAY-BASE-TYPE
        arg CertificateDataLength: type=uint32, direction=OUT, server-argument-impl-policy=USE-ARGUMENT-TYPE
      5 x error:
        E_NOT_OK: error-code=1  # The service request failed.
        KEYM_E_KEY_CERT_EMPTY: error-code=10  # The service request failed. The requested key or certificate is not available, slot is empty.
        KEYM_E_KEY_CERT_INVALID: error-code=6  # The service request failed. Key or certificate is invalid and cannot be used for the operation.
        KEYM_E_KEY_CERT_SIZE_MISMATCH: error-code=4  # The service request failed. Parameter size does not match the expected value.
        KEYM_E_PARAMETER_MISMATCH: error-code=5  # The service request failed. Parameter to function does not provide the expected value.
    KeyMCertificateElement_Ssa_TrustModelEcuPeerCert_Version  # Service of the certificate sub module to access certificate elements.
      operation CertificateElementGet: possible-error=[KeyMCertificateElement_Ssa_TrustModelEcuPeerCert_Version/E_NOT_OK, KeyMCertificateElement_Ssa_TrustModelEcuPeerCert_Version/KEYM_E_KEY_CERT_EMPTY, KeyMCertificateElement_Ssa_TrustModelEcuPeerCert_Version/KEYM_E_KEY_CERT_INVALID, KeyMCertificateElement_Ssa_TrustModelEcuPeerCert_Version/KEYM_E_KEY_CERT_SIZE_MISMATCH, KeyMCertificateElement_Ssa_TrustModelEcuPeerCert_Version/KEYM_E_PARAMETER_MISMATCH]  # Provides the content of a specific certificate element. The certificate configuration defines how the certificate submodule can find the element, e.g. by providing the object identifier (OID). This function is used to retrieve this information if only one element is assigned to the respective OID.
        arg CertificateElementData: type=KeyM_CertificateElementType_Ssa_TrustModelEcuPeerCert_Version, direction=OUT, server-argument-impl-policy=USE-ARRAY-BASE-TYPE
        arg CertificateDataLength: type=uint32, direction=OUT, server-argument-impl-policy=USE-ARGUMENT-TYPE
      5 x error:
        E_NOT_OK: error-code=1  # The service request failed.
        KEYM_E_KEY_CERT_EMPTY: error-code=10  # The service request failed. The requested key or certificate is not available, slot is empty.
        KEYM_E_KEY_CERT_INVALID: error-code=6  # The service request failed. Key or certificate is invalid and cannot be used for the operation.
        KEYM_E_KEY_CERT_SIZE_MISMATCH: error-code=4  # The service request failed. Parameter size does not match the expected value.
        KEYM_E_PARAMETER_MISMATCH: error-code=5  # The service request failed. Parameter to function does not provide the expected value.
    KeyMCertificateElement_Ssa_TrustModelBackendPeerCert_ext_basicConstraints  # Service of the certificate sub module to access certificate elements.
      operation CertificateElementGet: possible-error=[KeyMCertificateElement_Ssa_TrustModelBackendPeerCert_ext_basicConstraints/E_NOT_OK, KeyMCertificateElement_Ssa_TrustModelBackendPeerCert_ext_basicConstraints/KEYM_E_KEY_CERT_EMPTY, KeyMCertificateElement_Ssa_TrustModelBackendPeerCert_ext_basicConstraints/KEYM_E_KEY_CERT_INVALID, KeyMCertificateElement_Ssa_TrustModelBackendPeerCert_ext_basicConstraints/KEYM_E_KEY_CERT_SIZE_MISMATCH, KeyMCertificateElement_Ssa_TrustModelBackendPeerCert_ext_basicConstraints/KEYM_E_PARAMETER_MISMATCH]  # Provides the content of a specific certificate element. The certificate configuration defines how the certificate submodule can find the element, e.g. by providing the object identifier (OID). This function is used to retrieve this information if only one element is assigned to the respective OID.
        arg CertificateElementData: type=KeyM_CertificateElementType_Ssa_TrustModelBackendPeerCert_ext_basicConstraints, direction=OUT, server-argument-impl-policy=USE-ARRAY-BASE-TYPE
        arg CertificateDataLength: type=uint32, direction=OUT, server-argument-impl-policy=USE-ARGUMENT-TYPE
      5 x error:
        E_NOT_OK: error-code=1  # The service request failed.
        KEYM_E_KEY_CERT_EMPTY: error-code=10  # The service request failed. The requested key or certificate is not available, slot is empty.
        KEYM_E_KEY_CERT_INVALID: error-code=6  # The service request failed. Key or certificate is invalid and cannot be used for the operation.
        KEYM_E_KEY_CERT_SIZE_MISMATCH: error-code=4  # The service request failed. Parameter size does not match the expected value.
        KEYM_E_PARAMETER_MISMATCH: error-code=5  # The service request failed. Parameter to function does not provide the expected value.
    KeyMCertificateElement_Ssa_TrustModelIntermediatePeerCert_Version  # Service of the certificate sub module to access certificate elements.
      operation CertificateElementGet: possible-error=[KeyMCertificateElement_Ssa_TrustModelIntermediatePeerCert_Version/E_NOT_OK, KeyMCertificateElement_Ssa_TrustModelIntermediatePeerCert_Version/KEYM_E_KEY_CERT_EMPTY, KeyMCertificateElement_Ssa_TrustModelIntermediatePeerCert_Version/KEYM_E_KEY_CERT_INVALID, KeyMCertificateElement_Ssa_TrustModelIntermediatePeerCert_Version/KEYM_E_KEY_CERT_SIZE_MISMATCH, KeyMCertificateElement_Ssa_TrustModelIntermediatePeerCert_Version/KEYM_E_PARAMETER_MISMATCH]  # Provides the content of a specific certificate element. The certificate configuration defines how the certificate submodule can find the element, e.g. by providing the object identifier (OID). This function is used to retrieve this information if only one element is assigned to the respective OID.
        arg CertificateElementData: type=KeyM_CertificateElementType_Ssa_TrustModelIntermediatePeerCert_Version, direction=OUT, server-argument-impl-policy=USE-ARRAY-BASE-TYPE
        arg CertificateDataLength: type=uint32, direction=OUT, server-argument-impl-policy=USE-ARGUMENT-TYPE
      5 x error:
        E_NOT_OK: error-code=1  # The service request failed.
        KEYM_E_KEY_CERT_EMPTY: error-code=10  # The service request failed. The requested key or certificate is not available, slot is empty.
        KEYM_E_KEY_CERT_INVALID: error-code=6  # The service request failed. Key or certificate is invalid and cannot be used for the operation.
        KEYM_E_KEY_CERT_SIZE_MISMATCH: error-code=4  # The service request failed. Parameter size does not match the expected value.
        KEYM_E_PARAMETER_MISMATCH: error-code=5  # The service request failed. Parameter to function does not provide the expected value.
    KeyMCertificateElement_Ssa_TrustModelIntermediateCert_Version  # Service of the certificate sub module to access certificate elements.
      operation CertificateElementGet: possible-error=[KeyMCertificateElement_Ssa_TrustModelIntermediateCert_Version/E_NOT_OK, KeyMCertificateElement_Ssa_TrustModelIntermediateCert_Version/KEYM_E_KEY_CERT_EMPTY, KeyMCertificateElement_Ssa_TrustModelIntermediateCert_Version/KEYM_E_KEY_CERT_INVALID, KeyMCertificateElement_Ssa_TrustModelIntermediateCert_Version/KEYM_E_KEY_CERT_SIZE_MISMATCH, KeyMCertificateElement_Ssa_TrustModelIntermediateCert_Version/KEYM_E_PARAMETER_MISMATCH]  # Provides the content of a specific certificate element. The certificate configuration defines how the certificate submodule can find the element, e.g. by providing the object identifier (OID). This function is used to retrieve this information if only one element is assigned to the respective OID.
        arg CertificateElementData: type=KeyM_CertificateElementType_Ssa_TrustModelIntermediateCert_Version, direction=OUT, server-argument-impl-policy=USE-ARRAY-BASE-TYPE
        arg CertificateDataLength: type=uint32, direction=OUT, server-argument-impl-policy=USE-ARGUMENT-TYPE
      5 x error:
        E_NOT_OK: error-code=1  # The service request failed.
        KEYM_E_KEY_CERT_EMPTY: error-code=10  # The service request failed. The requested key or certificate is not available, slot is empty.
        KEYM_E_KEY_CERT_INVALID: error-code=6  # The service request failed. Key or certificate is invalid and cannot be used for the operation.
        KEYM_E_KEY_CERT_SIZE_MISMATCH: error-code=4  # The service request failed. Parameter size does not match the expected value.
        KEYM_E_PARAMETER_MISMATCH: error-code=5  # The service request failed. Parameter to function does not provide the expected value.
    KeyMCertificateElement_Ssa_TrustModelBackendCert_ext_basicConstraints  # Service of the certificate sub module to access certificate elements.
      operation CertificateElementGet: possible-error=[KeyMCertificateElement_Ssa_TrustModelBackendCert_ext_basicConstraints/E_NOT_OK, KeyMCertificateElement_Ssa_TrustModelBackendCert_ext_basicConstraints/KEYM_E_KEY_CERT_EMPTY, KeyMCertificateElement_Ssa_TrustModelBackendCert_ext_basicConstraints/KEYM_E_KEY_CERT_INVALID, KeyMCertificateElement_Ssa_TrustModelBackendCert_ext_basicConstraints/KEYM_E_KEY_CERT_SIZE_MISMATCH, KeyMCertificateElement_Ssa_TrustModelBackendCert_ext_basicConstraints/KEYM_E_PARAMETER_MISMATCH]  # Provides the content of a specific certificate element. The certificate configuration defines how the certificate submodule can find the element, e.g. by providing the object identifier (OID). This function is used to retrieve this information if only one element is assigned to the respective OID.
        arg CertificateElementData: type=KeyM_CertificateElementType_Ssa_TrustModelBackendCert_ext_basicConstraints, direction=OUT, server-argument-impl-policy=USE-ARRAY-BASE-TYPE
        arg CertificateDataLength: type=uint32, direction=OUT, server-argument-impl-policy=USE-ARGUMENT-TYPE
      5 x error:
        E_NOT_OK: error-code=1  # The service request failed.
        KEYM_E_KEY_CERT_EMPTY: error-code=10  # The service request failed. The requested key or certificate is not available, slot is empty.
        KEYM_E_KEY_CERT_INVALID: error-code=6  # The service request failed. Key or certificate is invalid and cannot be used for the operation.
        KEYM_E_KEY_CERT_SIZE_MISMATCH: error-code=4  # The service request failed. Parameter size does not match the expected value.
        KEYM_E_PARAMETER_MISMATCH: error-code=5  # The service request failed. Parameter to function does not provide the expected value.
    KeyMCertificateElement_Ssa_TrustModelBackendPeerCert_ext_subKeyId  # Service of the certificate sub module to access certificate elements.
      operation CertificateElementGet: possible-error=[KeyMCertificateElement_Ssa_TrustModelBackendPeerCert_ext_subKeyId/E_NOT_OK, KeyMCertificateElement_Ssa_TrustModelBackendPeerCert_ext_subKeyId/KEYM_E_KEY_CERT_EMPTY, KeyMCertificateElement_Ssa_TrustModelBackendPeerCert_ext_subKeyId/KEYM_E_KEY_CERT_INVALID, KeyMCertificateElement_Ssa_TrustModelBackendPeerCert_ext_subKeyId/KEYM_E_KEY_CERT_SIZE_MISMATCH, KeyMCertificateElement_Ssa_TrustModelBackendPeerCert_ext_subKeyId/KEYM_E_PARAMETER_MISMATCH]  # Provides the content of a specific certificate element. The certificate configuration defines how the certificate submodule can find the element, e.g. by providing the object identifier (OID). This function is used to retrieve this information if only one element is assigned to the respective OID.
        arg CertificateElementData: type=KeyM_CertificateElementType_Ssa_TrustModelBackendPeerCert_ext_subKeyId, direction=OUT, server-argument-impl-policy=USE-ARRAY-BASE-TYPE
        arg CertificateDataLength: type=uint32, direction=OUT, server-argument-impl-policy=USE-ARGUMENT-TYPE
      5 x error:
        E_NOT_OK: error-code=1  # The service request failed.
        KEYM_E_KEY_CERT_EMPTY: error-code=10  # The service request failed. The requested key or certificate is not available, slot is empty.
        KEYM_E_KEY_CERT_INVALID: error-code=6  # The service request failed. Key or certificate is invalid and cannot be used for the operation.
        KEYM_E_KEY_CERT_SIZE_MISMATCH: error-code=4  # The service request failed. Parameter size does not match the expected value.
        KEYM_E_PARAMETER_MISMATCH: error-code=5  # The service request failed. Parameter to function does not provide the expected value.
    KeyMCertificateElement_Ssa_TrustModelIntermediateCert_ext_authKeyId  # Service of the certificate sub module to access certificate elements.
      operation CertificateElementGet: possible-error=[KeyMCertificateElement_Ssa_TrustModelIntermediateCert_ext_authKeyId/E_NOT_OK, KeyMCertificateElement_Ssa_TrustModelIntermediateCert_ext_authKeyId/KEYM_E_KEY_CERT_EMPTY, KeyMCertificateElement_Ssa_TrustModelIntermediateCert_ext_authKeyId/KEYM_E_KEY_CERT_INVALID, KeyMCertificateElement_Ssa_TrustModelIntermediateCert_ext_authKeyId/KEYM_E_KEY_CERT_SIZE_MISMATCH, KeyMCertificateElement_Ssa_TrustModelIntermediateCert_ext_authKeyId/KEYM_E_PARAMETER_MISMATCH]  # Provides the content of a specific certificate element. The certificate configuration defines how the certificate submodule can find the element, e.g. by providing the object identifier (OID). This function is used to retrieve this information if only one element is assigned to the respective OID.
        arg CertificateElementData: type=KeyM_CertificateElementType_Ssa_TrustModelIntermediateCert_ext_authKeyId, direction=OUT, server-argument-impl-policy=USE-ARRAY-BASE-TYPE
        arg CertificateDataLength: type=uint32, direction=OUT, server-argument-impl-policy=USE-ARGUMENT-TYPE
      5 x error:
        E_NOT_OK: error-code=1  # The service request failed.
        KEYM_E_KEY_CERT_EMPTY: error-code=10  # The service request failed. The requested key or certificate is not available, slot is empty.
        KEYM_E_KEY_CERT_INVALID: error-code=6  # The service request failed. Key or certificate is invalid and cannot be used for the operation.
        KEYM_E_KEY_CERT_SIZE_MISMATCH: error-code=4  # The service request failed. Parameter size does not match the expected value.
        KEYM_E_PARAMETER_MISMATCH: error-code=5  # The service request failed. Parameter to function does not provide the expected value.
    KeyMCertificateElement_Ssa_TrustModelBackendCert_ext_subKeyId  # Service of the certificate sub module to access certificate elements.
      operation CertificateElementGet: possible-error=[KeyMCertificateElement_Ssa_TrustModelBackendCert_ext_subKeyId/E_NOT_OK, KeyMCertificateElement_Ssa_TrustModelBackendCert_ext_subKeyId/KEYM_E_KEY_CERT_EMPTY, KeyMCertificateElement_Ssa_TrustModelBackendCert_ext_subKeyId/KEYM_E_KEY_CERT_INVALID, KeyMCertificateElement_Ssa_TrustModelBackendCert_ext_subKeyId/KEYM_E_KEY_CERT_SIZE_MISMATCH, KeyMCertificateElement_Ssa_TrustModelBackendCert_ext_subKeyId/KEYM_E_PARAMETER_MISMATCH]  # Provides the content of a specific certificate element. The certificate configuration defines how the certificate submodule can find the element, e.g. by providing the object identifier (OID). This function is used to retrieve this information if only one element is assigned to the respective OID.
        arg CertificateElementData: type=KeyM_CertificateElementType_Ssa_TrustModelBackendCert_ext_subKeyId, direction=OUT, server-argument-impl-policy=USE-ARRAY-BASE-TYPE
        arg CertificateDataLength: type=uint32, direction=OUT, server-argument-impl-policy=USE-ARGUMENT-TYPE
      5 x error:
        E_NOT_OK: error-code=1  # The service request failed.
        KEYM_E_KEY_CERT_EMPTY: error-code=10  # The service request failed. The requested key or certificate is not available, slot is empty.
        KEYM_E_KEY_CERT_INVALID: error-code=6  # The service request failed. Key or certificate is invalid and cannot be used for the operation.
        KEYM_E_KEY_CERT_SIZE_MISMATCH: error-code=4  # The service request failed. Parameter size does not match the expected value.
        KEYM_E_PARAMETER_MISMATCH: error-code=5  # The service request failed. Parameter to function does not provide the expected value.
    KeyMCertificateElement_Ssa_TrustModelIntermediateCert_ext_basicConstraints  # Service of the certificate sub module to access certificate elements.
      operation CertificateElementGet: possible-error=[KeyMCertificateElement_Ssa_TrustModelIntermediateCert_ext_basicConstraints/E_NOT_OK, KeyMCertificateElement_Ssa_TrustModelIntermediateCert_ext_basicConstraints/KEYM_E_KEY_CERT_EMPTY, KeyMCertificateElement_Ssa_TrustModelIntermediateCert_ext_basicConstraints/KEYM_E_KEY_CERT_INVALID, KeyMCertificateElement_Ssa_TrustModelIntermediateCert_ext_basicConstraints/KEYM_E_KEY_CERT_SIZE_MISMATCH, KeyMCertificateElement_Ssa_TrustModelIntermediateCert_ext_basicConstraints/KEYM_E_PARAMETER_MISMATCH]  # Provides the content of a specific certificate element. The certificate configuration defines how the certificate submodule can find the element, e.g. by providing the object identifier (OID). This function is used to retrieve this information if only one element is assigned to the respective OID.
        arg CertificateElementData: type=KeyM_CertificateElementType_Ssa_TrustModelIntermediateCert_ext_basicConstraints, direction=OUT, server-argument-impl-policy=USE-ARRAY-BASE-TYPE
        arg CertificateDataLength: type=uint32, direction=OUT, server-argument-impl-policy=USE-ARGUMENT-TYPE
      5 x error:
        E_NOT_OK: error-code=1  # The service request failed.
        KEYM_E_KEY_CERT_EMPTY: error-code=10  # The service request failed. The requested key or certificate is not available, slot is empty.
        KEYM_E_KEY_CERT_INVALID: error-code=6  # The service request failed. Key or certificate is invalid and cannot be used for the operation.
        KEYM_E_KEY_CERT_SIZE_MISMATCH: error-code=4  # The service request failed. Parameter size does not match the expected value.
        KEYM_E_PARAMETER_MISMATCH: error-code=5  # The service request failed. Parameter to function does not provide the expected value.
    KeyMCertificateElement_Ssa_TrustModelRootCert_validityNotAfter  # Service of the certificate sub module to access certificate elements.
      operation CertificateElementGet: possible-error=[KeyMCertificateElement_Ssa_TrustModelRootCert_validityNotAfter/E_NOT_OK, KeyMCertificateElement_Ssa_TrustModelRootCert_validityNotAfter/KEYM_E_KEY_CERT_EMPTY, KeyMCertificateElement_Ssa_TrustModelRootCert_validityNotAfter/KEYM_E_KEY_CERT_INVALID, KeyMCertificateElement_Ssa_TrustModelRootCert_validityNotAfter/KEYM_E_KEY_CERT_SIZE_MISMATCH, KeyMCertificateElement_Ssa_TrustModelRootCert_validityNotAfter/KEYM_E_PARAMETER_MISMATCH]  # Provides the content of a specific certificate element. The certificate configuration defines how the certificate submodule can find the element, e.g. by providing the object identifier (OID). This function is used to retrieve this information if only one element is assigned to the respective OID.
        arg CertificateElementData: type=KeyM_CertificateElementType_Ssa_TrustModelRootCert_validityNotAfter, direction=OUT, server-argument-impl-policy=USE-ARRAY-BASE-TYPE
        arg CertificateDataLength: type=uint32, direction=OUT, server-argument-impl-policy=USE-ARGUMENT-TYPE
      5 x error:
        E_NOT_OK: error-code=1  # The service request failed.
        KEYM_E_KEY_CERT_EMPTY: error-code=10  # The service request failed. The requested key or certificate is not available, slot is empty.
        KEYM_E_KEY_CERT_INVALID: error-code=6  # The service request failed. Key or certificate is invalid and cannot be used for the operation.
        KEYM_E_KEY_CERT_SIZE_MISMATCH: error-code=4  # The service request failed. Parameter size does not match the expected value.
        KEYM_E_PARAMETER_MISMATCH: error-code=5  # The service request failed. Parameter to function does not provide the expected value.
    KeyMCertificateElement_Ssa_TrustModelBackendPeerCert_SerialNo  # Service of the certificate sub module to access certificate elements.
      operation CertificateElementGet: possible-error=[KeyMCertificateElement_Ssa_TrustModelBackendPeerCert_SerialNo/E_NOT_OK, KeyMCertificateElement_Ssa_TrustModelBackendPeerCert_SerialNo/KEYM_E_KEY_CERT_EMPTY, KeyMCertificateElement_Ssa_TrustModelBackendPeerCert_SerialNo/KEYM_E_KEY_CERT_INVALID, KeyMCertificateElement_Ssa_TrustModelBackendPeerCert_SerialNo/KEYM_E_KEY_CERT_SIZE_MISMATCH, KeyMCertificateElement_Ssa_TrustModelBackendPeerCert_SerialNo/KEYM_E_PARAMETER_MISMATCH]  # Provides the content of a specific certificate element. The certificate configuration defines how the certificate submodule can find the element, e.g. by providing the object identifier (OID). This function is used to retrieve this information if only one element is assigned to the respective OID.
        arg CertificateElementData: type=KeyM_CertificateElementType_Ssa_TrustModelBackendPeerCert_SerialNo, direction=OUT, server-argument-impl-policy=USE-ARRAY-BASE-TYPE
        arg CertificateDataLength: type=uint32, direction=OUT, server-argument-impl-policy=USE-ARGUMENT-TYPE
      5 x error:
        E_NOT_OK: error-code=1  # The service request failed.
        KEYM_E_KEY_CERT_EMPTY: error-code=10  # The service request failed. The requested key or certificate is not available, slot is empty.
        KEYM_E_KEY_CERT_INVALID: error-code=6  # The service request failed. Key or certificate is invalid and cannot be used for the operation.
        KEYM_E_KEY_CERT_SIZE_MISMATCH: error-code=4  # The service request failed. Parameter size does not match the expected value.
        KEYM_E_PARAMETER_MISMATCH: error-code=5  # The service request failed. Parameter to function does not provide the expected value.
    KeyMCertificateElement_Ssa_TrustModelIntermediateCert_ext_subKeyId  # Service of the certificate sub module to access certificate elements.
      operation CertificateElementGet: possible-error=[KeyMCertificateElement_Ssa_TrustModelIntermediateCert_ext_subKeyId/E_NOT_OK, KeyMCertificateElement_Ssa_TrustModelIntermediateCert_ext_subKeyId/KEYM_E_KEY_CERT_EMPTY, KeyMCertificateElement_Ssa_TrustModelIntermediateCert_ext_subKeyId/KEYM_E_KEY_CERT_INVALID, KeyMCertificateElement_Ssa_TrustModelIntermediateCert_ext_subKeyId/KEYM_E_KEY_CERT_SIZE_MISMATCH, KeyMCertificateElement_Ssa_TrustModelIntermediateCert_ext_subKeyId/KEYM_E_PARAMETER_MISMATCH]  # Provides the content of a specific certificate element. The certificate configuration defines how the certificate submodule can find the element, e.g. by providing the object identifier (OID). This function is used to retrieve this information if only one element is assigned to the respective OID.
        arg CertificateElementData: type=KeyM_CertificateElementType_Ssa_TrustModelIntermediateCert_ext_subKeyId, direction=OUT, server-argument-impl-policy=USE-ARRAY-BASE-TYPE
        arg CertificateDataLength: type=uint32, direction=OUT, server-argument-impl-policy=USE-ARGUMENT-TYPE
      5 x error:
        E_NOT_OK: error-code=1  # The service request failed.
        KEYM_E_KEY_CERT_EMPTY: error-code=10  # The service request failed. The requested key or certificate is not available, slot is empty.
        KEYM_E_KEY_CERT_INVALID: error-code=6  # The service request failed. Key or certificate is invalid and cannot be used for the operation.
        KEYM_E_KEY_CERT_SIZE_MISMATCH: error-code=4  # The service request failed. Parameter size does not match the expected value.
        KEYM_E_PARAMETER_MISMATCH: error-code=5  # The service request failed. Parameter to function does not provide the expected value.
    KeyMCertificateElement_Ssa_TrustModelBackendPeerCert_validityNotAfter  # Service of the certificate sub module to access certificate elements.
      operation CertificateElementGet: possible-error=[KeyMCertificateElement_Ssa_TrustModelBackendPeerCert_validityNotAfter/E_NOT_OK, KeyMCertificateElement_Ssa_TrustModelBackendPeerCert_validityNotAfter/KEYM_E_KEY_CERT_EMPTY, KeyMCertificateElement_Ssa_TrustModelBackendPeerCert_validityNotAfter/KEYM_E_KEY_CERT_INVALID, KeyMCertificateElement_Ssa_TrustModelBackendPeerCert_validityNotAfter/KEYM_E_KEY_CERT_SIZE_MISMATCH, KeyMCertificateElement_Ssa_TrustModelBackendPeerCert_validityNotAfter/KEYM_E_PARAMETER_MISMATCH]  # Provides the content of a specific certificate element. The certificate configuration defines how the certificate submodule can find the element, e.g. by providing the object identifier (OID). This function is used to retrieve this information if only one element is assigned to the respective OID.
        arg CertificateElementData: type=KeyM_CertificateElementType_Ssa_TrustModelBackendPeerCert_validityNotAfter, direction=OUT, server-argument-impl-policy=USE-ARRAY-BASE-TYPE
        arg CertificateDataLength: type=uint32, direction=OUT, server-argument-impl-policy=USE-ARGUMENT-TYPE
      5 x error:
        E_NOT_OK: error-code=1  # The service request failed.
        KEYM_E_KEY_CERT_EMPTY: error-code=10  # The service request failed. The requested key or certificate is not available, slot is empty.
        KEYM_E_KEY_CERT_INVALID: error-code=6  # The service request failed. Key or certificate is invalid and cannot be used for the operation.
        KEYM_E_KEY_CERT_SIZE_MISMATCH: error-code=4  # The service request failed. Parameter size does not match the expected value.
        KEYM_E_PARAMETER_MISMATCH: error-code=5  # The service request failed. Parameter to function does not provide the expected value.
    KeyMCertificateElement_Ssa_TrustModelRootCert_Version  # Service of the certificate sub module to access certificate elements.
      operation CertificateElementGet: possible-error=[KeyMCertificateElement_Ssa_TrustModelRootCert_Version/E_NOT_OK, KeyMCertificateElement_Ssa_TrustModelRootCert_Version/KEYM_E_KEY_CERT_EMPTY, KeyMCertificateElement_Ssa_TrustModelRootCert_Version/KEYM_E_KEY_CERT_INVALID, KeyMCertificateElement_Ssa_TrustModelRootCert_Version/KEYM_E_KEY_CERT_SIZE_MISMATCH, KeyMCertificateElement_Ssa_TrustModelRootCert_Version/KEYM_E_PARAMETER_MISMATCH]  # Provides the content of a specific certificate element. The certificate configuration defines how the certificate submodule can find the element, e.g. by providing the object identifier (OID). This function is used to retrieve this information if only one element is assigned to the respective OID.
        arg CertificateElementData: type=KeyM_CertificateElementType_Ssa_TrustModelRootCert_Version, direction=OUT, server-argument-impl-policy=USE-ARRAY-BASE-TYPE
        arg CertificateDataLength: type=uint32, direction=OUT, server-argument-impl-policy=USE-ARGUMENT-TYPE
      5 x error:
        E_NOT_OK: error-code=1  # The service request failed.
        KEYM_E_KEY_CERT_EMPTY: error-code=10  # The service request failed. The requested key or certificate is not available, slot is empty.
        KEYM_E_KEY_CERT_INVALID: error-code=6  # The service request failed. Key or certificate is invalid and cannot be used for the operation.
        KEYM_E_KEY_CERT_SIZE_MISMATCH: error-code=4  # The service request failed. Parameter size does not match the expected value.
        KEYM_E_PARAMETER_MISMATCH: error-code=5  # The service request failed. Parameter to function does not provide the expected value.
    KeyMCertificate_Ssa_TrustModelEcuPeerCert  # Service of Certificate sub module
      operation GetStatus: possible-error=KeyMCertificate_Ssa_TrustModelEcuPeerCert/E_NOT_OK  # Provides the status of a certificate.
        arg Status: type=KeyM_CertificateStatusType, direction=OUT, server-argument-impl-policy=USE-ARGUMENT-TYPE
      operation VerifyCertificate: possible-error=[KeyMCertificate_Ssa_TrustModelEcuPeerCert/E_NOT_OK, KeyMCertificate_Ssa_TrustModelEcuPeerCert/KEYM_E_BUSY, KeyMCertificate_Ssa_TrustModelEcuPeerCert/KEYM_E_CERT_INVALID_CHAIN_OF_TRUST, KeyMCertificate_Ssa_TrustModelEcuPeerCert/KEYM_E_KEY_CERT_EMPTY, KeyMCertificate_Ssa_TrustModelEcuPeerCert/KEYM_E_KEY_CERT_SIZE_MISMATCH, KeyMCertificate_Ssa_TrustModelEcuPeerCert/KEYM_E_PARAMETER_MISMATCH]  # Verify certificate data from the certificate sub module .
      8 x error:
        E_NOT_OK: error-code=1  # The service request failed.
        KEYM_E_BUSY: error-code=2  # The service request failed. Key management is busy with other operations.
        KEYM_E_CERT_INVALID_CHAIN_OF_TRUST: error-code=11  # The service request failed. Certificate verification failed - Invalid Chain of Trust.
        KEYM_E_KEY_CERT_EMPTY: error-code=10  # The service request failed. The requested key or certificate is not available, slot is empty.
        KEYM_E_KEY_CERT_READ_FAIL: error-code=9  # The service request failed. Certificate or key could not be provided due to a read or permission failure.
        KEYM_E_KEY_CERT_SIZE_MISMATCH: error-code=4  # The service request failed. Parameter size does not match the expected value.
        KEYM_E_KEY_CERT_WRITE_FAIL: error-code=7  # The service request failed. Certificate or key could not be provided due to a write or permission failure.
        KEYM_E_PARAMETER_MISMATCH: error-code=5  # The service request failed. Parameter to function does not provide the expected value.
    KeyMCertificateElement_Ssa_TrustModelIntermediateCert_Issuer  # Service of the certificate sub module to access certificate elements.
      operation CertificateElementGet: possible-error=[KeyMCertificateElement_Ssa_TrustModelIntermediateCert_Issuer/E_NOT_OK, KeyMCertificateElement_Ssa_TrustModelIntermediateCert_Issuer/KEYM_E_KEY_CERT_EMPTY, KeyMCertificateElement_Ssa_TrustModelIntermediateCert_Issuer/KEYM_E_KEY_CERT_INVALID, KeyMCertificateElement_Ssa_TrustModelIntermediateCert_Issuer/KEYM_E_KEY_CERT_SIZE_MISMATCH, KeyMCertificateElement_Ssa_TrustModelIntermediateCert_Issuer/KEYM_E_PARAMETER_MISMATCH]  # Provides the content of a specific certificate element. The certificate configuration defines how the certificate submodule can find the element, e.g. by providing the object identifier (OID). This function is used to retrieve this information if only one element is assigned to the respective OID.
        arg CertificateElementData: type=KeyM_CertificateElementType_Ssa_TrustModelIntermediateCert_Issuer, direction=OUT, server-argument-impl-policy=USE-ARRAY-BASE-TYPE
        arg CertificateDataLength: type=uint32, direction=OUT, server-argument-impl-policy=USE-ARGUMENT-TYPE
      5 x error:
        E_NOT_OK: error-code=1  # The service request failed.
        KEYM_E_KEY_CERT_EMPTY: error-code=10  # The service request failed. The requested key or certificate is not available, slot is empty.
        KEYM_E_KEY_CERT_INVALID: error-code=6  # The service request failed. Key or certificate is invalid and cannot be used for the operation.
        KEYM_E_KEY_CERT_SIZE_MISMATCH: error-code=4  # The service request failed. Parameter size does not match the expected value.
        KEYM_E_PARAMETER_MISMATCH: error-code=5  # The service request failed. Parameter to function does not provide the expected value.
    KeyMCertificateElement_Ssa_TrustModelBackendPeerCert_Version  # Service of the certificate sub module to access certificate elements.
      operation CertificateElementGet: possible-error=[KeyMCertificateElement_Ssa_TrustModelBackendPeerCert_Version/E_NOT_OK, KeyMCertificateElement_Ssa_TrustModelBackendPeerCert_Version/KEYM_E_KEY_CERT_EMPTY, KeyMCertificateElement_Ssa_TrustModelBackendPeerCert_Version/KEYM_E_KEY_CERT_INVALID, KeyMCertificateElement_Ssa_TrustModelBackendPeerCert_Version/KEYM_E_KEY_CERT_SIZE_MISMATCH, KeyMCertificateElement_Ssa_TrustModelBackendPeerCert_Version/KEYM_E_PARAMETER_MISMATCH]  # Provides the content of a specific certificate element. The certificate configuration defines how the certificate submodule can find the element, e.g. by providing the object identifier (OID). This function is used to retrieve this information if only one element is assigned to the respective OID.
        arg CertificateElementData: type=KeyM_CertificateElementType_Ssa_TrustModelBackendPeerCert_Version, direction=OUT, server-argument-impl-policy=USE-ARRAY-BASE-TYPE
        arg CertificateDataLength: type=uint32, direction=OUT, server-argument-impl-policy=USE-ARGUMENT-TYPE
      5 x error:
        E_NOT_OK: error-code=1  # The service request failed.
        KEYM_E_KEY_CERT_EMPTY: error-code=10  # The service request failed. The requested key or certificate is not available, slot is empty.
        KEYM_E_KEY_CERT_INVALID: error-code=6  # The service request failed. Key or certificate is invalid and cannot be used for the operation.
        KEYM_E_KEY_CERT_SIZE_MISMATCH: error-code=4  # The service request failed. Parameter size does not match the expected value.
        KEYM_E_PARAMETER_MISMATCH: error-code=5  # The service request failed. Parameter to function does not provide the expected value.
    KeyMCertificateElement_Ssa_TrustModelBackendCert_Issuer  # Service of the certificate sub module to access certificate elements.
      operation CertificateElementGet: possible-error=[KeyMCertificateElement_Ssa_TrustModelBackendCert_Issuer/E_NOT_OK, KeyMCertificateElement_Ssa_TrustModelBackendCert_Issuer/KEYM_E_KEY_CERT_EMPTY, KeyMCertificateElement_Ssa_TrustModelBackendCert_Issuer/KEYM_E_KEY_CERT_INVALID, KeyMCertificateElement_Ssa_TrustModelBackendCert_Issuer/KEYM_E_KEY_CERT_SIZE_MISMATCH, KeyMCertificateElement_Ssa_TrustModelBackendCert_Issuer/KEYM_E_PARAMETER_MISMATCH]  # Provides the content of a specific certificate element. The certificate configuration defines how the certificate submodule can find the element, e.g. by providing the object identifier (OID). This function is used to retrieve this information if only one element is assigned to the respective OID.
        arg CertificateElementData: type=KeyM_CertificateElementType_Ssa_TrustModelBackendCert_Issuer, direction=OUT, server-argument-impl-policy=USE-ARRAY-BASE-TYPE
        arg CertificateDataLength: type=uint32, direction=OUT, server-argument-impl-policy=USE-ARGUMENT-TYPE
      5 x error:
        E_NOT_OK: error-code=1  # The service request failed.
        KEYM_E_KEY_CERT_EMPTY: error-code=10  # The service request failed. The requested key or certificate is not available, slot is empty.
        KEYM_E_KEY_CERT_INVALID: error-code=6  # The service request failed. Key or certificate is invalid and cannot be used for the operation.
        KEYM_E_KEY_CERT_SIZE_MISMATCH: error-code=4  # The service request failed. Parameter size does not match the expected value.
        KEYM_E_PARAMETER_MISMATCH: error-code=5  # The service request failed. Parameter to function does not provide the expected value.
    KeyMCertificateElement_Ssa_TrustModelIntermediateCert_SerialNo  # Service of the certificate sub module to access certificate elements.
      operation CertificateElementGet: possible-error=[KeyMCertificateElement_Ssa_TrustModelIntermediateCert_SerialNo/E_NOT_OK, KeyMCertificateElement_Ssa_TrustModelIntermediateCert_SerialNo/KEYM_E_KEY_CERT_EMPTY, KeyMCertificateElement_Ssa_TrustModelIntermediateCert_SerialNo/KEYM_E_KEY_CERT_INVALID, KeyMCertificateElement_Ssa_TrustModelIntermediateCert_SerialNo/KEYM_E_KEY_CERT_SIZE_MISMATCH, KeyMCertificateElement_Ssa_TrustModelIntermediateCert_SerialNo/KEYM_E_PARAMETER_MISMATCH]  # Provides the content of a specific certificate element. The certificate configuration defines how the certificate submodule can find the element, e.g. by providing the object identifier (OID). This function is used to retrieve this information if only one element is assigned to the respective OID.
        arg CertificateElementData: type=KeyM_CertificateElementType_Ssa_TrustModelIntermediateCert_SerialNo, direction=OUT, server-argument-impl-policy=USE-ARRAY-BASE-TYPE
        arg CertificateDataLength: type=uint32, direction=OUT, server-argument-impl-policy=USE-ARGUMENT-TYPE
      5 x error:
        E_NOT_OK: error-code=1  # The service request failed.
        KEYM_E_KEY_CERT_EMPTY: error-code=10  # The service request failed. The requested key or certificate is not available, slot is empty.
        KEYM_E_KEY_CERT_INVALID: error-code=6  # The service request failed. Key or certificate is invalid and cannot be used for the operation.
        KEYM_E_KEY_CERT_SIZE_MISMATCH: error-code=4  # The service request failed. Parameter size does not match the expected value.
        KEYM_E_PARAMETER_MISMATCH: error-code=5  # The service request failed. Parameter to function does not provide the expected value.
    KeyMCertificateElement_Ssa_TrustModelBackendCert_SerialNo  # Service of the certificate sub module to access certificate elements.
      operation CertificateElementGet: possible-error=[KeyMCertificateElement_Ssa_TrustModelBackendCert_SerialNo/E_NOT_OK, KeyMCertificateElement_Ssa_TrustModelBackendCert_SerialNo/KEYM_E_KEY_CERT_EMPTY, KeyMCertificateElement_Ssa_TrustModelBackendCert_SerialNo/KEYM_E_KEY_CERT_INVALID, KeyMCertificateElement_Ssa_TrustModelBackendCert_SerialNo/KEYM_E_KEY_CERT_SIZE_MISMATCH, KeyMCertificateElement_Ssa_TrustModelBackendCert_SerialNo/KEYM_E_PARAMETER_MISMATCH]  # Provides the content of a specific certificate element. The certificate configuration defines how the certificate submodule can find the element, e.g. by providing the object identifier (OID). This function is used to retrieve this information if only one element is assigned to the respective OID.
        arg CertificateElementData: type=KeyM_CertificateElementType_Ssa_TrustModelBackendCert_SerialNo, direction=OUT, server-argument-impl-policy=USE-ARRAY-BASE-TYPE
        arg CertificateDataLength: type=uint32, direction=OUT, server-argument-impl-policy=USE-ARGUMENT-TYPE
      5 x error:
        E_NOT_OK: error-code=1  # The service request failed.
        KEYM_E_KEY_CERT_EMPTY: error-code=10  # The service request failed. The requested key or certificate is not available, slot is empty.
        KEYM_E_KEY_CERT_INVALID: error-code=6  # The service request failed. Key or certificate is invalid and cannot be used for the operation.
        KEYM_E_KEY_CERT_SIZE_MISMATCH: error-code=4  # The service request failed. Parameter size does not match the expected value.
        KEYM_E_PARAMETER_MISMATCH: error-code=5  # The service request failed. Parameter to function does not provide the expected value.
    KeyMCertificateElement_Ssa_TrustModelIntermediateCert_subject  # Service of the certificate sub module to access certificate elements.
      operation CertificateElementGet: possible-error=[KeyMCertificateElement_Ssa_TrustModelIntermediateCert_subject/E_NOT_OK, KeyMCertificateElement_Ssa_TrustModelIntermediateCert_subject/KEYM_E_KEY_CERT_EMPTY, KeyMCertificateElement_Ssa_TrustModelIntermediateCert_subject/KEYM_E_KEY_CERT_INVALID, KeyMCertificateElement_Ssa_TrustModelIntermediateCert_subject/KEYM_E_KEY_CERT_SIZE_MISMATCH, KeyMCertificateElement_Ssa_TrustModelIntermediateCert_subject/KEYM_E_PARAMETER_MISMATCH]  # Provides the content of a specific certificate element. The certificate configuration defines how the certificate submodule can find the element, e.g. by providing the object identifier (OID). This function is used to retrieve this information if only one element is assigned to the respective OID.
        arg CertificateElementData: type=KeyM_CertificateElementType_Ssa_TrustModelIntermediateCert_subject, direction=OUT, server-argument-impl-policy=USE-ARRAY-BASE-TYPE
        arg CertificateDataLength: type=uint32, direction=OUT, server-argument-impl-policy=USE-ARGUMENT-TYPE
      5 x error:
        E_NOT_OK: error-code=1  # The service request failed.
        KEYM_E_KEY_CERT_EMPTY: error-code=10  # The service request failed. The requested key or certificate is not available, slot is empty.
        KEYM_E_KEY_CERT_INVALID: error-code=6  # The service request failed. Key or certificate is invalid and cannot be used for the operation.
        KEYM_E_KEY_CERT_SIZE_MISMATCH: error-code=4  # The service request failed. Parameter size does not match the expected value.
        KEYM_E_PARAMETER_MISMATCH: error-code=5  # The service request failed. Parameter to function does not provide the expected value.
    KeyMCertificateElement_Ssa_TrustModelEcuCert_ext_authKeyId  # Service of the certificate sub module to access certificate elements.
      operation CertificateElementGet: possible-error=[KeyMCertificateElement_Ssa_TrustModelEcuCert_ext_authKeyId/E_NOT_OK, KeyMCertificateElement_Ssa_TrustModelEcuCert_ext_authKeyId/KEYM_E_KEY_CERT_EMPTY, KeyMCertificateElement_Ssa_TrustModelEcuCert_ext_authKeyId/KEYM_E_KEY_CERT_INVALID, KeyMCertificateElement_Ssa_TrustModelEcuCert_ext_authKeyId/KEYM_E_KEY_CERT_SIZE_MISMATCH, KeyMCertificateElement_Ssa_TrustModelEcuCert_ext_authKeyId/KEYM_E_PARAMETER_MISMATCH]  # Provides the content of a specific certificate element. The certificate configuration defines how the certificate submodule can find the element, e.g. by providing the object identifier (OID). This function is used to retrieve this information if only one element is assigned to the respective OID.
        arg CertificateElementData: type=KeyM_CertificateElementType_Ssa_TrustModelEcuCert_ext_authKeyId, direction=OUT, server-argument-impl-policy=USE-ARRAY-BASE-TYPE
        arg CertificateDataLength: type=uint32, direction=OUT, server-argument-impl-policy=USE-ARGUMENT-TYPE
      5 x error:
        E_NOT_OK: error-code=1  # The service request failed.
        KEYM_E_KEY_CERT_EMPTY: error-code=10  # The service request failed. The requested key or certificate is not available, slot is empty.
        KEYM_E_KEY_CERT_INVALID: error-code=6  # The service request failed. Key or certificate is invalid and cannot be used for the operation.
        KEYM_E_KEY_CERT_SIZE_MISMATCH: error-code=4  # The service request failed. Parameter size does not match the expected value.
        KEYM_E_PARAMETER_MISMATCH: error-code=5  # The service request failed. Parameter to function does not provide the expected value.
    KeyMCertificateElement_Ssa_TrustModelEcuCert_SubjectPublicKeyInfoKey  # Service of the certificate sub module to access certificate elements.
      operation CertificateElementGet: possible-error=[KeyMCertificateElement_Ssa_TrustModelEcuCert_SubjectPublicKeyInfoKey/E_NOT_OK, KeyMCertificateElement_Ssa_TrustModelEcuCert_SubjectPublicKeyInfoKey/KEYM_E_KEY_CERT_EMPTY, KeyMCertificateElement_Ssa_TrustModelEcuCert_SubjectPublicKeyInfoKey/KEYM_E_KEY_CERT_INVALID, KeyMCertificateElement_Ssa_TrustModelEcuCert_SubjectPublicKeyInfoKey/KEYM_E_KEY_CERT_SIZE_MISMATCH, KeyMCertificateElement_Ssa_TrustModelEcuCert_SubjectPublicKeyInfoKey/KEYM_E_PARAMETER_MISMATCH]  # Provides the content of a specific certificate element. The certificate configuration defines how the certificate submodule can find the element, e.g. by providing the object identifier (OID). This function is used to retrieve this information if only one element is assigned to the respective OID.
        arg CertificateElementData: type=KeyM_CertificateElementType_Ssa_TrustModelEcuCert_SubjectPublicKeyInfoKey, direction=OUT, server-argument-impl-policy=USE-ARRAY-BASE-TYPE
        arg CertificateDataLength: type=uint32, direction=OUT, server-argument-impl-policy=USE-ARGUMENT-TYPE
      5 x error:
        E_NOT_OK: error-code=1  # The service request failed.
        KEYM_E_KEY_CERT_EMPTY: error-code=10  # The service request failed. The requested key or certificate is not available, slot is empty.
        KEYM_E_KEY_CERT_INVALID: error-code=6  # The service request failed. Key or certificate is invalid and cannot be used for the operation.
        KEYM_E_KEY_CERT_SIZE_MISMATCH: error-code=4  # The service request failed. Parameter size does not match the expected value.
        KEYM_E_PARAMETER_MISMATCH: error-code=5  # The service request failed. Parameter to function does not provide the expected value.
    KeyMCertificateNotification  # This service interface provides callbacks for certificate management operations.
      operation CertificateVerifyCallbackNotification  # Notifies the application that a certificate verification has been finished.
        arg Result: type=KeyM_CertificateStatusType, direction=IN, server-argument-impl-policy=USE-ARGUMENT-TYPE
      operation ServiceCertificateCallbackNotification  # Notifies the application that the certificate service operation has been finished. This function is used by the certificate submodule. This callback is only provided if KeyMServiceCertificateFunctionEnabled is set to TRUE.
        arg Result: type=KeyM_ResultType, direction=IN, server-argument-impl-policy=USE-ARGUMENT-TYPE
        arg ResponseDataLength: type=uint16, direction=IN, server-argument-impl-policy=USE-ARGUMENT-TYPE
        arg ResponseData: type=KeyM_const_CryptoKeyDataType, direction=IN, server-argument-impl-policy=USE-ARGUMENT-TYPE
    KeyMCertificateElement_Ssa_TrustModelEcuCert_ext_specialEcu  # Service of the certificate sub module to access certificate elements.
      operation CertificateElementGet: possible-error=[KeyMCertificateElement_Ssa_TrustModelEcuCert_ext_specialEcu/E_NOT_OK, KeyMCertificateElement_Ssa_TrustModelEcuCert_ext_specialEcu/KEYM_E_KEY_CERT_EMPTY, KeyMCertificateElement_Ssa_TrustModelEcuCert_ext_specialEcu/KEYM_E_KEY_CERT_INVALID, KeyMCertificateElement_Ssa_TrustModelEcuCert_ext_specialEcu/KEYM_E_KEY_CERT_SIZE_MISMATCH, KeyMCertificateElement_Ssa_TrustModelEcuCert_ext_specialEcu/KEYM_E_PARAMETER_MISMATCH]  # Provides the content of a specific certificate element. The certificate configuration defines how the certificate submodule can find the element, e.g. by providing the object identifier (OID). This function is used to retrieve this information if only one element is assigned to the respective OID.
        arg CertificateElementData: type=KeyM_CertificateElementType_Ssa_TrustModelEcuCert_ext_specialEcu, direction=OUT, server-argument-impl-policy=USE-ARRAY-BASE-TYPE
        arg CertificateDataLength: type=uint32, direction=OUT, server-argument-impl-policy=USE-ARGUMENT-TYPE
      5 x error:
        E_NOT_OK: error-code=1  # The service request failed.
        KEYM_E_KEY_CERT_EMPTY: error-code=10  # The service request failed. The requested key or certificate is not available, slot is empty.
        KEYM_E_KEY_CERT_INVALID: error-code=6  # The service request failed. Key or certificate is invalid and cannot be used for the operation.
        KEYM_E_KEY_CERT_SIZE_MISMATCH: error-code=4  # The service request failed. Parameter size does not match the expected value.
        KEYM_E_PARAMETER_MISMATCH: error-code=5  # The service request failed. Parameter to function does not provide the expected value.
    KeyMCertificateElement_Ssa_TrustModelEcuCert_validityNotAfter  # Service of the certificate sub module to access certificate elements.
      operation CertificateElementGet: possible-error=[KeyMCertificateElement_Ssa_TrustModelEcuCert_validityNotAfter/E_NOT_OK, KeyMCertificateElement_Ssa_TrustModelEcuCert_validityNotAfter/KEYM_E_KEY_CERT_EMPTY, KeyMCertificateElement_Ssa_TrustModelEcuCert_validityNotAfter/KEYM_E_KEY_CERT_INVALID, KeyMCertificateElement_Ssa_TrustModelEcuCert_validityNotAfter/KEYM_E_KEY_CERT_SIZE_MISMATCH, KeyMCertificateElement_Ssa_TrustModelEcuCert_validityNotAfter/KEYM_E_PARAMETER_MISMATCH]  # Provides the content of a specific certificate element. The certificate configuration defines how the certificate submodule can find the element, e.g. by providing the object identifier (OID). This function is used to retrieve this information if only one element is assigned to the respective OID.
        arg CertificateElementData: type=KeyM_CertificateElementType_Ssa_TrustModelEcuCert_validityNotAfter, direction=OUT, server-argument-impl-policy=USE-ARRAY-BASE-TYPE
        arg CertificateDataLength: type=uint32, direction=OUT, server-argument-impl-policy=USE-ARGUMENT-TYPE
      5 x error:
        E_NOT_OK: error-code=1  # The service request failed.
        KEYM_E_KEY_CERT_EMPTY: error-code=10  # The service request failed. The requested key or certificate is not available, slot is empty.
        KEYM_E_KEY_CERT_INVALID: error-code=6  # The service request failed. Key or certificate is invalid and cannot be used for the operation.
        KEYM_E_KEY_CERT_SIZE_MISMATCH: error-code=4  # The service request failed. Parameter size does not match the expected value.
        KEYM_E_PARAMETER_MISMATCH: error-code=5  # The service request failed. Parameter to function does not provide the expected value.
    KeyMCertificateElement_Ssa_TrustModelEcuCert_ext_subKeyId  # Service of the certificate sub module to access certificate elements.
      operation CertificateElementGet: possible-error=[KeyMCertificateElement_Ssa_TrustModelEcuCert_ext_subKeyId/E_NOT_OK, KeyMCertificateElement_Ssa_TrustModelEcuCert_ext_subKeyId/KEYM_E_KEY_CERT_EMPTY, KeyMCertificateElement_Ssa_TrustModelEcuCert_ext_subKeyId/KEYM_E_KEY_CERT_INVALID, KeyMCertificateElement_Ssa_TrustModelEcuCert_ext_subKeyId/KEYM_E_KEY_CERT_SIZE_MISMATCH, KeyMCertificateElement_Ssa_TrustModelEcuCert_ext_subKeyId/KEYM_E_PARAMETER_MISMATCH]  # Provides the content of a specific certificate element. The certificate configuration defines how the certificate submodule can find the element, e.g. by providing the object identifier (OID). This function is used to retrieve this information if only one element is assigned to the respective OID.
        arg CertificateElementData: type=KeyM_CertificateElementType_Ssa_TrustModelEcuCert_ext_subKeyId, direction=OUT, server-argument-impl-policy=USE-ARRAY-BASE-TYPE
        arg CertificateDataLength: type=uint32, direction=OUT, server-argument-impl-policy=USE-ARGUMENT-TYPE
      5 x error:
        E_NOT_OK: error-code=1  # The service request failed.
        KEYM_E_KEY_CERT_EMPTY: error-code=10  # The service request failed. The requested key or certificate is not available, slot is empty.
        KEYM_E_KEY_CERT_INVALID: error-code=6  # The service request failed. Key or certificate is invalid and cannot be used for the operation.
        KEYM_E_KEY_CERT_SIZE_MISMATCH: error-code=4  # The service request failed. Parameter size does not match the expected value.
        KEYM_E_PARAMETER_MISMATCH: error-code=5  # The service request failed. Parameter to function does not provide the expected value.
    KeyMCertificateElement_Ssa_TrustModelEcuCert_ext_uniqueECUID  # Service of the certificate sub module to access certificate elements.
      operation CertificateElementGet: possible-error=[KeyMCertificateElement_Ssa_TrustModelEcuCert_ext_uniqueECUID/E_NOT_OK, KeyMCertificateElement_Ssa_TrustModelEcuCert_ext_uniqueECUID/KEYM_E_KEY_CERT_EMPTY, KeyMCertificateElement_Ssa_TrustModelEcuCert_ext_uniqueECUID/KEYM_E_KEY_CERT_INVALID, KeyMCertificateElement_Ssa_TrustModelEcuCert_ext_uniqueECUID/KEYM_E_KEY_CERT_SIZE_MISMATCH, KeyMCertificateElement_Ssa_TrustModelEcuCert_ext_uniqueECUID/KEYM_E_PARAMETER_MISMATCH]  # Provides the content of a specific certificate element. The certificate configuration defines how the certificate submodule can find the element, e.g. by providing the object identifier (OID). This function is used to retrieve this information if only one element is assigned to the respective OID.
        arg CertificateElementData: type=KeyM_CertificateElementType_Ssa_TrustModelEcuCert_ext_uniqueECUID, direction=OUT, server-argument-impl-policy=USE-ARRAY-BASE-TYPE
        arg CertificateDataLength: type=uint32, direction=OUT, server-argument-impl-policy=USE-ARGUMENT-TYPE
      5 x error:
        E_NOT_OK: error-code=1  # The service request failed.
        KEYM_E_KEY_CERT_EMPTY: error-code=10  # The service request failed. The requested key or certificate is not available, slot is empty.
        KEYM_E_KEY_CERT_INVALID: error-code=6  # The service request failed. Key or certificate is invalid and cannot be used for the operation.
        KEYM_E_KEY_CERT_SIZE_MISMATCH: error-code=4  # The service request failed. Parameter size does not match the expected value.
        KEYM_E_PARAMETER_MISMATCH: error-code=5  # The service request failed. Parameter to function does not provide the expected value.
    KeyMCertificateElement_Ssa_TrustModelRootCert_ext_basicConstraints  # Service of the certificate sub module to access certificate elements.
      operation CertificateElementGet: possible-error=[KeyMCertificateElement_Ssa_TrustModelRootCert_ext_basicConstraints/E_NOT_OK, KeyMCertificateElement_Ssa_TrustModelRootCert_ext_basicConstraints/KEYM_E_KEY_CERT_EMPTY, KeyMCertificateElement_Ssa_TrustModelRootCert_ext_basicConstraints/KEYM_E_KEY_CERT_INVALID, KeyMCertificateElement_Ssa_TrustModelRootCert_ext_basicConstraints/KEYM_E_KEY_CERT_SIZE_MISMATCH, KeyMCertificateElement_Ssa_TrustModelRootCert_ext_basicConstraints/KEYM_E_PARAMETER_MISMATCH]  # Provides the content of a specific certificate element. The certificate configuration defines how the certificate submodule can find the element, e.g. by providing the object identifier (OID). This function is used to retrieve this information if only one element is assigned to the respective OID.
        arg CertificateElementData: type=KeyM_CertificateElementType_Ssa_TrustModelRootCert_ext_basicConstraints, direction=OUT, server-argument-impl-policy=USE-ARRAY-BASE-TYPE
        arg CertificateDataLength: type=uint32, direction=OUT, server-argument-impl-policy=USE-ARGUMENT-TYPE
      5 x error:
        E_NOT_OK: error-code=1  # The service request failed.
        KEYM_E_KEY_CERT_EMPTY: error-code=10  # The service request failed. The requested key or certificate is not available, slot is empty.
        KEYM_E_KEY_CERT_INVALID: error-code=6  # The service request failed. Key or certificate is invalid and cannot be used for the operation.
        KEYM_E_KEY_CERT_SIZE_MISMATCH: error-code=4  # The service request failed. Parameter size does not match the expected value.
        KEYM_E_PARAMETER_MISMATCH: error-code=5  # The service request failed. Parameter to function does not provide the expected value.
    KeyMCertificateElement_Ssa_TrustModelIntermediatePeerCert_ext_authKeyId  # Service of the certificate sub module to access certificate elements.
      operation CertificateElementGet: possible-error=[KeyMCertificateElement_Ssa_TrustModelIntermediatePeerCert_ext_authKeyId/E_NOT_OK, KeyMCertificateElement_Ssa_TrustModelIntermediatePeerCert_ext_authKeyId/KEYM_E_KEY_CERT_EMPTY, KeyMCertificateElement_Ssa_TrustModelIntermediatePeerCert_ext_authKeyId/KEYM_E_KEY_CERT_INVALID, KeyMCertificateElement_Ssa_TrustModelIntermediatePeerCert_ext_authKeyId/KEYM_E_KEY_CERT_SIZE_MISMATCH, KeyMCertificateElement_Ssa_TrustModelIntermediatePeerCert_ext_authKeyId/KEYM_E_PARAMETER_MISMATCH]  # Provides the content of a specific certificate element. The certificate configuration defines how the certificate submodule can find the element, e.g. by providing the object identifier (OID). This function is used to retrieve this information if only one element is assigned to the respective OID.
        arg CertificateElementData: type=KeyM_CertificateElementType_Ssa_TrustModelIntermediatePeerCert_ext_authKeyId, direction=OUT, server-argument-impl-policy=USE-ARRAY-BASE-TYPE
        arg CertificateDataLength: type=uint32, direction=OUT, server-argument-impl-policy=USE-ARGUMENT-TYPE
      5 x error:
        E_NOT_OK: error-code=1  # The service request failed.
        KEYM_E_KEY_CERT_EMPTY: error-code=10  # The service request failed. The requested key or certificate is not available, slot is empty.
        KEYM_E_KEY_CERT_INVALID: error-code=6  # The service request failed. Key or certificate is invalid and cannot be used for the operation.
        KEYM_E_KEY_CERT_SIZE_MISMATCH: error-code=4  # The service request failed. Parameter size does not match the expected value.
        KEYM_E_PARAMETER_MISMATCH: error-code=5  # The service request failed. Parameter to function does not provide the expected value.
    KeyMCertificateElement_Ssa_TrustModelRootCert_ext_keyUsage  # Service of the certificate sub module to access certificate elements.
      operation CertificateElementGet: possible-error=[KeyMCertificateElement_Ssa_TrustModelRootCert_ext_keyUsage/E_NOT_OK, KeyMCertificateElement_Ssa_TrustModelRootCert_ext_keyUsage/KEYM_E_KEY_CERT_EMPTY, KeyMCertificateElement_Ssa_TrustModelRootCert_ext_keyUsage/KEYM_E_KEY_CERT_INVALID, KeyMCertificateElement_Ssa_TrustModelRootCert_ext_keyUsage/KEYM_E_KEY_CERT_SIZE_MISMATCH, KeyMCertificateElement_Ssa_TrustModelRootCert_ext_keyUsage/KEYM_E_PARAMETER_MISMATCH]  # Provides the content of a specific certificate element. The certificate configuration defines how the certificate submodule can find the element, e.g. by providing the object identifier (OID). This function is used to retrieve this information if only one element is assigned to the respective OID.
        arg CertificateElementData: type=KeyM_CertificateElementType_Ssa_TrustModelRootCert_ext_keyUsage, direction=OUT, server-argument-impl-policy=USE-ARRAY-BASE-TYPE
        arg CertificateDataLength: type=uint32, direction=OUT, server-argument-impl-policy=USE-ARGUMENT-TYPE
      5 x error:
        E_NOT_OK: error-code=1  # The service request failed.
        KEYM_E_KEY_CERT_EMPTY: error-code=10  # The service request failed. The requested key or certificate is not available, slot is empty.
        KEYM_E_KEY_CERT_INVALID: error-code=6  # The service request failed. Key or certificate is invalid and cannot be used for the operation.
        KEYM_E_KEY_CERT_SIZE_MISMATCH: error-code=4  # The service request failed. Parameter size does not match the expected value.
        KEYM_E_PARAMETER_MISMATCH: error-code=5  # The service request failed. Parameter to function does not provide the expected value.
    KeyMCertificateElement_Ssa_TrustModelIntermediatePeerCert_ext_basicConstraints  # Service of the certificate sub module to access certificate elements.
      operation CertificateElementGet: possible-error=[KeyMCertificateElement_Ssa_TrustModelIntermediatePeerCert_ext_basicConstraints/E_NOT_OK, KeyMCertificateElement_Ssa_TrustModelIntermediatePeerCert_ext_basicConstraints/KEYM_E_KEY_CERT_EMPTY, KeyMCertificateElement_Ssa_TrustModelIntermediatePeerCert_ext_basicConstraints/KEYM_E_KEY_CERT_INVALID, KeyMCertificateElement_Ssa_TrustModelIntermediatePeerCert_ext_basicConstraints/KEYM_E_KEY_CERT_SIZE_MISMATCH, KeyMCertificateElement_Ssa_TrustModelIntermediatePeerCert_ext_basicConstraints/KEYM_E_PARAMETER_MISMATCH]  # Provides the content of a specific certificate element. The certificate configuration defines how the certificate submodule can find the element, e.g. by providing the object identifier (OID). This function is used to retrieve this information if only one element is assigned to the respective OID.
        arg CertificateElementData: type=KeyM_CertificateElementType_Ssa_TrustModelIntermediatePeerCert_ext_basicConstraints, direction=OUT, server-argument-impl-policy=USE-ARRAY-BASE-TYPE
        arg CertificateDataLength: type=uint32, direction=OUT, server-argument-impl-policy=USE-ARGUMENT-TYPE
      5 x error:
        E_NOT_OK: error-code=1  # The service request failed.
        KEYM_E_KEY_CERT_EMPTY: error-code=10  # The service request failed. The requested key or certificate is not available, slot is empty.
        KEYM_E_KEY_CERT_INVALID: error-code=6  # The service request failed. Key or certificate is invalid and cannot be used for the operation.
        KEYM_E_KEY_CERT_SIZE_MISMATCH: error-code=4  # The service request failed. Parameter size does not match the expected value.
        KEYM_E_PARAMETER_MISMATCH: error-code=5  # The service request failed. Parameter to function does not provide the expected value.
    KeyMCertificateElement_Ssa_TrustModelRootCert_ext_subKeyId  # Service of the certificate sub module to access certificate elements.
      operation CertificateElementGet: possible-error=[KeyMCertificateElement_Ssa_TrustModelRootCert_ext_subKeyId/E_NOT_OK, KeyMCertificateElement_Ssa_TrustModelRootCert_ext_subKeyId/KEYM_E_KEY_CERT_EMPTY, KeyMCertificateElement_Ssa_TrustModelRootCert_ext_subKeyId/KEYM_E_KEY_CERT_INVALID, KeyMCertificateElement_Ssa_TrustModelRootCert_ext_subKeyId/KEYM_E_KEY_CERT_SIZE_MISMATCH, KeyMCertificateElement_Ssa_TrustModelRootCert_ext_subKeyId/KEYM_E_PARAMETER_MISMATCH]  # Provides the content of a specific certificate element. The certificate configuration defines how the certificate submodule can find the element, e.g. by providing the object identifier (OID). This function is used to retrieve this information if only one element is assigned to the respective OID.
        arg CertificateElementData: type=KeyM_CertificateElementType_Ssa_TrustModelRootCert_ext_subKeyId, direction=OUT, server-argument-impl-policy=USE-ARRAY-BASE-TYPE
        arg CertificateDataLength: type=uint32, direction=OUT, server-argument-impl-policy=USE-ARGUMENT-TYPE
      5 x error:
        E_NOT_OK: error-code=1  # The service request failed.
        KEYM_E_KEY_CERT_EMPTY: error-code=10  # The service request failed. The requested key or certificate is not available, slot is empty.
        KEYM_E_KEY_CERT_INVALID: error-code=6  # The service request failed. Key or certificate is invalid and cannot be used for the operation.
        KEYM_E_KEY_CERT_SIZE_MISMATCH: error-code=4  # The service request failed. Parameter size does not match the expected value.
        KEYM_E_PARAMETER_MISMATCH: error-code=5  # The service request failed. Parameter to function does not provide the expected value.
    KeyMCertificateElement_Ssa_TrustModelIntermediatePeerCert_ext_subKeyId  # Service of the certificate sub module to access certificate elements.
      operation CertificateElementGet: possible-error=[KeyMCertificateElement_Ssa_TrustModelIntermediatePeerCert_ext_subKeyId/E_NOT_OK, KeyMCertificateElement_Ssa_TrustModelIntermediatePeerCert_ext_subKeyId/KEYM_E_KEY_CERT_EMPTY, KeyMCertificateElement_Ssa_TrustModelIntermediatePeerCert_ext_subKeyId/KEYM_E_KEY_CERT_INVALID, KeyMCertificateElement_Ssa_TrustModelIntermediatePeerCert_ext_subKeyId/KEYM_E_KEY_CERT_SIZE_MISMATCH, KeyMCertificateElement_Ssa_TrustModelIntermediatePeerCert_ext_subKeyId/KEYM_E_PARAMETER_MISMATCH]  # Provides the content of a specific certificate element. The certificate configuration defines how the certificate submodule can find the element, e.g. by providing the object identifier (OID). This function is used to retrieve this information if only one element is assigned to the respective OID.
        arg CertificateElementData: type=KeyM_CertificateElementType_Ssa_TrustModelIntermediatePeerCert_ext_subKeyId, direction=OUT, server-argument-impl-policy=USE-ARRAY-BASE-TYPE
        arg CertificateDataLength: type=uint32, direction=OUT, server-argument-impl-policy=USE-ARGUMENT-TYPE
      5 x error:
        E_NOT_OK: error-code=1  # The service request failed.
        KEYM_E_KEY_CERT_EMPTY: error-code=10  # The service request failed. The requested key or certificate is not available, slot is empty.
        KEYM_E_KEY_CERT_INVALID: error-code=6  # The service request failed. Key or certificate is invalid and cannot be used for the operation.
        KEYM_E_KEY_CERT_SIZE_MISMATCH: error-code=4  # The service request failed. Parameter size does not match the expected value.
        KEYM_E_PARAMETER_MISMATCH: error-code=5  # The service request failed. Parameter to function does not provide the expected value.
    KeyMCertificateElement_Ssa_TrustModelRootCert_Issuer  # Service of the certificate sub module to access certificate elements.
      operation CertificateElementGet: possible-error=[KeyMCertificateElement_Ssa_TrustModelRootCert_Issuer/E_NOT_OK, KeyMCertificateElement_Ssa_TrustModelRootCert_Issuer/KEYM_E_KEY_CERT_EMPTY, KeyMCertificateElement_Ssa_TrustModelRootCert_Issuer/KEYM_E_KEY_CERT_INVALID, KeyMCertificateElement_Ssa_TrustModelRootCert_Issuer/KEYM_E_KEY_CERT_SIZE_MISMATCH, KeyMCertificateElement_Ssa_TrustModelRootCert_Issuer/KEYM_E_PARAMETER_MISMATCH]  # Provides the content of a specific certificate element. The certificate configuration defines how the certificate submodule can find the element, e.g. by providing the object identifier (OID). This function is used to retrieve this information if only one element is assigned to the respective OID.
        arg CertificateElementData: type=KeyM_CertificateElementType_Ssa_TrustModelRootCert_Issuer, direction=OUT, server-argument-impl-policy=USE-ARRAY-BASE-TYPE
        arg CertificateDataLength: type=uint32, direction=OUT, server-argument-impl-policy=USE-ARGUMENT-TYPE
      5 x error:
        E_NOT_OK: error-code=1  # The service request failed.
        KEYM_E_KEY_CERT_EMPTY: error-code=10  # The service request failed. The requested key or certificate is not available, slot is empty.
        KEYM_E_KEY_CERT_INVALID: error-code=6  # The service request failed. Key or certificate is invalid and cannot be used for the operation.
        KEYM_E_KEY_CERT_SIZE_MISMATCH: error-code=4  # The service request failed. Parameter size does not match the expected value.
        KEYM_E_PARAMETER_MISMATCH: error-code=5  # The service request failed. Parameter to function does not provide the expected value.
    KeyMCertificateElement_Ssa_TrustModelRootCert_SerialNo  # Service of the certificate sub module to access certificate elements.
      operation CertificateElementGet: possible-error=[KeyMCertificateElement_Ssa_TrustModelRootCert_SerialNo/E_NOT_OK, KeyMCertificateElement_Ssa_TrustModelRootCert_SerialNo/KEYM_E_KEY_CERT_EMPTY, KeyMCertificateElement_Ssa_TrustModelRootCert_SerialNo/KEYM_E_KEY_CERT_INVALID, KeyMCertificateElement_Ssa_TrustModelRootCert_SerialNo/KEYM_E_KEY_CERT_SIZE_MISMATCH, KeyMCertificateElement_Ssa_TrustModelRootCert_SerialNo/KEYM_E_PARAMETER_MISMATCH]  # Provides the content of a specific certificate element. The certificate configuration defines how the certificate submodule can find the element, e.g. by providing the object identifier (OID). This function is used to retrieve this information if only one element is assigned to the respective OID.
        arg CertificateElementData: type=KeyM_CertificateElementType_Ssa_TrustModelRootCert_SerialNo, direction=OUT, server-argument-impl-policy=USE-ARRAY-BASE-TYPE
        arg CertificateDataLength: type=uint32, direction=OUT, server-argument-impl-policy=USE-ARGUMENT-TYPE
      5 x error:
        E_NOT_OK: error-code=1  # The service request failed.
        KEYM_E_KEY_CERT_EMPTY: error-code=10  # The service request failed. The requested key or certificate is not available, slot is empty.
        KEYM_E_KEY_CERT_INVALID: error-code=6  # The service request failed. Key or certificate is invalid and cannot be used for the operation.
        KEYM_E_KEY_CERT_SIZE_MISMATCH: error-code=4  # The service request failed. Parameter size does not match the expected value.
        KEYM_E_PARAMETER_MISMATCH: error-code=5  # The service request failed. Parameter to function does not provide the expected value.
    KeyMCertificateElement_Ssa_TrustModelEcuCert_Version  # Service of the certificate sub module to access certificate elements.
      operation CertificateElementGet: possible-error=[KeyMCertificateElement_Ssa_TrustModelEcuCert_Version/E_NOT_OK, KeyMCertificateElement_Ssa_TrustModelEcuCert_Version/KEYM_E_KEY_CERT_EMPTY, KeyMCertificateElement_Ssa_TrustModelEcuCert_Version/KEYM_E_KEY_CERT_INVALID, KeyMCertificateElement_Ssa_TrustModelEcuCert_Version/KEYM_E_KEY_CERT_SIZE_MISMATCH, KeyMCertificateElement_Ssa_TrustModelEcuCert_Version/KEYM_E_PARAMETER_MISMATCH]  # Provides the content of a specific certificate element. The certificate configuration defines how the certificate submodule can find the element, e.g. by providing the object identifier (OID). This function is used to retrieve this information if only one element is assigned to the respective OID.
        arg CertificateElementData: type=KeyM_CertificateElementType_Ssa_TrustModelEcuCert_Version, direction=OUT, server-argument-impl-policy=USE-ARRAY-BASE-TYPE
        arg CertificateDataLength: type=uint32, direction=OUT, server-argument-impl-policy=USE-ARGUMENT-TYPE
      5 x error:
        E_NOT_OK: error-code=1  # The service request failed.
        KEYM_E_KEY_CERT_EMPTY: error-code=10  # The service request failed. The requested key or certificate is not available, slot is empty.
        KEYM_E_KEY_CERT_INVALID: error-code=6  # The service request failed. Key or certificate is invalid and cannot be used for the operation.
        KEYM_E_KEY_CERT_SIZE_MISMATCH: error-code=4  # The service request failed. Parameter size does not match the expected value.
        KEYM_E_PARAMETER_MISMATCH: error-code=5  # The service request failed. Parameter to function does not provide the expected value.
    KeyMCertificateElement_Ssa_TrustModelEcuCert_Issuer  # Service of the certificate sub module to access certificate elements.
      operation CertificateElementGet: possible-error=[KeyMCertificateElement_Ssa_TrustModelEcuCert_Issuer/E_NOT_OK, KeyMCertificateElement_Ssa_TrustModelEcuCert_Issuer/KEYM_E_KEY_CERT_EMPTY, KeyMCertificateElement_Ssa_TrustModelEcuCert_Issuer/KEYM_E_KEY_CERT_INVALID, KeyMCertificateElement_Ssa_TrustModelEcuCert_Issuer/KEYM_E_KEY_CERT_SIZE_MISMATCH, KeyMCertificateElement_Ssa_TrustModelEcuCert_Issuer/KEYM_E_PARAMETER_MISMATCH]  # Provides the content of a specific certificate element. The certificate configuration defines how the certificate submodule can find the element, e.g. by providing the object identifier (OID). This function is used to retrieve this information if only one element is assigned to the respective OID.
        arg CertificateElementData: type=KeyM_CertificateElementType_Ssa_TrustModelEcuCert_Issuer, direction=OUT, server-argument-impl-policy=USE-ARRAY-BASE-TYPE
        arg CertificateDataLength: type=uint32, direction=OUT, server-argument-impl-policy=USE-ARGUMENT-TYPE
      5 x error:
        E_NOT_OK: error-code=1  # The service request failed.
        KEYM_E_KEY_CERT_EMPTY: error-code=10  # The service request failed. The requested key or certificate is not available, slot is empty.
        KEYM_E_KEY_CERT_INVALID: error-code=6  # The service request failed. Key or certificate is invalid and cannot be used for the operation.
        KEYM_E_KEY_CERT_SIZE_MISMATCH: error-code=4  # The service request failed. Parameter size does not match the expected value.
        KEYM_E_PARAMETER_MISMATCH: error-code=5  # The service request failed. Parameter to function does not provide the expected value.
    KeyMCertificateElement_Ssa_TrustModelIntermediatePeerCert_SerialNo  # Service of the certificate sub module to access certificate elements.
      operation CertificateElementGet: possible-error=[KeyMCertificateElement_Ssa_TrustModelIntermediatePeerCert_SerialNo/E_NOT_OK, KeyMCertificateElement_Ssa_TrustModelIntermediatePeerCert_SerialNo/KEYM_E_KEY_CERT_EMPTY, KeyMCertificateElement_Ssa_TrustModelIntermediatePeerCert_SerialNo/KEYM_E_KEY_CERT_INVALID, KeyMCertificateElement_Ssa_TrustModelIntermediatePeerCert_SerialNo/KEYM_E_KEY_CERT_SIZE_MISMATCH, KeyMCertificateElement_Ssa_TrustModelIntermediatePeerCert_SerialNo/KEYM_E_PARAMETER_MISMATCH]  # Provides the content of a specific certificate element. The certificate configuration defines how the certificate submodule can find the element, e.g. by providing the object identifier (OID). This function is used to retrieve this information if only one element is assigned to the respective OID.
        arg CertificateElementData: type=KeyM_CertificateElementType_Ssa_TrustModelIntermediatePeerCert_SerialNo, direction=OUT, server-argument-impl-policy=USE-ARRAY-BASE-TYPE
        arg CertificateDataLength: type=uint32, direction=OUT, server-argument-impl-policy=USE-ARGUMENT-TYPE
      5 x error:
        E_NOT_OK: error-code=1  # The service request failed.
        KEYM_E_KEY_CERT_EMPTY: error-code=10  # The service request failed. The requested key or certificate is not available, slot is empty.
        KEYM_E_KEY_CERT_INVALID: error-code=6  # The service request failed. Key or certificate is invalid and cannot be used for the operation.
        KEYM_E_KEY_CERT_SIZE_MISMATCH: error-code=4  # The service request failed. Parameter size does not match the expected value.
        KEYM_E_PARAMETER_MISMATCH: error-code=5  # The service request failed. Parameter to function does not provide the expected value.
    KeyMCertificateElement_Ssa_TrustModelEcuPeerCert_ext_authKeyId  # Service of the certificate sub module to access certificate elements.
      operation CertificateElementGet: possible-error=[KeyMCertificateElement_Ssa_TrustModelEcuPeerCert_ext_authKeyId/E_NOT_OK, KeyMCertificateElement_Ssa_TrustModelEcuPeerCert_ext_authKeyId/KEYM_E_KEY_CERT_EMPTY, KeyMCertificateElement_Ssa_TrustModelEcuPeerCert_ext_authKeyId/KEYM_E_KEY_CERT_INVALID, KeyMCertificateElement_Ssa_TrustModelEcuPeerCert_ext_authKeyId/KEYM_E_KEY_CERT_SIZE_MISMATCH, KeyMCertificateElement_Ssa_TrustModelEcuPeerCert_ext_authKeyId/KEYM_E_PARAMETER_MISMATCH]  # Provides the content of a specific certificate element. The certificate configuration defines how the certificate submodule can find the element, e.g. by providing the object identifier (OID). This function is used to retrieve this information if only one element is assigned to the respective OID.
        arg CertificateElementData: type=KeyM_CertificateElementType_Ssa_TrustModelEcuPeerCert_ext_authKeyId, direction=OUT, server-argument-impl-policy=USE-ARRAY-BASE-TYPE
        arg CertificateDataLength: type=uint32, direction=OUT, server-argument-impl-policy=USE-ARGUMENT-TYPE
      5 x error:
        E_NOT_OK: error-code=1  # The service request failed.
        KEYM_E_KEY_CERT_EMPTY: error-code=10  # The service request failed. The requested key or certificate is not available, slot is empty.
        KEYM_E_KEY_CERT_INVALID: error-code=6  # The service request failed. Key or certificate is invalid and cannot be used for the operation.
        KEYM_E_KEY_CERT_SIZE_MISMATCH: error-code=4  # The service request failed. Parameter size does not match the expected value.
        KEYM_E_PARAMETER_MISMATCH: error-code=5  # The service request failed. Parameter to function does not provide the expected value.
    KeyMCertificateElement_Ssa_TrustModelEcuPeerCert_ext_specialEcu  # Service of the certificate sub module to access certificate elements.
      operation CertificateElementGet: possible-error=[KeyMCertificateElement_Ssa_TrustModelEcuPeerCert_ext_specialEcu/E_NOT_OK, KeyMCertificateElement_Ssa_TrustModelEcuPeerCert_ext_specialEcu/KEYM_E_KEY_CERT_EMPTY, KeyMCertificateElement_Ssa_TrustModelEcuPeerCert_ext_specialEcu/KEYM_E_KEY_CERT_INVALID, KeyMCertificateElement_Ssa_TrustModelEcuPeerCert_ext_specialEcu/KEYM_E_KEY_CERT_SIZE_MISMATCH, KeyMCertificateElement_Ssa_TrustModelEcuPeerCert_ext_specialEcu/KEYM_E_PARAMETER_MISMATCH]  # Provides the content of a specific certificate element. The certificate configuration defines how the certificate submodule can find the element, e.g. by providing the object identifier (OID). This function is used to retrieve this information if only one element is assigned to the respective OID.
        arg CertificateElementData: type=KeyM_CertificateElementType_Ssa_TrustModelEcuPeerCert_ext_specialEcu, direction=OUT, server-argument-impl-policy=USE-ARRAY-BASE-TYPE
        arg CertificateDataLength: type=uint32, direction=OUT, server-argument-impl-policy=USE-ARGUMENT-TYPE
      5 x error:
        E_NOT_OK: error-code=1  # The service request failed.
        KEYM_E_KEY_CERT_EMPTY: error-code=10  # The service request failed. The requested key or certificate is not available, slot is empty.
        KEYM_E_KEY_CERT_INVALID: error-code=6  # The service request failed. Key or certificate is invalid and cannot be used for the operation.
        KEYM_E_KEY_CERT_SIZE_MISMATCH: error-code=4  # The service request failed. Parameter size does not match the expected value.
        KEYM_E_PARAMETER_MISMATCH: error-code=5  # The service request failed. Parameter to function does not provide the expected value.
    KeyMCertificateElement_Ssa_TrustModelEcuPeerCert_ext_subKeyId  # Service of the certificate sub module to access certificate elements.
      operation CertificateElementGet: possible-error=[KeyMCertificateElement_Ssa_TrustModelEcuPeerCert_ext_subKeyId/E_NOT_OK, KeyMCertificateElement_Ssa_TrustModelEcuPeerCert_ext_subKeyId/KEYM_E_KEY_CERT_EMPTY, KeyMCertificateElement_Ssa_TrustModelEcuPeerCert_ext_subKeyId/KEYM_E_KEY_CERT_INVALID, KeyMCertificateElement_Ssa_TrustModelEcuPeerCert_ext_subKeyId/KEYM_E_KEY_CERT_SIZE_MISMATCH, KeyMCertificateElement_Ssa_TrustModelEcuPeerCert_ext_subKeyId/KEYM_E_PARAMETER_MISMATCH]  # Provides the content of a specific certificate element. The certificate configuration defines how the certificate submodule can find the element, e.g. by providing the object identifier (OID). This function is used to retrieve this information if only one element is assigned to the respective OID.
        arg CertificateElementData: type=KeyM_CertificateElementType_Ssa_TrustModelEcuPeerCert_ext_subKeyId, direction=OUT, server-argument-impl-policy=USE-ARRAY-BASE-TYPE
        arg CertificateDataLength: type=uint32, direction=OUT, server-argument-impl-policy=USE-ARGUMENT-TYPE
      5 x error:
        E_NOT_OK: error-code=1  # The service request failed.
        KEYM_E_KEY_CERT_EMPTY: error-code=10  # The service request failed. The requested key or certificate is not available, slot is empty.
        KEYM_E_KEY_CERT_INVALID: error-code=6  # The service request failed. Key or certificate is invalid and cannot be used for the operation.
        KEYM_E_KEY_CERT_SIZE_MISMATCH: error-code=4  # The service request failed. Parameter size does not match the expected value.
        KEYM_E_PARAMETER_MISMATCH: error-code=5  # The service request failed. Parameter to function does not provide the expected value.
    KeyMCertificateElement_Ssa_TrustModelEcuCert_SerialNo  # Service of the certificate sub module to access certificate elements.
      operation CertificateElementGet: possible-error=[KeyMCertificateElement_Ssa_TrustModelEcuCert_SerialNo/E_NOT_OK, KeyMCertificateElement_Ssa_TrustModelEcuCert_SerialNo/KEYM_E_KEY_CERT_EMPTY, KeyMCertificateElement_Ssa_TrustModelEcuCert_SerialNo/KEYM_E_KEY_CERT_INVALID, KeyMCertificateElement_Ssa_TrustModelEcuCert_SerialNo/KEYM_E_KEY_CERT_SIZE_MISMATCH, KeyMCertificateElement_Ssa_TrustModelEcuCert_SerialNo/KEYM_E_PARAMETER_MISMATCH]  # Provides the content of a specific certificate element. The certificate configuration defines how the certificate submodule can find the element, e.g. by providing the object identifier (OID). This function is used to retrieve this information if only one element is assigned to the respective OID.
        arg CertificateElementData: type=KeyM_CertificateElementType_Ssa_TrustModelEcuCert_SerialNo, direction=OUT, server-argument-impl-policy=USE-ARRAY-BASE-TYPE
        arg CertificateDataLength: type=uint32, direction=OUT, server-argument-impl-policy=USE-ARGUMENT-TYPE
      5 x error:
        E_NOT_OK: error-code=1  # The service request failed.
        KEYM_E_KEY_CERT_EMPTY: error-code=10  # The service request failed. The requested key or certificate is not available, slot is empty.
        KEYM_E_KEY_CERT_INVALID: error-code=6  # The service request failed. Key or certificate is invalid and cannot be used for the operation.
        KEYM_E_KEY_CERT_SIZE_MISMATCH: error-code=4  # The service request failed. Parameter size does not match the expected value.
        KEYM_E_PARAMETER_MISMATCH: error-code=5  # The service request failed. Parameter to function does not provide the expected value.
    KeyMCertificateElement_Ssa_TrustModelEcuPeerCert_SerialNo  # Service of the certificate sub module to access certificate elements.
      operation CertificateElementGet: possible-error=[KeyMCertificateElement_Ssa_TrustModelEcuPeerCert_SerialNo/E_NOT_OK, KeyMCertificateElement_Ssa_TrustModelEcuPeerCert_SerialNo/KEYM_E_KEY_CERT_EMPTY, KeyMCertificateElement_Ssa_TrustModelEcuPeerCert_SerialNo/KEYM_E_KEY_CERT_INVALID, KeyMCertificateElement_Ssa_TrustModelEcuPeerCert_SerialNo/KEYM_E_KEY_CERT_SIZE_MISMATCH, KeyMCertificateElement_Ssa_TrustModelEcuPeerCert_SerialNo/KEYM_E_PARAMETER_MISMATCH]  # Provides the content of a specific certificate element. The certificate configuration defines how the certificate submodule can find the element, e.g. by providing the object identifier (OID). This function is used to retrieve this information if only one element is assigned to the respective OID.
        arg CertificateElementData: type=KeyM_CertificateElementType_Ssa_TrustModelEcuPeerCert_SerialNo, direction=OUT, server-argument-impl-policy=USE-ARRAY-BASE-TYPE
        arg CertificateDataLength: type=uint32, direction=OUT, server-argument-impl-policy=USE-ARGUMENT-TYPE
      5 x error:
        E_NOT_OK: error-code=1  # The service request failed.
        KEYM_E_KEY_CERT_EMPTY: error-code=10  # The service request failed. The requested key or certificate is not available, slot is empty.
        KEYM_E_KEY_CERT_INVALID: error-code=6  # The service request failed. Key or certificate is invalid and cannot be used for the operation.
        KEYM_E_KEY_CERT_SIZE_MISMATCH: error-code=4  # The service request failed. Parameter size does not match the expected value.
        KEYM_E_PARAMETER_MISMATCH: error-code=5  # The service request failed. Parameter to function does not provide the expected value.
    KeyMCertificateElement_Ssa_TrustModelIntermediatePeerCert_validityNotAfter  # Service of the certificate sub module to access certificate elements.
      operation CertificateElementGet: possible-error=[KeyMCertificateElement_Ssa_TrustModelIntermediatePeerCert_validityNotAfter/E_NOT_OK, KeyMCertificateElement_Ssa_TrustModelIntermediatePeerCert_validityNotAfter/KEYM_E_KEY_CERT_EMPTY, KeyMCertificateElement_Ssa_TrustModelIntermediatePeerCert_validityNotAfter/KEYM_E_KEY_CERT_INVALID, KeyMCertificateElement_Ssa_TrustModelIntermediatePeerCert_validityNotAfter/KEYM_E_KEY_CERT_SIZE_MISMATCH, KeyMCertificateElement_Ssa_TrustModelIntermediatePeerCert_validityNotAfter/KEYM_E_PARAMETER_MISMATCH]  # Provides the content of a specific certificate element. The certificate configuration defines how the certificate submodule can find the element, e.g. by providing the object identifier (OID). This function is used to retrieve this information if only one element is assigned to the respective OID.
        arg CertificateElementData: type=KeyM_CertificateElementType_Ssa_TrustModelIntermediatePeerCert_validityNotAfter, direction=OUT, server-argument-impl-policy=USE-ARRAY-BASE-TYPE
        arg CertificateDataLength: type=uint32, direction=OUT, server-argument-impl-policy=USE-ARGUMENT-TYPE
      5 x error:
        E_NOT_OK: error-code=1  # The service request failed.
        KEYM_E_KEY_CERT_EMPTY: error-code=10  # The service request failed. The requested key or certificate is not available, slot is empty.
        KEYM_E_KEY_CERT_INVALID: error-code=6  # The service request failed. Key or certificate is invalid and cannot be used for the operation.
        KEYM_E_KEY_CERT_SIZE_MISMATCH: error-code=4  # The service request failed. Parameter size does not match the expected value.
        KEYM_E_PARAMETER_MISMATCH: error-code=5  # The service request failed. Parameter to function does not provide the expected value.
    KeyMCertificateElement_Ssa_TrustModelRootCert_subject  # Service of the certificate sub module to access certificate elements.
      operation CertificateElementGet: possible-error=[KeyMCertificateElement_Ssa_TrustModelRootCert_subject/E_NOT_OK, KeyMCertificateElement_Ssa_TrustModelRootCert_subject/KEYM_E_KEY_CERT_EMPTY, KeyMCertificateElement_Ssa_TrustModelRootCert_subject/KEYM_E_KEY_CERT_INVALID, KeyMCertificateElement_Ssa_TrustModelRootCert_subject/KEYM_E_KEY_CERT_SIZE_MISMATCH, KeyMCertificateElement_Ssa_TrustModelRootCert_subject/KEYM_E_PARAMETER_MISMATCH]  # Provides the content of a specific certificate element. The certificate configuration defines how the certificate submodule can find the element, e.g. by providing the object identifier (OID). This function is used to retrieve this information if only one element is assigned to the respective OID.
        arg CertificateElementData: type=KeyM_CertificateElementType_Ssa_TrustModelRootCert_subject, direction=OUT, server-argument-impl-policy=USE-ARRAY-BASE-TYPE
        arg CertificateDataLength: type=uint32, direction=OUT, server-argument-impl-policy=USE-ARGUMENT-TYPE
      5 x error:
        E_NOT_OK: error-code=1  # The service request failed.
        KEYM_E_KEY_CERT_EMPTY: error-code=10  # The service request failed. The requested key or certificate is not available, slot is empty.
        KEYM_E_KEY_CERT_INVALID: error-code=6  # The service request failed. Key or certificate is invalid and cannot be used for the operation.
        KEYM_E_KEY_CERT_SIZE_MISMATCH: error-code=4  # The service request failed. Parameter size does not match the expected value.
        KEYM_E_PARAMETER_MISMATCH: error-code=5  # The service request failed. Parameter to function does not provide the expected value.
    KeyMCertificateElement_Ssa_TrustModelRootCert_SubjectPublicKeyInfoKey  # Service of the certificate sub module to access certificate elements.
      operation CertificateElementGet: possible-error=[KeyMCertificateElement_Ssa_TrustModelRootCert_SubjectPublicKeyInfoKey/E_NOT_OK, KeyMCertificateElement_Ssa_TrustModelRootCert_SubjectPublicKeyInfoKey/KEYM_E_KEY_CERT_EMPTY, KeyMCertificateElement_Ssa_TrustModelRootCert_SubjectPublicKeyInfoKey/KEYM_E_KEY_CERT_INVALID, KeyMCertificateElement_Ssa_TrustModelRootCert_SubjectPublicKeyInfoKey/KEYM_E_KEY_CERT_SIZE_MISMATCH, KeyMCertificateElement_Ssa_TrustModelRootCert_SubjectPublicKeyInfoKey/KEYM_E_PARAMETER_MISMATCH]  # Provides the content of a specific certificate element. The certificate configuration defines how the certificate submodule can find the element, e.g. by providing the object identifier (OID). This function is used to retrieve this information if only one element is assigned to the respective OID.
        arg CertificateElementData: type=KeyM_CertificateElementType_Ssa_TrustModelRootCert_SubjectPublicKeyInfoKey, direction=OUT, server-argument-impl-policy=USE-ARRAY-BASE-TYPE
        arg CertificateDataLength: type=uint32, direction=OUT, server-argument-impl-policy=USE-ARGUMENT-TYPE
      5 x error:
        E_NOT_OK: error-code=1  # The service request failed.
        KEYM_E_KEY_CERT_EMPTY: error-code=10  # The service request failed. The requested key or certificate is not available, slot is empty.
        KEYM_E_KEY_CERT_INVALID: error-code=6  # The service request failed. Key or certificate is invalid and cannot be used for the operation.
        KEYM_E_KEY_CERT_SIZE_MISMATCH: error-code=4  # The service request failed. Parameter size does not match the expected value.
        KEYM_E_PARAMETER_MISMATCH: error-code=5  # The service request failed. Parameter to function does not provide the expected value.
