[part 1 of 4: packages /AUTOLIV/GlobalDictionary to /SecurityArchitecture/extSwc/Csm_swc/Interfaces]
AUTOSAR XML (schema 00049)
package /AUTOLIV/GlobalDictionary
  mode declaration group BswM_RoEMode: initial-mode=BSWM_CLEAR_ROE_MODE
    mode BSWM_CLEAR_ROE_MODE
    mode BSWM_SEND_ROE_FRAME
  client server interface icsEcuSleepState
    operation GetAfterRunMode
      arg u8AfterRunMode: type=u8EcuSleepStateType_Appl, direction=OUT, server-argument-impl-policy=USE-ARGUMENT-TYPE
package /AUTOLIV/GlobalDictionary/ClientServerInterfaces
  40 x client server interface:
    icsAutotestCallback
      operation AutotestCallback
        arg pu8TestResult: type=u8TestResultType_Appl, direction=OUT, server-argument-impl-policy=USE-ARGUMENT-TYPE
    icsAutotestServices
      operation GetLastCriticalAutotestID
        arg u8AutoTestId: type=UInt8_Appl, direction=OUT, server-argument-impl-policy=USE-ARGUMENT-TYPE
      operation GetTestResult
        arg u8AutoTestId: type=u8AutoTestIdType_Appl, direction=IN, server-argument-impl-policy=USE-ARGUMENT-TYPE
        arg u8TestResult: type=u8TestResultType_Appl, direction=OUT, server-argument-impl-policy=USE-ARGUMENT-TYPE
    icsBeltPosition
      6 x operation:
        GetFromMinPos_deg
          arg ps16BeltPosition_deg: type=s16BeltPosition_degType_Appl, direction=OUT, server-argument-impl-policy=USE-ARGUMENT-TYPE
        GetFromMinPos_mm
          arg ps16BeltPosition_mm: type=s16BeltPosition_mmType_Appl, direction=OUT, server-argument-impl-policy=USE-ARGUMENT-TYPE
        GetFromT0_deg  # Provides the belt position in degrees
          arg ps16BeltPosition_deg: type=s16BeltPosition_degType_Appl, direction=OUT, server-argument-impl-policy=USE-ARGUMENT-TYPE
        GetFromT0_mm  # Provides the belt position in millimeters
          arg ps16BeltPosition_mm: type=s16BeltPosition_mmType_Appl, direction=OUT, server-argument-impl-policy=USE-ARGUMENT-TYPE
        GetRange_deg  # Provides the belt position range in degrees (for min and max)
          arg ps16BeltPosition_min_deg: type=s16BeltPosition_degType_Appl, direction=OUT, server-argument-impl-policy=USE-ARGUMENT-TYPE  # Minimum displacement of the belt in degrees (1LSB ≡ 1deg)
          arg ps16BeltPosition_max_deg: type=s16BeltPosition_degType_Appl, direction=OUT, server-argument-impl-policy=USE-ARGUMENT-TYPE  # Maximum displacement of the belt in degrees (1LSB ≡ 1deg)
        GetRange_mm  # Provides the belt position range in millimeters (for min and max)
          arg ps16BeltPosition_min_mm: type=s16BeltPosition_mmType_Appl, direction=OUT, server-argument-impl-policy=USE-ARGUMENT-TYPE  # Minimum displacement of the belt in millimeters (1LSB ≡ 1mm)
          arg ps16BeltPosition_max_mm: type=s16BeltPosition_mmType_Appl, direction=OUT, server-argument-impl-policy=USE-ARGUMENT-TYPE  # Maximum displacement of the belt in millimeters (1LSB ≡ 1mm)
    icsBeltSpeed
      operation GetSpeed_SingleEdge_deg_s
        arg ps32BeltSpeed_SE_deg_s: type=s32BeltSpeed_deg_sType, direction=OUT, server-argument-impl-policy=USE-ARGUMENT-TYPE
      operation GetSpeed_deg_s
        arg ps32BeltSpeed_deg_s: type=s32BeltSpeed_deg_sType_Appl, direction=OUT, server-argument-impl-policy=USE-ARGUMENT-TYPE
      operation GetSpeed_mm_s
        arg ps32BeltSpeed_mm_s: type=s32BeltSpeed_mm_sType_Appl, direction=OUT, server-argument-impl-policy=USE-ARGUMENT-TYPE
    icsCurrent
      4 x operation:
        ConvertCurrent_mAtoLSB
          arg s32MotorCurrentInmA: type=s32MotorCurrentInmAType_Appl, direction=IN, server-argument-impl-policy=USE-ARGUMENT-TYPE
          arg pu16CurrentinLSB: type=u16CurrentInLSBType_Appl, direction=OUT, server-argument-impl-policy=USE-ARGUMENT-TYPE
        Get_A
          arg ps8MotorCurrentInA: type=s8MotorCurrentInAType_Appl, direction=OUT, server-argument-impl-policy=USE-ARGUMENT-TYPE
        Get_LSB
          arg pu16CurrentInLSB: type=u16CurrentInLSBType_Appl, direction=OUT, server-argument-impl-policy=USE-ARGUMENT-TYPE
        Get_mA
          arg ps32MotorCurrentInmA: type=s32MotorCurrentInmAType_Appl, direction=OUT, server-argument-impl-policy=USE-ARGUMENT-TYPE
    icsModeManagement
      operation CheckModeStatus
        arg u32ModesToCheck: type=u32ModeMaskType_Appl, direction=IN, server-argument-impl-policy=USE-ARGUMENT-TYPE
        arg bModeStatus: type=u8ModeStatusType_Appl, direction=OUT, server-argument-impl-policy=USE-ARGUMENT-TYPE
    icsMoto_P
      operation GetPowerOrder  # To get the current applied power order
        arg ps16MotorPowerOrder: type=s16MotorPowerOrderType_Appl, direction=OUT, server-argument-impl-policy=USE-ARGUMENT-TYPE  # Value of the current power order
      operation SetPowerOrder
        arg s16MotorPowerOrder: type=s16MotorPowerOrderType_Appl, direction=IN, server-argument-impl-policy=USE-ARGUMENT-TYPE  # Value of the power order to apply
        arg u16BoostDutyCycle: type=u16BoostPWMOrderType_Appl, direction=IN, server-argument-impl-policy=USE-ARGUMENT-TYPE
    icsMotor_T
      operation GetDeficiencyLevel
        arg pu32DeficiencyLevel: type=u32DeficiencyLevelType_Appl, direction=OUT, server-argument-impl-policy=USE-ARGUMENT-TYPE
      operation InitializeDeficiencyLevel  # This operation aims at initializing the deficiency level data
        arg u32DeficiencyLevel: type=u32DeficiencyLevelType_Appl, direction=IN, server-argument-impl-policy=USE-ARGUMENT-TYPE  # Value of the deficiency level to take into account at start-up
    icsNvmIfServices  # Covers AUTOSAR_SWS_NVRAMManager.pdf V3.2.0 R4.0 Rev 3 - NVM734
      4 x operation:
        GetCalibBlockLength
          arg cu16BlockId: type=u16CalibBlockIdType_Appl, direction=IN, server-argument-impl-policy=USE-ARGUMENT-TYPE
          arg pu16BlockLength: type=UInt16_Appl, direction=OUT, server-argument-impl-policy=USE-ARGUMENT-TYPE
        GetNvmBlockLength
          arg cu16BlockId: type=u16NvmBlockIdType_Appl, direction=IN, server-argument-impl-policy=USE-ARGUMENT-TYPE
          arg pu16BlockLength: type=UInt16_Appl, direction=OUT, server-argument-impl-policy=USE-ARGUMENT-TYPE
        GetNvmBlockStatus
          arg cu16BlockId: type=u16NvmBlockIdType_Appl, direction=IN, server-argument-impl-policy=USE-ARGUMENT-TYPE
          arg pu8BlockStatus: type=u8RequestResultType_Appl, direction=OUT, server-argument-impl-policy=USE-ARGUMENT-TYPE
        SynchronousRecord
          arg cu16BlockId: type=u16NvmBlockIdType_Appl, direction=IN, server-argument-impl-policy=USE-ARGUMENT-TYPE
          arg pu8RequestResult: type=u8RequestResultType_Appl, direction=OUT, server-argument-impl-policy=USE-ARGUMENT-TYPE
      4 x error:
        BLOCK_JOB_PENDING: error-code=5
        FAILED: error-code=2
        MEMORY_CLUSTER_BUSY: error-code=4
        PARAM_OUT_OF_RANGE: error-code=3
    icsPyroDevice
      operation GetPyroActivationStatus
        arg pb8PyroActivationStatus: type=b8PyroActivationStatusType_Appl, direction=OUT, server-argument-impl-policy=USE-ARGUMENT-TYPE  # Status of the pyro device activation
    icsResetCause
      operation ConfirmResetCause
      operation DetermineResetCause
      operation GetResetCause
        arg pu32ResetCause: type=u32ResetCauseType_Appl, direction=OUT, server-argument-impl-policy=USE-ARGUMENT-TYPE  # Cause of the ECU reset cause
    icsSampledAnalogSignal: is-service=true
      5 x operation:
        Get
          arg pu16SampledSignal: type=u16SampledSignalType_Appl, direction=OUT, server-argument-impl-policy=USE-ARGUMENT-TYPE
        Get_100ms
          arg pu16SampledSignal: type=u16SampledSignalType_Appl, direction=OUT, server-argument-impl-policy=USE-ARGUMENT-TYPE
        Get_10ms
          arg pu16SampledSignal: type=u16SampledSignalType_Appl, direction=OUT, server-argument-impl-policy=USE-ARGUMENT-TYPE
        Get_20ms
          arg pu16SampledSignal: type=u16SampledSignalType_Appl, direction=OUT, server-argument-impl-policy=USE-ARGUMENT-TYPE
        Get_2ms
          arg pu16SampledSignal: type=u16SampledSignalType_Appl, direction=OUT, server-argument-impl-policy=USE-ARGUMENT-TYPE
    icsTemperature
      operation GetFiltered
        arg pu16FilteredTemperature: type=u16InternalTemperatureType_Appl, direction=OUT, server-argument-impl-policy=USE-ARGUMENT-TYPE
      operation GetFiltered_deg
        arg ps16InternalTemperature_deg: type=s16InternalTemperature_deg_Type_Appl, direction=OUT, server-argument-impl-policy=USE-ARGUMENT-TYPE  # Value of temperature in Celcius degreees
      operation Init
    icsVoltage
      5 x operation:
        Get
          arg pu16Voltage: type=u16VoltageType_Appl, direction=OUT, server-argument-impl-policy=USE-ARGUMENT-TYPE
        Get_100ms
          arg pu16Voltage: type=u16VoltageType_Appl, direction=OUT, server-argument-impl-policy=USE-ARGUMENT-TYPE
        Get_10ms
          arg pu16Voltage: type=u16VoltageType_Appl, direction=OUT, server-argument-impl-policy=USE-ARGUMENT-TYPE
        Get_20ms
          arg pu16Voltage: type=u16VoltageType_Appl, direction=OUT, server-argument-impl-policy=USE-ARGUMENT-TYPE
        Get_2ms
          arg pu16Voltage: type=u16VoltageType_Appl, direction=OUT, server-argument-impl-policy=USE-ARGUMENT-TYPE
    DcmTxNotification  # This interface will gather all the service types which could be connected between the Can_Dcm and the DIA component
      operation GetTxNotification
      error KU8_NOK: error-code=5  # Actions related to the DiagOnCAN service cannot be performed
      error KU8_OK: error-code=10  # Actions related to the DiagOnCAN service are all completed
      error KU8_PENDING: error-code=7  # Actions related to the DiagOnCAN service are not completed yet
    icsAcknowledgeEccError  # interface to acknowledge ECC error status information in non initialized RAM memory
      operation AcknowledgeEccError  # Operation to acknowledge the ECC error status information
        arg u8EccMemoryType: type=u8EccErrorType_Appl, direction=IN, server-argument-impl-policy=USE-ARGUMENT-TYPE  # parameter to indicate to ECC runnable which ECC error status shall be acknowledged (RAM, DFLASH, PFLASH)
    icsAdcManage
      operation DeInit
      operation IsrProgramAdcSampling
    icsAecStatus
      7 x operation:
        GetAecDeskillThrs
          arg u8AecId: type=u8AecIdentifierType_Appl, direction=IN, server-argument-impl-policy=USE-ARGUMENT-TYPE
          arg pu16AecDeskillThrs: type=UInt16_Appl, direction=OUT, server-argument-impl-policy=USE-ARGUMENT-TYPE
        GetAecGroupsStatus
          arg pu32AecGroupsStatus: type=u32AecGroupsType_Appl, direction=OUT, server-argument-impl-policy=USE-ARGUMENT-TYPE
        GetAecNvpBlockRecordingStatus
          arg b8AecNvpBlockRecordingStatus: type=b8BooleanType_Appl, direction=OUT, server-argument-impl-policy=USE-ARGUMENT-TYPE
        GetAecQualificationCount
          arg u8AecId: type=UInt8_Appl, direction=IN, server-argument-impl-policy=USE-ARGUMENT-TYPE
          arg pu8AecQualificationCount: type=UInt8_Appl, direction=OUT, server-argument-impl-policy=USE-ARGUMENT-TYPE
        GetAecStatus
          arg u8AecIdentifier: type=u8AecIdentifierType_Appl, direction=IN, server-argument-impl-policy=USE-ARGUMENT-TYPE
          arg pu8AecStatus: type=u8AecStatusType_Appl, direction=OUT, server-argument-impl-policy=USE-ARGUMENT-TYPE
        GetNumberOfImplementedAec
          arg pu8NbOfAec: type=UInt8_Appl, direction=OUT, server-argument-impl-policy=USE-ARGUMENT-TYPE
        SetAecEvent
          arg u8AecIdentifier: type=u8AecIdentifierType_Appl, direction=IN, server-argument-impl-policy=USE-ARGUMENT-TYPE
          arg u8Command: type=u8AecCommandType_Appl, direction=IN, server-argument-impl-policy=USE-ARGUMENT-TYPE
    icsCanNmServices
      operation GetNMCurrentState
        arg u8CanNmState: type=u8CanNmStateType_Appl, direction=OUT, server-argument-impl-policy=USE-ARGUMENT-TYPE
      operation GetNMCurrentStateXOR
        arg u8CanNmStateXOR: type=u8CanNmStateType_Appl, direction=OUT, server-argument-impl-policy=USE-ARGUMENT-TYPE
      operation RequestSleepMode
    icsDiagRequestCycle
      operation ClearDiagRequestCycle
      operation GetDiagRequestCycle
        arg u8DiagRequestCycle: type=u8CycleNumberType_Appl, direction=OUT, server-argument-impl-policy=USE-ARGUMENT-TYPE
    icsEccError
      operation GetEccError  # To get the status of the specified Ecc error
        arg u8EccError: type=u8EccErrorType_Appl, direction=IN, server-argument-impl-policy=USE-ARGUMENT-TYPE  # Specify the type of ecc error for which the status has to be read
        arg pu8EccErrorStatus: type=u8EccErrorStatusType_Appl, direction=OUT, server-argument-impl-policy=USE-ARGUMENT-TYPE  # Contains the status of the specified Ecc error
    icsEolServices
      operation SetCycleCounterDatasetIndex
        arg u8DatasetIndex: type=UInt8_Appl, direction=IN, server-argument-impl-policy=USE-ARGUMENT-TYPE
    icsEsmInterfaces
      5 x operation:
        GetCurrentState
          arg u8CurrentState: type=u8EsmStateType_Appl, direction=OUT, server-argument-impl-policy=USE-ARGUMENT-TYPE
        GetCurrentStateXOR
          arg u8ESMStateXOR: type=u8EsmStateType, direction=OUT, server-argument-impl-policy=USE-ARGUMENT-TYPE
        GoToLowPower
        IsECUInOperation
          arg bIsECUInOperation: type=b8BooleanType_Appl, direction=OUT, server-argument-impl-policy=USE-ARGUMENT-TYPE
        SetEvent
          arg cu8EventID: type=u8EsmEventIdType_Appl, direction=IN, server-argument-impl-policy=USE-ARGUMENT-TYPE
          arg bIsESMEventSet: type=b8BooleanType_Appl, direction=OUT, server-argument-impl-policy=USE-ARGUMENT-TYPE
    icsExternalClock
      4 x operation:
        DisableExternalClock
        EnableExternalClock
        GetExternalClockStatus
          arg pu8ClkStatus: type=u8ClkStatusType_Appl, direction=OUT, server-argument-impl-policy=USE-ARGUMENT-TYPE
        InitExternalClock
    icsHbsControl
      operation DisableHBSMonitoring
      operation EnableHBSMonitoring
    icsInPositionState
      operation GetInPositionState
        arg pu8InPositionState: type=uint8, direction=INOUT, server-argument-impl-policy=USE-ARGUMENT-TYPE
    icsInternalWatchdogReset
      operation Reset  # Operation call to immediatly reset the MCU.
    icsInternalWatchdogTest
      operation GetIntWdgTestResult
        arg pu8WdgTestResult: type=u8WdgTestResultType_Appl, direction=OUT, server-argument-impl-policy=USE-ARGUMENT-TYPE  # Contains the status of the Internal Watchdog Test
      operation LaunchIntWdgTest
    icsMicInterfaces
      operation CheckStackOverflowInterrupt
    icsPwmServices
      operation DisablePWM
        arg cu8TargetChannel: type=u8PwmChannelId_Appl, direction=IN, server-argument-impl-policy=USE-ARGUMENT-TYPE
      operation EnablePWM
        arg cu8TargetChannel: type=u8PwmChannelId_Appl, direction=IN, server-argument-impl-policy=USE-ARGUMENT-TYPE
      operation SetDutyCycle
        arg cu8TargetChannel: type=u8PwmChannelId_Appl, direction=IN, server-argument-impl-policy=USE-ARGUMENT-TYPE
        arg cu16DutyCycle: type=UInt16_Appl, direction=IN, server-argument-impl-policy=USE-ARGUMENT-TYPE
    icsResetCauseNotification  # Interface for notification to RCM by other SW modules of the cause which will lead to reset
      operation NotifyResetCause
        arg u32ResetCauseNotification: type=u32ResetReasonNotificationType_Appl, direction=IN, server-argument-impl-policy=USE-ARGUMENT-TYPE  # Reset Cause information that will lead to a SW reset.
        arg u32ResetCauseStatus: type=u32ResetReasonNotificationStatusType_Appl, direction=IN, server-argument-impl-policy=USE-ARGUMENT-TYPE  # Flag to set or clear the reset cause notification
    icsResistance
      operation Get
        arg u16ECUInternalTemperature: type=u16InternalTemperatureType_Appl, direction=IN, server-argument-impl-policy=USE-ARGUMENT-TYPE
        arg pu16Resistance_mOhm: type=u16Resistance_mOhmType_Appl, direction=OUT, server-argument-impl-policy=USE-ARGUMENT-TYPE
    icsSpiIfServices
      operation GetResetCauses
        arg u16ResetCauses: type=uint16, direction=OUT, server-argument-impl-policy=USE-ARGUMENT-TYPE
      operation MainFunction
    icsSurveyBatteryVoltage
      operation GetStatus  # Returns the battery status
        arg pu8BatteryVoltageSurveyStatus: type=u8BatteryVoltageSurveyStatusType_Appl, direction=OUT, server-argument-impl-policy=USE-ARGUMENT-TYPE
      operation Monitor  # Triggered at the end of ADC conversion. Computes the battery state
    icsSwMonitoring
      operation GetJob
        arg pu8JobType: type=u8JobTypesListType_Appl, direction=OUT, server-argument-impl-policy=USE-ARGUMENT-TYPE
        arg pu8MonitoringParam: type=UInt8_Appl, direction=OUT, server-argument-impl-policy=USE-ARGUMENT-TYPE
      operation GetStatistics
        arg pu32Min: type=UInt32_Appl, direction=OUT, server-argument-impl-policy=USE-ARGUMENT-TYPE  # Minimum duration observed since SCH_SetMonitoredJob
        arg pu32Max: type=UInt32_Appl, direction=OUT, server-argument-impl-policy=USE-ARGUMENT-TYPE  # Maximum duration observed since SCH_SetMonitoredJob
      operation SelectJob
        arg u8JobType: type=u8JobTypesListType_Appl, direction=IN, server-argument-impl-policy=USE-ARGUMENT-TYPE  # Type of job to monitor
        arg u8MonitoringParam: type=UInt8_Appl, direction=IN, server-argument-impl-policy=USE-ARGUMENT-TYPE  # Additional parameters for the job monitoring
    icsSynchronousMotorControl
      operation ExecuteEmergencyBrakingSequence
      operation ExecuteHighPowerStep  # To execute the high power step in the real time context of the client
      operation ResetMotorStageStatus
    icsSystemContextManagement
      6 x operation:
        GetBatteryHysteresisThrs
          arg pu16BatteryHysteresisThrs: type=uint16, direction=INOUT, server-argument-impl-policy=USE-ARGUMENT-TYPE
        GetLastTensionningState
          arg pu8LastExecutedCycle: type=u8CycleNumberType_Appl, direction=OUT, server-argument-impl-policy=USE-ARGUMENT-TYPE
        GetMonitoredCycle
          arg u8LastInterrCycle: type=u8CycleNumberType_Appl, direction=OUT, server-argument-impl-policy=USE-ARGUMENT-TYPE
        ManageSystemContextStorage
          arg b8IsBatteryLoss: type=b8BooleanType_Appl, direction=IN, server-argument-impl-policy=USE-ARGUMENT-TYPE
        RestoreSystemContext
        SuperviseKL30bg
          arg u16KL30bgLevel: type=u16SampledSignalType_Appl, direction=IN, server-argument-impl-policy=USE-ARGUMENT-TYPE
    icsSystemTime
      4 x operation:
        ReadAbsoluteSystemTime  # To read the absolute system time (time elapsed since the initial ECU programming) COVERS: PRO_SF05_3449
          arg pstAbsoluteSystemTime: type=stAbsoluteSystemTimeType_Appl, direction=OUT, server-argument-impl-policy=USE-ARGUMENT-TYPE  # Value of the absolute system time
        ReadRelativeSystemTime  # To read the value of the relative system time (time elapsed since the last power on reset). COVERS: PRO_SF03_3450
          arg pu32RelativeSystemTime: type=u32RelativeSystemTimeType_Appl, direction=OUT, server-argument-impl-policy=USE-ARGUMENT-TYPE  # Value of the relative system time
        WriteAbsoluteSystemTime  # To change the value of the absolute system time (time elapsed since the initial ECU programming) COVERS: PRO_SF05_5980
          arg stAbsoluteSystemTime: type=stAbsoluteSystemTimeType_Appl, direction=IN, server-argument-impl-policy=USE-ARGUMENT-TYPE  # Value of the absolute system time
        WriteRelativeSystemTime  # To change the value of the relative system time (time elapsed since the last power on reset). COVERS: PRO_SF05_6301
          arg u32RelativeSystemTime: type=u32RelativeSystemTimeType_Appl, direction=IN, server-argument-impl-policy=USE-ARGUMENT-TYPE  # Value of the relative system time
    icsTimInterfaces  # Get the actual value of the TIM internal counter
      operation GetInternalCounter  # Returns the actual value of the TIM internal timer
        arg u32TimInternalCounter: type=u32InternalCounterType_Appl, direction=OUT, server-argument-impl-policy=USE-ARGUMENT-TYPE
    ics_ServiceAutotest: is-service=true
      operation GetTestResult
        arg pu8TestResult: type=u8TestResultType_Appl, direction=OUT, server-argument-impl-policy=USE-ARGUMENT-TYPE
package /AUTOLIV/GlobalDictionary/SenderReceiverInterfaces
  19 x sender receiver interface:
    isrAlgorithmFlagsStatus
      5 x data:
        b8InterruptFlag: type=b8AlgorithmFlagsStatusType_Appl  # State of the algorithm interrupt flag
        b8PreActivationFlag: type=b8AlgorithmFlagsStatusType_Appl
        b8PreConditionsFlag: type=b8AlgorithmFlagsStatusType_Appl  # State of the pre conditions related to the decision algorithm
        b8TriggerFlag: type=b8AlgorithmFlagsStatusType_Appl  # State of the algorithm trigger flag
        u8TriggeringSource: type=u8TriggeringSourceType_Appl  # Sources identifier requesting a belt function triggering.
    isrBuckleDoorSwitch  # Buckle switch status provided by CAN
      data u8BuckleSwitch: type=u8lBuckleSwitchStatusType_Appl  # buckle switch state value
      data u8DoorSwitch: type=u8DoorSwitchStatusType_Appl  # Indicates if the signal has been received or not
    isrCustomerSpecific
      10 x data:
        b8HardReleaseRequest: type=b8BooleanType_Appl
        b8IsCarCrankingActive: type=b8IsCarCrankingActiveType_Appl
        b8IsCarCrashDetected: type=b8IsCarCrashDetectedType_Appl
        b8IsTrigOffEventAllowed: type=b8BooleanType_Appl
        b8PreCrashRequestEnable: type=b8BooleanType_Appl
        u8BeltSlackStatus: type=u8BeltSlackStatusType_Appl
        u8HapticRequest: type=u8HapticRequestType_Appl
        u8PreCrashRequest: type=u8PreCrashRequestType_Appl
        u8TriggerRequest: type=UInt8_Appl
        b8SignalRelInhibition: type=b8BooleanType_Appl
    isrCycleNumber
      data u8CycleNumber: type=u8CycleNumberType_Appl
    isrDriverControls
      9 x data:
        b8VehicleMovingBackwards: type=b8BooleanType_Appl  # Bit set by vehicle moving backwards detection
        s16AccelerationPedalPositionRate: type=s16AccelerationPedalPositionRateType_Appl  # Acceleration pedal position gradient in %/s
        s16BrakePressureRate: type=s16BrakePressureRateType_Appl  # Brake Pressure gradient applied to wheels in bar/s
        s16HWAngle: type=s16HWAngleType_Appl  # Handwheel angle in deg
        s16HWRate: type=s16HWRateType_Appl  # Handwheel angle rate in deg/s
        u16BrakePressure: type=u16BrakePressureType_Appl  # Brake Pressure applied to wheels in bar
        u16VehicleSpeed: type=u16VehicleSpeedType_Appl  # Vehicle speed in m/s
        u8AccelerationPedalPosition: type=u8AccelerationPedalPositionType_Appl  # Acceleration pedal position in %
        u8KlemmenStatus: type=u8KlemmenStatusType_Appl
    isrStepNumber
      data u8StepNumber: type=u8StepNumberType_Appl  # Contains the step number currently executed
    isrBeltParkingAuthorizationState
      data u8BeltParkingAuthorizationState: type=u8BeltParkingAuthorizationStateType_Appl
    isrBeltParkingComputedSignals
      4 x data:
        b8BeltMovingInDetected: type=b8BooleanType_Appl
        b8BeltMovingOutDetected: type=b8BooleanType_Appl
        u8RepetitionCounter: type=UInt8_Appl  # Belt Parking Door cycle repetition counter
        u8RetractionStatus: type=u8RetractionStatusType_Appl
    isrCarAcceleration
      data b8IsCarAccelerationLow: type=b8IsCarAccelerationLowType_Appl
    isrEmergencyBraking
      data b8DefectStatus: type=b8DefectStatusType_Appl
      data u8SeverityLevel: type=u8SeverityLevelType_Appl
    isrEvasiveManeuver
      data b8DefectStatus: type=b8DefectStatusType_Appl
      data u8SeverityLevel: type=u8SeverityLevelType_Appl
    isrIMU
      6 x data:
        s16AccX: type=s16AccelerationType_Appl
        s16AccY: type=s16AccelerationType_Appl
        s16AccZ: type=s16AccelerationType_Appl
        s16PitchRate: type=s16AngleRateType_Appl  # Pitch rate of vehicle in deg/s
        s16RollRate: type=s16AngleRateType_Appl  # Roll rate of vehicle in deg/s
        s16YawRate: type=s16AngleRateType_Appl  # Yaw rate of vehicle in deg/s
    isrOverSteering
      data b8DefectStatus: type=b8DefectStatusType_Appl
      data u8SeverityLevel: type=u8SeverityLevelType_Appl
    isrPreCrashSeverityLevel
      data u8PreCrashSeverityLevel: type=u8PreCrashSeverityLevelType_Appl
    isrRollStabilityControl
      data b8DefectStatus: type=b8DefectStatusType_Appl
      data u8SeverityLevel: type=u8SeverityLevelType_Appl
    isrUnderSteering
      data b8DefectStatus: type=b8DefectStatusType_Appl
      data u8SeverityLevel: type=u8SeverityLevelType_Appl
    isrVBoostBadConditionsStatus
      data b8IsMaxBadConditionsCountReached: type=b8BooleanType_Appl
    isrVariantCodingValidity
      data u8CodingValidity: type=UInt8
      data u8VehicleEquipValidity: type=UInt8
    isrNVMBlockUpdateStatus
      data b8NVMBlockStatus: type=b8BooleanType
package /AUTOLIV/GlobalDictionary/ModeSwithInterfaces
  mode switch interface BswM_CurrentMode: is-service=true
    mode group BswM_RoEMode: type=BswM_RoEMode
package /AUTOLIV/GlobalDictionary/SwAddrMethods
  5 x sw addr method:
    CODE: memory-allocation-keyword-policy=ADDR-METHOD-SHORT-NAME, section-type=CODE
    CONST: memory-allocation-keyword-policy=ADDR-METHOD-SHORT-NAME-AND-ALIGNMENT, section-initialization-policy=NO-INIT, section-type=CONST
    VAR_ALV: memory-allocation-keyword-policy=ADDR-METHOD-SHORT-NAME-AND-ALIGNMENT, section-initialization-policy=CLEARED, section-type=VAR
    VAR_INIT: memory-allocation-keyword-policy=ADDR-METHOD-SHORT-NAME-AND-ALIGNMENT, section-initialization-policy=INIT, section-type=VAR
    VAR_NO_INIT: memory-allocation-keyword-policy=ADDR-METHOD-SHORT-NAME, section-initialization-policy=NO-INIT, section-type=VAR
package /SecurityArchitecture/external/Csm_swc/Interfaces
  17 x client server interface, all with is-service=true, service-kind=CRYPTO-SERVICE-MANAGER:
    CsmEncrypt_AES128Encrypt  # This interface is used to perform the encryption.
      operation CancelJob: possible-error=[CsmEncrypt_AES128Encrypt/E_NOT_OK, CsmEncrypt_AES128Encrypt/CSM_E_JOB_CANCELED]  # Cancels the Job
      operation Encrypt: possible-error=[CsmEncrypt_AES128Encrypt/CSM_E_BUSY, CsmEncrypt_AES128Encrypt/CSM_E_SMALL_BUFFER, CsmEncrypt_AES128Encrypt/E_NOT_OK, CsmEncrypt_AES128Encrypt/CSM_E_KEY_EMPTY, CsmEncrypt_AES128Encrypt/CSM_E_KEY_NOT_VALID, CsmEncrypt_AES128Encrypt/CSM_E_KEY_SIZE_MISMATCH]  # This interface shall be used to start the Encrypt service of the CSM module.
        4 x arg:
          dataBuffer: type=Csm_EncryptDataType_AES128Encrypt, direction=IN, server-argument-impl-policy=USE-ARRAY-BASE-TYPE
          dataLength: type=uint32, direction=IN, server-argument-impl-policy=USE-ARGUMENT-TYPE
          resultBuffer: type=Csm_EncryptResultType_AES128Encrypt, direction=OUT, server-argument-impl-policy=USE-ARRAY-BASE-TYPE
          resultLength: type=uint32, direction=INOUT, server-argument-impl-policy=USE-ARGUMENT-TYPE
      7 x error:
        CSM_E_BUSY: error-code=2  # The service request failed because the service is still busy.
        CSM_E_SMALL_BUFFER: error-code=3  # The service request failed because the provided buffer is too small to store the result.
        E_NOT_OK: error-code=1  # The service request failed.
        CSM_E_JOB_CANCELED: error-code=12
        CSM_E_KEY_EMPTY: error-code=13
        CSM_E_KEY_NOT_VALID: error-code=9
        CSM_E_KEY_SIZE_MISMATCH: error-code=10
    CsmHash_Sha2_512  # A cryptographic hash function is a deterministic procedure that takes an arbitrary block of data and returns a fixed-size bit string, the hash value, such that an accidental or intentional change to the data will change the hash value. Main properties of hash functions are that it is infeasible to find a message that has a given hash or to find two different messages with the same hash.
      operation CancelJob: possible-error=[CsmHash_Sha2_512/E_NOT_OK, CsmHash_Sha2_512/CSM_E_JOB_CANCELED]  # Cancels the Job
      operation Hash: possible-error=[CsmHash_Sha2_512/CSM_E_BUSY, CsmHash_Sha2_512/CSM_E_SMALL_BUFFER, CsmHash_Sha2_512/E_NOT_OK]  # This interface shall be used to start the hash computation service of the CSM module.
        4 x arg:
          dataBuffer: type=Csm_HashDataType_Sha2_512, direction=IN, server-argument-impl-policy=USE-ARRAY-BASE-TYPE
          dataLength: type=uint32, direction=IN, server-argument-impl-policy=USE-ARGUMENT-TYPE
          resultBuffer: type=Csm_HashResultType_Sha2_512, direction=OUT, server-argument-impl-policy=USE-ARRAY-BASE-TYPE
          resultLength: type=uint32, direction=INOUT, server-argument-impl-policy=USE-ARGUMENT-TYPE
      4 x error:
        CSM_E_BUSY: error-code=2  # The service request failed because the service is still busy.
        CSM_E_SMALL_BUFFER: error-code=3  # The service request failed because the provided buffer is too small to store the result.
        E_NOT_OK: error-code=1  # The service request failed.
        CSM_E_JOB_CANCELED: error-code=12
    CsmKeyManagement_KeyM_SigVerifyKey_TrustModelEcu  # Interface to execute the key management functions.
      6 x operation:
        KeyCopy: possible-error=[CsmKeyManagement_KeyM_SigVerifyKey_TrustModelEcu/CSM_E_BUSY, CsmKeyManagement_KeyM_SigVerifyKey_TrustModelEcu/CSM_E_KEY_READ_FAIL, CsmKeyManagement_KeyM_SigVerifyKey_TrustModelEcu/CSM_E_KEY_SIZE_MISMATCH, CsmKeyManagement_KeyM_SigVerifyKey_TrustModelEcu/CSM_E_KEY_WRITE_FAIL, CsmKeyManagement_KeyM_SigVerifyKey_TrustModelEcu/CSM_E_SMALL_BUFFER, CsmKeyManagement_KeyM_SigVerifyKey_TrustModelEcu/E_NOT_OK, CsmKeyManagement_KeyM_SigVerifyKey_TrustModelEcu/CSM_E_KEY_EMPTY]  # This function shall copy all key elements from the source key to a target key.
          arg targetKeyId: type=uint32, direction=IN, server-argument-impl-policy=USE-ARGUMENT-TYPE
        KeyElementCopy: possible-error=[CsmKeyManagement_KeyM_SigVerifyKey_TrustModelEcu/CSM_E_BUSY, CsmKeyManagement_KeyM_SigVerifyKey_TrustModelEcu/CSM_E_KEY_READ_FAIL, CsmKeyManagement_KeyM_SigVerifyKey_TrustModelEcu/CSM_E_KEY_SIZE_MISMATCH, CsmKeyManagement_KeyM_SigVerifyKey_TrustModelEcu/CSM_E_KEY_WRITE_FAIL, CsmKeyManagement_KeyM_SigVerifyKey_TrustModelEcu/CSM_E_SMALL_BUFFER, CsmKeyManagement_KeyM_SigVerifyKey_TrustModelEcu/E_NOT_OK, CsmKeyManagement_KeyM_SigVerifyKey_TrustModelEcu/CSM_E_KEY_EMPTY]  # This function shall copy a key elements from one key to a target key.
          arg keyElementId: type=uint32, direction=IN, server-argument-impl-policy=USE-ARGUMENT-TYPE
          arg targetKeyId: type=uint32, direction=IN, server-argument-impl-policy=USE-ARGUMENT-TYPE
          arg targetKeyElementId: type=uint32, direction=IN, server-argument-impl-policy=USE-ARGUMENT-TYPE
        KeyElementCopyPartial: possible-error=[CsmKeyManagement_KeyM_SigVerifyKey_TrustModelEcu/CSM_E_BUSY, CsmKeyManagement_KeyM_SigVerifyKey_TrustModelEcu/CSM_E_KEY_EMPTY, CsmKeyManagement_KeyM_SigVerifyKey_TrustModelEcu/CSM_E_KEY_NOT_AVAILABLE, CsmKeyManagement_KeyM_SigVerifyKey_TrustModelEcu/CSM_E_KEY_READ_FAIL, CsmKeyManagement_KeyM_SigVerifyKey_TrustModelEcu/CSM_E_KEY_SIZE_MISMATCH, CsmKeyManagement_KeyM_SigVerifyKey_TrustModelEcu/CSM_E_KEY_WRITE_FAIL, CsmKeyManagement_KeyM_SigVerifyKey_TrustModelEcu/E_NOT_OK]  # This function shall copy parts of a key element from one key to parts of a target key element of a target key.
          6 x arg, all with type=uint32, direction=IN, server-argument-impl-policy=USE-ARGUMENT-TYPE:
            keyElementId
            keyElementSourceOffset
            keyElementTargetOffset
            keyElementCopyLength
            targetKeyId
            targetKeyElementId
        KeyElementGet: possible-error=[CsmKeyManagement_KeyM_SigVerifyKey_TrustModelEcu/CSM_E_BUSY, CsmKeyManagement_KeyM_SigVerifyKey_TrustModelEcu/CSM_E_KEY_NOT_AVAILABLE, CsmKeyManagement_KeyM_SigVerifyKey_TrustModelEcu/CSM_E_KEY_READ_FAIL, CsmKeyManagement_KeyM_SigVerifyKey_TrustModelEcu/CSM_E_SMALL_BUFFER, CsmKeyManagement_KeyM_SigVerifyKey_TrustModelEcu/E_NOT_OK, CsmKeyManagement_KeyM_SigVerifyKey_TrustModelEcu/CSM_E_KEY_EMPTY]  # Retrieves the key element bytes from a specific key element of the key and stores the key element in the provided buffer.
          arg keyElementId: type=uint32, direction=IN, server-argument-impl-policy=USE-ARGUMENT-TYPE
          arg keyPtr: type=Csm_KeyDataType_KeyM_SigVerifyKey_TrustModelEcu, direction=OUT, server-argument-impl-policy=USE-ARRAY-BASE-TYPE
          arg keyLength: type=uint32, direction=INOUT, server-argument-impl-policy=USE-ARGUMENT-TYPE
        KeyElementSet: possible-error=[CsmKeyManagement_KeyM_SigVerifyKey_TrustModelEcu/CSM_E_BUSY, CsmKeyManagement_KeyM_SigVerifyKey_TrustModelEcu/CSM_E_KEY_NOT_AVAILABLE, CsmKeyManagement_KeyM_SigVerifyKey_TrustModelEcu/CSM_E_KEY_SIZE_MISMATCH, CsmKeyManagement_KeyM_SigVerifyKey_TrustModelEcu/CSM_E_KEY_WRITE_FAIL, CsmKeyManagement_KeyM_SigVerifyKey_TrustModelEcu/E_NOT_OK]  # Sets the given key element bytes to the key.
          arg keyElementId: type=uint32, direction=IN, server-argument-impl-policy=USE-ARGUMENT-TYPE
          arg keyPtr: type=Csm_KeyDataType_KeyM_SigVerifyKey_TrustModelEcu, direction=IN, server-argument-impl-policy=USE-ARRAY-BASE-TYPE
          arg keyLength: type=uint32, direction=IN, server-argument-impl-policy=USE-ARGUMENT-TYPE
        KeySetValid: possible-error=[CsmKeyManagement_KeyM_SigVerifyKey_TrustModelEcu/CSM_E_BUSY, CsmKeyManagement_KeyM_SigVerifyKey_TrustModelEcu/E_NOT_OK]  # Sets the given key element bytes to the key.
      8 x error:
        CSM_E_BUSY: error-code=2  # The service request failed because the service is still busy.
        CSM_E_KEY_EMPTY: error-code=13  # The service request failed because of uninitialized source key element.
        CSM_E_KEY_NOT_AVAILABLE: error-code=8  # The service request failed because the key is not available.
        CSM_E_KEY_READ_FAIL: error-code=6  # The service request failed because read access was denied.
        CSM_E_KEY_SIZE_MISMATCH: error-code=10  # The service request failed because the key element is not partially accessible and the provided key element length is too short or too long for that key element.
        CSM_E_KEY_WRITE_FAIL: error-code=7  # The service request failed because write access was denied.
        CSM_E_SMALL_BUFFER: error-code=3  # The service request failed because the provided buffer is too small to store the result.
        E_NOT_OK: error-code=1  # The service request failed.
    CsmKeyManagement_KeyM_SigVerifyKey_TrustModelEcuPeer  # Interface to execute the key management functions.
      6 x operation:
        KeyCopy: possible-error=[CsmKeyManagement_KeyM_SigVerifyKey_TrustModelEcuPeer/CSM_E_BUSY, CsmKeyManagement_KeyM_SigVerifyKey_TrustModelEcuPeer/CSM_E_KEY_READ_FAIL, CsmKeyManagement_KeyM_SigVerifyKey_TrustModelEcuPeer/CSM_E_KEY_SIZE_MISMATCH, CsmKeyManagement_KeyM_SigVerifyKey_TrustModelEcuPeer/CSM_E_KEY_WRITE_FAIL, CsmKeyManagement_KeyM_SigVerifyKey_TrustModelEcuPeer/CSM_E_SMALL_BUFFER, CsmKeyManagement_KeyM_SigVerifyKey_TrustModelEcuPeer/E_NOT_OK, CsmKeyManagement_KeyM_SigVerifyKey_TrustModelEcuPeer/CSM_E_KEY_EMPTY]  # This function shall copy all key elements from the source key to a target key.
          arg targetKeyId: type=uint32, direction=IN, server-argument-impl-policy=USE-ARGUMENT-TYPE
        KeyElementCopy: possible-error=[CsmKeyManagement_KeyM_SigVerifyKey_TrustModelEcuPeer/CSM_E_BUSY, CsmKeyManagement_KeyM_SigVerifyKey_TrustModelEcuPeer/CSM_E_KEY_READ_FAIL, CsmKeyManagement_KeyM_SigVerifyKey_TrustModelEcuPeer/CSM_E_KEY_SIZE_MISMATCH, CsmKeyManagement_KeyM_SigVerifyKey_TrustModelEcuPeer/CSM_E_KEY_WRITE_FAIL, CsmKeyManagement_KeyM_SigVerifyKey_TrustModelEcuPeer/CSM_E_SMALL_BUFFER, CsmKeyManagement_KeyM_SigVerifyKey_TrustModelEcuPeer/E_NOT_OK, CsmKeyManagement_KeyM_SigVerifyKey_TrustModelEcuPeer/CSM_E_KEY_EMPTY]  # This function shall copy a key elements from one key to a target key.
          arg keyElementId: type=uint32, direction=IN, server-argument-impl-policy=USE-ARGUMENT-TYPE
          arg targetKeyId: type=uint32, direction=IN, server-argument-impl-policy=USE-ARGUMENT-TYPE
          arg targetKeyElementId: type=uint32, direction=IN, server-argument-impl-policy=USE-ARGUMENT-TYPE
        KeyElementCopyPartial: possible-error=[CsmKeyManagement_KeyM_SigVerifyKey_TrustModelEcuPeer/CSM_E_BUSY, CsmKeyManagement_KeyM_SigVerifyKey_TrustModelEcuPeer/CSM_E_KEY_EMPTY, CsmKeyManagement_KeyM_SigVerifyKey_TrustModelEcuPeer/CSM_E_KEY_NOT_AVAILABLE, CsmKeyManagement_KeyM_SigVerifyKey_TrustModelEcuPeer/CSM_E_KEY_READ_FAIL, CsmKeyManagement_KeyM_SigVerifyKey_TrustModelEcuPeer/CSM_E_KEY_SIZE_MISMATCH, CsmKeyManagement_KeyM_SigVerifyKey_TrustModelEcuPeer/CSM_E_KEY_WRITE_FAIL, CsmKeyManagement_KeyM_SigVerifyKey_TrustModelEcuPeer/E_NOT_OK]  # This function shall copy parts of a key element from one key to parts of a target key element of a target key.
          6 x arg, all with type=uint32, direction=IN, server-argument-impl-policy=USE-ARGUMENT-TYPE:
            keyElementId
            keyElementSourceOffset
            keyElementTargetOffset
            keyElementCopyLength
            targetKeyId
            targetKeyElementId
        KeyElementGet: possible-error=[CsmKeyManagement_KeyM_SigVerifyKey_TrustModelEcuPeer/CSM_E_BUSY, CsmKeyManagement_KeyM_SigVerifyKey_TrustModelEcuPeer/CSM_E_KEY_NOT_AVAILABLE, CsmKeyManagement_KeyM_SigVerifyKey_TrustModelEcuPeer/CSM_E_KEY_READ_FAIL, CsmKeyManagement_KeyM_SigVerifyKey_TrustModelEcuPeer/CSM_E_SMALL_BUFFER, CsmKeyManagement_KeyM_SigVerifyKey_TrustModelEcuPeer/E_NOT_OK, CsmKeyManagement_KeyM_SigVerifyKey_TrustModelEcuPeer/CSM_E_KEY_EMPTY]  # Retrieves the key element bytes from a specific key element of the key and stores the key element in the provided buffer.
          arg keyElementId: type=uint32, direction=IN, server-argument-impl-policy=USE-ARGUMENT-TYPE
          arg keyPtr: type=Csm_KeyDataType_KeyM_SigVerifyKey_TrustModelEcuPeer, direction=OUT, server-argument-impl-policy=USE-ARRAY-BASE-TYPE
          arg keyLength: type=uint32, direction=INOUT, server-argument-impl-policy=USE-ARGUMENT-TYPE
        KeyElementSet: possible-error=[CsmKeyManagement_KeyM_SigVerifyKey_TrustModelEcuPeer/CSM_E_BUSY, CsmKeyManagement_KeyM_SigVerifyKey_TrustModelEcuPeer/CSM_E_KEY_NOT_AVAILABLE, CsmKeyManagement_KeyM_SigVerifyKey_TrustModelEcuPeer/CSM_E_KEY_SIZE_MISMATCH, CsmKeyManagement_KeyM_SigVerifyKey_TrustModelEcuPeer/CSM_E_KEY_WRITE_FAIL, CsmKeyManagement_KeyM_SigVerifyKey_TrustModelEcuPeer/E_NOT_OK]  # Sets the given key element bytes to the key.
          arg keyElementId: type=uint32, direction=IN, server-argument-impl-policy=USE-ARGUMENT-TYPE
          arg keyPtr: type=Csm_KeyDataType_KeyM_SigVerifyKey_TrustModelEcuPeer, direction=IN, server-argument-impl-policy=USE-ARRAY-BASE-TYPE
          arg keyLength: type=uint32, direction=IN, server-argument-impl-policy=USE-ARGUMENT-TYPE
        KeySetValid: possible-error=[CsmKeyManagement_KeyM_SigVerifyKey_TrustModelEcuPeer/CSM_E_BUSY, CsmKeyManagement_KeyM_SigVerifyKey_TrustModelEcuPeer/E_NOT_OK]  # Sets the given key element bytes to the key.
      8 x error:
        CSM_E_BUSY: error-code=2  # The service request failed because the service is still busy.
        CSM_E_KEY_EMPTY: error-code=13  # The service request failed because of uninitialized source key element.
        CSM_E_KEY_NOT_AVAILABLE: error-code=8  # The service request failed because the key is not available.
        CSM_E_KEY_READ_FAIL: error-code=6  # The service request failed because read access was denied.
        CSM_E_KEY_SIZE_MISMATCH: error-code=10  # The service request failed because the key element is not partially accessible and the provided key element length is too short or too long for that key element.
        CSM_E_KEY_WRITE_FAIL: error-code=7  # The service request failed because write access was denied.
        CSM_E_SMALL_BUFFER: error-code=3  # The service request failed because the provided buffer is too small to store the result.
        E_NOT_OK: error-code=1  # The service request failed.
    CsmKeyManagement_Ssa_EcuCert  # Interface to execute the key management functions.
      operation KeyElementGet: possible-error=[CsmKeyManagement_Ssa_EcuCert/CSM_E_BUSY, CsmKeyManagement_Ssa_EcuCert/CSM_E_KEY_NOT_AVAILABLE, CsmKeyManagement_Ssa_EcuCert/CSM_E_KEY_READ_FAIL, CsmKeyManagement_Ssa_EcuCert/CSM_E_SMALL_BUFFER, CsmKeyManagement_Ssa_EcuCert/E_NOT_OK, CsmKeyManagement_Ssa_EcuCert/CSM_E_KEY_EMPTY]  # Retrieves the key element bytes from a specific key element of the key and stores the key element in the provided buffer.
        arg keyElementId: type=uint32, direction=IN, server-argument-impl-policy=USE-ARGUMENT-TYPE
        arg keyPtr: type=Csm_KeyDataType_Ssa_EcuCert, direction=OUT, server-argument-impl-policy=USE-ARRAY-BASE-TYPE
        arg keyLength: type=uint32, direction=INOUT, server-argument-impl-policy=USE-ARGUMENT-TYPE
      operation KeyElementSet: possible-error=[CsmKeyManagement_Ssa_EcuCert/CSM_E_BUSY, CsmKeyManagement_Ssa_EcuCert/CSM_E_KEY_NOT_AVAILABLE, CsmKeyManagement_Ssa_EcuCert/CSM_E_KEY_SIZE_MISMATCH, CsmKeyManagement_Ssa_EcuCert/CSM_E_KEY_WRITE_FAIL, CsmKeyManagement_Ssa_EcuCert/CSM_E_SMALL_BUFFER, CsmKeyManagement_Ssa_EcuCert/E_NOT_OK]  # Sets the given key element bytes to the key.
        arg keyElementId: type=uint32, direction=IN, server-argument-impl-policy=USE-ARGUMENT-TYPE
        arg keyPtr: type=Csm_KeyDataType_Ssa_EcuCert, direction=IN, server-argument-impl-policy=USE-ARRAY-BASE-TYPE
        arg keyLength: type=uint32, direction=IN, server-argument-impl-policy=USE-ARGUMENT-TYPE
      operation KeySetValid: possible-error=[CsmKeyManagement_Ssa_EcuCert/CSM_E_BUSY, CsmKeyManagement_Ssa_EcuCert/E_NOT_OK]  # Sets the given key element bytes to the key.
      8 x error:
        CSM_E_BUSY: error-code=2  # The service request failed because the service is still busy.
        CSM_E_KEY_NOT_AVAILABLE: error-code=8  # The service request failed because the key is not available.
        CSM_E_KEY_READ_FAIL: error-code=6  # The service request failed because read access was denied.
        CSM_E_KEY_SIZE_MISMATCH: error-code=10  # The service request failed because the key element is not partially accessible and the provided key element length is too short or too long for that key element.
        CSM_E_KEY_WRITE_FAIL: error-code=7  # The service request failed because write access was denied.
        CSM_E_SMALL_BUFFER: error-code=3  # The service request failed because the provided buffer is too small to store the result.
        E_NOT_OK: error-code=1  # The service request failed.
        CSM_E_KEY_EMPTY: error-code=13
    CsmKeyManagement_Ssa_PrivateEcuKey  # Interface to execute the key management functions.
      operation KeyElementGet: possible-error=[CsmKeyManagement_Ssa_PrivateEcuKey/CSM_E_BUSY, CsmKeyManagement_Ssa_PrivateEcuKey/CSM_E_KEY_NOT_AVAILABLE, CsmKeyManagement_Ssa_PrivateEcuKey/CSM_E_KEY_READ_FAIL, CsmKeyManagement_Ssa_PrivateEcuKey/CSM_E_SMALL_BUFFER, CsmKeyManagement_Ssa_PrivateEcuKey/E_NOT_OK, CsmKeyManagement_Ssa_PrivateEcuKey/CSM_E_KEY_EMPTY]  # Retrieves the key element bytes from a specific key element of the key and stores the key element in the provided buffer.
        arg keyElementId: type=uint32, direction=IN, server-argument-impl-policy=USE-ARGUMENT-TYPE
        arg keyPtr: type=Csm_KeyDataType_Ssa_PrivateEcuKey, direction=OUT, server-argument-impl-policy=USE-ARRAY-BASE-TYPE
        arg keyLength: type=uint32, direction=INOUT, server-argument-impl-policy=USE-ARGUMENT-TYPE
      operation KeyElementSet: possible-error=[CsmKeyManagement_Ssa_PrivateEcuKey/CSM_E_BUSY, CsmKeyManagement_Ssa_PrivateEcuKey/CSM_E_KEY_NOT_AVAILABLE, CsmKeyManagement_Ssa_PrivateEcuKey/CSM_E_KEY_SIZE_MISMATCH, CsmKeyManagement_Ssa_PrivateEcuKey/CSM_E_KEY_WRITE_FAIL, CsmKeyManagement_Ssa_PrivateEcuKey/CSM_E_SMALL_BUFFER, CsmKeyManagement_Ssa_PrivateEcuKey/E_NOT_OK]  # Sets the given key element bytes to the key.
        arg keyElementId: type=uint32, direction=IN, server-argument-impl-policy=USE-ARGUMENT-TYPE
        arg keyPtr: type=Csm_KeyDataType_Ssa_PrivateEcuKey, direction=IN, server-argument-impl-policy=USE-ARRAY-BASE-TYPE
        arg keyLength: type=uint32, direction=IN, server-argument-impl-policy=USE-ARGUMENT-TYPE
      operation KeySetValid: possible-error=[CsmKeyManagement_Ssa_PrivateEcuKey/CSM_E_BUSY, CsmKeyManagement_Ssa_PrivateEcuKey/E_NOT_OK]  # Sets the given key element bytes to the key.
      8 x error:
        CSM_E_BUSY: error-code=2  # The service request failed because the service is still busy.
        CSM_E_KEY_NOT_AVAILABLE: error-code=8  # The service request failed because the key is not available.
        CSM_E_KEY_READ_FAIL: error-code=6  # The service request failed because read access was denied.
        CSM_E_KEY_SIZE_MISMATCH: error-code=10  # The service request failed because the key element is not partially accessible and the provided key element length is too short or too long for that key element.
        CSM_E_KEY_WRITE_FAIL: error-code=7  # The service request failed because write access was denied.
        CSM_E_SMALL_BUFFER: error-code=3  # The service request failed because the provided buffer is too small to store the result.
        E_NOT_OK: error-code=1  # The service request failed.
        CSM_E_KEY_EMPTY: error-code=13
    CsmKeyManagement_Ssa_SharedSecret  # Interface to execute the key management functions.
      operation KeyElementGet: possible-error=[CsmKeyManagement_Ssa_SharedSecret/CSM_E_BUSY, CsmKeyManagement_Ssa_SharedSecret/CSM_E_KEY_NOT_AVAILABLE, CsmKeyManagement_Ssa_SharedSecret/CSM_E_KEY_READ_FAIL, CsmKeyManagement_Ssa_SharedSecret/CSM_E_SMALL_BUFFER, CsmKeyManagement_Ssa_SharedSecret/E_NOT_OK, CsmKeyManagement_Ssa_SharedSecret/CSM_E_KEY_EMPTY]  # Retrieves the key element bytes from a specific key element of the key and stores the key element in the provided buffer.
        arg keyElementId: type=uint32, direction=IN, server-argument-impl-policy=USE-ARGUMENT-TYPE
        arg keyPtr: type=Csm_KeyDataType_Ssa_SharedSecret, direction=OUT, server-argument-impl-policy=USE-ARRAY-BASE-TYPE
        arg keyLength: type=uint32, direction=INOUT, server-argument-impl-policy=USE-ARGUMENT-TYPE
      operation KeyElementSet: possible-error=[CsmKeyManagement_Ssa_SharedSecret/CSM_E_BUSY, CsmKeyManagement_Ssa_SharedSecret/CSM_E_KEY_NOT_AVAILABLE, CsmKeyManagement_Ssa_SharedSecret/CSM_E_KEY_SIZE_MISMATCH, CsmKeyManagement_Ssa_SharedSecret/CSM_E_KEY_WRITE_FAIL, CsmKeyManagement_Ssa_SharedSecret/CSM_E_SMALL_BUFFER, CsmKeyManagement_Ssa_SharedSecret/E_NOT_OK]  # Sets the given key element bytes to the key.
        arg keyElementId: type=uint32, direction=IN, server-argument-impl-policy=USE-ARGUMENT-TYPE
        arg keyPtr: type=Csm_KeyDataType_Ssa_SharedSecret, direction=IN, server-argument-impl-policy=USE-ARRAY-BASE-TYPE
        arg keyLength: type=uint32, direction=IN, server-argument-impl-policy=USE-ARGUMENT-TYPE
      operation KeySetValid: possible-error=[CsmKeyManagement_Ssa_SharedSecret/CSM_E_BUSY, CsmKeyManagement_Ssa_SharedSecret/E_NOT_OK]  # Sets the given key element bytes to the key.
      8 x error:
        CSM_E_BUSY: error-code=2  # The service request failed because the service is still busy.
        CSM_E_KEY_NOT_AVAILABLE: error-code=8  # The service request failed because the key is not available.
        CSM_E_KEY_READ_FAIL: error-code=6  # The service request failed because read access was denied.
        CSM_E_KEY_SIZE_MISMATCH: error-code=10  # The service request failed because the key element is not partially accessible and the provided key element length is too short or too long for that key element.
        CSM_E_KEY_WRITE_FAIL: error-code=7  # The service request failed because write access was denied.
        CSM_E_SMALL_BUFFER: error-code=3  # The service request failed because the provided buffer is too small to store the result.
        E_NOT_OK: error-code=1  # The service request failed.
        CSM_E_KEY_EMPTY: error-code=13
    CsmKeyManagement_Ssa_TrustModelPrivateEcuKey  # Interface to execute the key management functions.
      8 x operation:
        KeyCopy: possible-error=[CsmKeyManagement_Ssa_TrustModelPrivateEcuKey/CSM_E_BUSY, CsmKeyManagement_Ssa_TrustModelPrivateEcuKey/CSM_E_KEY_READ_FAIL, CsmKeyManagement_Ssa_TrustModelPrivateEcuKey/CSM_E_KEY_SIZE_MISMATCH, CsmKeyManagement_Ssa_TrustModelPrivateEcuKey/CSM_E_KEY_WRITE_FAIL, CsmKeyManagement_Ssa_TrustModelPrivateEcuKey/CSM_E_SMALL_BUFFER, CsmKeyManagement_Ssa_TrustModelPrivateEcuKey/E_NOT_OK, CsmKeyManagement_Ssa_TrustModelPrivateEcuKey/CSM_E_KEY_EMPTY]  # This function shall copy all key elements from the source key to a target key.
          arg targetKeyId: type=uint32, direction=IN, server-argument-impl-policy=USE-ARGUMENT-TYPE
        KeyDerive: possible-error=[CsmKeyManagement_Ssa_TrustModelPrivateEcuKey/E_NOT_OK, CsmKeyManagement_Ssa_TrustModelPrivateEcuKey/CSM_E_BUSY, CsmKeyManagement_Ssa_TrustModelPrivateEcuKey/CSM_E_KEY_EMPTY, CsmKeyManagement_Ssa_TrustModelPrivateEcuKey/CSM_E_KEY_READ_FAIL, CsmKeyManagement_Ssa_TrustModelPrivateEcuKey/CSM_E_KEY_SIZE_MISMATCH, CsmKeyManagement_Ssa_TrustModelPrivateEcuKey/CSM_E_KEY_WRITE_FAIL]  # Derives a new key by using the key elements in the given key. The given key contains the key elements for the password and salt. The derived key is stored in the key element with the id 1 of the key identified by targetCryptoKeyId.
          arg targetKeyId: type=uint32, direction=IN, server-argument-impl-policy=USE-ARGUMENT-TYPE
        KeyElementCopy: possible-error=[CsmKeyManagement_Ssa_TrustModelPrivateEcuKey/CSM_E_BUSY, CsmKeyManagement_Ssa_TrustModelPrivateEcuKey/CSM_E_KEY_READ_FAIL, CsmKeyManagement_Ssa_TrustModelPrivateEcuKey/CSM_E_KEY_SIZE_MISMATCH, CsmKeyManagement_Ssa_TrustModelPrivateEcuKey/CSM_E_KEY_WRITE_FAIL, CsmKeyManagement_Ssa_TrustModelPrivateEcuKey/CSM_E_SMALL_BUFFER, CsmKeyManagement_Ssa_TrustModelPrivateEcuKey/E_NOT_OK, CsmKeyManagement_Ssa_TrustModelPrivateEcuKey/CSM_E_KEY_EMPTY]  # This function shall copy a key elements from one key to a target key.
          arg keyElementId: type=uint32, direction=IN, server-argument-impl-policy=USE-ARGUMENT-TYPE
          arg targetKeyId: type=uint32, direction=IN, server-argument-impl-policy=USE-ARGUMENT-TYPE
          arg targetKeyElementId: type=uint32, direction=IN, server-argument-impl-policy=USE-ARGUMENT-TYPE
        KeyElementCopyPartial: possible-error=[CsmKeyManagement_Ssa_TrustModelPrivateEcuKey/CSM_E_BUSY, CsmKeyManagement_Ssa_TrustModelPrivateEcuKey/CSM_E_KEY_EMPTY, CsmKeyManagement_Ssa_TrustModelPrivateEcuKey/CSM_E_KEY_NOT_AVAILABLE, CsmKeyManagement_Ssa_TrustModelPrivateEcuKey/CSM_E_KEY_READ_FAIL, CsmKeyManagement_Ssa_TrustModelPrivateEcuKey/CSM_E_KEY_SIZE_MISMATCH, CsmKeyManagement_Ssa_TrustModelPrivateEcuKey/CSM_E_KEY_WRITE_FAIL, CsmKeyManagement_Ssa_TrustModelPrivateEcuKey/E_NOT_OK]  # This function shall copy parts of a key element from one key to parts of a target key element of a target key.
          6 x arg, all with type=uint32, direction=IN, server-argument-impl-policy=USE-ARGUMENT-TYPE:
            keyElementId
            keyElementSourceOffset
            keyElementTargetOffset
            keyElementCopyLength
            targetKeyId
            targetKeyElementId
        KeyElementGet: possible-error=[CsmKeyManagement_Ssa_TrustModelPrivateEcuKey/CSM_E_BUSY, CsmKeyManagement_Ssa_TrustModelPrivateEcuKey/CSM_E_KEY_NOT_AVAILABLE, CsmKeyManagement_Ssa_TrustModelPrivateEcuKey/CSM_E_KEY_READ_FAIL, CsmKeyManagement_Ssa_TrustModelPrivateEcuKey/CSM_E_SMALL_BUFFER, CsmKeyManagement_Ssa_TrustModelPrivateEcuKey/E_NOT_OK, CsmKeyManagement_Ssa_TrustModelPrivateEcuKey/CSM_E_KEY_EMPTY]  # Retrieves the key element bytes from a specific key element of the key and stores the key element in the provided buffer.
          arg keyElementId: type=uint32, direction=IN, server-argument-impl-policy=USE-ARGUMENT-TYPE
          arg keyPtr: type=Csm_KeyDataType_Ssa_TrustModelPrivateEcuKey, direction=OUT, server-argument-impl-policy=USE-ARRAY-BASE-TYPE
          arg keyLength: type=uint32, direction=INOUT, server-argument-impl-policy=USE-ARGUMENT-TYPE
        KeyElementSet: possible-error=[CsmKeyManagement_Ssa_TrustModelPrivateEcuKey/CSM_E_BUSY, CsmKeyManagement_Ssa_TrustModelPrivateEcuKey/CSM_E_KEY_NOT_AVAILABLE, CsmKeyManagement_Ssa_TrustModelPrivateEcuKey/CSM_E_KEY_SIZE_MISMATCH, CsmKeyManagement_Ssa_TrustModelPrivateEcuKey/CSM_E_KEY_WRITE_FAIL, CsmKeyManagement_Ssa_TrustModelPrivateEcuKey/E_NOT_OK]  # Sets the given key element bytes to the key.
          arg keyElementId: type=uint32, direction=IN, server-argument-impl-policy=USE-ARGUMENT-TYPE
          arg keyPtr: type=Csm_KeyDataType_Ssa_TrustModelPrivateEcuKey, direction=IN, server-argument-impl-policy=USE-ARRAY-BASE-TYPE
          arg keyLength: type=uint32, direction=IN, server-argument-impl-policy=USE-ARGUMENT-TYPE
        KeyGenerate: possible-error=[CsmKeyManagement_Ssa_TrustModelPrivateEcuKey/CSM_E_BUSY, CsmKeyManagement_Ssa_TrustModelPrivateEcuKey/E_NOT_OK, CsmKeyManagement_Ssa_TrustModelPrivateEcuKey/CSM_E_KEY_EMPTY]  # Generates new key material and store it in the key identified by keyId.
        KeySetValid: possible-error=[CsmKeyManagement_Ssa_TrustModelPrivateEcuKey/CSM_E_BUSY, CsmKeyManagement_Ssa_TrustModelPrivateEcuKey/E_NOT_OK]  # Sets the given key element bytes to the key.
      8 x error:
        CSM_E_BUSY: error-code=2  # The service request failed because the service is still busy.
        CSM_E_KEY_EMPTY: error-code=13  # The service request failed because of uninitialized source key element.
        CSM_E_KEY_NOT_AVAILABLE: error-code=8  # The service request failed because the key is not available.
        CSM_E_KEY_READ_FAIL: error-code=6  # The service request failed because read access was denied.
        CSM_E_KEY_SIZE_MISMATCH: error-code=10  # The service request failed because the key element is not partially accessible and the provided key element length is too short or too long for that key element.
        CSM_E_KEY_WRITE_FAIL: error-code=7  # The service request failed because write access was denied.
        CSM_E_SMALL_BUFFER: error-code=3  # The service request failed because the provided buffer is too small to store the result.
        E_NOT_OK: error-code=1  # The service request failed.
    CsmKeyManagement_Ssa_TrustModelPrivateEcuUniqueKey  # Interface to execute the key management functions.
      8 x operation:
        KeyCopy: possible-error=[CsmKeyManagement_Ssa_TrustModelPrivateEcuUniqueKey/CSM_E_BUSY, CsmKeyManagement_Ssa_TrustModelPrivateEcuUniqueKey/CSM_E_KEY_READ_FAIL, CsmKeyManagement_Ssa_TrustModelPrivateEcuUniqueKey/CSM_E_KEY_SIZE_MISMATCH, CsmKeyManagement_Ssa_TrustModelPrivateEcuUniqueKey/CSM_E_KEY_WRITE_FAIL, CsmKeyManagement_Ssa_TrustModelPrivateEcuUniqueKey/CSM_E_SMALL_BUFFER, CsmKeyManagement_Ssa_TrustModelPrivateEcuUniqueKey/E_NOT_OK, CsmKeyManagement_Ssa_TrustModelPrivateEcuUniqueKey/CSM_E_KEY_EMPTY]  # This function shall copy all key elements from the source key to a target key.
          arg targetKeyId: type=uint32, direction=IN, server-argument-impl-policy=USE-ARGUMENT-TYPE
        KeyDerive: possible-error=[CsmKeyManagement_Ssa_TrustModelPrivateEcuUniqueKey/E_NOT_OK, CsmKeyManagement_Ssa_TrustModelPrivateEcuUniqueKey/CSM_E_BUSY, CsmKeyManagement_Ssa_TrustModelPrivateEcuUniqueKey/CSM_E_KEY_EMPTY, CsmKeyManagement_Ssa_TrustModelPrivateEcuUniqueKey/CSM_E_KEY_READ_FAIL, CsmKeyManagement_Ssa_TrustModelPrivateEcuUniqueKey/CSM_E_KEY_SIZE_MISMATCH, CsmKeyManagement_Ssa_TrustModelPrivateEcuUniqueKey/CSM_E_KEY_WRITE_FAIL]  # Derives a new key by using the key elements in the given key. The given key contains the key elements for the password and salt. The derived key is stored in the key element with the id 1 of the key identified by targetCryptoKeyId.
          arg targetKeyId: type=uint32, direction=IN, server-argument-impl-policy=USE-ARGUMENT-TYPE
        KeyElementCopy: possible-error=[CsmKeyManagement_Ssa_TrustModelPrivateEcuUniqueKey/CSM_E_BUSY, CsmKeyManagement_Ssa_TrustModelPrivateEcuUniqueKey/CSM_E_KEY_READ_FAIL, CsmKeyManagement_Ssa_TrustModelPrivateEcuUniqueKey/CSM_E_KEY_SIZE_MISMATCH, CsmKeyManagement_Ssa_TrustModelPrivateEcuUniqueKey/CSM_E_KEY_WRITE_FAIL, CsmKeyManagement_Ssa_TrustModelPrivateEcuUniqueKey/CSM_E_SMALL_BUFFER, CsmKeyManagement_Ssa_TrustModelPrivateEcuUniqueKey/E_NOT_OK, CsmKeyManagement_Ssa_TrustModelPrivateEcuUniqueKey/CSM_E_KEY_EMPTY]  # This function shall copy a key elements from one key to a target key.
          arg keyElementId: type=uint32, direction=IN, server-argument-impl-policy=USE-ARGUMENT-TYPE
          arg targetKeyId: type=uint32, direction=IN, server-argument-impl-policy=USE-ARGUMENT-TYPE
          arg targetKeyElementId: type=uint32, direction=IN, server-argument-impl-policy=USE-ARGUMENT-TYPE
        KeyElementCopyPartial: possible-error=[CsmKeyManagement_Ssa_TrustModelPrivateEcuUniqueKey/CSM_E_BUSY, CsmKeyManagement_Ssa_TrustModelPrivateEcuUniqueKey/CSM_E_KEY_EMPTY, CsmKeyManagement_Ssa_TrustModelPrivateEcuUniqueKey/CSM_E_KEY_NOT_AVAILABLE, CsmKeyManagement_Ssa_TrustModelPrivateEcuUniqueKey/CSM_E_KEY_READ_FAIL, CsmKeyManagement_Ssa_TrustModelPrivateEcuUniqueKey/CSM_E_KEY_SIZE_MISMATCH, CsmKeyManagement_Ssa_TrustModelPrivateEcuUniqueKey/CSM_E_KEY_WRITE_FAIL, CsmKeyManagement_Ssa_TrustModelPrivateEcuUniqueKey/E_NOT_OK]  # This function shall copy parts of a key element from one key to parts of a target key element of a target key.
          6 x arg, all with type=uint32, direction=IN, server-argument-impl-policy=USE-ARGUMENT-TYPE:
            keyElementId
            keyElementSourceOffset
            keyElementTargetOffset
            keyElementCopyLength
            targetKeyId
            targetKeyElementId
        KeyElementGet: possible-error=[CsmKeyManagement_Ssa_TrustModelPrivateEcuUniqueKey/CSM_E_BUSY, CsmKeyManagement_Ssa_TrustModelPrivateEcuUniqueKey/CSM_E_KEY_NOT_AVAILABLE, CsmKeyManagement_Ssa_TrustModelPrivateEcuUniqueKey/CSM_E_KEY_READ_FAIL, CsmKeyManagement_Ssa_TrustModelPrivateEcuUniqueKey/CSM_E_SMALL_BUFFER, CsmKeyManagement_Ssa_TrustModelPrivateEcuUniqueKey/E_NOT_OK, CsmKeyManagement_Ssa_TrustModelPrivateEcuUniqueKey/CSM_E_KEY_EMPTY]  # Retrieves the key element bytes from a specific key element of the key and stores the key element in the provided buffer.
          arg keyElementId: type=uint32, direction=IN, server-argument-impl-policy=USE-ARGUMENT-TYPE
          arg keyPtr: type=Csm_KeyDataType_Ssa_TrustModelPrivateEcuUniqueKey, direction=OUT, server-argument-impl-policy=USE-ARRAY-BASE-TYPE
          arg keyLength: type=uint32, direction=INOUT, server-argument-impl-policy=USE-ARGUMENT-TYPE
        KeyElementSet: possible-error=[CsmKeyManagement_Ssa_TrustModelPrivateEcuUniqueKey/CSM_E_BUSY, CsmKeyManagement_Ssa_TrustModelPrivateEcuUniqueKey/CSM_E_KEY_NOT_AVAILABLE, CsmKeyManagement_Ssa_TrustModelPrivateEcuUniqueKey/CSM_E_KEY_SIZE_MISMATCH, CsmKeyManagement_Ssa_TrustModelPrivateEcuUniqueKey/CSM_E_KEY_WRITE_FAIL, CsmKeyManagement_Ssa_TrustModelPrivateEcuUniqueKey/E_NOT_OK]  # Sets the given key element bytes to the key.
          arg keyElementId: type=uint32, direction=IN, server-argument-impl-policy=USE-ARGUMENT-TYPE
          arg keyPtr: type=Csm_KeyDataType_Ssa_TrustModelPrivateEcuUniqueKey, direction=IN, server-argument-impl-policy=USE-ARRAY-BASE-TYPE
          arg keyLength: type=uint32, direction=IN, server-argument-impl-policy=USE-ARGUMENT-TYPE
        KeyGenerate: possible-error=[CsmKeyManagement_Ssa_TrustModelPrivateEcuUniqueKey/CSM_E_BUSY, CsmKeyManagement_Ssa_TrustModelPrivateEcuUniqueKey/E_NOT_OK, CsmKeyManagement_Ssa_TrustModelPrivateEcuUniqueKey/CSM_E_KEY_EMPTY]  # Generates new key material and store it in the key identified by keyId.
        KeySetValid: possible-error=[CsmKeyManagement_Ssa_TrustModelPrivateEcuUniqueKey/CSM_E_BUSY, CsmKeyManagement_Ssa_TrustModelPrivateEcuUniqueKey/E_NOT_OK]  # Sets the given key element bytes to the key.
      8 x error:
        CSM_E_BUSY: error-code=2  # The service request failed because the service is still busy.
        CSM_E_KEY_EMPTY: error-code=13  # The service request failed because of uninitialized source key element.
        CSM_E_KEY_NOT_AVAILABLE: error-code=8  # The service request failed because the key is not available.
        CSM_E_KEY_READ_FAIL: error-code=6  # The service request failed because read access was denied.
        CSM_E_KEY_SIZE_MISMATCH: error-code=10  # The service request failed because the key element is not partially accessible and the provided key element length is too short or too long for that key element.
        CSM_E_KEY_WRITE_FAIL: error-code=7  # The service request failed because write access was denied.
        CSM_E_SMALL_BUFFER: error-code=3  # The service request failed because the provided buffer is too small to store the result.
        E_NOT_OK: error-code=1  # The service request failed.
    CsmSignatureGenerate_SigGenEd25519  # A digital signature is a type of asymmetric cryptography. Digital signatures are equivalent to traditional handwritten signatures in many respects. Digital signatures can be used to authenticate the source of messages as well as to prove integrity of signed messages. If a message is digitally signed, any change in the message after signature will invalidate the signature. Furthermore, there is no efficient way to modify a message and its signature to produce a new message with a valid signature.
      operation CancelJob: possible-error=[CsmSignatureGenerate_SigGenEd25519/E_NOT_OK, CsmSignatureGenerate_SigGenEd25519/CSM_E_JOB_CANCELED]  # Cancels the Job.
      operation SignatureGenerate: possible-error=[CsmSignatureGenerate_SigGenEd25519/CSM_E_BUSY, CsmSignatureGenerate_SigGenEd25519/CSM_E_SMALL_BUFFER, CsmSignatureGenerate_SigGenEd25519/E_NOT_OK, CsmSignatureGenerate_SigGenEd25519/CSM_E_KEY_EMPTY, CsmSignatureGenerate_SigGenEd25519/CSM_E_KEY_NOT_VALID, CsmSignatureGenerate_SigGenEd25519/CSM_E_KEY_SIZE_MISMATCH]  # This interface shall be used to start the signature generate service of the CSM module.
        4 x arg:
          dataBuffer: type=Csm_SignatureGenerateDataType_SigGenEd25519, direction=IN, server-argument-impl-policy=USE-ARRAY-BASE-TYPE
          dataLength: type=uint32, direction=IN, server-argument-impl-policy=USE-ARGUMENT-TYPE
          resultBuffer: type=Csm_SignatureGenerateResultType_SigGenEd25519, direction=OUT, server-argument-impl-policy=USE-ARRAY-BASE-TYPE
          resultLength: type=uint32, direction=INOUT, server-argument-impl-policy=USE-ARGUMENT-TYPE
      7 x error:
        CSM_E_BUSY: error-code=2  # The service request failed because the service is still busy.
        CSM_E_SMALL_BUFFER: error-code=3  # The service request failed because the provided buffer is too small to store the result.
        E_NOT_OK: error-code=1  # The service request failed.
        CSM_E_JOB_CANCELED: error-code=12
        CSM_E_KEY_EMPTY: error-code=13
        CSM_E_KEY_NOT_VALID: error-code=9
        CSM_E_KEY_SIZE_MISMATCH: error-code=10
    CsmSignatureGenerate_SigGenEd25519ph  # A digital signature is a type of asymmetric cryptography. Digital signatures are equivalent to traditional handwritten signatures in many respects. Digital signatures can be used to authenticate the source of messages as well as to prove integrity of signed messages. If a message is digitally signed, any change in the message after signature will invalidate the signature. Furthermore, there is no efficient way to modify a message and its signature to produce a new message with a valid signature.
      operation CancelJob: possible-error=[CsmSignatureGenerate_SigGenEd25519ph/E_NOT_OK, CsmSignatureGenerate_SigGenEd25519ph/CSM_E_JOB_CANCELED]  # Cancels the Job
      operation SignatureGenerate: possible-error=[CsmSignatureGenerate_SigGenEd25519ph/CSM_E_BUSY, CsmSignatureGenerate_SigGenEd25519ph/CSM_E_SMALL_BUFFER, CsmSignatureGenerate_SigGenEd25519ph/E_NOT_OK, CsmSignatureGenerate_SigGenEd25519ph/CSM_E_KEY_EMPTY, CsmSignatureGenerate_SigGenEd25519ph/CSM_E_KEY_NOT_VALID, CsmSignatureGenerate_SigGenEd25519ph/CSM_E_KEY_SIZE_MISMATCH]  # This interface shall be used to start the signature generate service of the CSM module.
        4 x arg:
          dataBuffer: type=Csm_SignatureGenerateDataType_SigGenEd25519ph, direction=IN, server-argument-impl-policy=USE-ARRAY-BASE-TYPE
          dataLength: type=uint32, direction=IN, server-argument-impl-policy=USE-ARGUMENT-TYPE
          resultBuffer: type=Csm_SignatureGenerateResultType_SigGenEd25519ph, direction=OUT, server-argument-impl-policy=USE-ARRAY-BASE-TYPE
          resultLength: type=uint32, direction=INOUT, server-argument-impl-policy=USE-ARGUMENT-TYPE
      7 x error:
        CSM_E_BUSY: error-code=2  # The service request failed because the service is still busy.
        CSM_E_SMALL_BUFFER: error-code=3  # The service request failed because the provided buffer is too small to store the result.
        E_NOT_OK: error-code=1  # The service request failed.
        CSM_E_JOB_CANCELED: error-code=12
        CSM_E_KEY_EMPTY: error-code=13
        CSM_E_KEY_NOT_VALID: error-code=9
        CSM_E_KEY_SIZE_MISMATCH: error-code=10
    CsmSignatureVerify_SigVerifyEd25519  # A digital signature is a type of asymmetric cryptography. Digital signatures are equivalent to traditional handwritten signatures in many respects. Digital signatures can be used to authenticate the source of messages as well as to prove integrity of signed messages. If a message is digitally signed, any change in the message after signature will invalidate the signature. Furthermore, there is no efficient way to modify a message and its signature to produce a new message with a valid signature.
      operation CancelJob: possible-error=[CsmSignatureVerify_SigVerifyEd25519/E_NOT_OK, CsmSignatureVerify_SigVerifyEd25519/CSM_E_JOB_CANCELED]  # Cancels the Job.
      operation SignatureVerify: possible-error=[CsmSignatureVerify_SigVerifyEd25519/CSM_E_BUSY, CsmSignatureVerify_SigVerifyEd25519/CSM_E_SMALL_BUFFER, CsmSignatureVerify_SigVerifyEd25519/E_NOT_OK, CsmSignatureVerify_SigVerifyEd25519/CSM_E_KEY_EMPTY, CsmSignatureVerify_SigVerifyEd25519/CSM_E_KEY_NOT_VALID, CsmSignatureVerify_SigVerifyEd25519/CSM_E_KEY_SIZE_MISMATCH]  # This interface shall be used to start the signature verification service of the CSM module.
        5 x arg:
          dataBuffer: type=Csm_SignatureVerifyDataType_SigVerifyEd25519, direction=IN, server-argument-impl-policy=USE-ARRAY-BASE-TYPE
          dataLength: type=uint32, direction=IN, server-argument-impl-policy=USE-ARGUMENT-TYPE
          compareBuffer: type=Csm_SignatureVerifyCompareType_SigVerifyEd25519, direction=IN, server-argument-impl-policy=USE-ARRAY-BASE-TYPE
          compareLength: type=uint32, direction=IN, server-argument-impl-policy=USE-ARGUMENT-TYPE
          verifyResult: type=Crypto_VerifyResultType, direction=OUT, server-argument-impl-policy=USE-ARGUMENT-TYPE
      7 x error:
        CSM_E_BUSY: error-code=2  # The service request failed because the service is still busy.
        CSM_E_SMALL_BUFFER: error-code=3  # The service request failed because the provided buffer is too small to store the result.
        E_NOT_OK: error-code=1  # The service request failed.
        CSM_E_JOB_CANCELED: error-code=12
        CSM_E_KEY_EMPTY: error-code=13
        CSM_E_KEY_NOT_VALID: error-code=9
        CSM_E_KEY_SIZE_MISMATCH: error-code=10
    CsmSignatureVerify_SigVerifyEd25519ph  # A digital signature is a type of asymmetric cryptography. Digital signatures are equivalent to traditional handwritten signatures in many respects. Digital signatures can be used to authenticate the source of messages as well as to prove integrity of signed messages. If a message is digitally signed, any change in the message after signature will invalidate the signature. Furthermore, there is no efficient way to modify a message and its signature to produce a new message with a valid signature.
      operation CancelJob: possible-error=[CsmSignatureVerify_SigVerifyEd25519ph/E_NOT_OK, CsmSignatureVerify_SigVerifyEd25519ph/CSM_E_JOB_CANCELED]  # Cancels the Job
      operation SignatureVerify: possible-error=[CsmSignatureVerify_SigVerifyEd25519ph/CSM_E_BUSY, CsmSignatureVerify_SigVerifyEd25519ph/CSM_E_SMALL_BUFFER, CsmSignatureVerify_SigVerifyEd25519ph/E_NOT_OK, CsmSignatureVerify_SigVerifyEd25519ph/CSM_E_KEY_EMPTY, CsmSignatureVerify_SigVerifyEd25519ph/CSM_E_KEY_NOT_VALID, CsmSignatureVerify_SigVerifyEd25519ph/CSM_E_KEY_SIZE_MISMATCH]  # This interface shall be used to start the signature verification service of the CSM module.
        5 x arg:
          dataBuffer: type=Csm_SignatureVerifyDataType_SigVerifyEd25519ph, direction=IN, server-argument-impl-policy=USE-ARRAY-BASE-TYPE
          dataLength: type=uint32, direction=IN, server-argument-impl-policy=USE-ARGUMENT-TYPE
          signatureBuffer: type=Csm_SignatureVerifyCompareType_SigVerifyEd25519ph, direction=IN, server-argument-impl-policy=USE-ARRAY-BASE-TYPE
          signatureLength: type=uint32, direction=IN, server-argument-impl-policy=USE-ARGUMENT-TYPE
          verifyBuffer: type=Crypto_VerifyResultType, direction=OUT, server-argument-impl-policy=USE-ARGUMENT-TYPE
      7 x error:
        CSM_E_BUSY: error-code=2  # The service request failed because the service is still busy.
        CSM_E_SMALL_BUFFER: error-code=3  # The service request failed because the provided buffer is too small to store the result.
        E_NOT_OK: error-code=1  # The service request failed.
        CSM_E_JOB_CANCELED: error-code=12
        CSM_E_KEY_EMPTY: error-code=13
        CSM_E_KEY_NOT_VALID: error-code=9
        CSM_E_KEY_SIZE_MISMATCH: error-code=10
    CsmMacGenerate_MacGenAesCmacTruncRealTimeOffset  # A truncated message authentication code (MAC) is a short piece of information used to authenticate a message. A MAC algorithm accepts as input a secret key and an arbitrary-length message to be authenticated, and outputs a MAC. The MAC value protects both a message's data integrity as well as its authenticity, by allowing verifiers (who also possess the secret key) to detect any changes to the message content.
      operation CancelJob: possible-error=[CsmMacGenerate_MacGenAesCmacTruncRealTimeOffset/CSM_E_JOB_CANCELED, CsmMacGenerate_MacGenAesCmacTruncRealTimeOffset/E_NOT_OK]  # Cancels the Job
      operation MacGenerate: possible-error=[CsmMacGenerate_MacGenAesCmacTruncRealTimeOffset/CSM_E_BUSY, CsmMacGenerate_MacGenAesCmacTruncRealTimeOffset/CSM_E_KEY_EMPTY, CsmMacGenerate_MacGenAesCmacTruncRealTimeOffset/CSM_E_KEY_NOT_VALID, CsmMacGenerate_MacGenAesCmacTruncRealTimeOffset/CSM_E_KEY_SIZE_MISMATCH, CsmMacGenerate_MacGenAesCmacTruncRealTimeOffset/CSM_E_SMALL_BUFFER, CsmMacGenerate_MacGenAesCmacTruncRealTimeOffset/E_NOT_OK]  # This interface shall be used to start the MAC generation service of the CSM module.
        4 x arg:
          dataBuffer: type=Csm_DataType_MacAesCmacRealTimeOffset, direction=IN, server-argument-impl-policy=USE-ARRAY-BASE-TYPE
          dataLength: type=uint32, direction=IN, server-argument-impl-policy=USE-ARGUMENT-TYPE
          macBuffer: type=Csm_MacGenerateResultType_MacGenAesCmacTrunc, direction=OUT, server-argument-impl-policy=USE-ARRAY-BASE-TYPE
          macLength: type=uint32, direction=INOUT, server-argument-impl-policy=USE-ARGUMENT-TYPE
      7 x error:
        CSM_E_BUSY: error-code=2  # The service request failed because the service is still busy.
        CSM_E_JOB_CANCELED: error-code=12
        CSM_E_KEY_EMPTY: error-code=13
        CSM_E_KEY_NOT_VALID: error-code=9
        CSM_E_KEY_SIZE_MISMATCH: error-code=10
        CSM_E_SMALL_BUFFER: error-code=3  # The service request failed because the provided buffer is too small to store the result.
        E_NOT_OK: error-code=1  # The service request failed.
    CsmMacGenerate_MacGenAesCmacTruncTickCount  # A truncated message authentication code (MAC) is a short piece of information used to authenticate a message. A MAC algorithm accepts as input a secret key and an arbitrary-length message to be authenticated, and outputs a MAC. The MAC value protects both a message's data integrity as well as its authenticity, by allowing verifiers (who also possess the secret key) to detect any changes to the message content.
      operation CancelJob: possible-error=[CsmMacGenerate_MacGenAesCmacTruncTickCount/CSM_E_JOB_CANCELED, CsmMacGenerate_MacGenAesCmacTruncTickCount/E_NOT_OK]  # Cancels the Job
      operation MacGenerate: possible-error=[CsmMacGenerate_MacGenAesCmacTruncTickCount/CSM_E_BUSY, CsmMacGenerate_MacGenAesCmacTruncTickCount/CSM_E_KEY_EMPTY, CsmMacGenerate_MacGenAesCmacTruncTickCount/CSM_E_KEY_NOT_VALID, CsmMacGenerate_MacGenAesCmacTruncTickCount/CSM_E_KEY_SIZE_MISMATCH, CsmMacGenerate_MacGenAesCmacTruncTickCount/CSM_E_SMALL_BUFFER, CsmMacGenerate_MacGenAesCmacTruncTickCount/E_NOT_OK]  # This interface shall be used to start the MAC generation service of the CSM module.
        4 x arg:
          dataBuffer: type=Csm_DataType_MacAesCmacTickCount, direction=IN, server-argument-impl-policy=USE-ARRAY-BASE-TYPE
          dataLength: type=uint32, direction=IN, server-argument-impl-policy=USE-ARGUMENT-TYPE
          macBuffer: type=Csm_MacGenerateResultType_MacGenAesCmacTrunc, direction=OUT, server-argument-impl-policy=USE-ARRAY-BASE-TYPE
          macLength: type=uint32, direction=INOUT, server-argument-impl-policy=USE-ARGUMENT-TYPE
      7 x error:
        CSM_E_BUSY: error-code=2  # The service request failed because the service is still busy.
        CSM_E_JOB_CANCELED: error-code=12
        CSM_E_KEY_EMPTY: error-code=13
        CSM_E_KEY_NOT_VALID: error-code=9
        CSM_E_KEY_SIZE_MISMATCH: error-code=10
        CSM_E_SMALL_BUFFER: error-code=3  # The service request failed because the provided buffer is too small to store the result.
        E_NOT_OK: error-code=1  # The service request failed.
    CsmMacGenerate_MacGenAesCmacTruncVin  # A truncated message authentication code (MAC) is a short piece of information used to authenticate a message. A MAC algorithm accepts as input a secret key and an arbitrary-length message to be authenticated, and outputs a MAC. The MAC value protects both a message's data integrity as well as its authenticity, by allowing verifiers (who also possess the secret key) to detect any changes to the message content.
      operation CancelJob: possible-error=[CsmMacGenerate_MacGenAesCmacTruncVin/CSM_E_JOB_CANCELED, CsmMacGenerate_MacGenAesCmacTruncVin/E_NOT_OK]  # Cancels the Job
      operation MacGenerate: possible-error=[CsmMacGenerate_MacGenAesCmacTruncVin/CSM_E_BUSY, CsmMacGenerate_MacGenAesCmacTruncVin/CSM_E_KEY_EMPTY, CsmMacGenerate_MacGenAesCmacTruncVin/CSM_E_KEY_NOT_VALID, CsmMacGenerate_MacGenAesCmacTruncVin/CSM_E_KEY_SIZE_MISMATCH, CsmMacGenerate_MacGenAesCmacTruncVin/CSM_E_SMALL_BUFFER, CsmMacGenerate_MacGenAesCmacTruncVin/E_NOT_OK]  # This interface shall be used to start the MAC generation service of the CSM module.
        4 x arg:
          dataBuffer: type=Csm_DataType_MacAesCmacVin, direction=IN, server-argument-impl-policy=USE-ARRAY-BASE-TYPE
          dataLength: type=uint32, direction=IN, server-argument-impl-policy=USE-ARGUMENT-TYPE
          macBuffer: type=Csm_MacGenerateResultType_MacGenAesCmacTrunc, direction=OUT, server-argument-impl-policy=USE-ARRAY-BASE-TYPE
          macLength: type=uint32, direction=INOUT, server-argument-impl-policy=USE-ARGUMENT-TYPE
      7 x error:
        CSM_E_BUSY: error-code=2  # The service request failed because the service is still busy.
        CSM_E_JOB_CANCELED: error-code=12
        CSM_E_KEY_EMPTY: error-code=13
        CSM_E_KEY_NOT_VALID: error-code=9
        CSM_E_KEY_SIZE_MISMATCH: error-code=10
        CSM_E_SMALL_BUFFER: error-code=3  # The service request failed because the provided buffer is too small to store the result.
        E_NOT_OK: error-code=1  # The service request failed.
    CsmMacGenerate_MacGenAesCmacTruncAuth  # A truncated message authentication code (MAC) is a short piece of information used to authenticate a message. A MAC algorithm accepts as input a secret key and an arbitrary-length message to be authenticated, and outputs a MAC. The MAC value protects both a message's data integrity as well as its authenticity, by allowing verifiers (who also possess the secret key) to detect any changes to the message content.
      operation CancelJob: possible-error=[CsmMacGenerate_MacGenAesCmacTruncAuth/CSM_E_JOB_CANCELED, CsmMacGenerate_MacGenAesCmacTruncAuth/E_NOT_OK]  # Cancels the Job
      operation MacGenerate: possible-error=[CsmMacGenerate_MacGenAesCmacTruncAuth/CSM_E_BUSY, CsmMacGenerate_MacGenAesCmacTruncAuth/CSM_E_KEY_EMPTY, CsmMacGenerate_MacGenAesCmacTruncAuth/CSM_E_KEY_NOT_VALID, CsmMacGenerate_MacGenAesCmacTruncAuth/CSM_E_KEY_SIZE_MISMATCH, CsmMacGenerate_MacGenAesCmacTruncAuth/CSM_E_SMALL_BUFFER, CsmMacGenerate_MacGenAesCmacTruncAuth/E_NOT_OK]  # This interface shall be used to start the MAC generation service of the CSM module.
        4 x arg:
          dataBuffer: type=Csm_DataType_MacAesCmacAuth, direction=IN, server-argument-impl-policy=USE-ARRAY-BASE-TYPE
          dataLength: type=uint32, direction=IN, server-argument-impl-policy=USE-ARGUMENT-TYPE
          macBuffer: type=Csm_MacGenerateResultType_MacGenAesCmacTrunc, direction=OUT, server-argument-impl-policy=USE-ARRAY-BASE-TYPE
          macLength: type=uint32, direction=INOUT, server-argument-impl-policy=USE-ARGUMENT-TYPE
      7 x error:
        CSM_E_BUSY: error-code=2  # The service request failed because the service is still busy.
        CSM_E_JOB_CANCELED: error-code=12
        CSM_E_KEY_EMPTY: error-code=13
        CSM_E_KEY_NOT_VALID: error-code=9
        CSM_E_KEY_SIZE_MISMATCH: error-code=10
        CSM_E_SMALL_BUFFER: error-code=3  # The service request failed because the provided buffer is too small to store the result.
        E_NOT_OK: error-code=1  # The service request failed.
package /SecurityArchitecture/external/Dcm_swc
  mode declaration group DcmDiagnosticSessionControl: category=EXPLICIT_ORDER, initial-mode=DEFAULT_SESSION, on-transition-value=255
    4 x mode:
      DEFAULT_SESSION: value=1
      PROGRAMMING_SESSION: value=2
      EXTENDED_SESSION: value=3
      Development: value=126
package /SecurityArchitecture/external/Dcm_swc/Interfaces
  18 x client server interface, all with is-service=true, service-kind=DIAGNOSTIC-COMMUNICATION-MANAGER:
    DataServices_DID_0192_Status_of_Central_Authentication_for_UserRole_Production
      operation ConditionCheckRead: possible-error=[DataServices_DID_0192_Status_of_Central_Authentication_for_UserRole_Production/DCM_E_PENDING, DataServices_DID_0192_Status_of_Central_Authentication_for_UserRole_Production/E_NOT_OK]
        arg OpStatus: type=Dcm_OpStatusType, direction=IN, server-argument-impl-policy=USE-ARGUMENT-TYPE
        arg ErrorCode: type=Dcm_NegativeResponseCodeType, direction=OUT, server-argument-impl-policy=USE-ARGUMENT-TYPE
      operation ReadData: possible-error=[DataServices_DID_0192_Status_of_Central_Authentication_for_UserRole_Production/DCM_E_PENDING, DataServices_DID_0192_Status_of_Central_Authentication_for_UserRole_Production/E_NOT_OK]
        arg OpStatus: type=Dcm_OpStatusType, direction=IN, server-argument-impl-policy=USE-ARGUMENT-TYPE
        arg Data: type=Dcm_Data1ByteType, direction=OUT, server-argument-impl-policy=USE-ARGUMENT-TYPE
      operation WriteData: possible-error=[DataServices_DID_0192_Status_of_Central_Authentication_for_UserRole_Production/DCM_E_PENDING, DataServices_DID_0192_Status_of_Central_Authentication_for_UserRole_Production/E_NOT_OK]
        arg Data: type=Dcm_Data1ByteType, direction=IN, server-argument-impl-policy=USE-ARGUMENT-TYPE
        arg OpStatus: type=Dcm_OpStatusType, direction=IN, server-argument-impl-policy=USE-ARGUMENT-TYPE
        arg ErrorCode: type=Dcm_NegativeResponseCodeType, direction=OUT, server-argument-impl-policy=USE-ARGUMENT-TYPE
      error DCM_E_PENDING: error-code=10
      error E_NOT_OK: error-code=1
    DataServices_DID_0193_Common_Name
      operation ConditionCheckRead: possible-error=[DataServices_DID_0193_Common_Name/DCM_E_PENDING, DataServices_DID_0193_Common_Name/E_NOT_OK]
        arg OpStatus: type=Dcm_OpStatusType, direction=IN, server-argument-impl-policy=USE-ARGUMENT-TYPE
        arg ErrorCode: type=Dcm_NegativeResponseCodeType, direction=OUT, server-argument-impl-policy=USE-ARGUMENT-TYPE
      operation ReadData: possible-error=[DataServices_DID_0193_Common_Name/DCM_E_PENDING, DataServices_DID_0193_Common_Name/E_NOT_OK]
        arg OpStatus: type=Dcm_OpStatusType, direction=IN, server-argument-impl-policy=USE-ARGUMENT-TYPE
        arg Data: type=Dcm_Data30ByteType, direction=OUT, server-argument-impl-policy=USE-ARGUMENT-TYPE
      error DCM_E_PENDING: error-code=10
      error E_NOT_OK: error-code=1
    DataServices_DID_0193_SerialNumber
      operation ConditionCheckRead: possible-error=[DataServices_DID_0193_SerialNumber/DCM_E_PENDING, DataServices_DID_0193_SerialNumber/E_NOT_OK]
        arg OpStatus: type=Dcm_OpStatusType, direction=IN, server-argument-impl-policy=USE-ARGUMENT-TYPE
        arg ErrorCode: type=Dcm_NegativeResponseCodeType, direction=OUT, server-argument-impl-policy=USE-ARGUMENT-TYPE
      operation ReadData: possible-error=[DataServices_DID_0193_SerialNumber/DCM_E_PENDING, DataServices_DID_0193_SerialNumber/E_NOT_OK]
        arg OpStatus: type=Dcm_OpStatusType, direction=IN, server-argument-impl-policy=USE-ARGUMENT-TYPE
        arg Data: type=Dcm_Data16ByteType, direction=OUT, server-argument-impl-policy=USE-ARGUMENT-TYPE
      error DCM_E_PENDING: error-code=10
      error E_NOT_OK: error-code=1
    DataServices_DID_0193_SubjectKeyIdentifier
      operation ConditionCheckRead: possible-error=[DataServices_DID_0193_SubjectKeyIdentifier/DCM_E_PENDING, DataServices_DID_0193_SubjectKeyIdentifier/E_NOT_OK]
        arg OpStatus: type=Dcm_OpStatusType, direction=IN, server-argument-impl-policy=USE-ARGUMENT-TYPE
        arg ErrorCode: type=Dcm_NegativeResponseCodeType, direction=OUT, server-argument-impl-policy=USE-ARGUMENT-TYPE
      operation ReadData: possible-error=[DataServices_DID_0193_SubjectKeyIdentifier/DCM_E_PENDING, DataServices_DID_0193_SubjectKeyIdentifier/E_NOT_OK]
        arg OpStatus: type=Dcm_OpStatusType, direction=IN, server-argument-impl-policy=USE-ARGUMENT-TYPE
        arg Data: type=Dcm_Data20ByteType, direction=OUT, server-argument-impl-policy=USE-ARGUMENT-TYPE
      error DCM_E_PENDING: error-code=10
      error E_NOT_OK: error-code=1
    DataServices_DID_0193_SubjectPublicKeyInfo
      operation ConditionCheckRead: possible-error=[DataServices_DID_0193_SubjectPublicKeyInfo/DCM_E_PENDING, DataServices_DID_0193_SubjectPublicKeyInfo/E_NOT_OK]
        arg OpStatus: type=Dcm_OpStatusType, direction=IN, server-argument-impl-policy=USE-ARGUMENT-TYPE
        arg ErrorCode: type=Dcm_NegativeResponseCodeType, direction=OUT, server-argument-impl-policy=USE-ARGUMENT-TYPE
      operation ReadData: possible-error=[DataServices_DID_0193_SubjectPublicKeyInfo/DCM_E_PENDING, DataServices_DID_0193_SubjectPublicKeyInfo/E_NOT_OK]
        arg OpStatus: type=Dcm_OpStatusType, direction=IN, server-argument-impl-policy=USE-ARGUMENT-TYPE
        arg Data: type=Dcm_Data32ByteType, direction=OUT, server-argument-impl-policy=USE-ARGUMENT-TYPE
      error DCM_E_PENDING: error-code=10
      error E_NOT_OK: error-code=1
    DataServices_DID_0194_ECC_CA_Certificate_Identification
      operation ConditionCheckRead: possible-error=[DataServices_DID_0194_ECC_CA_Certificate_Identification/DCM_E_PENDING, DataServices_DID_0194_ECC_CA_Certificate_Identification/E_NOT_OK]
        arg OpStatus: type=Dcm_OpStatusType, direction=IN, server-argument-impl-policy=USE-ARGUMENT-TYPE
        arg ErrorCode: type=Dcm_NegativeResponseCodeType, direction=OUT, server-argument-impl-policy=USE-ARGUMENT-TYPE
      operation ReadData: possible-error=[DataServices_DID_0194_ECC_CA_Certificate_Identification/DCM_E_PENDING, DataServices_DID_0194_ECC_CA_Certificate_Identification/E_NOT_OK]
        arg OpStatus: type=Dcm_OpStatusType, direction=IN, server-argument-impl-policy=USE-ARGUMENT-TYPE
        arg Data: type=Dcm_Data20ByteType, direction=OUT, server-argument-impl-policy=USE-ARGUMENT-TYPE
      error DCM_E_PENDING: error-code=10
      error E_NOT_OK: error-code=1
    DataServices_ECU_Certificate_Read_Data_Signature
      operation ConditionCheckRead: possible-error=[DataServices_ECU_Certificate_Read_Data_Signature/DCM_E_PENDING, DataServices_ECU_Certificate_Read_Data_Signature/E_NOT_OK]
        arg OpStatus: type=Dcm_OpStatusType, direction=IN, server-argument-impl-policy=USE-ARGUMENT-TYPE
        arg ErrorCode: type=Dcm_NegativeResponseCodeType, direction=OUT, server-argument-impl-policy=USE-ARGUMENT-TYPE
      operation ReadData: possible-error=[DataServices_ECU_Certificate_Read_Data_Signature/DCM_E_PENDING, DataServices_ECU_Certificate_Read_Data_Signature/E_NOT_OK]
        arg OpStatus: type=Dcm_OpStatusType, direction=IN, server-argument-impl-policy=USE-ARGUMENT-TYPE
        arg Data: type=Dcm_Data64ByteType, direction=OUT, server-argument-impl-policy=USE-ARRAY-BASE-TYPE
      error DCM_E_PENDING: error-code=10
      error E_NOT_OK: error-code=1
    DataServices_ECU_Certificate_Read_ECU_Certificate
      operation ConditionCheckRead: possible-error=[DataServices_ECU_Certificate_Read_ECU_Certificate/DCM_E_PENDING, DataServices_ECU_Certificate_Read_ECU_Certificate/E_NOT_OK]
        arg OpStatus: type=Dcm_OpStatusType, direction=IN, server-argument-impl-policy=USE-ARGUMENT-TYPE
        arg ErrorCode: type=Dcm_NegativeResponseCodeType, direction=OUT, server-argument-impl-policy=USE-ARGUMENT-TYPE
      operation ReadData: possible-error=[DataServices_ECU_Certificate_Read_ECU_Certificate/DCM_E_PENDING, DataServices_ECU_Certificate_Read_ECU_Certificate/E_NOT_OK]
        arg OpStatus: type=Dcm_OpStatusType, direction=IN, server-argument-impl-policy=USE-ARGUMENT-TYPE
        arg Data: type=Dcm_Data1002ByteType, direction=OUT, server-argument-impl-policy=USE-ARRAY-BASE-TYPE
      operation ReadDataLength: possible-error=[DataServices_ECU_Certificate_Read_ECU_Certificate/DCM_E_PENDING, DataServices_ECU_Certificate_Read_ECU_Certificate/E_NOT_OK]
        arg OpStatus: type=Dcm_OpStatusType, direction=IN, server-argument-impl-policy=USE-ARGUMENT-TYPE
        arg DataLength: type=uint16, direction=OUT, server-argument-impl-policy=USE-ARGUMENT-TYPE
      error DCM_E_PENDING: error-code=10
      error E_NOT_OK: error-code=1
    DataServices_ECU_Certificate_Read_Ephemeral_ECU_Public_Key
      operation ConditionCheckRead: possible-error=[DataServices_ECU_Certificate_Read_Ephemeral_ECU_Public_Key/DCM_E_PENDING, DataServices_ECU_Certificate_Read_Ephemeral_ECU_Public_Key/E_NOT_OK]
        arg OpStatus: type=Dcm_OpStatusType, direction=IN, server-argument-impl-policy=USE-ARGUMENT-TYPE
        arg ErrorCode: type=Dcm_NegativeResponseCodeType, direction=OUT, server-argument-impl-policy=USE-ARGUMENT-TYPE
      operation ReadData: possible-error=[DataServices_ECU_Certificate_Read_Ephemeral_ECU_Public_Key/DCM_E_PENDING, DataServices_ECU_Certificate_Read_Ephemeral_ECU_Public_Key/E_NOT_OK]
        arg OpStatus: type=Dcm_OpStatusType, direction=IN, server-argument-impl-policy=USE-ARGUMENT-TYPE
        arg Data: type=Dcm_Data32ByteType, direction=OUT, server-argument-impl-policy=USE-ARRAY-BASE-TYPE
      error DCM_E_PENDING: error-code=10
      error E_NOT_OK: error-code=1
    DataServices_ECU_Certificate_Read_Nonce
      operation ConditionCheckRead: possible-error=[DataServices_ECU_Certificate_Read_Nonce/DCM_E_PENDING, DataServices_ECU_Certificate_Read_Nonce/E_NOT_OK]
        arg OpStatus: type=Dcm_OpStatusType, direction=IN, server-argument-impl-policy=USE-ARGUMENT-TYPE
        arg ErrorCode: type=Dcm_NegativeResponseCodeType, direction=OUT, server-argument-impl-policy=USE-ARGUMENT-TYPE
      operation ReadData: possible-error=[DataServices_ECU_Certificate_Read_Nonce/DCM_E_PENDING, DataServices_ECU_Certificate_Read_Nonce/E_NOT_OK]
        arg OpStatus: type=Dcm_OpStatusType, direction=IN, server-argument-impl-policy=USE-ARGUMENT-TYPE
        arg Data: type=Dcm_Data32ByteType, direction=OUT, server-argument-impl-policy=USE-ARRAY-BASE-TYPE
      error DCM_E_PENDING: error-code=10
      error E_NOT_OK: error-code=1
    RoutineServices_Routine_SecOC_ECU_Shared_Secret_Distribution
      operation Start: possible-error=[RoutineServices_Routine_SecOC_ECU_Shared_Secret_Distribution/DCM_E_FORCE_RCRRP, RoutineServices_Routine_SecOC_ECU_Shared_Secret_Distribution/DCM_E_PENDING, RoutineServices_Routine_SecOC_ECU_Shared_Secret_Distribution/E_NOT_OK]
        12 x arg:
          Date_and_Time: type=Dcm_Data7ByteType, direction=IN, server-argument-impl-policy=USE-ARRAY-BASE-TYPE
          Tick_Count: type=Dcm_Data5ByteType, direction=IN, server-argument-impl-policy=USE-ARRAY-BASE-TYPE
          Tick_Count_Offset: type=Dcm_Data5ByteType, direction=IN, server-argument-impl-policy=USE-ARRAY-BASE-TYPE
          Encrypted_Nonce_and_Shared_Secret: type=Dcm_Data80ByteType, direction=IN, server-argument-impl-policy=USE-ARRAY-BASE-TYPE
          Ephemeral_VSM_Public_Key: type=Dcm_Data32ByteType, direction=IN, server-argument-impl-policy=USE-ARRAY-BASE-TYPE
          Data_Signature: type=Dcm_Data64ByteType, direction=IN, server-argument-impl-policy=USE-ARRAY-BASE-TYPE
          VSMs_ECU_Certificate: type=Dcm_Data1002ByteType, direction=IN, server-argument-impl-policy=USE-ARRAY-BASE-TYPE
          OpStatus: type=Dcm_OpStatusType, direction=IN, server-argument-impl-policy=USE-ARGUMENT-TYPE
          routineInfo: type=uint8, direction=OUT, server-argument-impl-policy=USE-ARGUMENT-TYPE
          Verification_Result: type=uint8, direction=OUT, server-argument-impl-policy=USE-ARGUMENT-TYPE
          DataLength: type=uint16, direction=IN, server-argument-impl-policy=USE-ARGUMENT-TYPE
          ErrorCode: type=Dcm_NegativeResponseCodeType, direction=OUT, server-argument-impl-policy=USE-ARGUMENT-TYPE
      error DCM_E_FORCE_RCRRP: error-code=12
      error DCM_E_PENDING: error-code=10
      error E_NOT_OK: error-code=1
    RoutineServices_Routine_SecOC_ECU_Shared_Secret_Encryption
      operation Start: possible-error=[RoutineServices_Routine_SecOC_ECU_Shared_Secret_Encryption/DCM_E_FORCE_RCRRP, RoutineServices_Routine_SecOC_ECU_Shared_Secret_Encryption/DCM_E_PENDING, RoutineServices_Routine_SecOC_ECU_Shared_Secret_Encryption/E_NOT_OK]
        16 x arg:
          Nonce: type=Dcm_Data32ByteType, direction=IN, server-argument-impl-policy=USE-ARRAY-BASE-TYPE
          Ephemeral_ECU_Public_Key: type=Dcm_Data32ByteType, direction=IN, server-argument-impl-policy=USE-ARRAY-BASE-TYPE
          Data_Signature_In: type=Dcm_Data64ByteType, direction=IN, server-argument-impl-policy=USE-ARRAY-BASE-TYPE
          Target_ECU_Certificate: type=Dcm_Data1002ByteType, direction=IN, server-argument-impl-policy=USE-ARRAY-BASE-TYPE
          OpStatus: type=Dcm_OpStatusType, direction=IN, server-argument-impl-policy=USE-ARGUMENT-TYPE
          routineInfo: type=uint8, direction=OUT, server-argument-impl-policy=USE-ARGUMENT-TYPE
          Verification_Result: type=uint8, direction=OUT, server-argument-impl-policy=USE-ARGUMENT-TYPE
          Date_and_Time: type=Dcm_Data7ByteType, direction=OUT, server-argument-impl-policy=USE-ARRAY-BASE-TYPE
          Tick_Count: type=Dcm_Data5ByteType, direction=OUT, server-argument-impl-policy=USE-ARRAY-BASE-TYPE
          Tick_Count_Offset: type=Dcm_Data5ByteType, direction=OUT, server-argument-impl-policy=USE-ARRAY-BASE-TYPE
          Encrypted_Nonce_and_Shared_Secret: type=Dcm_Data80ByteType, direction=OUT, server-argument-impl-policy=USE-ARRAY-BASE-TYPE
          Ephemeral_VSM_Public_Key: type=Dcm_Data32ByteType, direction=OUT, server-argument-impl-policy=USE-ARRAY-BASE-TYPE
          Data_Signature_Out: type=Dcm_Data64ByteType, direction=OUT, server-argument-impl-policy=USE-ARRAY-BASE-TYPE
          VSM_s_ECU_Certificate: type=Dcm_Data1002ByteType, direction=OUT, server-argument-impl-policy=USE-ARRAY-BASE-TYPE
          DataLength: type=uint16, direction=INOUT, server-argument-impl-policy=USE-ARGUMENT-TYPE
          ErrorCode: type=Dcm_NegativeResponseCodeType, direction=OUT, server-argument-impl-policy=USE-ARGUMENT-TYPE
      error DCM_E_FORCE_RCRRP: error-code=12
      error DCM_E_PENDING: error-code=10
      error E_NOT_OK: error-code=1
    RoutineServices_Routine_SecOC_ECU_TickCount_Synchronization
      operation Start: possible-error=[RoutineServices_Routine_SecOC_ECU_TickCount_Synchronization/DCM_E_FORCE_RCRRP, RoutineServices_Routine_SecOC_ECU_TickCount_Synchronization/DCM_E_PENDING, RoutineServices_Routine_SecOC_ECU_TickCount_Synchronization/E_NOT_OK]
        16 x arg:
          Nonce: type=Dcm_Data32ByteType, direction=IN, server-argument-impl-policy=USE-ARRAY-BASE-TYPE
          Ephemeral_ECU_Public_Key: type=Dcm_Data32ByteType, direction=IN, server-argument-impl-policy=USE-ARRAY-BASE-TYPE
          Data_Signature_In: type=Dcm_Data64ByteType, direction=IN, server-argument-impl-policy=USE-ARRAY-BASE-TYPE
          Target_ECU_Certificate: type=Dcm_Data1002ByteType, direction=IN, server-argument-impl-policy=USE-ARRAY-BASE-TYPE
          OpStatus: type=Dcm_OpStatusType, direction=IN, server-argument-impl-policy=USE-ARGUMENT-TYPE
          routineInfo: type=uint8, direction=OUT, server-argument-impl-policy=USE-ARGUMENT-TYPE
          Verification_Result: type=uint8, direction=OUT, server-argument-impl-policy=USE-ARGUMENT-TYPE
          Date_and_Time: type=Dcm_Data7ByteType, direction=OUT, server-argument-impl-policy=USE-ARRAY-BASE-TYPE
          Tick_Count: type=Dcm_Data5ByteType, direction=OUT, server-argument-impl-policy=USE-ARRAY-BASE-TYPE
          Tick_Count_Offset: type=Dcm_Data5ByteType, direction=OUT, server-argument-impl-policy=USE-ARRAY-BASE-TYPE
          Encrypted_Nonce_and_Shared_Secret: type=Dcm_Data80ByteType, direction=OUT, server-argument-impl-policy=USE-ARRAY-BASE-TYPE
          Ephemeral_VSM_Public_Key: type=Dcm_Data32ByteType, direction=OUT, server-argument-impl-policy=USE-ARRAY-BASE-TYPE
          Data_Signature_Out: type=Dcm_Data64ByteType, direction=OUT, server-argument-impl-policy=USE-ARRAY-BASE-TYPE
          VSM_s_ECU_Certificate: type=Dcm_Data1002ByteType, direction=OUT, server-argument-impl-policy=USE-ARRAY-BASE-TYPE
          DataLength: type=uint16, direction=INOUT, server-argument-impl-policy=USE-ARGUMENT-TYPE
          ErrorCode: type=Dcm_NegativeResponseCodeType, direction=OUT, server-argument-impl-policy=USE-ARGUMENT-TYPE
      error DCM_E_FORCE_RCRRP: error-code=12
      error DCM_E_PENDING: error-code=10
      error E_NOT_OK: error-code=1
    RoutineServices_Routine_SecOC_Vehicle_Shared_Secret_Distribution
      operation Start: possible-error=[RoutineServices_Routine_SecOC_Vehicle_Shared_Secret_Distribution/DCM_E_FORCE_RCRRP, RoutineServices_Routine_SecOC_Vehicle_Shared_Secret_Distribution/DCM_E_PENDING, RoutineServices_Routine_SecOC_Vehicle_Shared_Secret_Distribution/E_NOT_OK]
        arg OpStatus: type=Dcm_OpStatusType, direction=IN, server-argument-impl-policy=USE-ARGUMENT-TYPE
        arg routineInfo: type=uint8, direction=OUT, server-argument-impl-policy=USE-ARGUMENT-TYPE
        arg ErrorCode: type=Dcm_NegativeResponseCodeType, direction=OUT, server-argument-impl-policy=USE-ARGUMENT-TYPE
      error DCM_E_FORCE_RCRRP: error-code=12
      error DCM_E_PENDING: error-code=10
      error E_NOT_OK: error-code=1
    RoutineServices_Routine_SecOC_VSM_Derive_Symmetric_Keys
      operation Start: possible-error=[RoutineServices_Routine_SecOC_VSM_Derive_Symmetric_Keys/DCM_E_FORCE_RCRRP, RoutineServices_Routine_SecOC_VSM_Derive_Symmetric_Keys/DCM_E_PENDING, RoutineServices_Routine_SecOC_VSM_Derive_Symmetric_Keys/E_NOT_OK]
        arg OpStatus: type=Dcm_OpStatusType, direction=IN, server-argument-impl-policy=USE-ARGUMENT-TYPE
        arg routineInfo: type=uint8, direction=OUT, server-argument-impl-policy=USE-ARGUMENT-TYPE
        arg ErrorCode: type=Dcm_NegativeResponseCodeType, direction=OUT, server-argument-impl-policy=USE-ARGUMENT-TYPE
      error DCM_E_FORCE_RCRRP: error-code=12
      error DCM_E_PENDING: error-code=10
      error E_NOT_OK: error-code=1
    RoutineServices_Routine_SecOC_VSM_Renew_Shared_Secret
      operation Start: possible-error=[RoutineServices_Routine_SecOC_VSM_Renew_Shared_Secret/DCM_E_FORCE_RCRRP, RoutineServices_Routine_SecOC_VSM_Renew_Shared_Secret/DCM_E_PENDING, RoutineServices_Routine_SecOC_VSM_Renew_Shared_Secret/E_NOT_OK]
        arg OpStatus: type=Dcm_OpStatusType, direction=IN, server-argument-impl-policy=USE-ARGUMENT-TYPE
        arg routineInfo: type=uint8, direction=OUT, server-argument-impl-policy=USE-ARGUMENT-TYPE
        arg ErrorCode: type=Dcm_NegativeResponseCodeType, direction=OUT, server-argument-impl-policy=USE-ARGUMENT-TYPE
      error DCM_E_FORCE_RCRRP: error-code=12
      error DCM_E_PENDING: error-code=10
      error E_NOT_OK: error-code=1
    RoutineServices_Trust_Model_SecOC_ECU_Shared_Secret_Encryption
      operation Start: possible-error=[RoutineServices_Trust_Model_SecOC_ECU_Shared_Secret_Encryption/DCM_E_FORCE_RCRRP, RoutineServices_Trust_Model_SecOC_ECU_Shared_Secret_Encryption/DCM_E_PENDING, RoutineServices_Trust_Model_SecOC_ECU_Shared_Secret_Encryption/E_NOT_OK]
        16 x arg, all with server-argument-impl-policy=USE-ARGUMENT-TYPE:
          Nonce_In: type=Dcm_Data32ByteType, direction=IN
          Ephemeral_ECU_Public_Key_In: type=Dcm_Data32ByteType, direction=IN
          In_Data_Signature_In: type=Dcm_Data64ByteType, direction=IN
          In_Certificates_In: type=Dcm_Data3006ByteType, direction=IN
          OpStatus: type=Dcm_OpStatusType, direction=IN
          routineInfo_Out: type=uint8, direction=OUT
          Verification_Result_Out: type=uint8, direction=OUT
          Date_and_Time_Out: type=Dcm_Data7ByteType, direction=OUT
          Tick_Count_Out: type=Dcm_Data5ByteType, direction=OUT
          Tick_Count_Offset_Out: type=Dcm_Data5ByteType, direction=OUT
          Encrypted_Nonce_and_Shared_Secret_Out: type=Dcm_Data80ByteType, direction=OUT
          Ephemeral_VSM_Public_Key_Out: type=Dcm_Data32ByteType, direction=OUT
          Out_Data_Signature_Out: type=Dcm_Data64ByteType, direction=OUT
          Out_Certificates_Out: type=Dcm_Data3006ByteType, direction=OUT
          DataLength: type=uint16, direction=INOUT
          ErrorCode: type=Dcm_NegativeResponseCodeType, direction=OUT
      error DCM_E_FORCE_RCRRP: error-code=12
      error DCM_E_PENDING: error-code=10
      error E_NOT_OK: error-code=1
    RoutineServices_Trust_Model_SecOC_ECU_TickCount_Synchronization
      operation Start: possible-error=[RoutineServices_Trust_Model_SecOC_ECU_TickCount_Synchronization/DCM_E_FORCE_RCRRP, RoutineServices_Trust_Model_SecOC_ECU_TickCount_Synchronization/DCM_E_PENDING, RoutineServices_Trust_Model_SecOC_ECU_TickCount_Synchronization/E_NOT_OK]
        16 x arg, all with server-argument-impl-policy=USE-ARGUMENT-TYPE:
          Nonce_In: type=Dcm_Data32ByteType, direction=IN
          Ephemeral_ECU_Public_Key_In: type=Dcm_Data32ByteType, direction=IN
          In_Data_Signature_In: type=Dcm_Data64ByteType, direction=IN
          In_Certificates_In: type=Dcm_Data3006ByteType, direction=IN
          OpStatus: type=Dcm_OpStatusType, direction=IN
          routineInfo_Out: type=uint8, direction=OUT
          Verification_Result_Out: type=uint8, direction=OUT
          Date_and_Time_Out: type=Dcm_Data7ByteType, direction=OUT
          Tick_Count_Out: type=Dcm_Data5ByteType, direction=OUT
          Tick_Count_Offset_Out: type=Dcm_Data5ByteType, direction=OUT
          Encrypted_Nonce_and_Shared_Secret_Out: type=Dcm_Data80ByteType, direction=OUT
          Ephemeral_VSM_Public_Key_Out: type=Dcm_Data32ByteType, direction=OUT
          Out_Data_Signature_Out: type=Dcm_Data64ByteType, direction=OUT
          Out_Certificates_Out: type=Dcm_Data3006ByteType, direction=OUT
          DataLength: type=uint16, direction=INOUT
          ErrorCode: type=Dcm_NegativeResponseCodeType, direction=OUT
      error DCM_E_FORCE_RCRRP: error-code=12
      error DCM_E_PENDING: error-code=10
      error E_NOT_OK: error-code=1
package /SecurityArchitecture/external/SecOC_swc/Interfaces
  sender receiver interface SecOC_VerificationStatusService: is-service=true, service-kind=VENDOR-SPECIFIC
    data verificationStatus: type=SecOC_VerificationStatusType
package /SecurityArchitecture/external/KeyM_swc/Interfaces
  5 x client server interface, all with is-service=true, service-kind=VENDOR-SPECIFIC:
    KeyMCertificateElement_Ssa_TrustModelBackendCert_ext_pkiRole  # Service of the certificate sub module to access certificate elements.
      operation CertificateElementGet: possible-error=[KeyMCertificateElement_Ssa_TrustModelBackendCert_ext_pkiRole/E_NOT_OK, KeyMCertificateElement_Ssa_TrustModelBackendCert_ext_pkiRole/KEYM_E_KEY_CERT_EMPTY, KeyMCertificateElement_Ssa_TrustModelBackendCert_ext_pkiRole/KEYM_E_KEY_CERT_INVALID, KeyMCertificateElement_Ssa_TrustModelBackendCert_ext_pkiRole/KEYM_E_KEY_CERT_SIZE_MISMATCH, KeyMCertificateElement_Ssa_TrustModelBackendCert_ext_pkiRole/KEYM_E_PARAMETER_MISMATCH]  # Provides the content of a specific certificate element. The certificate configuration defines how the certificate submodule can find the element, e.g. by providing the object identifier (OID). This function is used to retrieve this information if only one element is assigned to the respective OID.
        arg CertificateElementData: type=KeyM_CertificateElementType_Ssa_TrustModelBackendCert_ext_pkiRole, direction=OUT, server-argument-impl-policy=USE-ARRAY-BASE-TYPE
        arg CertificateDataLength: type=uint32, direction=OUT, server-argument-impl-policy=USE-ARGUMENT-TYPE
      5 x error:
        E_NOT_OK: error-code=1  # The service request failed.
        KEYM_E_KEY_CERT_EMPTY: error-code=10  # The service request failed. The requested key or certificate is not available, slot is empty.
        KEYM_E_KEY_CERT_INVALID: error-code=6  # The service request failed. Key or certificate is invalid and cannot be used for the operation.
        KEYM_E_KEY_CERT_SIZE_MISMATCH: error-code=4  # The service request failed. Parameter size does not match the expected value.
        KEYM_E_PARAMETER_MISMATCH: error-code=5  # The service request failed. Parameter to function does not provide the expected value.
    KeyMCertificateElement_Ssa_TrustModelEcuCert_ext_pkiRole  # Service of the certificate sub module to access certificate elements.
      operation CertificateElementGet: possible-error=[KeyMCertificateElement_Ssa_TrustModelEcuCert_ext_pkiRole/E_NOT_OK, KeyMCertificateElement_Ssa_TrustModelEcuCert_ext_pkiRole/KEYM_E_KEY_CERT_EMPTY, KeyMCertificateElement_Ssa_TrustModelEcuCert_ext_pkiRole/KEYM_E_KEY_CERT_INVALID, KeyMCertificateElement_Ssa_TrustModelEcuCert_ext_pkiRole/KEYM_E_KEY_CERT_SIZE_MISMATCH, KeyMCertificateElement_Ssa_TrustModelEcuCert_ext_pkiRole/KEYM_E_PARAMETER_MISMATCH]  # Provides the content of a specific certificate element. The certificate configuration defines how the certificate submodule can find the element, e.g. by providing the object identifier (OID). This function is used to retrieve this information if only one element is assigned to the respective OID.
        arg CertificateElementData: type=KeyM_CertificateElementType_Ssa_TrustModelEcuCert_ext_pkiRole, direction=OUT, server-argument-impl-policy=USE-ARRAY-BASE-TYPE
        arg CertificateDataLength: type=uint32, direction=OUT, server-argument-impl-policy=USE-ARGUMENT-TYPE
      5 x error:
        E_NOT_OK: error-code=1  # The service request failed.
        KEYM_E_KEY_CERT_EMPTY: error-code=10  # The service request failed. The requested key or certificate is not available, slot is empty.
        KEYM_E_KEY_CERT_INVALID: error-code=6  # The service request failed. Key or certificate is invalid and cannot be used for the operation.
        KEYM_E_KEY_CERT_SIZE_MISMATCH: error-code=4  # The service request failed. Parameter size does not match the expected value.
        KEYM_E_PARAMETER_MISMATCH: error-code=5  # The service request failed. Parameter to function does not provide the expected value.
    KeyMCertificateElement_Ssa_TrustModelIntermediateCert_ext_pkiRole  # Service of the certificate sub module to access certificate elements.
      operation CertificateElementGet: possible-error=[KeyMCertificateElement_Ssa_TrustModelIntermediateCert_ext_pkiRole/E_NOT_OK, KeyMCertificateElement_Ssa_TrustModelIntermediateCert_ext_pkiRole/KEYM_E_KEY_CERT_EMPTY, KeyMCertificateElement_Ssa_TrustModelIntermediateCert_ext_pkiRole/KEYM_E_KEY_CERT_INVALID, KeyMCertificateElement_Ssa_TrustModelIntermediateCert_ext_pkiRole/KEYM_E_KEY_CERT_SIZE_MISMATCH, KeyMCertificateElement_Ssa_TrustModelIntermediateCert_ext_pkiRole/KEYM_E_PARAMETER_MISMATCH]  # Provides the content of a specific certificate element. The certificate configuration defines how the certificate submodule can find the element, e.g. by providing the object identifier (OID). This function is used to retrieve this information if only one element is assigned to the respective OID.
        arg CertificateElementData: type=KeyM_CertificateElementType_Ssa_TrustModelIntermediateCert_ext_pkiRole, direction=OUT, server-argument-impl-policy=USE-ARRAY-BASE-TYPE
        arg CertificateDataLength: type=uint32, direction=OUT, server-argument-impl-policy=USE-ARGUMENT-TYPE
      5 x error:
        E_NOT_OK: error-code=1  # The service request failed.
        KEYM_E_KEY_CERT_EMPTY: error-code=10  # The service request failed. The requested key or certificate is not available, slot is empty.
        KEYM_E_KEY_CERT_INVALID: error-code=6  # The service request failed. Key or certificate is invalid and cannot be used for the operation.
        KEYM_E_KEY_CERT_SIZE_MISMATCH: error-code=4  # The service request failed. Parameter size does not match the expected value.
        KEYM_E_PARAMETER_MISMATCH: error-code=5  # The service request failed. Parameter to function does not provide the expected value.
    KeyMCertificateElement_Ssa_TrustModelRootCert_ext_authKeyId  # Service of the certificate sub module to access certificate elements.
      operation CertificateElementGet: possible-error=[KeyMCertificateElement_Ssa_TrustModelRootCert_ext_authKeyId/E_NOT_OK, KeyMCertificateElement_Ssa_TrustModelRootCert_ext_authKeyId/KEYM_E_KEY_CERT_EMPTY, KeyMCertificateElement_Ssa_TrustModelRootCert_ext_authKeyId/KEYM_E_KEY_CERT_INVALID, KeyMCertificateElement_Ssa_TrustModelRootCert_ext_authKeyId/KEYM_E_KEY_CERT_SIZE_MISMATCH, KeyMCertificateElement_Ssa_TrustModelRootCert_ext_authKeyId/KEYM_E_PARAMETER_MISMATCH]  # Provides the content of a specific certificate element. The certificate configuration defines how the certificate submodule can find the element, e.g. by providing the object identifier (OID). This function is used to retrieve this information if only one element is assigned to the respective OID.
        arg CertificateElementData: type=KeyM_CertificateElementType_Ssa_TrustModelRootCert_ext_authKeyId, direction=OUT, server-argument-impl-policy=USE-ARRAY-BASE-TYPE
        arg CertificateDataLength: type=uint32, direction=OUT, server-argument-impl-policy=USE-ARGUMENT-TYPE
      operation CertificateElementGetByIndex: possible-error=[KeyMCertificateElement_Ssa_TrustModelRootCert_ext_authKeyId/E_NOT_OK, KeyMCertificateElement_Ssa_TrustModelRootCert_ext_authKeyId/KEYM_E_KEY_CERT_EMPTY, KeyMCertificateElement_Ssa_TrustModelRootCert_ext_authKeyId/KEYM_E_KEY_CERT_INVALID, KeyMCertificateElement_Ssa_TrustModelRootCert_ext_authKeyId/KEYM_E_KEY_CERT_SIZE_MISMATCH, KeyMCertificateElement_Ssa_TrustModelRootCert_ext_authKeyId/KEYM_E_PARAMETER_MISMATCH]  # This operation provides data from a specific certificate element.
        arg Index: type=uint16, direction=IN, server-argument-impl-policy=USE-ARGUMENT-TYPE
        arg CertificateElementData: type=KeyM_CertificateElementType_Ssa_TrustModelRootCert_ext_authKeyId, direction=OUT, server-argument-impl-policy=USE-ARRAY-BASE-TYPE
        arg CertificateDataLength: type=uint32, direction=OUT, server-argument-impl-policy=USE-ARGUMENT-TYPE
      operation CertificateElementGetCount: possible-error=[KeyMCertificateElement_Ssa_TrustModelRootCert_ext_authKeyId/E_NOT_OK, KeyMCertificateElement_Ssa_TrustModelRootCert_ext_authKeyId/KEYM_E_KEY_CERT_EMPTY, KeyMCertificateElement_Ssa_TrustModelRootCert_ext_authKeyId/KEYM_E_KEY_CERT_INVALID, KeyMCertificateElement_Ssa_TrustModelRootCert_ext_authKeyId/KEYM_E_KEY_CERT_SIZE_MISMATCH, KeyMCertificateElement_Ssa_TrustModelRootCert_ext_authKeyId/KEYM_E_PARAMETER_MISMATCH]  # This operation returns the amount of items available for a certificate element.
        arg count: type=uint16, direction=OUT, server-argument-impl-policy=USE-ARGUMENT-TYPE
      5 x error:
        E_NOT_OK: error-code=1  # The service request failed.
        KEYM_E_KEY_CERT_EMPTY: error-code=10  # The service request failed. The requested key or certificate is not available, slot is empty.
        KEYM_E_KEY_CERT_INVALID: error-code=6  # The service request failed. Key or certificate is invalid and cannot be used for the operation.
        KEYM_E_KEY_CERT_SIZE_MISMATCH: error-code=4  # The service request failed. Parameter size does not match the expected value.
        KEYM_E_PARAMETER_MISMATCH: error-code=5  # The service request failed. Parameter to function does not provide the expected value.
    KeyMCertificateElement_Ssa_TrustModelRootCert_ext_pkiRole  # Service of the certificate sub module to access certificate elements.
      operation CertificateElementGet: possible-error=[KeyMCertificateElement_Ssa_TrustModelRootCert_ext_pkiRole/E_NOT_OK, KeyMCertificateElement_Ssa_TrustModelRootCert_ext_pkiRole/KEYM_E_KEY_CERT_EMPTY, KeyMCertificateElement_Ssa_TrustModelRootCert_ext_pkiRole/KEYM_E_KEY_CERT_INVALID, KeyMCertificateElement_Ssa_TrustModelRootCert_ext_pkiRole/KEYM_E_KEY_CERT_SIZE_MISMATCH, KeyMCertificateElement_Ssa_TrustModelRootCert_ext_pkiRole/KEYM_E_PARAMETER_MISMATCH]  # Provides the content of a specific certificate element. The certificate configuration defines how the certificate submodule can find the element, e.g. by providing the object identifier (OID). This function is used to retrieve this information if only one element is assigned to the respective OID.
        arg CertificateElementData: type=KeyM_CertificateElementType_Ssa_TrustModelRootCert_ext_pkiRole, direction=OUT, server-argument-impl-policy=USE-ARRAY-BASE-TYPE
        arg CertificateDataLength: type=uint32, direction=OUT, server-argument-impl-policy=USE-ARGUMENT-TYPE
      operation CertificateElementGetByIndex: possible-error=[KeyMCertificateElement_Ssa_TrustModelRootCert_ext_pkiRole/E_NOT_OK, KeyMCertificateElement_Ssa_TrustModelRootCert_ext_pkiRole/KEYM_E_KEY_CERT_EMPTY, KeyMCertificateElement_Ssa_TrustModelRootCert_ext_pkiRole/KEYM_E_KEY_CERT_INVALID, KeyMCertificateElement_Ssa_TrustModelRootCert_ext_pkiRole/KEYM_E_KEY_CERT_SIZE_MISMATCH, KeyMCertificateElement_Ssa_TrustModelRootCert_ext_pkiRole/KEYM_E_PARAMETER_MISMATCH]  # This operation provides data from a specific certificate element.
        arg Index: type=uint16, direction=IN, server-argument-impl-policy=USE-ARGUMENT-TYPE
        arg CertificateElementData: type=KeyM_CertificateElementType_Ssa_TrustModelRootCert_ext_pkiRole, direction=OUT, server-argument-impl-policy=USE-ARRAY-BASE-TYPE
        arg CertificateDataLength: type=uint32, direction=OUT, server-argument-impl-policy=USE-ARGUMENT-TYPE
      operation CertificateElementGetCount: possible-error=[KeyMCertificateElement_Ssa_TrustModelRootCert_ext_pkiRole/E_NOT_OK, KeyMCertificateElement_Ssa_TrustModelRootCert_ext_pkiRole/KEYM_E_KEY_CERT_EMPTY, KeyMCertificateElement_Ssa_TrustModelRootCert_ext_pkiRole/KEYM_E_KEY_CERT_INVALID, KeyMCertificateElement_Ssa_TrustModelRootCert_ext_pkiRole/KEYM_E_KEY_CERT_SIZE_MISMATCH, KeyMCertificateElement_Ssa_TrustModelRootCert_ext_pkiRole/KEYM_E_PARAMETER_MISMATCH]  # This operation returns the amount of items available for a certificate element.
        arg count: type=uint16, direction=OUT, server-argument-impl-policy=USE-ARGUMENT-TYPE
      5 x error:
        E_NOT_OK: error-code=1  # The service request failed.
        KEYM_E_KEY_CERT_EMPTY: error-code=10  # The service request failed. The requested key or certificate is not available, slot is empty.
        KEYM_E_KEY_CERT_INVALID: error-code=6  # The service request failed. Key or certificate is invalid and cannot be used for the operation.
        KEYM_E_KEY_CERT_SIZE_MISMATCH: error-code=4  # The service request failed. Parameter size does not match the expected value.
        KEYM_E_PARAMETER_MISMATCH: error-code=5  # The service request failed. Parameter to function does not provide the expected value.
package /SecurityArchitecture/extSwc/Csm_swc/Interfaces
  28 x client server interface, all with is-service=true, service-kind=CRYPTO-SERVICE-MANAGER:
    CsmDecrypt_AES128DecryptWithPadding  # This interface is used to perform the decryption.
      operation Decrypt: possible-error=[CsmDecrypt_AES128DecryptWithPadding/E_NOT_OK, CsmDecrypt_AES128DecryptWithPadding/CSM_E_BUSY, CsmDecrypt_AES128DecryptWithPadding/CSM_E_KEY_EMPTY, CsmDecrypt_AES128DecryptWithPadding/CSM_E_KEY_NOT_VALID, CsmDecrypt_AES128DecryptWithPadding/CSM_E_KEY_SIZE_MISMATCH, CsmDecrypt_AES128DecryptWithPadding/CSM_E_SMALL_BUFFER]  # This interface shall be used to start the Decrypt service of the CSM module.
        4 x arg:
          dataBuffer: type=Csm_DecryptDataType_AES128DecryptWithPadding, direction=IN, server-argument-impl-policy=USE-ARRAY-BASE-TYPE
          dataLength: type=uint32, direction=IN, server-argument-impl-policy=USE-ARGUMENT-TYPE
          resultBuffer: type=Csm_DecryptResultType_AES128DecryptWithPadding, direction=OUT, server-argument-impl-policy=USE-ARRAY-BASE-TYPE
          resultLength: type=uint32, direction=INOUT, server-argument-impl-policy=USE-ARGUMENT-TYPE
      7 x error:
        CSM_E_BUSY: error-code=2  # The service request failed because the service is still busy.
        CSM_E_JOB_CANCELED: error-code=12  # The job has been marked to be aborted at the next opportunity. It will be further processed until the job finish notification.
        CSM_E_KEY_EMPTY: error-code=13  # The service request failed because of uninitialized source key element.
        CSM_E_KEY_NOT_VALID: error-code=9  # The service request failed because the key is not valid.
        CSM_E_KEY_SIZE_MISMATCH: error-code=10  # The service request failed because the key element is not partially accessible and the provided key element length is too short or too long for that key element.
        CSM_E_SMALL_BUFFER: error-code=3  # The service request failed because the provided buffer is too small to store the result.
        E_NOT_OK: error-code=1  # The service request failed.
    CsmMacGenerate_MacGenAesCmac  # A message authentication code (MAC) is a short piece of information used to authenticate a message. A MAC algorithm accepts as input a secret key and an arbitrary-length message to be authenticated, and outputs a MAC. The MAC value protects both a message's data integrity as well as its authenticity, by allowing verifiers (who also possess the secret key) to detect any changes to the message content.
      operation MacGenerate: possible-error=[CsmMacGenerate_MacGenAesCmac/E_NOT_OK, CsmMacGenerate_MacGenAesCmac/CSM_E_BUSY, CsmMacGenerate_MacGenAesCmac/CSM_E_KEY_EMPTY, CsmMacGenerate_MacGenAesCmac/CSM_E_KEY_NOT_VALID, CsmMacGenerate_MacGenAesCmac/CSM_E_KEY_SIZE_MISMATCH, CsmMacGenerate_MacGenAesCmac/CSM_E_SMALL_BUFFER]  # This interface shall be used to start the MAC generation service of the CSM module.
        4 x arg:
          dataBuffer: type=Csm_MacGenerateDataType_MacGenAesCmac, direction=IN, server-argument-impl-policy=USE-ARRAY-BASE-TYPE
          dataLength: type=uint32, direction=IN, server-argument-impl-policy=USE-ARGUMENT-TYPE
          macBuffer: type=Csm_MacGenerateResultType_MacGenAesCmac, direction=OUT, server-argument-impl-policy=USE-ARRAY-BASE-TYPE
          macLength: type=uint32, direction=INOUT, server-argument-impl-policy=USE-ARGUMENT-TYPE
      7 x error:
        CSM_E_BUSY: error-code=2  # The service request failed because the service is still busy.
        CSM_E_SMALL_BUFFER: error-code=3  # The service request failed because the provided buffer is too small to store the result.
        E_NOT_OK: error-code=1  # The service request failed.
        CSM_E_JOB_CANCELED: error-code=12
        CSM_E_KEY_EMPTY: error-code=13
        CSM_E_KEY_NOT_VALID: error-code=9
        CSM_E_KEY_SIZE_MISMATCH: error-code=10
    CsmMacVerify_MacVerifyAesCmacRealTimeOffset  # A message authentication code (MAC) is a short piece of information used to authenticate a message. A MAC algorithm accepts as input a secret key and an arbitrary-length message to be authenticated, and outputs a MAC. The MAC value protects both a message's data integrity as well as its authenticity, by allowing verifiers (who also possess the secret key) to detect any changes to the message content.
      operation MacVerify: possible-error=[CsmMacVerify_MacVerifyAesCmacRealTimeOffset/E_NOT_OK, CsmMacVerify_MacVerifyAesCmacRealTimeOffset/CSM_E_BUSY, CsmMacVerify_MacVerifyAesCmacRealTimeOffset/CSM_E_KEY_EMPTY, CsmMacVerify_MacVerifyAesCmacRealTimeOffset/CSM_E_KEY_NOT_VALID, CsmMacVerify_MacVerifyAesCmacRealTimeOffset/CSM_E_KEY_SIZE_MISMATCH, CsmMacVerify_MacVerifyAesCmacRealTimeOffset/CSM_E_SMALL_BUFFER]  # This interface shall be used to start the MAC verification service of the CSM module.
        5 x arg:
          dataBuffer: type=Csm_DataType_MacAesCmacRealTimeOffset, direction=IN, server-argument-impl-policy=USE-ARRAY-BASE-TYPE
          dataLength: type=uint32, direction=IN, server-argument-impl-policy=USE-ARGUMENT-TYPE
          macBuffer: type=Csm_MacVerifyCompareType_MacVerifyAesCmac, direction=IN, server-argument-impl-policy=USE-ARRAY-BASE-TYPE
          macLength: type=uint32, direction=IN, server-argument-impl-policy=USE-ARGUMENT-TYPE
          verifyBuffer: type=Crypto_VerifyResultType, direction=OUT, server-argument-impl-policy=USE-ARGUMENT-TYPE
      7 x error:
        CSM_E_BUSY: error-code=2  # The service request failed because the service is still busy.
        CSM_E_JOB_CANCELED: error-code=12
        CSM_E_KEY_EMPTY: error-code=13
        CSM_E_KEY_NOT_VALID: error-code=9
        CSM_E_KEY_SIZE_MISMATCH: error-code=10
        CSM_E_SMALL_BUFFER: error-code=3  # The service request failed because the provided buffer is too small to store the result.
        E_NOT_OK: error-code=1  # The service request failed.
    CallbackNotification  # Interface for the callback notification.
      operation CallbackNotification
        arg result: type=Csm_ResultType, direction=IN, server-argument-impl-policy=USE-ARGUMENT-TYPE
    CsmMacVerify_MacVerifyAesCmacTickCount  # A message authentication code (MAC) is a short piece of information used to authenticate a message. A MAC algorithm accepts as input a secret key and an arbitrary-length message to be authenticated, and outputs a MAC. The MAC value protects both a message's data integrity as well as its authenticity, by allowing verifiers (who also possess the secret key) to detect any changes to the message content.
      operation MacVerify: possible-error=[CsmMacVerify_MacVerifyAesCmacTickCount/E_NOT_OK, CsmMacVerify_MacVerifyAesCmacTickCount/CSM_E_BUSY, CsmMacVerify_MacVerifyAesCmacTickCount/CSM_E_KEY_EMPTY, CsmMacVerify_MacVerifyAesCmacTickCount/CSM_E_KEY_NOT_VALID, CsmMacVerify_MacVerifyAesCmacTickCount/CSM_E_KEY_SIZE_MISMATCH, CsmMacVerify_MacVerifyAesCmacTickCount/CSM_E_SMALL_BUFFER]  # This interface shall be used to start the MAC verification service of the CSM module.
        5 x arg:
          dataBuffer: type=Csm_DataType_MacAesCmacTickCount, direction=IN, server-argument-impl-policy=USE-ARRAY-BASE-TYPE
          dataLength: type=uint32, direction=IN, server-argument-impl-policy=USE-ARGUMENT-TYPE
          macBuffer: type=Csm_MacVerifyCompareType_MacVerifyAesCmac, direction=IN, server-argument-impl-policy=USE-ARRAY-BASE-TYPE
          macLength: type=uint32, direction=IN, server-argument-impl-policy=USE-ARGUMENT-TYPE
          verifyBuffer: type=Crypto_VerifyResultType, direction=OUT, server-argument-impl-policy=USE-ARGUMENT-TYPE
      7 x error:
        CSM_E_BUSY: error-code=2  # The service request failed because the service is still busy.
        CSM_E_JOB_CANCELED: error-code=12
        CSM_E_KEY_EMPTY: error-code=13
        CSM_E_KEY_NOT_VALID: error-code=9
        CSM_E_KEY_SIZE_MISMATCH: error-code=10
        CSM_E_SMALL_BUFFER: error-code=3  # The service request failed because the provided buffer is too small to store the result.
        E_NOT_OK: error-code=1  # The service request failed.
    CsmJobKeyExchangeCalcPubVal  # Interface to execute calculation of the public value for key exchange.
      operation CancelJob: possible-error=[CsmJobKeyExchangeCalcPubVal/CSM_E_JOB_CANCELED, CsmJobKeyExchangeCalcPubVal/E_NOT_OK]  # Cancels the Job.
      operation KeyExchangeCalcPubVal: possible-error=[CsmJobKeyExchangeCalcPubVal/CSM_E_BUSY, CsmJobKeyExchangeCalcPubVal/CSM_E_KEY_EMPTY, CsmJobKeyExchangeCalcPubVal/CSM_E_SMALL_BUFFER, CsmJobKeyExchangeCalcPubVal/E_NOT_OK]  # Calculates the public value of the current user for the key exchange and stores the public key in the provided buffer.
        arg key: type=uint32, direction=IN, server-argument-impl-policy=USE-ARGUMENT-TYPE
        arg publicValuePtr: type=Csm_DataPtr, direction=IN, server-argument-impl-policy=USE-ARGUMENT-TYPE
        arg publicValueLengthPtr: type=Csm_LengthPtr, direction=IN, server-argument-impl-policy=USE-ARGUMENT-TYPE
      5 x error:
        CSM_E_BUSY: error-code=2  # The service request failed because the service is still busy.
        CSM_E_JOB_CANCELED: error-code=12  # The job has been marked to be aborted at the next opportunity. It will be further processed until the job finish notification.
        CSM_E_KEY_EMPTY: error-code=13  # The service request failed because of uninitialized source key element.
        CSM_E_SMALL_BUFFER: error-code=3  # The service request failed because the provided buffer is too small to store the result.
        E_NOT_OK: error-code=1  # The service request failed.
    CsmDecrypt_AES128Decrypt  # This interface is used to perform the decryption.
      operation Decrypt: possible-error=[CsmDecrypt_AES128Decrypt/E_NOT_OK, CsmDecrypt_AES128Decrypt/CSM_E_BUSY, CsmDecrypt_AES128Decrypt/CSM_E_KEY_EMPTY, CsmDecrypt_AES128Decrypt/CSM_E_KEY_NOT_VALID, CsmDecrypt_AES128Decrypt/CSM_E_KEY_SIZE_MISMATCH, CsmDecrypt_AES128Decrypt/CSM_E_SMALL_BUFFER]  # This interface shall be used to start the Decrypt service of the CSM module.
        4 x arg:
          dataBuffer: type=Csm_DecryptDataType_AES128Decrypt, direction=IN, server-argument-impl-policy=USE-ARRAY-BASE-TYPE
          dataLength: type=uint32, direction=IN, server-argument-impl-policy=USE-ARGUMENT-TYPE
          resultBuffer: type=Csm_DecryptResultType_AES128Decrypt, direction=OUT, server-argument-impl-policy=USE-ARRAY-BASE-TYPE
          resultLength: type=uint32, direction=INOUT, server-argument-impl-policy=USE-ARGUMENT-TYPE
      7 x error:
        CSM_E_BUSY: error-code=2  # The service request failed because the service is still busy.
        CSM_E_SMALL_BUFFER: error-code=3  # The service request failed because the provided buffer is too small to store the result.
        E_NOT_OK: error-code=1  # The service request failed.
        CSM_E_JOB_CANCELED: error-code=12
        CSM_E_KEY_EMPTY: error-code=13
        CSM_E_KEY_NOT_VALID: error-code=9
        CSM_E_KEY_SIZE_MISMATCH: error-code=10
    CsmKeyManagement_Ssa_RootCert  # Interface to execute the key management functions.
      operation KeyElementGet: possible-error=[CsmKeyManagement_Ssa_RootCert/CSM_E_BUSY, CsmKeyManagement_Ssa_RootCert/CSM_E_KEY_NOT_AVAILABLE, CsmKeyManagement_Ssa_RootCert/CSM_E_KEY_READ_FAIL, CsmKeyManagement_Ssa_RootCert/CSM_E_SMALL_BUFFER, CsmKeyManagement_Ssa_RootCert/E_NOT_OK, CsmKeyManagement_Ssa_RootCert/CSM_E_KEY_EMPTY]  # Retrieves the key element bytes from a specific key element of the key and stores the key element in the provided buffer.
        arg keyElementId: type=uint32, direction=IN, server-argument-impl-policy=USE-ARGUMENT-TYPE
        arg keyPtr: type=Csm_KeyDataType_Ssa_RootCert, direction=OUT, server-argument-impl-policy=USE-ARRAY-BASE-TYPE
        arg keyLength: type=uint32, direction=INOUT, server-argument-impl-policy=USE-ARGUMENT-TYPE
      operation KeyElementSet: possible-error=[CsmKeyManagement_Ssa_RootCert/CSM_E_BUSY, CsmKeyManagement_Ssa_RootCert/CSM_E_KEY_NOT_AVAILABLE, CsmKeyManagement_Ssa_RootCert/CSM_E_KEY_SIZE_MISMATCH, CsmKeyManagement_Ssa_RootCert/CSM_E_KEY_WRITE_FAIL, CsmKeyManagement_Ssa_RootCert/CSM_E_SMALL_BUFFER, CsmKeyManagement_Ssa_RootCert/E_NOT_OK]  # Sets the given key element bytes to the key.
        arg keyElementId: type=uint32, direction=IN, server-argument-impl-policy=USE-ARGUMENT-TYPE
        arg keyPtr: type=Csm_KeyDataType_Ssa_RootCert, direction=IN, server-argument-impl-policy=USE-ARRAY-BASE-TYPE
        arg keyLength: type=uint32, direction=IN, server-argument-impl-policy=USE-ARGUMENT-TYPE
      operation KeySetValid: possible-error=[CsmKeyManagement_Ssa_RootCert/CSM_E_BUSY, CsmKeyManagement_Ssa_RootCert/E_NOT_OK]  # Sets the given key element bytes to the key.
      8 x error:
        CSM_E_BUSY: error-code=2  # The service request failed because the service is still busy.
        CSM_E_KEY_NOT_AVAILABLE: error-code=8  # The service request failed because the key is not available.
        CSM_E_KEY_READ_FAIL: error-code=6  # The service request failed because read access was denied.
        CSM_E_KEY_SIZE_MISMATCH: error-code=10  # The service request failed because the key element is not partially accessible and the provided key element length is too short or too long for that key element.
        CSM_E_KEY_WRITE_FAIL: error-code=7  # The service request failed because write access was denied.
        CSM_E_SMALL_BUFFER: error-code=3  # The service request failed because the provided buffer is too small to store the result.
        E_NOT_OK: error-code=1  # The service request failed.
        CSM_E_KEY_EMPTY: error-code=13
    CsmMacVerify_MacVerifyAesCmacVin  # A message authentication code (MAC) is a short piece of information used to authenticate a message. A MAC algorithm accepts as input a secret key and an arbitrary-length message to be authenticated, and outputs a MAC. The MAC value protects both a message's data integrity as well as its authenticity, by allowing verifiers (who also possess the secret key) to detect any changes to the message content.
      operation MacVerify: possible-error=[CsmMacVerify_MacVerifyAesCmacVin/E_NOT_OK, CsmMacVerify_MacVerifyAesCmacVin/CSM_E_BUSY, CsmMacVerify_MacVerifyAesCmacVin/CSM_E_KEY_EMPTY, CsmMacVerify_MacVerifyAesCmacVin/CSM_E_KEY_NOT_VALID, CsmMacVerify_MacVerifyAesCmacVin/CSM_E_KEY_SIZE_MISMATCH, CsmMacVerify_MacVerifyAesCmacVin/CSM_E_SMALL_BUFFER]  # This interface shall be used to start the MAC verification service of the CSM module.
        5 x arg:
          dataBuffer: type=Csm_DataType_MacAesCmacVin, direction=IN, server-argument-impl-policy=USE-ARRAY-BASE-TYPE
          dataLength: type=uint32, direction=IN, server-argument-impl-policy=USE-ARGUMENT-TYPE
          macBuffer: type=Csm_MacVerifyCompareType_MacVerifyAesCmac, direction=IN, server-argument-impl-policy=USE-ARRAY-BASE-TYPE
          macLength: type=uint32, direction=IN, server-argument-impl-policy=USE-ARGUMENT-TYPE
          verifyBuffer: type=Crypto_VerifyResultType, direction=OUT, server-argument-impl-policy=USE-ARGUMENT-TYPE
      7 x error:
        CSM_E_BUSY: error-code=2  # The service request failed because the service is still busy.
        CSM_E_JOB_CANCELED: error-code=12
        CSM_E_KEY_EMPTY: error-code=13
        CSM_E_KEY_NOT_VALID: error-code=9
        CSM_E_KEY_SIZE_MISMATCH: error-code=10
        CSM_E_SMALL_BUFFER: error-code=3  # The service request failed because the provided buffer is too small to store the result.
        E_NOT_OK: error-code=1  # The service request failed.
    CsmMacVerify_MacVerifyAesCmacAuth  # A message authentication code (MAC) is a short piece of information used to authenticate a message. A MAC algorithm accepts as input a secret key and an arbitrary-length message to be authenticated, and outputs a MAC. The MAC value protects both a message's data integrity as well as its authenticity, by allowing verifiers (who also possess the secret key) to detect any changes to the message content.
      operation MacVerify: possible-error=[CsmMacVerify_MacVerifyAesCmacAuth/CSM_E_BUSY, CsmMacVerify_MacVerifyAesCmacAuth/CSM_E_KEY_EMPTY, CsmMacVerify_MacVerifyAesCmacAuth/CSM_E_KEY_NOT_VALID, CsmMacVerify_MacVerifyAesCmacAuth/CSM_E_KEY_SIZE_MISMATCH, CsmMacVerify_MacVerifyAesCmacAuth/CSM_E_SMALL_BUFFER, CsmMacVerify_MacVerifyAesCmacAuth/E_NOT_OK]  # This interface shall be used to start the MAC verification service of the CSM module.
        5 x arg:
          dataBuffer: type=Csm_DataType_MacAesCmacAuth, direction=IN, server-argument-impl-policy=USE-ARRAY-BASE-TYPE
          dataLength: type=uint32, direction=IN, server-argument-impl-policy=USE-ARGUMENT-TYPE
          macBuffer: type=Csm_MacVerifyCompareType_MacVerifyAesCmac, direction=IN, server-argument-impl-policy=USE-ARRAY-BASE-TYPE
          macLength: type=uint32, direction=IN, server-argument-impl-policy=USE-ARGUMENT-TYPE
          verifyBuffer: type=Crypto_VerifyResultType, direction=OUT, server-argument-impl-policy=USE-ARGUMENT-TYPE
      7 x error:
        CSM_E_BUSY: error-code=2  # The service request failed because the service is still busy.
        CSM_E_SMALL_BUFFER: error-code=3  # The service request failed because the provided buffer is too small to store the result.
        E_NOT_OK: error-code=1  # The service request failed.
        CSM_E_JOB_CANCELED: error-code=12
        CSM_E_KEY_EMPTY: error-code=13
        CSM_E_KEY_NOT_VALID: error-code=9
        CSM_E_KEY_SIZE_MISMATCH: error-code=10
    CsmKeyManagement_Ssa_TrustModelEcuLivePublicKey  # Interface to execute the key management functions.
      5 x operation:
        KeyCopy: possible-error=[CsmKeyManagement_Ssa_TrustModelEcuLivePublicKey/CSM_E_BUSY, CsmKeyManagement_Ssa_TrustModelEcuLivePublicKey/CSM_E_KEY_EMPTY, CsmKeyManagement_Ssa_TrustModelEcuLivePublicKey/E_NOT_OK, CsmKeyManagement_Ssa_TrustModelEcuLivePublicKey/CSM_E_KEY_READ_FAIL, CsmKeyManagement_Ssa_TrustModelEcuLivePublicKey/CSM_E_KEY_SIZE_MISMATCH, CsmKeyManagement_Ssa_TrustModelEcuLivePublicKey/CSM_E_KEY_WRITE_FAIL, CsmKeyManagement_Ssa_TrustModelEcuLivePublicKey/CSM_E_SMALL_BUFFER]  # This function shall copy all key elements from the source key to a target key.
          arg targetKeyId: type=uint32, direction=IN, server-argument-impl-policy=USE-ARGUMENT-TYPE
        KeyElementCopy: possible-error=[CsmKeyManagement_Ssa_TrustModelEcuLivePublicKey/CSM_E_BUSY, CsmKeyManagement_Ssa_TrustModelEcuLivePublicKey/CSM_E_KEY_EMPTY, CsmKeyManagement_Ssa_TrustModelEcuLivePublicKey/E_NOT_OK, CsmKeyManagement_Ssa_TrustModelEcuLivePublicKey/CSM_E_KEY_READ_FAIL, CsmKeyManagement_Ssa_TrustModelEcuLivePublicKey/CSM_E_KEY_SIZE_MISMATCH, CsmKeyManagement_Ssa_TrustModelEcuLivePublicKey/CSM_E_KEY_WRITE_FAIL, CsmKeyManagement_Ssa_TrustModelEcuLivePublicKey/CSM_E_SMALL_BUFFER]  # This function shall copy a key elements from one key to a target key.
          arg keyElementId: type=uint32, direction=IN, server-argument-impl-policy=USE-ARGUMENT-TYPE
          arg targetKeyId: type=uint32, direction=IN, server-argument-impl-policy=USE-ARGUMENT-TYPE
          arg targetKeyElementId: type=uint32, direction=IN, server-argument-impl-policy=USE-ARGUMENT-TYPE
        KeyElementGet: possible-error=[CsmKeyManagement_Ssa_TrustModelEcuLivePublicKey/CSM_E_BUSY, CsmKeyManagement_Ssa_TrustModelEcuLivePublicKey/CSM_E_KEY_EMPTY, CsmKeyManagement_Ssa_TrustModelEcuLivePublicKey/CSM_E_KEY_READ_FAIL, CsmKeyManagement_Ssa_TrustModelEcuLivePublicKey/CSM_E_SMALL_BUFFER, CsmKeyManagement_Ssa_TrustModelEcuLivePublicKey/E_NOT_OK, CsmKeyManagement_Ssa_TrustModelEcuLivePublicKey/CSM_E_KEY_NOT_AVAILABLE]  # Retrieves the key element bytes from a specific key element of the key and stores the key element in the provided buffer.
          arg keyElementId: type=uint32, direction=IN, server-argument-impl-policy=USE-ARGUMENT-TYPE
          arg keyPtr: type=Csm_KeyDataType_Ssa_TrustModelEcuLivePublicKey, direction=OUT, server-argument-impl-policy=USE-ARRAY-BASE-TYPE
          arg keyLength: type=uint32, direction=INOUT, server-argument-impl-policy=USE-ARGUMENT-TYPE
        KeyElementSet: possible-error=[CsmKeyManagement_Ssa_TrustModelEcuLivePublicKey/CSM_E_BUSY, CsmKeyManagement_Ssa_TrustModelEcuLivePublicKey/CSM_E_KEY_SIZE_MISMATCH, CsmKeyManagement_Ssa_TrustModelEcuLivePublicKey/CSM_E_KEY_WRITE_FAIL, CsmKeyManagement_Ssa_TrustModelEcuLivePublicKey/E_NOT_OK, CsmKeyManagement_Ssa_TrustModelEcuLivePublicKey/CSM_E_KEY_NOT_AVAILABLE]  # Sets the given key element bytes to the key.
          arg keyElementId: type=uint32, direction=IN, server-argument-impl-policy=USE-ARGUMENT-TYPE
          arg keyPtr: type=Csm_KeyDataType_Ssa_TrustModelEcuLivePublicKey, direction=IN, server-argument-impl-policy=USE-ARRAY-BASE-TYPE
          arg keyLength: type=uint32, direction=IN, server-argument-impl-policy=USE-ARGUMENT-TYPE
        KeySetValid: possible-error=[CsmKeyManagement_Ssa_TrustModelEcuLivePublicKey/CSM_E_BUSY, CsmKeyManagement_Ssa_TrustModelEcuLivePublicKey/E_NOT_OK]  # Sets the given key element bytes to the key.
      8 x error:
        CSM_E_BUSY: error-code=2  # The service request failed because the service is still busy.
        CSM_E_KEY_EMPTY: error-code=13  # The service request failed because of uninitialized source key element.
        CSM_E_KEY_NOT_AVAILABLE: error-code=8  # The service request failed because the key is not available.
        CSM_E_KEY_READ_FAIL: error-code=6  # The service request failed because read access was denied.
        CSM_E_KEY_SIZE_MISMATCH: error-code=10  # The service request failed because the key element is not partially accessible and the provided key element length is too short or too long for that key element.
        CSM_E_KEY_WRITE_FAIL: error-code=7  # The service request failed because write access was denied.
        CSM_E_SMALL_BUFFER: error-code=3  # The service request failed because the provided buffer is too small to store the result.
        E_NOT_OK: error-code=1  # The service request failed.
    CsmRandomGenerate_Random  # Starts the random number generation service of the CSM module.
      operation RandomGenerate: possible-error=[CsmRandomGenerate_Random/CSM_E_BUSY, CSM_E_ENTROPY_EXHAUSTION, CsmRandomGenerate_Random/E_NOT_OK]  # This interface shall be used to start the random generate service of the CSM module.
        arg resultBuffer: type=Csm_RandomGenerateResultType_Random, direction=OUT, server-argument-impl-policy=USE-ARRAY-BASE-TYPE
        arg resultLength: type=uint32, direction=INOUT, server-argument-impl-policy=USE-ARGUMENT-TYPE
      error CSM_E_BUSY: error-code=2  # The service request failed because the service is still busy.
      error CSM_E_ENTROPY_EXHAUSTION: error-code=4  # The service request failed because the entropy of the random number generator is exhausted.
      error E_NOT_OK: error-code=1  # The service request failed.
    CsmKeyManagement_Ssa_SharedSecretHash  # Interface to execute the key management functions.
      operation KeyElementGet: possible-error=[CsmKeyManagement_Ssa_SharedSecretHash/CSM_E_BUSY, CsmKeyManagement_Ssa_SharedSecretHash/CSM_E_KEY_NOT_AVAILABLE, CsmKeyManagement_Ssa_SharedSecretHash/CSM_E_KEY_READ_FAIL, CsmKeyManagement_Ssa_SharedSecretHash/CSM_E_SMALL_BUFFER, CsmKeyManagement_Ssa_SharedSecretHash/E_NOT_OK, CsmKeyManagement_Ssa_SharedSecretHash/CSM_E_KEY_EMPTY]  # Retrieves the key element bytes from a specific key element of the key and stores the key element in the provided buffer.
        arg keyElementId: type=uint32, direction=IN, server-argument-impl-policy=USE-ARGUMENT-TYPE
        arg keyPtr: type=Csm_KeyDataType_Ssa_SharedSecretHash, direction=OUT, server-argument-impl-policy=USE-ARRAY-BASE-TYPE
        arg keyLength: type=uint32, direction=INOUT, server-argument-impl-policy=USE-ARGUMENT-TYPE
      operation KeyElementSet: possible-error=[CsmKeyManagement_Ssa_SharedSecretHash/CSM_E_BUSY, CsmKeyManagement_Ssa_SharedSecretHash/CSM_E_KEY_NOT_AVAILABLE, CsmKeyManagement_Ssa_SharedSecretHash/CSM_E_KEY_SIZE_MISMATCH, CsmKeyManagement_Ssa_SharedSecretHash/CSM_E_KEY_WRITE_FAIL, CsmKeyManagement_Ssa_SharedSecretHash/CSM_E_SMALL_BUFFER, CsmKeyManagement_Ssa_SharedSecretHash/E_NOT_OK]  # Sets the given key element bytes to the key.
        arg keyElementId: type=uint32, direction=IN, server-argument-impl-policy=USE-ARGUMENT-TYPE
        arg keyPtr: type=Csm_KeyDataType_Ssa_SharedSecretHash, direction=IN, server-argument-impl-policy=USE-ARRAY-BASE-TYPE
        arg keyLength: type=uint32, direction=IN, server-argument-impl-policy=USE-ARGUMENT-TYPE
      operation KeySetValid: possible-error=[CsmKeyManagement_Ssa_SharedSecretHash/CSM_E_BUSY, CsmKeyManagement_Ssa_SharedSecretHash/E_NOT_OK]  # Sets the given key element bytes to the key.
      8 x error:
        CSM_E_BUSY: error-code=2  # The service request failed because the service is still busy.
        CSM_E_KEY_NOT_AVAILABLE: error-code=8  # The service request failed because the key is not available.
        CSM_E_KEY_READ_FAIL: error-code=6  # The service request failed because read access was denied.
        CSM_E_KEY_SIZE_MISMATCH: error-code=10  # The service request failed because the key element is not partially accessible and the provided key element length is too short or too long for that key element.
        CSM_E_KEY_WRITE_FAIL: error-code=7  # The service request failed because write access was denied.
        CSM_E_SMALL_BUFFER: error-code=3  # The service request failed because the provided buffer is too small to store the result.
        E_NOT_OK: error-code=1  # The service request failed.
        CSM_E_KEY_EMPTY: error-code=13
    CsmJobKeyExchangeCalcSecret  # Interface to execute calculation of shared secret for key exchange.
      operation CancelJob: possible-error=[CsmJobKeyExchangeCalcSecret/CSM_E_JOB_CANCELED, CsmJobKeyExchangeCalcSecret/E_NOT_OK]  # Cancels the Job.
      operation KeyExchangeCalcSecret: possible-error=[CsmJobKeyExchangeCalcSecret/CSM_E_BUSY, CsmJobKeyExchangeCalcSecret/CSM_E_KEY_EMPTY, CsmJobKeyExchangeCalcSecret/CSM_E_SMALL_BUFFER, CsmJobKeyExchangeCalcSecret/E_NOT_OK]  # Calculates the shared secret key for the key exchange with the key material of the key identified by the key and the partner public key. The shared secret key is stored as a key element in the same key.
        arg key: type=uint32, direction=IN, server-argument-impl-policy=USE-ARGUMENT-TYPE
        arg partnerPublicValuePtr: type=Csm_const_DataPtr, direction=IN, server-argument-impl-policy=USE-ARGUMENT-TYPE
        arg partnerPublicValueLength: type=uint32, direction=IN, server-argument-impl-policy=USE-ARGUMENT-TYPE
      5 x error:
        CSM_E_BUSY: error-code=2  # The service request failed because the service is still busy.
        CSM_E_JOB_CANCELED: error-code=12  # The job has been marked to be aborted at the next opportunity. It will be further processed until the job finish notification.
        CSM_E_KEY_EMPTY: error-code=13  # The service request failed because of uninitialized source key element.
        CSM_E_SMALL_BUFFER: error-code=3  # The service request failed because the provided buffer is too small to store the result.
        E_NOT_OK: error-code=1  # The service request failed.
    CsmJobKeyGenerate  # Interface to execute key generation.
      operation CancelJob: possible-error=[CsmJobKeyGenerate/CSM_E_JOB_CANCELED, CsmJobKeyGenerate/E_NOT_OK]  # Cancels the Job.
      operation KeyGenerate: possible-error=[CsmJobKeyGenerate/CSM_E_BUSY, CsmJobKeyGenerate/CSM_E_KEY_EMPTY, CsmJobKeyGenerate/E_NOT_OK]  # Generates new key material and stores it in the key identified by key.
        arg key: type=uint32, direction=IN, server-argument-impl-policy=USE-ARGUMENT-TYPE
      4 x error:
        CSM_E_BUSY: error-code=2  # The service request failed because the service is still busy.
        CSM_E_JOB_CANCELED: error-code=12  # The job has been marked to be aborted at the next opportunity. It will be further processed until the job finish notification.
        CSM_E_KEY_EMPTY: error-code=13  # The service request failed because of uninitialized source key element.
        E_NOT_OK: error-code=1  # The service request failed.
    CsmJobRandomSeed  # Interface to random seed operation.
      operation CancelJob: possible-error=[CsmJobRandomSeed/CSM_E_JOB_CANCELED, CsmJobRandomSeed/E_NOT_OK]  # Cancels the Job.
      operation RandomSeed: possible-error=[CsmJobRandomSeed/CSM_E_BUSY, CsmJobRandomSeed/E_NOT_OK]  # Utilize the random seed service.
        arg key: type=uint32, direction=IN, server-argument-impl-policy=USE-ARGUMENT-TYPE
        arg seedPtr: type=Csm_const_DataPtr, direction=IN, server-argument-impl-policy=USE-ARGUMENT-TYPE
        arg seedLength: type=uint32, direction=IN, server-argument-impl-policy=USE-ARGUMENT-TYPE
      error CSM_E_BUSY: error-code=2  # The service request failed because the service is still busy.
      error CSM_E_JOB_CANCELED: error-code=12  # The job has been marked to be aborted at the next opportunity. It will be further processed until the job finish notification.
      error E_NOT_OK: error-code=1  # The service request failed.
    CsmKeyManagement_Ssa_TrustModelEcuStagingPrivateKey  # Interface to execute the key management functions.
      5 x operation:
        KeyCopy: possible-error=[CsmKeyManagement_Ssa_TrustModelEcuStagingPrivateKey/CSM_E_BUSY, CsmKeyManagement_Ssa_TrustModelEcuStagingPrivateKey/CSM_E_KEY_EMPTY, CsmKeyManagement_Ssa_TrustModelEcuStagingPrivateKey/E_NOT_OK, CsmKeyManagement_Ssa_TrustModelEcuStagingPrivateKey/CSM_E_KEY_READ_FAIL, CsmKeyManagement_Ssa_TrustModelEcuStagingPrivateKey/CSM_E_KEY_SIZE_MISMATCH, CsmKeyManagement_Ssa_TrustModelEcuStagingPrivateKey/CSM_E_KEY_WRITE_FAIL, CsmKeyManagement_Ssa_TrustModelEcuStagingPrivateKey/CSM_E_SMALL_BUFFER]  # This function shall copy all key elements from the source key to a target key.
          arg targetKeyId: type=uint32, direction=IN, server-argument-impl-policy=USE-ARGUMENT-TYPE
        KeyElementCopy: possible-error=[CsmKeyManagement_Ssa_TrustModelEcuStagingPrivateKey/CSM_E_BUSY, CsmKeyManagement_Ssa_TrustModelEcuStagingPrivateKey/CSM_E_KEY_EMPTY, CsmKeyManagement_Ssa_TrustModelEcuStagingPrivateKey/E_NOT_OK, CsmKeyManagement_Ssa_TrustModelEcuStagingPrivateKey/CSM_E_KEY_READ_FAIL, CsmKeyManagement_Ssa_TrustModelEcuStagingPrivateKey/CSM_E_KEY_SIZE_MISMATCH, CsmKeyManagement_Ssa_TrustModelEcuStagingPrivateKey/CSM_E_KEY_WRITE_FAIL, CsmKeyManagement_Ssa_TrustModelEcuStagingPrivateKey/CSM_E_SMALL_BUFFER]  # This function shall copy a key elements from one key to a target key.
          arg keyElementId: type=uint32, direction=IN, server-argument-impl-policy=USE-ARGUMENT-TYPE
          arg targetKeyId: type=uint32, direction=IN, server-argument-impl-policy=USE-ARGUMENT-TYPE
          arg targetKeyElementId: type=uint32, direction=IN, server-argument-impl-policy=USE-ARGUMENT-TYPE
        KeyElementGet: possible-error=[CsmKeyManagement_Ssa_TrustModelEcuStagingPrivateKey/CSM_E_BUSY, CsmKeyManagement_Ssa_TrustModelEcuStagingPrivateKey/CSM_E_KEY_EMPTY, CsmKeyManagement_Ssa_TrustModelEcuStagingPrivateKey/CSM_E_KEY_READ_FAIL, CsmKeyManagement_Ssa_TrustModelEcuStagingPrivateKey/CSM_E_SMALL_BUFFER, CsmKeyManagement_Ssa_TrustModelEcuStagingPrivateKey/E_NOT_OK, CsmKeyManagement_Ssa_TrustModelEcuStagingPrivateKey/CSM_E_KEY_NOT_AVAILABLE]  # Retrieves the key element bytes from a specific key element of the key and stores the key element in the provided buffer.
          arg keyElementId: type=uint32, direction=IN, server-argument-impl-policy=USE-ARGUMENT-TYPE
          arg keyPtr: type=Csm_KeyDataType_Ssa_TrustModelEcuStagingPrivateKey, direction=OUT, server-argument-impl-policy=USE-ARRAY-BASE-TYPE
          arg keyLength: type=uint32, direction=INOUT, server-argument-impl-policy=USE-ARGUMENT-TYPE
        KeyElementSet: possible-error=[CsmKeyManagement_Ssa_TrustModelEcuStagingPrivateKey/CSM_E_BUSY, CsmKeyManagement_Ssa_TrustModelEcuStagingPrivateKey/CSM_E_KEY_SIZE_MISMATCH, CsmKeyManagement_Ssa_TrustModelEcuStagingPrivateKey/CSM_E_KEY_WRITE_FAIL, CsmKeyManagement_Ssa_TrustModelEcuStagingPrivateKey/E_NOT_OK, CsmKeyManagement_Ssa_TrustModelEcuStagingPrivateKey/CSM_E_KEY_NOT_AVAILABLE]  # Sets the given key element bytes to the key.
          arg keyElementId: type=uint32, direction=IN, server-argument-impl-policy=USE-ARGUMENT-TYPE
          arg keyPtr: type=Csm_KeyDataType_Ssa_TrustModelEcuStagingPrivateKey, direction=IN, server-argument-impl-policy=USE-ARRAY-BASE-TYPE
          arg keyLength: type=uint32, direction=IN, server-argument-impl-policy=USE-ARGUMENT-TYPE
        KeySetValid: possible-error=[CsmKeyManagement_Ssa_TrustModelEcuStagingPrivateKey/CSM_E_BUSY, CsmKeyManagement_Ssa_TrustModelEcuStagingPrivateKey/E_NOT_OK]  # Sets the given key element bytes to the key.
      8 x error:
        CSM_E_BUSY: error-code=2  # The service request failed because the service is still busy.
        CSM_E_KEY_EMPTY: error-code=13  # The service request failed because of uninitialized source key element.
        CSM_E_KEY_NOT_AVAILABLE: error-code=8  # The service request failed because the key is not available.
        CSM_E_KEY_READ_FAIL: error-code=6  # The service request failed because read access was denied.
        CSM_E_KEY_SIZE_MISMATCH: error-code=10  # The service request failed because the key element is not partially accessible and the provided key element length is too short or too long for that key element.
        CSM_E_KEY_WRITE_FAIL: error-code=7  # The service request failed because write access was denied.
        CSM_E_SMALL_BUFFER: error-code=3  # The service request failed because the provided buffer is too small to store the result.
        E_NOT_OK: error-code=1  # The service request failed.
    CsmKeyManagement_Ssa_SharedSecretKeyExchange  # Interface to execute the key management functions.
      5 x operation:
        KeyElementGet: possible-error=[CsmKeyManagement_Ssa_SharedSecretKeyExchange/CSM_E_BUSY, CsmKeyManagement_Ssa_SharedSecretKeyExchange/CSM_E_KEY_NOT_AVAILABLE, CsmKeyManagement_Ssa_SharedSecretKeyExchange/CSM_E_KEY_READ_FAIL, CsmKeyManagement_Ssa_SharedSecretKeyExchange/CSM_E_SMALL_BUFFER, CsmKeyManagement_Ssa_SharedSecretKeyExchange/E_NOT_OK, CsmKeyManagement_Ssa_SharedSecretKeyExchange/CSM_E_KEY_EMPTY]  # Retrieves the key element bytes from a specific key element of the key and stores the key element in the provided buffer.
          arg keyElementId: type=uint32, direction=IN, server-argument-impl-policy=USE-ARGUMENT-TYPE
          arg keyPtr: type=Csm_KeyDataType_Ssa_SharedSecretKeyExchange, direction=OUT, server-argument-impl-policy=USE-ARRAY-BASE-TYPE
          arg keyLength: type=uint32, direction=INOUT, server-argument-impl-policy=USE-ARGUMENT-TYPE
        KeyElementSet: possible-error=[CsmKeyManagement_Ssa_SharedSecretKeyExchange/CSM_E_BUSY, CsmKeyManagement_Ssa_SharedSecretKeyExchange/CSM_E_KEY_NOT_AVAILABLE, CsmKeyManagement_Ssa_SharedSecretKeyExchange/CSM_E_KEY_SIZE_MISMATCH, CsmKeyManagement_Ssa_SharedSecretKeyExchange/CSM_E_KEY_WRITE_FAIL, CsmKeyManagement_Ssa_SharedSecretKeyExchange/CSM_E_SMALL_BUFFER, CsmKeyManagement_Ssa_SharedSecretKeyExchange/E_NOT_OK]  # Sets the given key element bytes to the key.
          arg keyElementId: type=uint32, direction=IN, server-argument-impl-policy=USE-ARGUMENT-TYPE
          arg keyPtr: type=Csm_KeyDataType_Ssa_SharedSecretKeyExchange, direction=IN, server-argument-impl-policy=USE-ARRAY-BASE-TYPE
          arg keyLength: type=uint32, direction=IN, server-argument-impl-policy=USE-ARGUMENT-TYPE
        KeyExchangeCalcPubVal: possible-error=[CsmKeyManagement_Ssa_SharedSecretKeyExchange/CSM_E_BUSY, CsmKeyManagement_Ssa_SharedSecretKeyExchange/E_NOT_OK, CsmKeyManagement_Ssa_SharedSecretKeyExchange/CSM_E_KEY_EMPTY, CsmKeyManagement_Ssa_SharedSecretKeyExchange/CSM_E_SMALL_BUFFER]  # Calculates the public value of the current user for the key exchange and stores the public key in the provided buffer.
          arg publicValuePtr: type=Csm_PublicValueDataType_Ssa_SharedSecretKeyExchange, direction=OUT, server-argument-impl-policy=USE-ARRAY-BASE-TYPE
          arg publicValueLengthPtr: type=uint32, direction=INOUT, server-argument-impl-policy=USE-ARGUMENT-TYPE
        KeyExchangeCalcSecret: possible-error=[CsmKeyManagement_Ssa_SharedSecretKeyExchange/CSM_E_BUSY, CsmKeyManagement_Ssa_SharedSecretKeyExchange/E_NOT_OK, CsmKeyManagement_Ssa_SharedSecretKeyExchange/CSM_E_KEY_EMPTY, CsmKeyManagement_Ssa_SharedSecretKeyExchange/CSM_E_SMALL_BUFFER]  # Calculates the shared secret key for the key exchange with the key material of the key identified by the keyId and the partner public key. The shared secret key is stored as a key element in the same key.
          arg partnerPublicValuePtr: type=Csm_PublicValueDataType_Ssa_SharedSecretKeyExchange, direction=IN, server-argument-impl-policy=USE-ARRAY-BASE-TYPE
          arg partnerPublicValueLength: type=uint32, direction=IN, server-argument-impl-policy=USE-ARGUMENT-TYPE
        KeySetValid: possible-error=[CsmKeyManagement_Ssa_SharedSecretKeyExchange/CSM_E_BUSY, CsmKeyManagement_Ssa_SharedSecretKeyExchange/E_NOT_OK]  # Sets the given key element bytes to the key.
      8 x error:
        CSM_E_BUSY: error-code=2  # The service request failed because the service is still busy.
        CSM_E_KEY_NOT_AVAILABLE: error-code=8  # The service request failed because the key is not available.
        CSM_E_KEY_READ_FAIL: error-code=6  # The service request failed because read access was denied.
        CSM_E_KEY_SIZE_MISMATCH: error-code=10  # The service request failed because the key element is not partially accessible and the provided key element length is too short or too long for that key element.
        CSM_E_KEY_WRITE_FAIL: error-code=7  # The service request failed because write access was denied.
        CSM_E_SMALL_BUFFER: error-code=3  # The service request failed because the provided buffer is too small to store the result.
        E_NOT_OK: error-code=1  # The service request failed.
        CSM_E_KEY_EMPTY: error-code=13
    CsmKeyManagement_Ssa_SignatureRamKey  # Interface to execute the key management functions.
      operation KeyElementGet: possible-error=[CsmKeyManagement_Ssa_SignatureRamKey/CSM_E_BUSY, CsmKeyManagement_Ssa_SignatureRamKey/CSM_E_KEY_NOT_AVAILABLE, CsmKeyManagement_Ssa_SignatureRamKey/CSM_E_KEY_READ_FAIL, CsmKeyManagement_Ssa_SignatureRamKey/CSM_E_SMALL_BUFFER, CsmKeyManagement_Ssa_SignatureRamKey/E_NOT_OK, CsmKeyManagement_Ssa_SignatureRamKey/CSM_E_KEY_EMPTY]  # Retrieves the key element bytes from a specific key element of the key and stores the key element in the provided buffer.
        arg keyElementId: type=uint32, direction=IN, server-argument-impl-policy=USE-ARGUMENT-TYPE
        arg keyPtr: type=Csm_KeyDataType_Ssa_SignatureRamKey, direction=OUT, server-argument-impl-policy=USE-ARRAY-BASE-TYPE
        arg keyLength: type=uint32, direction=INOUT, server-argument-impl-policy=USE-ARGUMENT-TYPE
      operation KeyElementSet: possible-error=[CsmKeyManagement_Ssa_SignatureRamKey/CSM_E_BUSY, CsmKeyManagement_Ssa_SignatureRamKey/CSM_E_KEY_NOT_AVAILABLE, CsmKeyManagement_Ssa_SignatureRamKey/CSM_E_KEY_SIZE_MISMATCH, CsmKeyManagement_Ssa_SignatureRamKey/CSM_E_KEY_WRITE_FAIL, CsmKeyManagement_Ssa_SignatureRamKey/CSM_E_SMALL_BUFFER, CsmKeyManagement_Ssa_SignatureRamKey/E_NOT_OK]  # Sets the given key element bytes to the key.
        arg keyElementId: type=uint32, direction=IN, server-argument-impl-policy=USE-ARGUMENT-TYPE
        arg keyPtr: type=Csm_KeyDataType_Ssa_SignatureRamKey, direction=IN, server-argument-impl-policy=USE-ARRAY-BASE-TYPE
        arg keyLength: type=uint32, direction=IN, server-argument-impl-policy=USE-ARGUMENT-TYPE
      operation KeySetValid: possible-error=[CsmKeyManagement_Ssa_SignatureRamKey/CSM_E_BUSY, CsmKeyManagement_Ssa_SignatureRamKey/E_NOT_OK]  # Sets the given key element bytes to the key.
      8 x error:
        CSM_E_BUSY: error-code=2  # The service request failed because the service is still busy.
        CSM_E_KEY_NOT_AVAILABLE: error-code=8  # The service request failed because the key is not available.
        CSM_E_KEY_READ_FAIL: error-code=6  # The service request failed because read access was denied.
        CSM_E_KEY_SIZE_MISMATCH: error-code=10  # The service request failed because the key element is not partially accessible and the provided key element length is too short or too long for that key element.
        CSM_E_KEY_WRITE_FAIL: error-code=7  # The service request failed because write access was denied.
        CSM_E_SMALL_BUFFER: error-code=3  # The service request failed because the provided buffer is too small to store the result.
        E_NOT_OK: error-code=1  # The service request failed.
        CSM_E_KEY_EMPTY: error-code=13
    CsmKeyManagement_Ssa_SigPubKey_ReplacementAuthority  # Interface to execute the key management functions.
      5 x operation:
        KeyCopy: possible-error=[CsmKeyManagement_Ssa_SigPubKey_ReplacementAuthority/CSM_E_BUSY, CsmKeyManagement_Ssa_SigPubKey_ReplacementAuthority/CSM_E_KEY_EMPTY, CsmKeyManagement_Ssa_SigPubKey_ReplacementAuthority/CSM_E_KEY_READ_FAIL, CsmKeyManagement_Ssa_SigPubKey_ReplacementAuthority/CSM_E_KEY_SIZE_MISMATCH, CsmKeyManagement_Ssa_SigPubKey_ReplacementAuthority/CSM_E_KEY_WRITE_FAIL, CsmKeyManagement_Ssa_SigPubKey_ReplacementAuthority/CSM_E_SMALL_BUFFER, CsmKeyManagement_Ssa_SigPubKey_ReplacementAuthority/E_NOT_OK]  # This function shall copy all key elements from the source key to a target key.
          arg targetKeyId: type=uint32, direction=IN, server-argument-impl-policy=USE-ARGUMENT-TYPE
        KeyElementCopy: possible-error=[CsmKeyManagement_Ssa_SigPubKey_ReplacementAuthority/CSM_E_BUSY, CsmKeyManagement_Ssa_SigPubKey_ReplacementAuthority/CSM_E_KEY_EMPTY, CsmKeyManagement_Ssa_SigPubKey_ReplacementAuthority/CSM_E_KEY_READ_FAIL, CsmKeyManagement_Ssa_SigPubKey_ReplacementAuthority/CSM_E_KEY_SIZE_MISMATCH, CsmKeyManagement_Ssa_SigPubKey_ReplacementAuthority/CSM_E_KEY_WRITE_FAIL, CsmKeyManagement_Ssa_SigPubKey_ReplacementAuthority/CSM_E_SMALL_BUFFER, CsmKeyManagement_Ssa_SigPubKey_ReplacementAuthority/E_NOT_OK]  # This function shall copy a key elements from one key to a target key.
          arg keyElementId: type=uint32, direction=IN, server-argument-impl-policy=USE-ARGUMENT-TYPE
          arg targetKeyId: type=uint32, direction=IN, server-argument-impl-policy=USE-ARGUMENT-TYPE
          arg targetKeyElementId: type=uint32, direction=IN, server-argument-impl-policy=USE-ARGUMENT-TYPE
        KeyElementGet: possible-error=[CsmKeyManagement_Ssa_SigPubKey_ReplacementAuthority/CSM_E_BUSY, CsmKeyManagement_Ssa_SigPubKey_ReplacementAuthority/CSM_E_KEY_EMPTY, CsmKeyManagement_Ssa_SigPubKey_ReplacementAuthority/CSM_E_KEY_NOT_AVAILABLE, CsmKeyManagement_Ssa_SigPubKey_ReplacementAuthority/CSM_E_KEY_READ_FAIL, CsmKeyManagement_Ssa_SigPubKey_ReplacementAuthority/CSM_E_SMALL_BUFFER, CsmKeyManagement_Ssa_SigPubKey_ReplacementAuthority/E_NOT_OK]  # Retrieves the key element bytes from a specific key element of the key and stores the key element in the provided buffer.
          arg keyElementId: type=uint32, direction=IN, server-argument-impl-policy=USE-ARGUMENT-TYPE
          arg keyPtr: type=Csm_KeyDataType_Ssa_SigPubKey_ReplacementAuthority, direction=OUT, server-argument-impl-policy=USE-ARRAY-BASE-TYPE
          arg keyLength: type=uint32, direction=INOUT, server-argument-impl-policy=USE-ARGUMENT-TYPE
        KeyElementSet: possible-error=[CsmKeyManagement_Ssa_SigPubKey_ReplacementAuthority/CSM_E_BUSY, CsmKeyManagement_Ssa_SigPubKey_ReplacementAuthority/CSM_E_KEY_NOT_AVAILABLE, CsmKeyManagement_Ssa_SigPubKey_ReplacementAuthority/CSM_E_KEY_SIZE_MISMATCH, CsmKeyManagement_Ssa_SigPubKey_ReplacementAuthority/CSM_E_KEY_WRITE_FAIL, CsmKeyManagement_Ssa_SigPubKey_ReplacementAuthority/E_NOT_OK]  # Sets the given key element bytes to the key.
          arg keyElementId: type=uint32, direction=IN, server-argument-impl-policy=USE-ARGUMENT-TYPE
          arg keyPtr: type=Csm_KeyDataType_Ssa_SigPubKey_ReplacementAuthority, direction=IN, server-argument-impl-policy=USE-ARRAY-BASE-TYPE
          arg keyLength: type=uint32, direction=IN, server-argument-impl-policy=USE-ARGUMENT-TYPE
        KeySetValid: possible-error=[CsmKeyManagement_Ssa_SigPubKey_ReplacementAuthority/CSM_E_BUSY, CsmKeyManagement_Ssa_SigPubKey_ReplacementAuthority/E_NOT_OK]  # Sets the given key element bytes to the key.
      8 x error:
        CSM_E_BUSY: error-code=2  # The service request failed because the service is still busy.
        CSM_E_KEY_EMPTY: error-code=13  # The service request failed because of uninitialized source key element.
        CSM_E_KEY_NOT_AVAILABLE: error-code=8  # The service request failed because the key is not available.
        CSM_E_KEY_READ_FAIL: error-code=6  # The service request failed because read access was denied.
        CSM_E_KEY_SIZE_MISMATCH: error-code=10  # The service request failed because the key element is not partially accessible and the provided key element length is too short or too long for that key element.
        CSM_E_KEY_WRITE_FAIL: error-code=7  # The service request failed because write access was denied.
        CSM_E_SMALL_BUFFER: error-code=3  # The service request failed because the provided buffer is too small to store the result.
        E_NOT_OK: error-code=1  # The service request failed.
    CsmKeyManagement_Ssa_TrustModelEcuStagingPublicKey  # Interface to execute the key management functions.
      5 x operation:
        KeyCopy: possible-error=[CsmKeyManagement_Ssa_TrustModelEcuStagingPublicKey/CSM_E_BUSY, CsmKeyManagement_Ssa_TrustModelEcuStagingPublicKey/CSM_E_KEY_EMPTY, CsmKeyManagement_Ssa_TrustModelEcuStagingPublicKey/CSM_E_KEY_READ_FAIL, CsmKeyManagement_Ssa_TrustModelEcuStagingPublicKey/CSM_E_KEY_SIZE_MISMATCH, CsmKeyManagement_Ssa_TrustModelEcuStagingPublicKey/CSM_E_KEY_WRITE_FAIL, CsmKeyManagement_Ssa_TrustModelEcuStagingPublicKey/CSM_E_SMALL_BUFFER, CsmKeyManagement_Ssa_TrustModelEcuStagingPublicKey/E_NOT_OK]  # This function shall copy all key elements from the source key to a target key.
          arg targetKeyId: type=uint32, direction=IN, server-argument-impl-policy=USE-ARGUMENT-TYPE
        KeyElementCopy: possible-error=[CsmKeyManagement_Ssa_TrustModelEcuStagingPublicKey/CSM_E_BUSY, CsmKeyManagement_Ssa_TrustModelEcuStagingPublicKey/CSM_E_KEY_EMPTY, CsmKeyManagement_Ssa_TrustModelEcuStagingPublicKey/CSM_E_KEY_READ_FAIL, CsmKeyManagement_Ssa_TrustModelEcuStagingPublicKey/CSM_E_KEY_SIZE_MISMATCH, CsmKeyManagement_Ssa_TrustModelEcuStagingPublicKey/CSM_E_KEY_WRITE_FAIL, CsmKeyManagement_Ssa_TrustModelEcuStagingPublicKey/CSM_E_SMALL_BUFFER, CsmKeyManagement_Ssa_TrustModelEcuStagingPublicKey/E_NOT_OK]  # This function shall copy a key elements from one key to a target key.
          arg keyElementId: type=uint32, direction=IN, server-argument-impl-policy=USE-ARGUMENT-TYPE
          arg targetKeyId: type=uint32, direction=IN, server-argument-impl-policy=USE-ARGUMENT-TYPE
          arg targetKeyElementId: type=uint32, direction=IN, server-argument-impl-policy=USE-ARGUMENT-TYPE
        KeyElementGet: possible-error=[CsmKeyManagement_Ssa_TrustModelEcuStagingPublicKey/CSM_E_BUSY, CsmKeyManagement_Ssa_TrustModelEcuStagingPublicKey/CSM_E_KEY_EMPTY, CsmKeyManagement_Ssa_TrustModelEcuStagingPublicKey/CSM_E_KEY_NOT_AVAILABLE, CsmKeyManagement_Ssa_TrustModelEcuStagingPublicKey/CSM_E_KEY_READ_FAIL, CsmKeyManagement_Ssa_TrustModelEcuStagingPublicKey/CSM_E_SMALL_BUFFER, CsmKeyManagement_Ssa_TrustModelEcuStagingPublicKey/E_NOT_OK]  # Retrieves the key element bytes from a specific key element of the key and stores the key element in the provided buffer.
          arg keyElementId: type=uint32, direction=IN, server-argument-impl-policy=USE-ARGUMENT-TYPE
          arg keyPtr: type=Csm_KeyDataType_Ssa_TrustModelEcuStagingPublicKey, direction=OUT, server-argument-impl-policy=USE-ARRAY-BASE-TYPE
          arg keyLength: type=uint32, direction=INOUT, server-argument-impl-policy=USE-ARGUMENT-TYPE
        KeyElementSet: possible-error=[CsmKeyManagement_Ssa_TrustModelEcuStagingPublicKey/CSM_E_BUSY, CsmKeyManagement_Ssa_TrustModelEcuStagingPublicKey/CSM_E_KEY_NOT_AVAILABLE, CsmKeyManagement_Ssa_TrustModelEcuStagingPublicKey/CSM_E_KEY_SIZE_MISMATCH, CsmKeyManagement_Ssa_TrustModelEcuStagingPublicKey/CSM_E_KEY_WRITE_FAIL, CsmKeyManagement_Ssa_TrustModelEcuStagingPublicKey/E_NOT_OK]  # Sets the given key element bytes to the key.
          arg keyElementId: type=uint32, direction=IN, server-argument-impl-policy=USE-ARGUMENT-TYPE
          arg keyPtr: type=Csm_KeyDataType_Ssa_TrustModelEcuStagingPublicKey, direction=IN, server-argument-impl-policy=USE-ARRAY-BASE-TYPE
          arg keyLength: type=uint32, direction=IN, server-argument-impl-policy=USE-ARGUMENT-TYPE
        KeySetValid: possible-error=[CsmKeyManagement_Ssa_TrustModelEcuStagingPublicKey/CSM_E_BUSY, CsmKeyManagement_Ssa_TrustModelEcuStagingPublicKey/E_NOT_OK]  # Sets the given key element bytes to the key.
      8 x error:
        CSM_E_BUSY: error-code=2  # The service request failed because the service is still busy.
        CSM_E_KEY_EMPTY: error-code=13  # The service request failed because of uninitialized source key element.
        CSM_E_KEY_NOT_AVAILABLE: error-code=8  # The service request failed because the key is not available.
        CSM_E_KEY_READ_FAIL: error-code=6  # The service request failed because read access was denied.
        CSM_E_KEY_SIZE_MISMATCH: error-code=10  # The service request failed because the key element is not partially accessible and the provided key element length is too short or too long for that key element.
        CSM_E_KEY_WRITE_FAIL: error-code=7  # The service request failed because write access was denied.
        CSM_E_SMALL_BUFFER: error-code=3  # The service request failed because the provided buffer is too small to store the result.
        E_NOT_OK: error-code=1  # The service request failed.
    CsmKeyManagement_Ssa_AesRamKey  # Interface to execute the key management functions.
      operation KeyElementGet: possible-error=[CsmKeyManagement_Ssa_AesRamKey/CSM_E_BUSY, CsmKeyManagement_Ssa_AesRamKey/CSM_E_KEY_NOT_AVAILABLE, CsmKeyManagement_Ssa_AesRamKey/CSM_E_KEY_READ_FAIL, CsmKeyManagement_Ssa_AesRamKey/CSM_E_SMALL_BUFFER, CsmKeyManagement_Ssa_AesRamKey/E_NOT_OK, CsmKeyManagement_Ssa_AesRamKey/CSM_E_KEY_EMPTY]  # Retrieves the key element bytes from a specific key element of the key and stores the key element in the provided buffer.
        arg keyElementId: type=uint32, direction=IN, server-argument-impl-policy=USE-ARGUMENT-TYPE
        arg keyPtr: type=Csm_KeyDataType_Ssa_AesRamKey, direction=OUT, server-argument-impl-policy=USE-ARRAY-BASE-TYPE
        arg keyLength: type=uint32, direction=INOUT, server-argument-impl-policy=USE-ARGUMENT-TYPE
      operation KeyElementSet: possible-error=[CsmKeyManagement_Ssa_AesRamKey/CSM_E_BUSY, CsmKeyManagement_Ssa_AesRamKey/CSM_E_KEY_NOT_AVAILABLE, CsmKeyManagement_Ssa_AesRamKey/CSM_E_KEY_SIZE_MISMATCH, CsmKeyManagement_Ssa_AesRamKey/CSM_E_KEY_WRITE_FAIL, CsmKeyManagement_Ssa_AesRamKey/CSM_E_SMALL_BUFFER, CsmKeyManagement_Ssa_AesRamKey/E_NOT_OK]  # Sets the given key element bytes to the key.
        arg keyElementId: type=uint32, direction=IN, server-argument-impl-policy=USE-ARGUMENT-TYPE
        arg keyPtr: type=Csm_KeyDataType_Ssa_AesRamKey, direction=IN, server-argument-impl-policy=USE-ARRAY-BASE-TYPE
        arg keyLength: type=uint32, direction=IN, server-argument-impl-policy=USE-ARGUMENT-TYPE
      operation KeySetValid: possible-error=[CsmKeyManagement_Ssa_AesRamKey/CSM_E_BUSY, CsmKeyManagement_Ssa_AesRamKey/E_NOT_OK]  # Sets the given key element bytes to the key.
      8 x error:
        CSM_E_BUSY: error-code=2  # The service request failed because the service is still busy.
        CSM_E_KEY_NOT_AVAILABLE: error-code=8  # The service request failed because the key is not available.
        CSM_E_KEY_READ_FAIL: error-code=6  # The service request failed because read access was denied.
        CSM_E_KEY_SIZE_MISMATCH: error-code=10  # The service request failed because the key element is not partially accessible and the provided key element length is too short or too long for that key element.
        CSM_E_KEY_WRITE_FAIL: error-code=7  # The service request failed because write access was denied.
        CSM_E_SMALL_BUFFER: error-code=3  # The service request failed because the provided buffer is too small to store the result.
        E_NOT_OK: error-code=1  # The service request failed.
        CSM_E_KEY_EMPTY: error-code=13
    CsmKeyManagement_Ssa_BackendCert  # Interface to execute the key management functions.
      operation KeyElementGet: possible-error=[CsmKeyManagement_Ssa_BackendCert/CSM_E_BUSY, CsmKeyManagement_Ssa_BackendCert/CSM_E_KEY_NOT_AVAILABLE, CsmKeyManagement_Ssa_BackendCert/CSM_E_KEY_READ_FAIL, CsmKeyManagement_Ssa_BackendCert/CSM_E_SMALL_BUFFER, CsmKeyManagement_Ssa_BackendCert/E_NOT_OK, CsmKeyManagement_Ssa_BackendCert/CSM_E_KEY_EMPTY]  # Retrieves the key element bytes from a specific key element of the key and stores the key element in the provided buffer.
        arg keyElementId: type=uint32, direction=IN, server-argument-impl-policy=USE-ARGUMENT-TYPE
        arg keyPtr: type=Csm_KeyDataType_Ssa_BackendCert, direction=OUT, server-argument-impl-policy=USE-ARRAY-BASE-TYPE
        arg keyLength: type=uint32, direction=INOUT, server-argument-impl-policy=USE-ARGUMENT-TYPE
      operation KeyElementSet: possible-error=[CsmKeyManagement_Ssa_BackendCert/CSM_E_BUSY, CsmKeyManagement_Ssa_BackendCert/CSM_E_KEY_NOT_AVAILABLE, CsmKeyManagement_Ssa_BackendCert/CSM_E_KEY_SIZE_MISMATCH, CsmKeyManagement_Ssa_BackendCert/CSM_E_KEY_WRITE_FAIL, CsmKeyManagement_Ssa_BackendCert/CSM_E_SMALL_BUFFER, CsmKeyManagement_Ssa_BackendCert/E_NOT_OK]  # Sets the given key element bytes to the key.
        arg keyElementId: type=uint32, direction=IN, server-argument-impl-policy=USE-ARGUMENT-TYPE
        arg keyPtr: type=Csm_KeyDataType_Ssa_BackendCert, direction=IN, server-argument-impl-policy=USE-ARRAY-BASE-TYPE
        arg keyLength: type=uint32, direction=IN, server-argument-impl-policy=USE-ARGUMENT-TYPE
      operation KeySetValid: possible-error=[CsmKeyManagement_Ssa_BackendCert/CSM_E_BUSY, CsmKeyManagement_Ssa_BackendCert/E_NOT_OK]  # Sets the given key element bytes to the key.
      8 x error:
        CSM_E_BUSY: error-code=2  # The service request failed because the service is still busy.
        CSM_E_KEY_NOT_AVAILABLE: error-code=8  # The service request failed because the key is not available.
        CSM_E_KEY_READ_FAIL: error-code=6  # The service request failed because read access was denied.
        CSM_E_KEY_SIZE_MISMATCH: error-code=10  # The service request failed because the key element is not partially accessible and the provided key element length is too short or too long for that key element.
        CSM_E_KEY_WRITE_FAIL: error-code=7  # The service request failed because write access was denied.
        CSM_E_SMALL_BUFFER: error-code=3  # The service request failed because the provided buffer is too small to store the result.
        E_NOT_OK: error-code=1  # The service request failed.
        CSM_E_KEY_EMPTY: error-code=13
    CsmKeyManagement_Ssa_TrustModelEcuCsrPrivateKey  # Interface to execute the key management functions.
      6 x operation:
        KeyCopy: possible-error=[CsmKeyManagement_Ssa_TrustModelEcuCsrPrivateKey/CSM_E_BUSY, CsmKeyManagement_Ssa_TrustModelEcuCsrPrivateKey/CSM_E_KEY_EMPTY, CsmKeyManagement_Ssa_TrustModelEcuCsrPrivateKey/CSM_E_KEY_READ_FAIL, CsmKeyManagement_Ssa_TrustModelEcuCsrPrivateKey/CSM_E_KEY_SIZE_MISMATCH, CsmKeyManagement_Ssa_TrustModelEcuCsrPrivateKey/CSM_E_KEY_WRITE_FAIL, CsmKeyManagement_Ssa_TrustModelEcuCsrPrivateKey/CSM_E_SMALL_BUFFER, CsmKeyManagement_Ssa_TrustModelEcuCsrPrivateKey/E_NOT_OK]  # This function shall copy all key elements from the source key to a target key.
          arg targetKeyId: type=uint32, direction=IN, server-argument-impl-policy=USE-ARGUMENT-TYPE
        KeyElementCopy: possible-error=[CsmKeyManagement_Ssa_TrustModelEcuCsrPrivateKey/CSM_E_BUSY, CsmKeyManagement_Ssa_TrustModelEcuCsrPrivateKey/CSM_E_KEY_EMPTY, CsmKeyManagement_Ssa_TrustModelEcuCsrPrivateKey/CSM_E_KEY_READ_FAIL, CsmKeyManagement_Ssa_TrustModelEcuCsrPrivateKey/CSM_E_KEY_SIZE_MISMATCH, CsmKeyManagement_Ssa_TrustModelEcuCsrPrivateKey/CSM_E_KEY_WRITE_FAIL, CsmKeyManagement_Ssa_TrustModelEcuCsrPrivateKey/CSM_E_SMALL_BUFFER, CsmKeyManagement_Ssa_TrustModelEcuCsrPrivateKey/E_NOT_OK]  # This function shall copy a key elements from one key to a target key.
          arg keyElementId: type=uint32, direction=IN, server-argument-impl-policy=USE-ARGUMENT-TYPE
          arg targetKeyId: type=uint32, direction=IN, server-argument-impl-policy=USE-ARGUMENT-TYPE
          arg targetKeyElementId: type=uint32, direction=IN, server-argument-impl-policy=USE-ARGUMENT-TYPE
        KeyElementGet: possible-error=[CsmKeyManagement_Ssa_TrustModelEcuCsrPrivateKey/CSM_E_BUSY, CsmKeyManagement_Ssa_TrustModelEcuCsrPrivateKey/CSM_E_KEY_EMPTY, CsmKeyManagement_Ssa_TrustModelEcuCsrPrivateKey/CSM_E_KEY_NOT_AVAILABLE, CsmKeyManagement_Ssa_TrustModelEcuCsrPrivateKey/CSM_E_KEY_READ_FAIL, CsmKeyManagement_Ssa_TrustModelEcuCsrPrivateKey/CSM_E_SMALL_BUFFER, CsmKeyManagement_Ssa_TrustModelEcuCsrPrivateKey/E_NOT_OK]  # Retrieves the key element bytes from a specific key element of the key and stores the key element in the provided buffer.
          arg keyElementId: type=uint32, direction=IN, server-argument-impl-policy=USE-ARGUMENT-TYPE
          arg keyPtr: type=Csm_KeyDataType_Ssa_TrustModelEcuCsrPrivateKey, direction=OUT, server-argument-impl-policy=USE-ARRAY-BASE-TYPE
          arg keyLength: type=uint32, direction=INOUT, server-argument-impl-policy=USE-ARGUMENT-TYPE
        KeyElementSet: possible-error=[CsmKeyManagement_Ssa_TrustModelEcuCsrPrivateKey/CSM_E_BUSY, CsmKeyManagement_Ssa_TrustModelEcuCsrPrivateKey/CSM_E_KEY_NOT_AVAILABLE, CsmKeyManagement_Ssa_TrustModelEcuCsrPrivateKey/CSM_E_KEY_SIZE_MISMATCH, CsmKeyManagement_Ssa_TrustModelEcuCsrPrivateKey/CSM_E_KEY_WRITE_FAIL, CsmKeyManagement_Ssa_TrustModelEcuCsrPrivateKey/E_NOT_OK]  # Sets the given key element bytes to the key.
          arg keyElementId: type=uint32, direction=IN, server-argument-impl-policy=USE-ARGUMENT-TYPE
          arg keyPtr: type=Csm_KeyDataType_Ssa_TrustModelEcuCsrPrivateKey, direction=IN, server-argument-impl-policy=USE-ARRAY-BASE-TYPE
          arg keyLength: type=uint32, direction=IN, server-argument-impl-policy=USE-ARGUMENT-TYPE
        KeyGenerate: possible-error=[CsmKeyManagement_Ssa_TrustModelEcuCsrPrivateKey/CSM_E_BUSY, CsmKeyManagement_Ssa_TrustModelEcuCsrPrivateKey/CSM_E_KEY_EMPTY, CsmKeyManagement_Ssa_TrustModelEcuCsrPrivateKey/E_NOT_OK]  # Generates new key material and store it in the key identified by keyId.
        KeySetValid: possible-error=[CsmKeyManagement_Ssa_TrustModelEcuCsrPrivateKey/CSM_E_BUSY, CsmKeyManagement_Ssa_TrustModelEcuCsrPrivateKey/E_NOT_OK]  # Sets the given key element bytes to the key.
      8 x error:
        CSM_E_BUSY: error-code=2  # The service request failed because the service is still busy.
        CSM_E_KEY_EMPTY: error-code=13  # The service request failed because of uninitialized source key element.
        CSM_E_KEY_NOT_AVAILABLE: error-code=8  # The service request failed because the key is not available.
        CSM_E_KEY_READ_FAIL: error-code=6  # The service request failed because read access was denied.
        CSM_E_KEY_SIZE_MISMATCH: error-code=10  # The service request failed because the key element is not partially accessible and the provided key element length is too short or too long for that key element.
        CSM_E_KEY_WRITE_FAIL: error-code=7  # The service request failed because write access was denied.
        CSM_E_SMALL_BUFFER: error-code=3  # The service request failed because the provided buffer is too small to store the result.
        E_NOT_OK: error-code=1  # The service request failed.
    CsmKeyManagement_Ssa_RandomSeed  # Interface to execute the key management functions.
      operation KeySetValid: possible-error=[CsmKeyManagement_Ssa_RandomSeed/CSM_E_BUSY, CsmKeyManagement_Ssa_RandomSeed/E_NOT_OK]  # Sets the given key element bytes to the key.
      operation RandomSeed: possible-error=[CsmKeyManagement_Ssa_RandomSeed/CSM_E_BUSY, CsmKeyManagement_Ssa_RandomSeed/E_NOT_OK]  # Feeds a key element with a random seed.
        arg seedPtr: type=Csm_SeedDataTypeSsa_RandomSeed, direction=IN, server-argument-impl-policy=USE-ARRAY-BASE-TYPE
        arg seedLength: type=uint32, direction=IN, server-argument-impl-policy=USE-ARGUMENT-TYPE
      8 x error:
        CSM_E_BUSY: error-code=2  # The service request failed because the service is still busy.
        CSM_E_KEY_NOT_AVAILABLE: error-code=8  # The service request failed because the key is not available.
        CSM_E_KEY_READ_FAIL: error-code=6  # The service request failed because read access was denied.
        CSM_E_KEY_SIZE_MISMATCH: error-code=10  # The service request failed because the key element is not partially accessible and the provided key element length is too short or too long for that key element.
        CSM_E_KEY_WRITE_FAIL: error-code=7  # The service request failed because write access was denied.
        CSM_E_SMALL_BUFFER: error-code=3  # The service request failed because the provided buffer is too small to store the result.
        E_NOT_OK: error-code=1  # The service request failed.
        CSM_E_KEY_EMPTY: error-code=13  # The service request failed because of uninitialized source key element.
    CsmKeyManagement_Ssa_TrustModelEcuCsrPublicKey  # Interface to execute the key management functions.
      5 x operation:
        KeyCopy: possible-error=[CsmKeyManagement_Ssa_TrustModelEcuCsrPublicKey/CSM_E_BUSY, CsmKeyManagement_Ssa_TrustModelEcuCsrPublicKey/CSM_E_KEY_EMPTY, CsmKeyManagement_Ssa_TrustModelEcuCsrPublicKey/CSM_E_KEY_READ_FAIL, CsmKeyManagement_Ssa_TrustModelEcuCsrPublicKey/CSM_E_KEY_SIZE_MISMATCH, CsmKeyManagement_Ssa_TrustModelEcuCsrPublicKey/CSM_E_KEY_WRITE_FAIL, CsmKeyManagement_Ssa_TrustModelEcuCsrPublicKey/CSM_E_SMALL_BUFFER, CsmKeyManagement_Ssa_TrustModelEcuCsrPublicKey/E_NOT_OK]  # This function shall copy all key elements from the source key to a target key.
          arg targetKeyId: type=uint32, direction=IN, server-argument-impl-policy=USE-ARGUMENT-TYPE
        KeyElementCopy: possible-error=[CsmKeyManagement_Ssa_TrustModelEcuCsrPublicKey/CSM_E_BUSY, CsmKeyManagement_Ssa_TrustModelEcuCsrPublicKey/CSM_E_KEY_EMPTY, CsmKeyManagement_Ssa_TrustModelEcuCsrPublicKey/CSM_E_KEY_READ_FAIL, CsmKeyManagement_Ssa_TrustModelEcuCsrPublicKey/CSM_E_KEY_SIZE_MISMATCH, CsmKeyManagement_Ssa_TrustModelEcuCsrPublicKey/CSM_E_KEY_WRITE_FAIL, CsmKeyManagement_Ssa_TrustModelEcuCsrPublicKey/CSM_E_SMALL_BUFFER, CsmKeyManagement_Ssa_TrustModelEcuCsrPublicKey/E_NOT_OK]  # This function shall copy a key elements from one key to a target key.
          arg keyElementId: type=uint32, direction=IN, server-argument-impl-policy=USE-ARGUMENT-TYPE
          arg targetKeyId: type=uint32, direction=IN, server-argument-impl-policy=USE-ARGUMENT-TYPE
          arg targetKeyElementId: type=uint32, direction=IN, server-argument-impl-policy=USE-ARGUMENT-TYPE
        KeyElementGet: possible-error=[CsmKeyManagement_Ssa_TrustModelEcuCsrPublicKey/CSM_E_BUSY, CsmKeyManagement_Ssa_TrustModelEcuCsrPublicKey/CSM_E_KEY_EMPTY, CsmKeyManagement_Ssa_TrustModelEcuCsrPublicKey/CSM_E_KEY_NOT_AVAILABLE, CsmKeyManagement_Ssa_TrustModelEcuCsrPublicKey/CSM_E_KEY_READ_FAIL, CsmKeyManagement_Ssa_TrustModelEcuCsrPublicKey/CSM_E_SMALL_BUFFER, CsmKeyManagement_Ssa_TrustModelEcuCsrPublicKey/E_NOT_OK]  # Retrieves the key element bytes from a specific key element of the key and stores the key element in the provided buffer.
          arg keyElementId: type=uint32, direction=IN, server-argument-impl-policy=USE-ARGUMENT-TYPE
          arg keyPtr: type=Csm_KeyDataType_Ssa_TrustModelEcuCsrPublicKey, direction=OUT, server-argument-impl-policy=USE-ARRAY-BASE-TYPE
          arg keyLength: type=uint32, direction=INOUT, server-argument-impl-policy=USE-ARGUMENT-TYPE
        KeyElementSet: possible-error=[CsmKeyManagement_Ssa_TrustModelEcuCsrPublicKey/CSM_E_BUSY, CsmKeyManagement_Ssa_TrustModelEcuCsrPublicKey/CSM_E_KEY_NOT_AVAILABLE, CsmKeyManagement_Ssa_TrustModelEcuCsrPublicKey/CSM_E_KEY_SIZE_MISMATCH, CsmKeyManagement_Ssa_TrustModelEcuCsrPublicKey/CSM_E_KEY_WRITE_FAIL, CsmKeyManagement_Ssa_TrustModelEcuCsrPublicKey/E_NOT_OK]  # Sets the given key element bytes to the key.
          arg keyElementId: type=uint32, direction=IN, server-argument-impl-policy=USE-ARGUMENT-TYPE
          arg keyPtr: type=Csm_KeyDataType_Ssa_TrustModelEcuCsrPublicKey, direction=IN, server-argument-impl-policy=USE-ARRAY-BASE-TYPE
          arg keyLength: type=uint32, direction=IN, server-argument-impl-policy=USE-ARGUMENT-TYPE
        KeySetValid: possible-error=[CsmKeyManagement_Ssa_TrustModelEcuCsrPublicKey/CSM_E_BUSY, CsmKeyManagement_Ssa_TrustModelEcuCsrPublicKey/E_NOT_OK]  # Sets the given key element bytes to the key.
      8 x error:
        CSM_E_BUSY: error-code=2  # The service request failed because the service is still busy.
        CSM_E_KEY_EMPTY: error-code=13  # The service request failed because of uninitialized source key element.
        CSM_E_KEY_NOT_AVAILABLE: error-code=8  # The service request failed because the key is not available.
        CSM_E_KEY_READ_FAIL: error-code=6  # The service request failed because read access was denied.
        CSM_E_KEY_SIZE_MISMATCH: error-code=10  # The service request failed because the key element is not partially accessible and the provided key element length is too short or too long for that key element.
        CSM_E_KEY_WRITE_FAIL: error-code=7  # The service request failed because write access was denied.
        CSM_E_SMALL_BUFFER: error-code=3  # The service request failed because the provided buffer is too small to store the result.
        E_NOT_OK: error-code=1  # The service request failed.
    CsmKeyManagement_Ssa_TrustModelTempPublicKey  # Interface to execute the key management functions.
      5 x operation:
        KeyCopy: possible-error=[CsmKeyManagement_Ssa_TrustModelTempPublicKey/CSM_E_BUSY, CsmKeyManagement_Ssa_TrustModelTempPublicKey/CSM_E_KEY_EMPTY, CsmKeyManagement_Ssa_TrustModelTempPublicKey/E_NOT_OK, CsmKeyManagement_Ssa_TrustModelTempPublicKey/CSM_E_KEY_READ_FAIL, CsmKeyManagement_Ssa_TrustModelTempPublicKey/CSM_E_KEY_SIZE_MISMATCH, CsmKeyManagement_Ssa_TrustModelTempPublicKey/CSM_E_KEY_WRITE_FAIL, CsmKeyManagement_Ssa_TrustModelTempPublicKey/CSM_E_SMALL_BUFFER]  # This function shall copy all key elements from the source key to a target key.
          arg targetKeyId: type=uint32, direction=IN, server-argument-impl-policy=USE-ARGUMENT-TYPE
        KeyElementCopy: possible-error=[CsmKeyManagement_Ssa_TrustModelTempPublicKey/CSM_E_BUSY, CsmKeyManagement_Ssa_TrustModelTempPublicKey/CSM_E_KEY_EMPTY, CsmKeyManagement_Ssa_TrustModelTempPublicKey/E_NOT_OK, CsmKeyManagement_Ssa_TrustModelTempPublicKey/CSM_E_KEY_READ_FAIL, CsmKeyManagement_Ssa_TrustModelTempPublicKey/CSM_E_KEY_SIZE_MISMATCH, CsmKeyManagement_Ssa_TrustModelTempPublicKey/CSM_E_KEY_WRITE_FAIL, CsmKeyManagement_Ssa_TrustModelTempPublicKey/CSM_E_SMALL_BUFFER]  # This function shall copy a key elements from one key to a target key.
          arg keyElementId: type=uint32, direction=IN, server-argument-impl-policy=USE-ARGUMENT-TYPE
          arg targetKeyId: type=uint32, direction=IN, server-argument-impl-policy=USE-ARGUMENT-TYPE
          arg targetKeyElementId: type=uint32, direction=IN, server-argument-impl-policy=USE-ARGUMENT-TYPE
        KeyElementGet: possible-error=[CsmKeyManagement_Ssa_TrustModelTempPublicKey/CSM_E_BUSY, CsmKeyManagement_Ssa_TrustModelTempPublicKey/CSM_E_KEY_EMPTY, CsmKeyManagement_Ssa_TrustModelTempPublicKey/CSM_E_KEY_READ_FAIL, CsmKeyManagement_Ssa_TrustModelTempPublicKey/CSM_E_SMALL_BUFFER, CsmKeyManagement_Ssa_TrustModelTempPublicKey/E_NOT_OK, CsmKeyManagement_Ssa_TrustModelTempPublicKey/CSM_E_KEY_NOT_AVAILABLE]  # Retrieves the key element bytes from a specific key element of the key and stores the key element in the provided buffer.
          arg keyElementId: type=uint32, direction=IN, server-argument-impl-policy=USE-ARGUMENT-TYPE
          arg keyPtr: type=Csm_KeyDataType_Ssa_TrustModelTempPublicKey, direction=OUT, server-argument-impl-policy=USE-ARRAY-BASE-TYPE
          arg keyLength: type=uint32, direction=INOUT, server-argument-impl-policy=USE-ARGUMENT-TYPE
        KeyElementSet: possible-error=[CsmKeyManagement_Ssa_TrustModelTempPublicKey/CSM_E_BUSY, CsmKeyManagement_Ssa_TrustModelTempPublicKey/CSM_E_KEY_SIZE_MISMATCH, CsmKeyManagement_Ssa_TrustModelTempPublicKey/CSM_E_KEY_WRITE_FAIL, CsmKeyManagement_Ssa_TrustModelTempPublicKey/E_NOT_OK, CsmKeyManagement_Ssa_TrustModelTempPublicKey/CSM_E_KEY_NOT_AVAILABLE]  # Sets the given key element bytes to the key.
          arg keyElementId: type=uint32, direction=IN, server-argument-impl-policy=USE-ARGUMENT-TYPE
          arg keyPtr: type=Csm_KeyDataType_Ssa_TrustModelTempPublicKey, direction=IN, server-argument-impl-policy=USE-ARRAY-BASE-TYPE
          arg keyLength: type=uint32, direction=IN, server-argument-impl-policy=USE-ARGUMENT-TYPE
        KeySetValid: possible-error=[CsmKeyManagement_Ssa_TrustModelTempPublicKey/CSM_E_BUSY, CsmKeyManagement_Ssa_TrustModelTempPublicKey/E_NOT_OK]  # Sets the given key element bytes to the key.
      8 x error:
        CSM_E_BUSY: error-code=2  # The service request failed because the service is still busy.
        CSM_E_KEY_EMPTY: error-code=13  # The service request failed because of uninitialized source key element.
        CSM_E_KEY_NOT_AVAILABLE: error-code=8  # The service request failed because the key is not available.
        CSM_E_KEY_READ_FAIL: error-code=6  # The service request failed because read access was denied.
        CSM_E_KEY_SIZE_MISMATCH: error-code=10  # The service request failed because the key element is not partially accessible and the provided key element length is too short or too long for that key element.
        CSM_E_KEY_WRITE_FAIL: error-code=7  # The service request failed because write access was denied.
        CSM_E_SMALL_BUFFER: error-code=3  # The service request failed because the provided buffer is too small to store the result.
        E_NOT_OK: error-code=1  # The service request failed.
    CsmKeyManagement_Ssa_TrustModelEcuLivePrivateKey  # Interface to execute the key management functions.
      5 x operation:
        KeyCopy: possible-error=[CsmKeyManagement_Ssa_TrustModelEcuLivePrivateKey/CSM_E_BUSY, CsmKeyManagement_Ssa_TrustModelEcuLivePrivateKey/CSM_E_KEY_EMPTY, CsmKeyManagement_Ssa_TrustModelEcuLivePrivateKey/CSM_E_KEY_READ_FAIL, CsmKeyManagement_Ssa_TrustModelEcuLivePrivateKey/CSM_E_KEY_SIZE_MISMATCH, CsmKeyManagement_Ssa_TrustModelEcuLivePrivateKey/CSM_E_KEY_WRITE_FAIL, CsmKeyManagement_Ssa_TrustModelEcuLivePrivateKey/CSM_E_SMALL_BUFFER, CsmKeyManagement_Ssa_TrustModelEcuLivePrivateKey/E_NOT_OK]  # This function shall copy all key elements from the source key to a target key.
          arg targetKeyId: type=uint32, direction=IN, server-argument-impl-policy=USE-ARGUMENT-TYPE
        KeyElementCopy: possible-error=[CsmKeyManagement_Ssa_TrustModelEcuLivePrivateKey/CSM_E_BUSY, CsmKeyManagement_Ssa_TrustModelEcuLivePrivateKey/CSM_E_KEY_EMPTY, CsmKeyManagement_Ssa_TrustModelEcuLivePrivateKey/CSM_E_KEY_READ_FAIL, CsmKeyManagement_Ssa_TrustModelEcuLivePrivateKey/CSM_E_KEY_SIZE_MISMATCH, CsmKeyManagement_Ssa_TrustModelEcuLivePrivateKey/CSM_E_KEY_WRITE_FAIL, CsmKeyManagement_Ssa_TrustModelEcuLivePrivateKey/CSM_E_SMALL_BUFFER, CsmKeyManagement_Ssa_TrustModelEcuLivePrivateKey/E_NOT_OK]  # This function shall copy a key elements from one key to a target key.
          arg keyElementId: type=uint32, direction=IN, server-argument-impl-policy=USE-ARGUMENT-TYPE
          arg targetKeyId: type=uint32, direction=IN, server-argument-impl-policy=USE-ARGUMENT-TYPE
          arg targetKeyElementId: type=uint32, direction=IN, server-argument-impl-policy=USE-ARGUMENT-TYPE
        KeyElementGet: possible-error=[CsmKeyManagement_Ssa_TrustModelEcuLivePrivateKey/CSM_E_BUSY, CsmKeyManagement_Ssa_TrustModelEcuLivePrivateKey/CSM_E_KEY_EMPTY, CsmKeyManagement_Ssa_TrustModelEcuLivePrivateKey/CSM_E_KEY_NOT_AVAILABLE, CsmKeyManagement_Ssa_TrustModelEcuLivePrivateKey/CSM_E_KEY_READ_FAIL, CsmKeyManagement_Ssa_TrustModelEcuLivePrivateKey/CSM_E_SMALL_BUFFER, CsmKeyManagement_Ssa_TrustModelEcuLivePrivateKey/E_NOT_OK]  # Retrieves the key element bytes from a specific key element of the key and stores the key element in the provided buffer.
          arg keyElementId: type=uint32, direction=IN, server-argument-impl-policy=USE-ARGUMENT-TYPE
          arg keyPtr: type=Csm_KeyDataType_Ssa_TrustModelEcuLivePrivateKey, direction=OUT, server-argument-impl-policy=USE-ARRAY-BASE-TYPE
          arg keyLength: type=uint32, direction=INOUT, server-argument-impl-policy=USE-ARGUMENT-TYPE
        KeyElementSet: possible-error=[CsmKeyManagement_Ssa_TrustModelEcuLivePrivateKey/CSM_E_BUSY, CsmKeyManagement_Ssa_TrustModelEcuLivePrivateKey/CSM_E_KEY_NOT_AVAILABLE, CsmKeyManagement_Ssa_TrustModelEcuLivePrivateKey/CSM_E_KEY_SIZE_MISMATCH, CsmKeyManagement_Ssa_TrustModelEcuLivePrivateKey/CSM_E_KEY_WRITE_FAIL, CsmKeyManagement_Ssa_TrustModelEcuLivePrivateKey/E_NOT_OK]  # Sets the given key element bytes to the key.
          arg keyElementId: type=uint32, direction=IN, server-argument-impl-policy=USE-ARGUMENT-TYPE
          arg keyPtr: type=Csm_KeyDataType_Ssa_TrustModelEcuLivePrivateKey, direction=IN, server-argument-impl-policy=USE-ARRAY-BASE-TYPE
          arg keyLength: type=uint32, direction=IN, server-argument-impl-policy=USE-ARGUMENT-TYPE
        KeySetValid: possible-error=[CsmKeyManagement_Ssa_TrustModelEcuLivePrivateKey/CSM_E_BUSY, CsmKeyManagement_Ssa_TrustModelEcuLivePrivateKey/E_NOT_OK]  # Sets the given key element bytes to the key.
      8 x error:
        CSM_E_BUSY: error-code=2  # The service request failed because the service is still busy.
        CSM_E_KEY_EMPTY: error-code=13  # The service request failed because of uninitialized source key element.
        CSM_E_KEY_NOT_AVAILABLE: error-code=8  # The service request failed because the key is not available.
        CSM_E_KEY_READ_FAIL: error-code=6  # The service request failed because read access was denied.
        CSM_E_KEY_SIZE_MISMATCH: error-code=10  # The service request failed because the key element is not partially accessible and the provided key element length is too short or too long for that key element.
        CSM_E_KEY_WRITE_FAIL: error-code=7  # The service request failed because write access was denied.
        CSM_E_SMALL_BUFFER: error-code=3  # The service request failed because the provided buffer is too small to store the result.
        E_NOT_OK: error-code=1  # The service request failed.
