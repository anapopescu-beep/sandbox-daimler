[part 3 of 4: packages /SecurityArchitecture/extSwc/SecOC_swc/Interfaces to /ModeDclrGroups]
AUTOSAR XML (schema 00049)
package /SecurityArchitecture/extSwc/SecOC_swc/Interfaces
  client server interface SecOC_FreshnessManagement: is-service=true, service-kind=VENDOR-SPECIFIC
    4 x operation:
      GetRxFreshness: possible-error=[SecOC_FreshnessManagement/E_BUSY, SecOC_FreshnessManagement/E_NOT_OK, SecOC_FreshnessManagement/E_OK]  # This interface is used by the SecOC to obtain the current freshness value. This operation provides also a part of the Authentic-PDU data if configured.
        6 x arg:
          freshnessValueId: type=uint16, direction=IN, server-argument-impl-policy=USE-ARGUMENT-TYPE
          truncatedFreshnessValue: type=freshnessValueType, direction=IN, server-argument-impl-policy=USE-ARRAY-BASE-TYPE
          truncatedFreshnessValueLength: type=uint32, direction=IN, server-argument-impl-policy=USE-ARGUMENT-TYPE
          authVerifyAttempts: type=uint16, direction=IN, server-argument-impl-policy=USE-ARGUMENT-TYPE
          freshnessValue: type=freshnessValueType, direction=OUT, server-argument-impl-policy=USE-ARRAY-BASE-TYPE
          freshnessValueLength: type=uint32, direction=INOUT, server-argument-impl-policy=USE-ARGUMENT-TYPE
      GetTxFreshness: possible-error=[SecOC_FreshnessManagement/E_BUSY, SecOC_FreshnessManagement/E_NOT_OK, SecOC_FreshnessManagement/E_OK]  # This operation is used by the SecOC to obtain the freshness that corresponds to the freshnessValueId.
        arg freshnessValueId: type=uint16, direction=IN, server-argument-impl-policy=USE-ARGUMENT-TYPE
        arg freshnessValue: type=freshnessValueType, direction=OUT, server-argument-impl-policy=USE-ARRAY-BASE-TYPE
        arg freshnessValueLength: type=uint32, direction=INOUT, server-argument-impl-policy=USE-ARGUMENT-TYPE
      GetTxFreshnessTruncData: possible-error=[SecOC_FreshnessManagement/E_BUSY, SecOC_FreshnessManagement/E_NOT_OK, SecOC_FreshnessManagement/E_OK]  # This operation is used by the SecOC to obtain the freshness that corresponds to the freshnessValueId. The operation provides the freshness and also the truncated freshness that shall be placed into the Secured-IPDU.
        5 x arg:
          freshnessValueId: type=uint16, direction=IN, server-argument-impl-policy=USE-ARGUMENT-TYPE
          freshnessValue: type=freshnessValueType, direction=OUT, server-argument-impl-policy=USE-ARRAY-BASE-TYPE
          freshnessValueLength: type=uint32, direction=INOUT, server-argument-impl-policy=USE-ARGUMENT-TYPE
          truncatedFreshnessValue: type=freshnessValueType, direction=OUT, server-argument-impl-policy=USE-ARRAY-BASE-TYPE
          truncatedFreshnessValueLength: type=uint32, direction=INOUT, server-argument-impl-policy=USE-ARGUMENT-TYPE
      SPduTxConfirmation: possible-error=SecOC_FreshnessManagement/E_OK
        arg freshnessValueId: type=uint16, direction=IN, server-argument-impl-policy=USE-ARGUMENT-TYPE
    error E_BUSY: error-code=2
    error E_NOT_OK: error-code=1
    error E_OK: error-code=0
  client server interface VerificationStatusIndication: is-service=true, service-kind=VENDOR-SPECIFIC  # This service realizes a notification service that is used to propagate the status of an authentication attempt from the SecOC module to an SW-C through RTE.
    operation VerifyStatus: possible-error=[VerificationStatusIndication/E_NOT_OK, VerificationStatusIndication/E_OK]  # This service provides the ability to inform the application about the result of the verification attempt of a received PDU by the SecOC module.
      arg verificationStatus: type=SecOC_VerificationStatusType, direction=IN, server-argument-impl-policy=USE-ARGUMENT-TYPE
    error E_NOT_OK: error-code=1
    error E_OK: error-code=0
package /SecurityArchitecture/PortInterfaces
  38 x client server interface:
    RightsM_DiagnosticChannel
      4 x operation, all with possible-error=RightsM_DiagnosticChannel/E_NOT_OK:
        GetDiagChanAndAuthStatus
          arg diagChanAndAuthStatus: type=uint8, direction=OUT, server-argument-impl-policy=USE-ARGUMENT-TYPE
        GetDiagnosticUserRole
          arg userRole: type=RightsM_DiagnosticUserRoleType, direction=OUT, server-argument-impl-policy=USE-ARGUMENT-TYPE
        GetDiagnosticUserRolesBitMask
          arg userRolesBitMask: type=RightsM_ACL_BitMaskType, direction=OUT, server-argument-impl-policy=USE-ARGUMENT-TYPE
        GetPostProductionStatus
          arg status: type=Ssa_PostProductionStatusType, direction=OUT, server-argument-impl-policy=USE-ARGUMENT-TYPE
      error E_NOT_OK: error-code=1
    RightsM_DiagnosticFirewall
      operation GetDiagnosticUserRole: possible-error=RightsM_DiagnosticFirewall/E_NOT_OK
        arg SourceAddress: type=uint16, direction=IN, server-argument-impl-policy=USE-ARGUMENT-TYPE
        arg UserRole: type=RightsM_DiagnosticUserRoleType, direction=OUT, server-argument-impl-policy=USE-ARGUMENT-TYPE
      operation IsEnhancedAccessRightGranted: possible-error=RightsM_DiagnosticFirewall/E_NOT_OK
        arg SourceAddress: type=uint16, direction=IN, server-argument-impl-policy=USE-ARGUMENT-TYPE
        arg SID: type=uint8, direction=IN, server-argument-impl-policy=USE-ARGUMENT-TYPE
        arg AccessRightGranted: type=boolean, direction=OUT, server-argument-impl-policy=USE-ARGUMENT-TYPE
      error E_NOT_OK: error-code=1
    RightsM_EnhancedRights
      operation VerifySubjectKeyIdentifier: possible-error=RightsM_EnhancedRights/E_NOT_OK
        arg subjectKeyIdentifier: type=Ssa_Data20ByteType, direction=IN, server-argument-impl-policy=USE-ARRAY-BASE-TYPE
      error E_NOT_OK: error-code=1
    RightsM_Nonce
      operation Destroy: possible-error=[RightsM_Nonce/E_NOT_OK, RightsM_Nonce/E_PENDING]
      operation Get: possible-error=[RightsM_Nonce/E_NOT_OK, RightsM_Nonce/E_PENDING, E_INVALID]
        arg generateNew: type=boolean, direction=IN, server-argument-impl-policy=USE-ARGUMENT-TYPE
        arg nonce: type=Dcm_Data32ByteType, direction=OUT, server-argument-impl-policy=USE-ARRAY-BASE-TYPE
      error E_NOT_OK: error-code=1
      error E_PENDING: error-code=10
      error E_INVALID: error-code=3
    RoutineServices_Replace_Trust_model_Certificates
      operation Start: possible-error=[RoutineServices_Replace_Trust_model_Certificates/DCM_E_FORCE_RCRRP, RoutineServices_Replace_Trust_model_Certificates/DCM_E_PENDING, RoutineServices_Replace_Trust_model_Certificates/E_NOT_OK]
        6 x arg, all with server-argument-impl-policy=USE-ARGUMENT-TYPE:
          Trust_Certificates_In: type=Dcm_Data3006ByteType, direction=IN
          OpStatus: type=Dcm_OpStatusType, direction=IN
          routineInfo_Out: type=uint8, direction=OUT
          Verification_Result_Out: type=uint8, direction=OUT
          DataLength: type=uint16, direction=IN
          ErrorCode: type=Dcm_NegativeResponseCodeType, direction=OUT
      error DCM_E_FORCE_RCRRP: error-code=12
      error DCM_E_PENDING: error-code=10
      error E_NOT_OK: error-code=1
    RoutineServices_Replace_Trust_model_Root_Certificate
      operation Start: possible-error=[RoutineServices_Replace_Trust_model_Root_Certificate/DCM_E_FORCE_RCRRP, RoutineServices_Replace_Trust_model_Root_Certificate/DCM_E_PENDING, RoutineServices_Replace_Trust_model_Root_Certificate/E_NOT_OK]
        8 x arg, all with server-argument-impl-policy=USE-ARGUMENT-TYPE:
          signature_new_Root_In: type=Dcm_Data64ByteType, direction=IN
          signature_In: type=Dcm_Data64ByteType, direction=IN
          Certificates_In: type=Dcm_Data2004ByteType, direction=IN
          OpStatus: type=Dcm_OpStatusType, direction=IN
          routineInfo_Out: type=uint8, direction=OUT
          Verification_Result_Out: type=uint8, direction=OUT
          DataLength: type=uint16, direction=IN
          ErrorCode: type=Dcm_NegativeResponseCodeType, direction=OUT
      error DCM_E_FORCE_RCRRP: error-code=12
      error DCM_E_PENDING: error-code=10
      error E_NOT_OK: error-code=1
    RoutineServices_Routine_Authenticate_Diagnostic_User_or_Tester
      operation Start: possible-error=[RoutineServices_Routine_Authenticate_Diagnostic_User_or_Tester/DCM_E_FORCE_RCRRP, RoutineServices_Routine_Authenticate_Diagnostic_User_or_Tester/DCM_E_PENDING, RoutineServices_Routine_Authenticate_Diagnostic_User_or_Tester/E_NOT_OK]
        9 x arg:
          Configuration: type=uint8, direction=IN, server-argument-impl-policy=USE-ARGUMENT-TYPE
          Task: type=uint8, direction=IN, server-argument-impl-policy=USE-ARGUMENT-TYPE
          Challenge_Certificate_Proof_of_Ownership: type=Dcm_Data4004ByteType, direction=IN, server-argument-impl-policy=USE-ARRAY-BASE-TYPE
          OpStatus: type=Dcm_OpStatusType, direction=IN, server-argument-impl-policy=USE-ARGUMENT-TYPE
          routineInfo: type=uint8, direction=OUT, server-argument-impl-policy=USE-ARGUMENT-TYPE
          Verification_Result: type=uint8, direction=OUT, server-argument-impl-policy=USE-ARGUMENT-TYPE
          Authentication_Result: type=Dcm_Data3006ByteType, direction=OUT, server-argument-impl-policy=USE-ARRAY-BASE-TYPE
          DataLength: type=uint16, direction=INOUT, server-argument-impl-policy=USE-ARGUMENT-TYPE
          ErrorCode: type=Dcm_NegativeResponseCodeType, direction=OUT, server-argument-impl-policy=USE-ARGUMENT-TYPE
      error DCM_E_FORCE_RCRRP: error-code=12
      error DCM_E_PENDING: error-code=10
      error E_NOT_OK: error-code=1
    RoutineServices_Routine_Certificate_Self_Check
      operation Start: possible-error=[RoutineServices_Routine_Certificate_Self_Check/DCM_E_FORCE_RCRRP, RoutineServices_Routine_Certificate_Self_Check/DCM_E_PENDING, RoutineServices_Routine_Certificate_Self_Check/E_NOT_OK]
        5 x arg, all with server-argument-impl-policy=USE-ARGUMENT-TYPE:
          OpStatus: type=Dcm_OpStatusType, direction=IN
          routineInfo: type=uint8, direction=OUT
          Verification_Result: type=Dcm_Data18ByteType, direction=OUT
          DataLength: type=uint16, direction=OUT
          ErrorCode: type=Dcm_NegativeResponseCodeType, direction=OUT
      error DCM_E_FORCE_RCRRP: error-code=12
      error DCM_E_PENDING: error-code=10
      error E_NOT_OK: error-code=1
    RoutineServices_Routine_Enhance_Access_Rights
      operation Start: possible-error=[RoutineServices_Routine_Enhance_Access_Rights/DCM_E_FORCE_RCRRP, RoutineServices_Routine_Enhance_Access_Rights/DCM_E_PENDING, RoutineServices_Routine_Enhance_Access_Rights/E_NOT_OK]
        6 x arg:
          Enhanced_Rights_Certificate: type=Dcm_Data2002ByteType, direction=IN, server-argument-impl-policy=USE-ARRAY-BASE-TYPE
          OpStatus: type=Dcm_OpStatusType, direction=IN, server-argument-impl-policy=USE-ARGUMENT-TYPE
          routineInfo: type=uint8, direction=OUT, server-argument-impl-policy=USE-ARGUMENT-TYPE
          Verification_Result: type=uint8, direction=OUT, server-argument-impl-policy=USE-ARGUMENT-TYPE
          DataLength: type=uint16, direction=IN, server-argument-impl-policy=USE-ARGUMENT-TYPE
          ErrorCode: type=Dcm_NegativeResponseCodeType, direction=OUT, server-argument-impl-policy=USE-ARGUMENT-TYPE
      error DCM_E_FORCE_RCRRP: error-code=12
      error DCM_E_PENDING: error-code=10
      error E_NOT_OK: error-code=1
    RoutineServices_Routine_Evaluate_Data_Verification_Certificate
      operation Start: possible-error=[RoutineServices_Routine_Evaluate_Data_Verification_Certificate/DCM_E_FORCE_RCRRP, RoutineServices_Routine_Evaluate_Data_Verification_Certificate/DCM_E_PENDING, RoutineServices_Routine_Evaluate_Data_Verification_Certificate/E_NOT_OK]
        6 x arg:
          Data_Verification_Certificate: type=Dcm_Data2002ByteType, direction=IN, server-argument-impl-policy=USE-ARRAY-BASE-TYPE
          OpStatus: type=Dcm_OpStatusType, direction=IN, server-argument-impl-policy=USE-ARGUMENT-TYPE
          routineInfo: type=uint8, direction=OUT, server-argument-impl-policy=USE-ARGUMENT-TYPE
          Verification_Result: type=uint8, direction=OUT, server-argument-impl-policy=USE-ARGUMENT-TYPE
          DataLength: type=uint16, direction=IN, server-argument-impl-policy=USE-ARGUMENT-TYPE
          ErrorCode: type=Dcm_NegativeResponseCodeType, direction=OUT, server-argument-impl-policy=USE-ARGUMENT-TYPE
      error DCM_E_FORCE_RCRRP: error-code=12
      error DCM_E_PENDING: error-code=10
      error E_NOT_OK: error-code=1
    RoutineServices_Routine_Replace_Certificates
      operation Start: possible-error=[RoutineServices_Routine_Replace_Certificates/DCM_E_FORCE_RCRRP, RoutineServices_Routine_Replace_Certificates/DCM_E_PENDING, RoutineServices_Routine_Replace_Certificates/E_NOT_OK]
        6 x arg:
          Certificates: type=Dcm_Data4008ByteType, direction=IN, server-argument-impl-policy=USE-ARRAY-BASE-TYPE
          OpStatus: type=Dcm_OpStatusType, direction=IN, server-argument-impl-policy=USE-ARGUMENT-TYPE
          routineInfo: type=uint8, direction=OUT, server-argument-impl-policy=USE-ARGUMENT-TYPE
          Verification_Result: type=uint8, direction=OUT, server-argument-impl-policy=USE-ARGUMENT-TYPE
          DataLength: type=uint16, direction=IN, server-argument-impl-policy=USE-ARGUMENT-TYPE
          ErrorCode: type=Dcm_NegativeResponseCodeType, direction=OUT, server-argument-impl-policy=USE-ARGUMENT-TYPE
      error DCM_E_FORCE_RCRRP: error-code=12
      error DCM_E_PENDING: error-code=10
      error E_NOT_OK: error-code=1
    RoutineServices_Routine_Reset_VIN_Values
      operation Start: possible-error=[RoutineServices_Routine_Reset_VIN_Values/DCM_E_FORCE_RCRRP, RoutineServices_Routine_Reset_VIN_Values/DCM_E_PENDING, RoutineServices_Routine_Reset_VIN_Values/E_NOT_OK]
        arg OpStatus: type=Dcm_OpStatusType, direction=IN, server-argument-impl-policy=USE-ARGUMENT-TYPE
        arg routineInfo: type=uint8, direction=OUT, server-argument-impl-policy=USE-ARGUMENT-TYPE
        arg ErrorCode: type=Dcm_NegativeResponseCodeType, direction=OUT, server-argument-impl-policy=USE-ARGUMENT-TYPE
      error DCM_E_FORCE_RCRRP: error-code=12
      error DCM_E_PENDING: error-code=10
      error E_NOT_OK: error-code=1
    RoutineServices_Routine_SecOC_ECU_Shared_Secret_Distribution
      operation Start: possible-error=[RoutineServices_Routine_SecOC_ECU_Shared_Secret_Distribution/DCM_E_FORCE_RCRRP, RoutineServices_Routine_SecOC_ECU_Shared_Secret_Distribution/DCM_E_PENDING, RoutineServices_Routine_SecOC_ECU_Shared_Secret_Distribution/E_NOT_OK]
        12 x arg:
          Date_and_Time: type=Dcm_Data7ByteType, direction=IN, server-argument-impl-policy=USE-ARRAY-BASE-TYPE
          Tick_Count: type=Dcm_Data5ByteType, direction=IN, server-argument-impl-policy=USE-ARRAY-BASE-TYPE
          Tick_Count_Offset: type=Dcm_Data5ByteType, direction=IN, server-argument-impl-policy=USE-ARRAY-BASE-TYPE
          Encrypted_Nonce_and_Shared_Secret: type=Dcm_Data80ByteType, direction=IN, server-argument-impl-policy=USE-ARRAY-BASE-TYPE
          Ephemeral_VSM_Public_Key: type=Dcm_Data32ByteType, direction=IN, server-argument-impl-policy=USE-ARRAY-BASE-TYPE
          Data_Signature: type=Dcm_Data64ByteType, direction=IN, server-argument-impl-policy=USE-ARRAY-BASE-TYPE
          VSMs_ECU_Certificate: type=Dcm_Data1002ByteType, direction=IN, server-argument-impl-policy=USE-ARRAY-BASE-TYPE
          OpStatus: type=Dcm_OpStatusType, direction=IN, server-argument-impl-policy=USE-ARGUMENT-TYPE
          routineInfo: type=uint8, direction=OUT, server-argument-impl-policy=USE-ARGUMENT-TYPE
          Verification_Result: type=uint8, direction=OUT, server-argument-impl-policy=USE-ARGUMENT-TYPE
          DataLength: type=uint16, direction=IN, server-argument-impl-policy=USE-ARGUMENT-TYPE
          ErrorCode: type=Dcm_NegativeResponseCodeType, direction=OUT, server-argument-impl-policy=USE-ARGUMENT-TYPE
      error DCM_E_FORCE_RCRRP: error-code=12
      error DCM_E_PENDING: error-code=10
      error E_NOT_OK: error-code=1
    RoutineServices_Routine_Synchronize_Secured_System_Date_and_Time
      operation Start: possible-error=[RoutineServices_Routine_Synchronize_Secured_System_Date_and_Time/DCM_E_FORCE_RCRRP, RoutineServices_Routine_Synchronize_Secured_System_Date_and_Time/DCM_E_PENDING, RoutineServices_Routine_Synchronize_Secured_System_Date_and_Time/E_NOT_OK]
        4 x arg:
          OpStatus: type=Dcm_OpStatusType, direction=IN, server-argument-impl-policy=USE-ARGUMENT-TYPE
          routineInfo: type=uint8, direction=OUT, server-argument-impl-policy=USE-ARGUMENT-TYPE
          Nonce: type=Dcm_Data32ByteType, direction=OUT, server-argument-impl-policy=USE-ARRAY-BASE-TYPE
          ErrorCode: type=Dcm_NegativeResponseCodeType, direction=OUT, server-argument-impl-policy=USE-ARGUMENT-TYPE
      error DCM_E_FORCE_RCRRP: error-code=12
      error DCM_E_PENDING: error-code=10
      error E_NOT_OK: error-code=1
    RoutineServices_Routine_Verify_Signature
      operation Start: possible-error=[RoutineServices_Routine_Verify_Signature/DCM_E_FORCE_RCRRP, RoutineServices_Routine_Verify_Signature/DCM_E_PENDING, RoutineServices_Routine_Verify_Signature/E_NOT_OK]
        6 x arg:
          Data_to_be_checked: type=uint8, direction=IN, server-argument-impl-policy=USE-ARGUMENT-TYPE
          Signature_Value: type=Dcm_Data64ByteType, direction=IN, server-argument-impl-policy=USE-ARRAY-BASE-TYPE
          OpStatus: type=Dcm_OpStatusType, direction=IN, server-argument-impl-policy=USE-ARGUMENT-TYPE
          routineInfo: type=uint8, direction=OUT, server-argument-impl-policy=USE-ARGUMENT-TYPE
          Verification_Result: type=uint8, direction=OUT, server-argument-impl-policy=USE-ARGUMENT-TYPE
          ErrorCode: type=Dcm_NegativeResponseCodeType, direction=OUT, server-argument-impl-policy=USE-ARGUMENT-TYPE
      error DCM_E_FORCE_RCRRP: error-code=12
      error DCM_E_PENDING: error-code=10
      error E_NOT_OK: error-code=1
    RoutineServices_Trust_Model_SecOC_ECU_Shared_Secret_Distribution
      operation Start: possible-error=[RoutineServices_Trust_Model_SecOC_ECU_Shared_Secret_Distribution/DCM_E_FORCE_RCRRP, RoutineServices_Trust_Model_SecOC_ECU_Shared_Secret_Distribution/DCM_E_PENDING, RoutineServices_Trust_Model_SecOC_ECU_Shared_Secret_Distribution/E_NOT_OK]
        12 x arg, all with server-argument-impl-policy=USE-ARGUMENT-TYPE:
          Date_and_Time_In: type=Dcm_Data7ByteType, direction=IN
          Tick_Count_In: type=Dcm_Data5ByteType, direction=IN
          Tick_Count_Offset_In: type=Dcm_Data5ByteType, direction=IN
          Encrypted_Nonce_and_Shared_Secret_In: type=Dcm_Data80ByteType, direction=IN
          Ephemeral_VSM_Public_Key_In: type=Dcm_Data32ByteType, direction=IN
          Data_Signature_In: type=Dcm_Data64ByteType, direction=IN
          Certificates_In: type=Dcm_Data3006ByteType, direction=IN
          OpStatus: type=Dcm_OpStatusType, direction=IN
          routineInfo_Out: type=uint8, direction=OUT
          Verification_Result_Out: type=uint8, direction=OUT
          DataLength: type=uint16, direction=IN
          ErrorCode: type=Dcm_NegativeResponseCodeType, direction=OUT
      error DCM_E_FORCE_RCRRP: error-code=12
      error DCM_E_PENDING: error-code=10
      error E_NOT_OK: error-code=1
    SecLog_AuthorizationBySecurityAccess
      operation AuthorizationBySecurityAccess: possible-error=SecLog_AuthorizationBySecurityAccess/E_NOT_OK
        arg diagChanAuthStatus: type=uint8, direction=IN, server-argument-impl-policy=USE-ARGUMENT-TYPE
        arg securityLevel: type=uint8, direction=IN, server-argument-impl-policy=USE-ARGUMENT-TYPE
        arg securityAccessResult: type=uint8, direction=IN, server-argument-impl-policy=USE-ARGUMENT-TYPE
      error E_NOT_OK: error-code=1
    SecLog_ChangeTickCountOrDateAndTimeEvent
      operation ChangeTickCountOrDateAndTime: possible-error=SecLog_ChangeTickCountOrDateAndTimeEvent/E_NOT_OK
        arg contextDateTimeChange: type=uint8, direction=IN, server-argument-impl-policy=USE-ARGUMENT-TYPE
        arg deltaTimeChange: type=Ssa_Data5ByteType, direction=IN, server-argument-impl-policy=USE-ARRAY-BASE-TYPE
      error E_NOT_OK: error-code=1
    SecLog_ChangeVinEvent
      operation ChangeVin: possible-error=SecLog_ChangeVinEvent/E_NOT_OK
        arg newVin: type=SecLog_VinType, direction=IN, server-argument-impl-policy=USE-ARRAY-BASE-TYPE
      error E_NOT_OK: error-code=1
    SecLog_EcuIndividualAclReplacementEvent
      operation EcuIndividualAclReplacement: possible-error=SecLog_EcuIndividualAclReplacementEvent/E_NOT_OK
        arg newAclVersion: type=SecLog_AclVersionType, direction=IN, server-argument-impl-policy=USE-ARRAY-BASE-TYPE
        arg compatibility: type=uint8, direction=IN, server-argument-impl-policy=USE-ARGUMENT-TYPE
      error E_NOT_OK: error-code=1
    SecLog_FailedCertVerificationEvent
      operation FailedCertificateVerification: possible-error=SecLog_FailedCertVerificationEvent/E_NOT_OK
        arg pkiRole: type=CertP_PkiRoleType, direction=IN, server-argument-impl-policy=USE-ARGUMENT-TYPE
        arg validationResult: type=CertP_VerificationResultType, direction=IN, server-argument-impl-policy=USE-ARGUMENT-TYPE
      error E_NOT_OK: error-code=1
    SecLog_RightsManagementEvent
      operation RightsManagement: possible-error=SecLog_RightsManagementEvent/E_NOT_OK
        4 x arg, all with direction=IN, server-argument-impl-policy=USE-ARGUMENT-TYPE:
          diagChanAuthStatus: type=uint8
          serviceId: type=uint8
          subFunction: type=uint8
          dataIdOrRoutineId: type=uint16
      error E_NOT_OK: error-code=1
    SecLog_SecureBootOrAuthenticatedBootEvent
      operation SecureBootOrAuthenticatedBoot: possible-error=SecLog_SecureBootOrAuthenticatedBootEvent/E_NOT_OK
      error E_NOT_OK: error-code=1
    SecLog_SignatureVerificationEvent
      operation SignatureVerification: possible-error=SecLog_SignatureVerificationEvent/E_NOT_OK
        arg verificationResult: type=uint8, direction=IN, server-argument-impl-policy=USE-ARGUMENT-TYPE
      error E_NOT_OK: error-code=1
    SecLog_SuccessfulAuthAndEnhanceRights
      operation SuccessfulAuthAndEnhanceRights: possible-error=SecLog_SuccessfulAuthAndEnhanceRights/E_NOT_OK
        arg diagChanAuthStatus: type=uint8, direction=IN, server-argument-impl-policy=USE-ARGUMENT-TYPE
        arg pkiRole: type=CertP_PkiRoleType, direction=IN, server-argument-impl-policy=USE-ARGUMENT-TYPE
        arg authenticationContent: type=SecLog_AuthenticationContentType, direction=IN, server-argument-impl-policy=USE-ARRAY-BASE-TYPE
      error E_NOT_OK: error-code=1
    SecLog_SuccessfulCertVerificationEvent
      operation SuccessfulCertificateVerification: possible-error=SecLog_SuccessfulCertVerificationEvent/E_NOT_OK
        arg certId: type=RightsM_SerialNumberType, direction=IN, server-argument-impl-policy=USE-ARRAY-BASE-TYPE
        arg pkiRole: type=CertP_PkiRoleType, direction=IN, server-argument-impl-policy=USE-ARGUMENT-TYPE
      error E_NOT_OK: error-code=1
    SecLog_SuccessfulDiagServiceExecutionEvent
      operation SuccessfulDiagServiceExecution: possible-error=SecLog_SuccessfulDiagServiceExecutionEvent/E_NOT_OK
        arg additionalInfo: type=uint8, direction=IN, server-argument-impl-policy=USE-ARGUMENT-TYPE
      error E_NOT_OK: error-code=1
    SecurityAccessServices_GenericSecurityAccess
      operation CompareKey: possible-error=[SecurityAccessServices_GenericSecurityAccess/E_NOT_OK, SecurityAccessServices_GenericSecurityAccess/E_PENDING]
        4 x arg:
          secLevel: type=uint8, direction=IN, server-argument-impl-policy=USE-ARGUMENT-TYPE
          key: type=Dcm_Data64ByteType, direction=IN, server-argument-impl-policy=USE-ARRAY-BASE-TYPE
          opStatus: type=Dcm_OpStatusType, direction=IN, server-argument-impl-policy=USE-ARGUMENT-TYPE
          errorCode: type=Dcm_NegativeResponseCodeType, direction=OUT, server-argument-impl-policy=USE-ARGUMENT-TYPE
      operation GetSeed: possible-error=[SecurityAccessServices_GenericSecurityAccess/E_NOT_OK, SecurityAccessServices_GenericSecurityAccess/E_PENDING]
        4 x arg:
          secLevel: type=uint8, direction=IN, server-argument-impl-policy=USE-ARGUMENT-TYPE
          opStatus: type=Dcm_OpStatusType, direction=IN, server-argument-impl-policy=USE-ARGUMENT-TYPE
          seed: type=Dcm_Data32ByteType, direction=OUT, server-argument-impl-policy=USE-ARRAY-BASE-TYPE
          errorCode: type=Dcm_NegativeResponseCodeType, direction=OUT, server-argument-impl-policy=USE-ARGUMENT-TYPE
      error E_NOT_OK: error-code=1
      error E_PENDING: error-code=10
    Ssa_KeyStorage  # Requests for storing the key material or certificates permanently i.e. for making them persistent.
      operation StorePermanently: possible-error=[Ssa_KeyStorage/E_NOT_OK, Ssa_KeyStorage/E_PENDING]
        arg keyStorageUseCase: type=Ssa_KeyStorageUseCaseType, direction=IN, server-argument-impl-policy=USE-ARGUMENT-TYPE
        arg keyStorageTask: type=Ssa_KeyStorageTaskType, direction=IN, server-argument-impl-policy=USE-ARGUMENT-TYPE
      error E_NOT_OK: error-code=1
      error E_PENDING: error-code=2
    Ssa_RightsM_Certificate
      operation GetDiagAuthCertSerialNumber_SecurityAccess: possible-error=Ssa_RightsM_Certificate/E_NOT_OK  # Read the Diagnostic Authentication Certificate Serial Number belonging to the diagnostic channel the last successful security access was executed on.
        arg serialNumber: type=RightsM_SerialNumberType, direction=OUT, server-argument-impl-policy=USE-ARRAY-BASE-TYPE
      error E_NOT_OK: error-code=1
    Ssa_RightsM_DiagnosticInformation
      operation Get: possible-error=Ssa_RightsM_DiagnosticInformation/E_NOT_OK
        arg diagVersion: type=uint8, direction=OUT, server-argument-impl-policy=USE-ARGUMENT-TYPE
        arg diagVariant: type=uint8, direction=OUT, server-argument-impl-policy=USE-ARGUMENT-TYPE
      error E_NOT_OK: error-code=1
    Ssa_RngSeed  # Requests for true random data with high entropy, e.g. from a TRNG.
      operation GetTrueRandom: possible-error=[Ssa_RngSeed/E_NOT_OK, Ssa_RngSeed/E_PENDING]
        arg opStatus: type=Ssa_OpStatusType, direction=IN, server-argument-impl-policy=USE-ARGUMENT-TYPE
        arg data: type=Ssa_Data32ByteType, direction=OUT, server-argument-impl-policy=USE-ARRAY-BASE-TYPE
        arg dataLength: type=uint16, direction=INOUT, server-argument-impl-policy=USE-ARGUMENT-TYPE
      error E_NOT_OK: error-code=1
      error E_PENDING: error-code=2
    Ssa_TrustModelCsr  # Requests for preparation of the Trust Model CSR (certificate signing request).
      operation GetCommonName: possible-error=Ssa_TrustModelCsr/E_NOT_OK
        arg data: type=Ssa_Data30ByteType, direction=OUT, server-argument-impl-policy=USE-ARRAY-BASE-TYPE
        arg dataLength: type=uint16, direction=INOUT, server-argument-impl-policy=USE-ARGUMENT-TYPE
      error E_NOT_OK: error-code=1
    SsaCdd_CryptoInterface
      4 x operation, all with possible-error=SsaCdd_CryptoInterface/E_NOT_OK:
        CancelJob
          arg jobId: type=uint32, direction=IN, server-argument-impl-policy=USE-ARGUMENT-TYPE
          arg operationMode: type=Crypto_OperationModeType, direction=IN, server-argument-impl-policy=USE-ARGUMENT-TYPE
        Hash
          6 x arg, all with direction=IN, server-argument-impl-policy=USE-ARGUMENT-TYPE:
            jobId: type=uint32
            operationMode: type=Crypto_OperationModeType
            dataBuffer: type=Ssa_ConstDataPtr
            dataLength: type=uint32
            resultBuffer: type=Ssa_DataPtr
            resultLength: type=Ssa_LengthPtr
        SignatureGenerate
          6 x arg, all with direction=IN, server-argument-impl-policy=USE-ARGUMENT-TYPE:
            jobId: type=uint32
            operationMode: type=Crypto_OperationModeType
            dataBuffer: type=Ssa_ConstDataPtr
            dataLength: type=uint32
            resultBuffer: type=Ssa_DataPtr
            resultLength: type=Ssa_LengthPtr
        SignatureVerify
          7 x arg, all with direction=IN, server-argument-impl-policy=USE-ARGUMENT-TYPE:
            jobId: type=uint32
            operationMode: type=Crypto_OperationModeType
            dataBuffer: type=Ssa_ConstDataPtr
            dataLength: type=uint32
            compareBuffer: type=Ssa_ConstDataPtr
            compareLength: type=uint32
            resultBuffer: type=Ssa_VerifyResultPtr
      error E_NOT_OK: error-code=1
    SsaCdd_Csm_KeyInterface
      4 x operation, all with possible-error=[SsaCdd_Csm_KeyInterface/E_NOT_OK, SsaCdd_Csm_KeyInterface/E_BUSY]:
        KeyElementCopy
          4 x arg, all with type=uint32, direction=IN, server-argument-impl-policy=USE-ARGUMENT-TYPE:
            keyId
            keyElementId
            targetKeyId
            targetKeyElementId
        KeyElementGet
          4 x arg, all with direction=IN, server-argument-impl-policy=USE-ARGUMENT-TYPE:
            keyId: type=uint32
            keyElementId: type=uint32
            keyPtr: type=Ssa_DataPtr
            keyLengthPtr: type=Ssa_LengthPtr
        KeyElementSet
          4 x arg, all with direction=IN, server-argument-impl-policy=USE-ARGUMENT-TYPE:
            keyId: type=uint32
            keyElementId: type=uint32
            keyPtr: type=Ssa_ConstDataPtr
            keyLength: type=uint32
        KeySetValid
          arg keyId: type=uint32, direction=IN, server-argument-impl-policy=USE-ARGUMENT-TYPE
      error E_NOT_OK: error-code=1
      error E_BUSY: error-code=2
    TimeM_RealTime
      operation Compare: possible-error=TimeM_RealTime/E_NOT_OK
        4 x arg, all with server-argument-impl-policy=USE-ARGUMENT-TYPE:
          t1: type=TimeM_DateTimeType, direction=IN
          compareOp: type=TimeM_CompareOperatorType, direction=IN
          t2: type=TimeM_DateTimeType, direction=IN
          result: type=boolean, direction=OUT
      operation Get: possible-error=TimeM_RealTime/E_NOT_OK
        arg realTime: type=TimeM_DateTimeType, direction=OUT, server-argument-impl-policy=USE-ARGUMENT-TYPE
      operation Set: possible-error=TimeM_RealTime/E_NOT_OK
        arg realTime: type=TimeM_DateTimeType, direction=IN, server-argument-impl-policy=USE-ARGUMENT-TYPE
        arg changeReason: type=TimeM_RealTimeChangeReasonType, direction=IN, server-argument-impl-policy=USE-ARGUMENT-TYPE
      error E_NOT_OK: error-code=1
    TimeM_TickCount
      operation Get: possible-error=TimeM_TickCount/E_NOT_OK
        arg tickCount: type=uint64, direction=OUT, server-argument-impl-policy=USE-ARGUMENT-TYPE
      error E_NOT_OK: error-code=1
    TimeM_TimeRawData
      operation Get: possible-error=TimeM_TimeRawData/E_NOT_OK
        arg dateTimeOffset: type=Ssa_Data7ByteType, direction=OUT, server-argument-impl-policy=USE-ARRAY-BASE-TYPE
        arg tickCountOffset: type=Ssa_Data5ByteType, direction=OUT, server-argument-impl-policy=USE-ARRAY-BASE-TYPE
        arg tickCount: type=Ssa_Data5ByteType, direction=OUT, server-argument-impl-policy=USE-ARRAY-BASE-TYPE
      operation ResetLocalTickCount: possible-error=TimeM_TimeRawData/E_NOT_OK
      operation Set: possible-error=TimeM_TimeRawData/E_NOT_OK
        arg dateTimeOffset: type=Ssa_Data7ByteType, direction=IN, server-argument-impl-policy=USE-ARRAY-BASE-TYPE
        arg tickCountOffset: type=Ssa_Data5ByteType, direction=IN, server-argument-impl-policy=USE-ARRAY-BASE-TYPE
        arg tickCount: type=Ssa_Data5ByteType, direction=IN, server-argument-impl-policy=USE-ARRAY-BASE-TYPE
      error E_NOT_OK: error-code=1
  10 x sender receiver interface:
    RightsM_Com_AuthenticationBroadcast
      data authentication: type=RightsM_AuthenticationBroadcastType
    RightsM_SecurityLevelChange  # Notifies application about the current active security level.
      data currentLevel: type=uint8  # Current security level. Default is 0.
    SecLog_EventNotification  # Notifies application about on occurred log event which shall trigger an ROE.
      data Data: type=Ssa_Data7ByteType
    SecLog_MacVerificationSecureBroadcastEvent
      data verificationStatus: type=SecOC_VerificationStatusType
    Ssa_BusOdometer
      data DI_Odo_Pr5_ST3: type=Ssa_OdometerRecordType  # This is a sender receiver interface for communication of the bus odometer value.
    Ssa_ChangeTickCountEvent
      data Id: type=Ssa_ChangeTickCountEventIdType
      data TickCount: type=Ssa_Data5ByteType
    Ssa_FailedMacVerifCounterEvent
      data Event: sw-impl-policy=QUEUED, type=Ssa_FailedMacVerifCounterEventType
    Ssa_IgnitionStatus  # Ignition switch state
      data Ign_Stat_Pr5_ST3: type=Ssa_IgnitionStatusType  # Ignition switch state
    Ssa_PowernetMgmtState  # Powernet Managment State
      data PN14_DDP_Sw_Stat_ST3: type=Ssa_PowernetMgmtStateType
    TimeM_Com_RealTimeOffset
      data realTimeOffset: type=Ssa_Data12ByteType
  26 x client server interface:
    CertP_Functions
      6 x operation:
        AttributeCertificate_Parse: possible-error=CertP_Functions/E_NOT_OK
          arg rawCertData: type=CertP_RawCertBufferType, direction=IN, server-argument-impl-policy=USE-ARRAY-BASE-TYPE
          arg rawCertLength: type=uint16, direction=IN, server-argument-impl-policy=USE-ARGUMENT-TYPE
          arg parsedCert: type=CertP_ParsedCertStructureType, direction=OUT, server-argument-impl-policy=USE-ARGUMENT-TYPE
        Certificate_Compare: possible-error=CertP_Functions/E_NOT_OK
          7 x arg:
            rawCertData1: type=CertP_RawCertBufferType, direction=IN, server-argument-impl-policy=USE-ARRAY-BASE-TYPE
            parsedCert1: type=CertP_ParsedCertStructureType, direction=IN, server-argument-impl-policy=USE-ARGUMENT-TYPE
            pkiRole1: type=CertP_PkiRoleType, direction=IN, server-argument-impl-policy=USE-ARGUMENT-TYPE
            rawCertData2: type=CertP_RawCertBufferType, direction=IN, server-argument-impl-policy=USE-ARRAY-BASE-TYPE
            parsedCert2: type=CertP_ParsedCertStructureType, direction=IN, server-argument-impl-policy=USE-ARGUMENT-TYPE
            pkiRole2: type=CertP_PkiRoleType, direction=IN, server-argument-impl-policy=USE-ARGUMENT-TYPE
            isEqual: type=boolean, direction=OUT, server-argument-impl-policy=USE-ARGUMENT-TYPE
        Certificate_Parse: possible-error=CertP_Functions/E_NOT_OK
          arg rawCertData: type=CertP_RawCertBufferType, direction=IN, server-argument-impl-policy=USE-ARRAY-BASE-TYPE
          arg rawCertLength: type=uint16, direction=IN, server-argument-impl-policy=USE-ARGUMENT-TYPE
          arg parsedCert: type=CertP_ParsedCertStructureType, direction=OUT, server-argument-impl-policy=USE-ARGUMENT-TYPE
        Certificate_Verify: possible-error=[CertP_Functions/E_NOT_OK, CertP_Functions/E_PENDING]
          5 x arg:
            rawCertData: type=CertP_RawCertBufferType, direction=IN, server-argument-impl-policy=USE-ARRAY-BASE-TYPE
            parsedCert: type=CertP_ParsedCertStructureType, direction=INOUT, server-argument-impl-policy=USE-ARGUMENT-TYPE
            rawCertIssuer: type=CertP_RawCertBufferType, direction=IN, server-argument-impl-policy=USE-ARRAY-BASE-TYPE
            parsedCertIssuer: type=CertP_ParsedCertStructureType, direction=IN, server-argument-impl-policy=USE-ARGUMENT-TYPE
            expectedPkiRole: type=CertP_PkiRoleType, direction=IN, server-argument-impl-policy=USE-ARGUMENT-TYPE
        Certificate_Verify_Extended: possible-error=[CertP_Functions/E_NOT_OK, CertP_Functions/E_PENDING]
          6 x arg:
            rawCertData: type=CertP_RawCertBufferType, direction=IN, server-argument-impl-policy=USE-ARRAY-BASE-TYPE
            parsedCert: type=CertP_ParsedCertStructureType, direction=INOUT, server-argument-impl-policy=USE-ARGUMENT-TYPE
            rawCertIssuer: type=CertP_RawCertBufferType, direction=IN, server-argument-impl-policy=USE-ARRAY-BASE-TYPE
            parsedCertIssuer: type=CertP_ParsedCertStructureType, direction=IN, server-argument-impl-policy=USE-ARGUMENT-TYPE
            expectedPkiRole: type=CertP_PkiRoleType, direction=IN, server-argument-impl-policy=USE-ARGUMENT-TYPE
            expectedNonce: type=RightsM_AuthNonceType, direction=IN, server-argument-impl-policy=USE-ARGUMENT-TYPE
        ParseTime: possible-error=CertP_Functions/E_NOT_OK
          arg data: type=Ssa_Data15ByteType, direction=IN, server-argument-impl-policy=USE-ARRAY-BASE-TYPE
          arg dataLength: type=uint16, direction=IN, server-argument-impl-policy=USE-ARGUMENT-TYPE
          arg dateTime: type=TimeM_DateTimeType, direction=OUT, server-argument-impl-policy=USE-ARGUMENT-TYPE
      error E_NOT_OK: error-code=1
      error E_PENDING: error-code=10
    Coding_VIN
      operation Get: possible-error=Coding_VIN/E_NOT_OK
        arg vin: type=Coding_VINDataType, direction=OUT, server-argument-impl-policy=USE-ARRAY-BASE-TYPE
      error E_NOT_OK: error-code=1
    Coding_VINControl
      operation GetStoreState: possible-error=Coding_VINControl/E_NOT_OK
        arg state: type=Ssa_VinStoreStateType, direction=OUT, server-argument-impl-policy=USE-ARGUMENT-TYPE
      operation Lock: possible-error=Coding_VINControl/E_NOT_OK
        arg locked: type=boolean, direction=IN, server-argument-impl-policy=USE-ARGUMENT-TYPE
      operation Set: possible-error=Coding_VINControl/E_NOT_OK
        arg vin: type=Coding_VINDataType, direction=IN, server-argument-impl-policy=USE-ARRAY-BASE-TYPE
      error E_NOT_OK: error-code=1
    DataServices_DID_018F_Secured_PDU_Data_IDs_and_Key_CMACs
      operation ConditionCheckRead: possible-error=[DataServices_DID_018F_Secured_PDU_Data_IDs_and_Key_CMACs/DCM_E_PENDING, DataServices_DID_018F_Secured_PDU_Data_IDs_and_Key_CMACs/E_NOT_OK]
        arg OpStatus: type=Dcm_OpStatusType, direction=IN, server-argument-impl-policy=USE-ARGUMENT-TYPE
        arg ErrorCode: type=Dcm_NegativeResponseCodeType, direction=OUT, server-argument-impl-policy=USE-ARGUMENT-TYPE
      operation ReadData: possible-error=[DataServices_DID_018F_Secured_PDU_Data_IDs_and_Key_CMACs/DCM_E_PENDING, DataServices_DID_018F_Secured_PDU_Data_IDs_and_Key_CMACs/E_NOT_OK]
        arg OpStatus: type=Dcm_OpStatusType, direction=IN, server-argument-impl-policy=USE-ARGUMENT-TYPE
        arg Data: type=Dcm_Data4092ByteType, direction=OUT, server-argument-impl-policy=USE-ARGUMENT-TYPE
      operation ReadDataLength: possible-error=[DataServices_DID_018F_Secured_PDU_Data_IDs_and_Key_CMACs/DCM_E_PENDING, DataServices_DID_018F_Secured_PDU_Data_IDs_and_Key_CMACs/E_NOT_OK]
        arg OpStatus: type=Dcm_OpStatusType, direction=IN, server-argument-impl-policy=USE-ARGUMENT-TYPE
        arg DataLength: type=uint16, direction=OUT, server-argument-impl-policy=USE-ARGUMENT-TYPE
      error DCM_E_PENDING: error-code=10
      error E_NOT_OK: error-code=1
    DataServices_DID_0191_Generated_Random_Number
      operation ConditionCheckRead: possible-error=[DataServices_DID_0191_Generated_Random_Number/DCM_E_PENDING, DataServices_DID_0191_Generated_Random_Number/E_NOT_OK]
        arg OpStatus: type=Dcm_OpStatusType, direction=IN, server-argument-impl-policy=USE-ARGUMENT-TYPE
        arg ErrorCode: type=Dcm_NegativeResponseCodeType, direction=OUT, server-argument-impl-policy=USE-ARGUMENT-TYPE
      operation ReadData: possible-error=[DataServices_DID_0191_Generated_Random_Number/DCM_E_PENDING, DataServices_DID_0191_Generated_Random_Number/E_NOT_OK]
        arg OpStatus: type=Dcm_OpStatusType, direction=IN, server-argument-impl-policy=USE-ARGUMENT-TYPE
        arg Data: type=Dcm_Data32ByteType, direction=OUT, server-argument-impl-policy=USE-ARGUMENT-TYPE
      error DCM_E_PENDING: error-code=10
      error E_NOT_OK: error-code=1
    DataServices_DID_0191_Generated_Random_Number_Result
      operation ConditionCheckRead: possible-error=[DataServices_DID_0191_Generated_Random_Number_Result/DCM_E_PENDING, DataServices_DID_0191_Generated_Random_Number_Result/E_NOT_OK]
        arg OpStatus: type=Dcm_OpStatusType, direction=IN, server-argument-impl-policy=USE-ARGUMENT-TYPE
        arg ErrorCode: type=Dcm_NegativeResponseCodeType, direction=OUT, server-argument-impl-policy=USE-ARGUMENT-TYPE
      operation ReadData: possible-error=[DataServices_DID_0191_Generated_Random_Number_Result/DCM_E_PENDING, DataServices_DID_0191_Generated_Random_Number_Result/E_NOT_OK]
        arg OpStatus: type=Dcm_OpStatusType, direction=IN, server-argument-impl-policy=USE-ARGUMENT-TYPE
        arg Data: type=Dcm_Data1ByteType, direction=OUT, server-argument-impl-policy=USE-ARGUMENT-TYPE
      error DCM_E_PENDING: error-code=10
      error E_NOT_OK: error-code=1
    DataServices_DID_0199_Certificates
      operation ConditionCheckRead: possible-error=[DataServices_DID_0199_Certificates/DCM_E_PENDING, DataServices_DID_0199_Certificates/E_NOT_OK]
        arg OpStatus: type=Dcm_OpStatusType, direction=IN, server-argument-impl-policy=USE-ARGUMENT-TYPE
        arg ErrorCode: type=Dcm_NegativeResponseCodeType, direction=OUT, server-argument-impl-policy=USE-ARGUMENT-TYPE
      operation ReadData: possible-error=[DataServices_DID_0199_Certificates/DCM_E_PENDING, DataServices_DID_0199_Certificates/E_NOT_OK]
        arg OpStatus: type=Dcm_OpStatusType, direction=IN, server-argument-impl-policy=USE-ARGUMENT-TYPE
        arg Data: type=Dcm_Data3006ByteType, direction=OUT, server-argument-impl-policy=USE-ARGUMENT-TYPE
      operation ReadDataLength: possible-error=[DataServices_DID_0199_Certificates/DCM_E_PENDING, DataServices_DID_0199_Certificates/E_NOT_OK]
        arg OpStatus: type=Dcm_OpStatusType, direction=IN, server-argument-impl-policy=USE-ARGUMENT-TYPE
        arg DataLength: type=uint16, direction=OUT, server-argument-impl-policy=USE-ARGUMENT-TYPE
      error DCM_E_PENDING: error-code=10
      error E_NOT_OK: error-code=1
    DataServices_DID_0199_Data_Signature
      operation ConditionCheckRead: possible-error=[DataServices_DID_0199_Data_Signature/DCM_E_PENDING, DataServices_DID_0199_Data_Signature/E_NOT_OK]
        arg OpStatus: type=Dcm_OpStatusType, direction=IN, server-argument-impl-policy=USE-ARGUMENT-TYPE
        arg ErrorCode: type=Dcm_NegativeResponseCodeType, direction=OUT, server-argument-impl-policy=USE-ARGUMENT-TYPE
      operation ReadData: possible-error=[DataServices_DID_0199_Data_Signature/DCM_E_PENDING, DataServices_DID_0199_Data_Signature/E_NOT_OK]
        arg OpStatus: type=Dcm_OpStatusType, direction=IN, server-argument-impl-policy=USE-ARGUMENT-TYPE
        arg Data: type=Dcm_Data64ByteType, direction=OUT, server-argument-impl-policy=USE-ARGUMENT-TYPE
      error DCM_E_PENDING: error-code=10
      error E_NOT_OK: error-code=1
    DataServices_DID_0199_Ephemeral_ECU_Public_Key
      operation ConditionCheckRead: possible-error=[DataServices_DID_0199_Ephemeral_ECU_Public_Key/DCM_E_PENDING, DataServices_DID_0199_Ephemeral_ECU_Public_Key/E_NOT_OK]
        arg OpStatus: type=Dcm_OpStatusType, direction=IN, server-argument-impl-policy=USE-ARGUMENT-TYPE
        arg ErrorCode: type=Dcm_NegativeResponseCodeType, direction=OUT, server-argument-impl-policy=USE-ARGUMENT-TYPE
      operation ReadData: possible-error=[DataServices_DID_0199_Ephemeral_ECU_Public_Key/DCM_E_PENDING, DataServices_DID_0199_Ephemeral_ECU_Public_Key/E_NOT_OK]
        arg OpStatus: type=Dcm_OpStatusType, direction=IN, server-argument-impl-policy=USE-ARGUMENT-TYPE
        arg Data: type=Dcm_Data32ByteType, direction=OUT, server-argument-impl-policy=USE-ARGUMENT-TYPE
      error DCM_E_PENDING: error-code=10
      error E_NOT_OK: error-code=1
    DataServices_DID_0199_Nonce
      operation ConditionCheckRead: possible-error=[DataServices_DID_0199_Nonce/DCM_E_PENDING, DataServices_DID_0199_Nonce/E_NOT_OK]
        arg OpStatus: type=Dcm_OpStatusType, direction=IN, server-argument-impl-policy=USE-ARGUMENT-TYPE
        arg ErrorCode: type=Dcm_NegativeResponseCodeType, direction=OUT, server-argument-impl-policy=USE-ARGUMENT-TYPE
      operation ReadData: possible-error=[DataServices_DID_0199_Nonce/DCM_E_PENDING, DataServices_DID_0199_Nonce/E_NOT_OK]
        arg OpStatus: type=Dcm_OpStatusType, direction=IN, server-argument-impl-policy=USE-ARGUMENT-TYPE
        arg Data: type=Dcm_Data32ByteType, direction=OUT, server-argument-impl-policy=USE-ARGUMENT-TYPE
      error DCM_E_PENDING: error-code=10
      error E_NOT_OK: error-code=1
    DataServices_DID_019A_Trust_model_ECU_CSR
      operation ConditionCheckRead: possible-error=[DataServices_DID_019A_Trust_model_ECU_CSR/DCM_E_PENDING, DataServices_DID_019A_Trust_model_ECU_CSR/E_NOT_OK]
        arg OpStatus: type=Dcm_OpStatusType, direction=IN, server-argument-impl-policy=USE-ARGUMENT-TYPE
        arg ErrorCode: type=Dcm_NegativeResponseCodeType, direction=OUT, server-argument-impl-policy=USE-ARGUMENT-TYPE
      operation ReadData: possible-error=[DataServices_DID_019A_Trust_model_ECU_CSR/DCM_E_PENDING, DataServices_DID_019A_Trust_model_ECU_CSR/E_NOT_OK]
        arg OpStatus: type=Dcm_OpStatusType, direction=IN, server-argument-impl-policy=USE-ARGUMENT-TYPE
        arg Data: type=Dcm_Data1002ByteType, direction=OUT, server-argument-impl-policy=USE-ARGUMENT-TYPE
      operation ReadDataLength: possible-error=[DataServices_DID_019A_Trust_model_ECU_CSR/DCM_E_PENDING, DataServices_DID_019A_Trust_model_ECU_CSR/E_NOT_OK]
        arg OpStatus: type=Dcm_OpStatusType, direction=IN, server-argument-impl-policy=USE-ARGUMENT-TYPE
        arg DataLength: type=uint16, direction=OUT, server-argument-impl-policy=USE-ARGUMENT-TYPE
      error DCM_E_PENDING: error-code=10
      error E_NOT_OK: error-code=1
    DataServices_DID_019B_Trust_model_ECU_Certificate
      operation ConditionCheckRead: possible-error=[DataServices_DID_019B_Trust_model_ECU_Certificate/DCM_E_PENDING, DataServices_DID_019B_Trust_model_ECU_Certificate/E_NOT_OK]
        arg OpStatus: type=Dcm_OpStatusType, direction=IN, server-argument-impl-policy=USE-ARGUMENT-TYPE
        arg ErrorCode: type=Dcm_NegativeResponseCodeType, direction=OUT, server-argument-impl-policy=USE-ARGUMENT-TYPE
      operation ReadData: possible-error=[DataServices_DID_019B_Trust_model_ECU_Certificate/DCM_E_PENDING, DataServices_DID_019B_Trust_model_ECU_Certificate/E_NOT_OK]
        arg OpStatus: type=Dcm_OpStatusType, direction=IN, server-argument-impl-policy=USE-ARGUMENT-TYPE
        arg Data: type=Dcm_Data1002ByteType, direction=OUT, server-argument-impl-policy=USE-ARGUMENT-TYPE
      operation ReadDataLength: possible-error=[DataServices_DID_019B_Trust_model_ECU_Certificate/DCM_E_PENDING, DataServices_DID_019B_Trust_model_ECU_Certificate/E_NOT_OK]
        arg OpStatus: type=Dcm_OpStatusType, direction=IN, server-argument-impl-policy=USE-ARGUMENT-TYPE
        arg DataLength: type=uint16, direction=OUT, server-argument-impl-policy=USE-ARGUMENT-TYPE
      error DCM_E_PENDING: error-code=10
      error E_NOT_OK: error-code=1
    DataServices_DID_019C_Trust_model_Intermediate_CA_Certificate
      operation ConditionCheckRead: possible-error=[DataServices_DID_019C_Trust_model_Intermediate_CA_Certificate/DCM_E_PENDING, DataServices_DID_019C_Trust_model_Intermediate_CA_Certificate/E_NOT_OK]
        arg OpStatus: type=Dcm_OpStatusType, direction=IN, server-argument-impl-policy=USE-ARGUMENT-TYPE
        arg ErrorCode: type=Dcm_NegativeResponseCodeType, direction=OUT, server-argument-impl-policy=USE-ARGUMENT-TYPE
      operation ReadData: possible-error=[DataServices_DID_019C_Trust_model_Intermediate_CA_Certificate/DCM_E_PENDING, DataServices_DID_019C_Trust_model_Intermediate_CA_Certificate/E_NOT_OK]
        arg OpStatus: type=Dcm_OpStatusType, direction=IN, server-argument-impl-policy=USE-ARGUMENT-TYPE
        arg Data: type=Dcm_Data1002ByteType, direction=OUT, server-argument-impl-policy=USE-ARGUMENT-TYPE
      operation ReadDataLength: possible-error=[DataServices_DID_019C_Trust_model_Intermediate_CA_Certificate/DCM_E_PENDING, DataServices_DID_019C_Trust_model_Intermediate_CA_Certificate/E_NOT_OK]
        arg OpStatus: type=Dcm_OpStatusType, direction=IN, server-argument-impl-policy=USE-ARGUMENT-TYPE
        arg DataLength: type=uint16, direction=OUT, server-argument-impl-policy=USE-ARGUMENT-TYPE
      error DCM_E_PENDING: error-code=10
      error E_NOT_OK: error-code=1
    DataServices_DID_019D_Trust_model_Backend_CA_certificate
      operation ConditionCheckRead: possible-error=[DataServices_DID_019D_Trust_model_Backend_CA_certificate/DCM_E_PENDING, DataServices_DID_019D_Trust_model_Backend_CA_certificate/E_NOT_OK]
        arg OpStatus: type=Dcm_OpStatusType, direction=IN, server-argument-impl-policy=USE-ARGUMENT-TYPE
        arg ErrorCode: type=Dcm_NegativeResponseCodeType, direction=OUT, server-argument-impl-policy=USE-ARGUMENT-TYPE
      operation ReadData: possible-error=[DataServices_DID_019D_Trust_model_Backend_CA_certificate/DCM_E_PENDING, DataServices_DID_019D_Trust_model_Backend_CA_certificate/E_NOT_OK]
        arg OpStatus: type=Dcm_OpStatusType, direction=IN, server-argument-impl-policy=USE-ARGUMENT-TYPE
        arg Data: type=Dcm_Data1002ByteType, direction=OUT, server-argument-impl-policy=USE-ARGUMENT-TYPE
      operation ReadDataLength: possible-error=[DataServices_DID_019D_Trust_model_Backend_CA_certificate/DCM_E_PENDING, DataServices_DID_019D_Trust_model_Backend_CA_certificate/E_NOT_OK]
        arg OpStatus: type=Dcm_OpStatusType, direction=IN, server-argument-impl-policy=USE-ARGUMENT-TYPE
        arg DataLength: type=uint16, direction=OUT, server-argument-impl-policy=USE-ARGUMENT-TYPE
      error DCM_E_PENDING: error-code=10
      error E_NOT_OK: error-code=1
    DataServices_DID_019E_Trust_model_Root_CA_certificate
      operation ConditionCheckRead: possible-error=[DataServices_DID_019E_Trust_model_Root_CA_certificate/DCM_E_PENDING, DataServices_DID_019E_Trust_model_Root_CA_certificate/E_NOT_OK]
        arg OpStatus: type=Dcm_OpStatusType, direction=IN, server-argument-impl-policy=USE-ARGUMENT-TYPE
        arg ErrorCode: type=Dcm_NegativeResponseCodeType, direction=OUT, server-argument-impl-policy=USE-ARGUMENT-TYPE
      operation ReadData: possible-error=[DataServices_DID_019E_Trust_model_Root_CA_certificate/DCM_E_PENDING, DataServices_DID_019E_Trust_model_Root_CA_certificate/E_NOT_OK]
        arg OpStatus: type=Dcm_OpStatusType, direction=IN, server-argument-impl-policy=USE-ARGUMENT-TYPE
        arg Data: type=Dcm_Data1002ByteType, direction=OUT, server-argument-impl-policy=USE-ARGUMENT-TYPE
      operation ReadDataLength: possible-error=[DataServices_DID_019E_Trust_model_Root_CA_certificate/DCM_E_PENDING, DataServices_DID_019E_Trust_model_Root_CA_certificate/E_NOT_OK]
        arg OpStatus: type=Dcm_OpStatusType, direction=IN, server-argument-impl-policy=USE-ARGUMENT-TYPE
        arg DataLength: type=uint16, direction=OUT, server-argument-impl-policy=USE-ARGUMENT-TYPE
      error DCM_E_PENDING: error-code=10
      error E_NOT_OK: error-code=1
    DataServices_DID_019F_Trust_model_certificates
      operation ConditionCheckRead: possible-error=[DataServices_DID_019F_Trust_model_certificates/DCM_E_PENDING, DataServices_DID_019F_Trust_model_certificates/E_NOT_OK]
        arg OpStatus: type=Dcm_OpStatusType, direction=IN, server-argument-impl-policy=USE-ARGUMENT-TYPE
        arg ErrorCode: type=Dcm_NegativeResponseCodeType, direction=OUT, server-argument-impl-policy=USE-ARGUMENT-TYPE
      operation ReadData: possible-error=[DataServices_DID_019F_Trust_model_certificates/DCM_E_PENDING, DataServices_DID_019F_Trust_model_certificates/E_NOT_OK]
        arg OpStatus: type=Dcm_OpStatusType, direction=IN, server-argument-impl-policy=USE-ARGUMENT-TYPE
        arg Data: type=Dcm_Data4008ByteType, direction=OUT, server-argument-impl-policy=USE-ARGUMENT-TYPE
      operation ReadDataLength: possible-error=[DataServices_DID_019F_Trust_model_certificates/DCM_E_PENDING, DataServices_DID_019F_Trust_model_certificates/E_NOT_OK]
        arg OpStatus: type=Dcm_OpStatusType, direction=IN, server-argument-impl-policy=USE-ARGUMENT-TYPE
        arg DataLength: type=uint16, direction=OUT, server-argument-impl-policy=USE-ARGUMENT-TYPE
      error DCM_E_PENDING: error-code=10
      error E_NOT_OK: error-code=1
    DataServices_ECU_Certificate_Read_Data_Signature
      operation ConditionCheckRead: possible-error=[DataServices_ECU_Certificate_Read_Data_Signature/DCM_E_PENDING, DataServices_ECU_Certificate_Read_Data_Signature/E_NOT_OK]
        arg OpStatus: type=Dcm_OpStatusType, direction=IN, server-argument-impl-policy=USE-ARGUMENT-TYPE
        arg ErrorCode: type=Dcm_NegativeResponseCodeType, direction=OUT, server-argument-impl-policy=USE-ARGUMENT-TYPE
      operation ReadData: possible-error=[DataServices_ECU_Certificate_Read_Data_Signature/DCM_E_PENDING, DataServices_ECU_Certificate_Read_Data_Signature/E_NOT_OK]
        arg OpStatus: type=Dcm_OpStatusType, direction=IN, server-argument-impl-policy=USE-ARGUMENT-TYPE
        arg Data: type=Dcm_Data64ByteType, direction=OUT, server-argument-impl-policy=USE-ARRAY-BASE-TYPE
      error DCM_E_PENDING: error-code=10
      error E_NOT_OK: error-code=1
    DataServices_ECU_Certificate_Read_ECU_Certificate
      operation ConditionCheckRead: possible-error=[DataServices_ECU_Certificate_Read_ECU_Certificate/DCM_E_PENDING, DataServices_ECU_Certificate_Read_ECU_Certificate/E_NOT_OK]
        arg OpStatus: type=Dcm_OpStatusType, direction=IN, server-argument-impl-policy=USE-ARGUMENT-TYPE
        arg ErrorCode: type=Dcm_NegativeResponseCodeType, direction=OUT, server-argument-impl-policy=USE-ARGUMENT-TYPE
      operation ReadData: possible-error=[DataServices_ECU_Certificate_Read_ECU_Certificate/DCM_E_PENDING, DataServices_ECU_Certificate_Read_ECU_Certificate/E_NOT_OK]
        arg OpStatus: type=Dcm_OpStatusType, direction=IN, server-argument-impl-policy=USE-ARGUMENT-TYPE
        arg Data: type=Dcm_Data1002ByteType, direction=OUT, server-argument-impl-policy=USE-ARRAY-BASE-TYPE
      operation ReadDataLength: possible-error=[DataServices_ECU_Certificate_Read_ECU_Certificate/DCM_E_PENDING, DataServices_ECU_Certificate_Read_ECU_Certificate/E_NOT_OK]
        arg OpStatus: type=Dcm_OpStatusType, direction=IN, server-argument-impl-policy=USE-ARGUMENT-TYPE
        arg DataLength: type=uint16, direction=OUT, server-argument-impl-policy=USE-ARGUMENT-TYPE
      error DCM_E_PENDING: error-code=10
      error E_NOT_OK: error-code=1
    DataServices_ECU_Certificate_Read_Ephemeral_ECU_Public_Key
      operation ConditionCheckRead: possible-error=[DataServices_ECU_Certificate_Read_Ephemeral_ECU_Public_Key/DCM_E_PENDING, DataServices_ECU_Certificate_Read_Ephemeral_ECU_Public_Key/E_NOT_OK]
        arg OpStatus: type=Dcm_OpStatusType, direction=IN, server-argument-impl-policy=USE-ARGUMENT-TYPE
        arg ErrorCode: type=Dcm_NegativeResponseCodeType, direction=OUT, server-argument-impl-policy=USE-ARGUMENT-TYPE
      operation ReadData: possible-error=[DataServices_ECU_Certificate_Read_Ephemeral_ECU_Public_Key/DCM_E_PENDING, DataServices_ECU_Certificate_Read_Ephemeral_ECU_Public_Key/E_NOT_OK]
        arg OpStatus: type=Dcm_OpStatusType, direction=IN, server-argument-impl-policy=USE-ARGUMENT-TYPE
        arg Data: type=Dcm_Data32ByteType, direction=OUT, server-argument-impl-policy=USE-ARRAY-BASE-TYPE
      error DCM_E_PENDING: error-code=10
      error E_NOT_OK: error-code=1
    DataServices_ECU_Certificate_Read_Nonce
      operation ConditionCheckRead: possible-error=[DataServices_ECU_Certificate_Read_Nonce/DCM_E_PENDING, DataServices_ECU_Certificate_Read_Nonce/E_NOT_OK]
        arg OpStatus: type=Dcm_OpStatusType, direction=IN, server-argument-impl-policy=USE-ARGUMENT-TYPE
        arg ErrorCode: type=Dcm_NegativeResponseCodeType, direction=OUT, server-argument-impl-policy=USE-ARGUMENT-TYPE
      operation ReadData: possible-error=[DataServices_ECU_Certificate_Read_Nonce/DCM_E_PENDING, DataServices_ECU_Certificate_Read_Nonce/E_NOT_OK]
        arg OpStatus: type=Dcm_OpStatusType, direction=IN, server-argument-impl-policy=USE-ARGUMENT-TYPE
        arg Data: type=Dcm_Data32ByteType, direction=OUT, server-argument-impl-policy=USE-ARRAY-BASE-TYPE
      error DCM_E_PENDING: error-code=10
      error E_NOT_OK: error-code=1
    DataServices_Security_Event_Log_Current_Counter_Values_Read_Security_Event_Log_Current_Counter_Values
      operation ConditionCheckRead: possible-error=[DataServices_Security_Event_Log_Current_Counter_Values_Read_Security_Event_Log_Current_Counter_Values/DCM_E_PENDING, DataServices_Security_Event_Log_Current_Counter_Values_Read_Security_Event_Log_Current_Counter_Values/E_NOT_OK]
        arg OpStatus: type=Dcm_OpStatusType, direction=IN, server-argument-impl-policy=USE-ARGUMENT-TYPE
        arg ErrorCode: type=Dcm_NegativeResponseCodeType, direction=OUT, server-argument-impl-policy=USE-ARGUMENT-TYPE
      operation ReadData: possible-error=[DataServices_Security_Event_Log_Current_Counter_Values_Read_Security_Event_Log_Current_Counter_Values/DCM_E_PENDING, DataServices_Security_Event_Log_Current_Counter_Values_Read_Security_Event_Log_Current_Counter_Values/E_NOT_OK]
        arg OpStatus: type=Dcm_OpStatusType, direction=IN, server-argument-impl-policy=USE-ARGUMENT-TYPE
        arg Data: type=Dcm_Data1024ByteType, direction=OUT, server-argument-impl-policy=USE-ARRAY-BASE-TYPE
      operation ReadDataLength: possible-error=[DataServices_Security_Event_Log_Current_Counter_Values_Read_Security_Event_Log_Current_Counter_Values/DCM_E_PENDING, DataServices_Security_Event_Log_Current_Counter_Values_Read_Security_Event_Log_Current_Counter_Values/E_NOT_OK]
        arg OpStatus: type=Dcm_OpStatusType, direction=IN, server-argument-impl-policy=USE-ARGUMENT-TYPE
        arg DataLength: type=uint16, direction=OUT, server-argument-impl-policy=USE-ARGUMENT-TYPE
      error DCM_E_PENDING: error-code=10
      error E_NOT_OK: error-code=1
    DataServices_Security_Event_Log_Read_Security_Event_Log_Entry
      operation ConditionCheckRead: possible-error=[DataServices_Security_Event_Log_Read_Security_Event_Log_Entry/DCM_E_PENDING, DataServices_Security_Event_Log_Read_Security_Event_Log_Entry/E_NOT_OK]
        arg OpStatus: type=Dcm_OpStatusType, direction=IN, server-argument-impl-policy=USE-ARGUMENT-TYPE
        arg ErrorCode: type=Dcm_NegativeResponseCodeType, direction=OUT, server-argument-impl-policy=USE-ARGUMENT-TYPE
      operation ReadData: possible-error=[DataServices_Security_Event_Log_Read_Security_Event_Log_Entry/DCM_E_PENDING, DataServices_Security_Event_Log_Read_Security_Event_Log_Entry/E_NOT_OK]
        arg OpStatus: type=Dcm_OpStatusType, direction=IN, server-argument-impl-policy=USE-ARGUMENT-TYPE
        arg Data: type=Dcm_Data4092ByteType, direction=OUT, server-argument-impl-policy=USE-ARRAY-BASE-TYPE
      operation ReadDataLength: possible-error=[DataServices_Security_Event_Log_Read_Security_Event_Log_Entry/DCM_E_PENDING, DataServices_Security_Event_Log_Read_Security_Event_Log_Entry/E_NOT_OK]
        arg OpStatus: type=Dcm_OpStatusType, direction=IN, server-argument-impl-policy=USE-ARGUMENT-TYPE
        arg DataLength: type=uint16, direction=OUT, server-argument-impl-policy=USE-ARGUMENT-TYPE
      error DCM_E_PENDING: error-code=10
      error E_NOT_OK: error-code=1
    FvM_FreshnessManagement
      operation GetRxFreshness: possible-error=[FvM_FreshnessManagement/E_BUSY, FvM_FreshnessManagement/E_NOT_OK, FvM_FreshnessManagement/E_OK]
        6 x arg:
          freshnessValueId: type=uint16, direction=IN, server-argument-impl-policy=USE-ARGUMENT-TYPE
          truncatedFreshnessValue: type=freshnessValueType, direction=IN, server-argument-impl-policy=USE-ARRAY-BASE-TYPE
          truncatedFreshnessValueLength: type=uint32, direction=IN, server-argument-impl-policy=USE-ARGUMENT-TYPE
          authVerifyAttempts: type=uint16, direction=IN, server-argument-impl-policy=USE-ARGUMENT-TYPE
          freshnessValue: type=freshnessValueType, direction=OUT, server-argument-impl-policy=USE-ARRAY-BASE-TYPE
          freshnessValueLength: type=uint32, direction=INOUT, server-argument-impl-policy=USE-ARGUMENT-TYPE
      operation GetTxFreshness: possible-error=[FvM_FreshnessManagement/E_BUSY, FvM_FreshnessManagement/E_NOT_OK, FvM_FreshnessManagement/E_OK]
        arg freshnessValueId: type=uint16, direction=IN, server-argument-impl-policy=USE-ARGUMENT-TYPE
        arg freshnessValue: type=freshnessValueType, direction=OUT, server-argument-impl-policy=USE-ARRAY-BASE-TYPE
        arg freshnessValueLength: type=uint32, direction=INOUT, server-argument-impl-policy=USE-ARGUMENT-TYPE
      error E_BUSY: error-code=2
      error E_NOT_OK: error-code=1
      error E_OK: error-code=0
    FvM_InitialTickCount
      operation Set: possible-error=FvM_InitialTickCount/E_NOT_OK
        arg tickCount: type=uint64, direction=IN, server-argument-impl-policy=USE-ARGUMENT-TYPE
      error E_NOT_OK: error-code=1
    FvM_LocalTickCountSyncStatus
      operation Get: possible-error=FvM_LocalTickCountSyncStatus/E_NOT_OK
        arg syncState: type=Ssa_TickCountSyncStateType, direction=OUT, server-argument-impl-policy=USE-ARGUMENT-TYPE
      error E_NOT_OK: error-code=1
    KeyM_Certificate
      6 x operation:
        CheckTrustModelChainOfTrust: possible-error=KeyM_Certificate/E_NOT_OK
          arg state: type=Ssa_TrustModelChainState_Type, direction=OUT, server-argument-impl-policy=USE-ARGUMENT-TYPE
        GetBackendSerialNumber: possible-error=KeyM_Certificate/E_NOT_OK
          arg serialNumber: type=Ssa_Data2ByteType, direction=OUT, server-argument-impl-policy=USE-ARRAY-BASE-TYPE
          arg serialNumberLength: type=uint16, direction=INOUT, server-argument-impl-policy=USE-ARGUMENT-TYPE
        GetBackendSubject: possible-error=KeyM_Certificate/E_NOT_OK
          arg backendSubject: type=Ssa_Data30ByteType, direction=OUT, server-argument-impl-policy=USE-ARRAY-BASE-TYPE
          arg dataLength: type=uint16, direction=INOUT, server-argument-impl-policy=USE-ARGUMENT-TYPE
        SignData1024ByteWithEcuPrivateKey: possible-error=[KeyM_Certificate/E_NOT_OK, KeyM_Certificate/E_PENDING]
          arg data: type=Ssa_Data1024ByteType, direction=IN, server-argument-impl-policy=USE-ARRAY-BASE-TYPE
          arg dataLength: type=uint16, direction=IN, server-argument-impl-policy=USE-ARGUMENT-TYPE
          arg signature: type=Ssa_Data64ByteType, direction=OUT, server-argument-impl-policy=USE-ARRAY-BASE-TYPE
        SignData4092ByteWithEcuPrivateKey: possible-error=[KeyM_Certificate/E_NOT_OK, KeyM_Certificate/E_PENDING]
          arg data: type=Ssa_Data4092ByteType, direction=IN, server-argument-impl-policy=USE-ARRAY-BASE-TYPE
          arg dataLength: type=uint16, direction=IN, server-argument-impl-policy=USE-ARGUMENT-TYPE
          arg signature: type=Ssa_Data64ByteType, direction=OUT, server-argument-impl-policy=USE-ARRAY-BASE-TYPE
        VerifyCertWithBackendCert: possible-error=[KeyM_Certificate/E_NOT_OK, KeyM_Certificate/E_PENDING]
          5 x arg:
            cert: type=CertP_RawCertBufferType, direction=IN, server-argument-impl-policy=USE-ARRAY-BASE-TYPE
            parsedCertStructure: type=CertP_ParsedCertStructureType, direction=INOUT, server-argument-impl-policy=USE-ARGUMENT-TYPE
            certLength: type=uint16, direction=IN, server-argument-impl-policy=USE-ARGUMENT-TYPE
            expectedPkiRole: type=CertP_PkiRoleType, direction=IN, server-argument-impl-policy=USE-ARGUMENT-TYPE
            expectedNonce: type=RightsM_AuthNonceType, direction=IN, server-argument-impl-policy=USE-ARGUMENT-TYPE
      error E_NOT_OK: error-code=1
      error E_PENDING: error-code=10
  mode switch interface Coding_MemoryStatus
    mode group MemoryStatus: type=Coding_MemoryStatus
  mode switch interface Coding_Mode
    mode group CodingStatus: type=ModeDeclarationGroups/Coding_Mode
  13 x sender receiver interface:
    BcTp_Com_Data_Auth  # Interface for passing 8 byte of Data as signal to or from Com.
      data VSS_TP_Auth_ST3: type=Ssa_Data8ByteType  # Data passed or received to Com.
    BcTp_Com_Data_RealTmOffset  # Interface for passing 8 byte of Data as signal to or from Com.
      data VSS_TP_RealTmOffset_ST3: type=Ssa_Data8ByteType  # Data passed or received to Com.
    BcTp_Com_Data_SecTickCount  # Interface for passing 8 byte of Data as signal to or from Com.
      data VSS_TP_SecTickCount_ST3: type=Ssa_Data8ByteType  # Data passed or received to Com.
    BcTp_Com_Data_SharedSecret  # Interface for passing 8 byte of Data as signal to or from Com.
      data VSS_TP_SharedSecret_ST3: type=Ssa_Data8ByteType  # Data passed or received to Com.
    BcTp_Com_Data_VIN  # Interface for passing 8 byte of Data as signal to or from Com.
      data VSS_TP_VIN_ST3: type=Ssa_Data8ByteType  # Data passed or received to Com.
    Coding_Com_VIN
      data VIN: type=Coding_VINDataType
    Coding_VINStatus
      data status: type=VIN_Status
    FvM_Com_TickCount
      data tickCount: type=Ssa_Data6ByteType
    FvM_Com_TickCountTimeout
      data state: type=uint8
    FvM_LocalTickCountAndSyncStatus
      data Data: type=Ssa_LocalTickCountAndSyncStatusType
    KeyM_Com_SharedSecret
      data sharedSecret: type=KeyM_SharedSecretType
    KeyM_ReplaceRootCertificate  # Notifies application about the change of the root certificate to a productive one.
      data isProductive: type=boolean
    ProcCtrl_DispatchServices
      data ServiceId: type=uint8
  mode switch interface RightsM_Authentication: is-service=true  # Notifies about a successful authentication of at least one tester.
    mode group Mode: type=RightsM_AuthenticationMode
  mode switch interface Ssa_OperationMode: is-service=true  # Mode port interface for controlling runnable execution.
    mode group Mode: type=Ssa_OperationMode
  sender receiver interface Ssa_BswM_ComIndication: is-service=true
    data comMode: type=Ssa_BswM_ComModeType
  client server interface SsaCdd_KeyM_CertInterface
    4 x operation:
      CsrElementSet: possible-error=[SsaCdd_KeyM_CertInterface/E_NOT_OK, SsaCdd_KeyM_CertInterface/KEYM_E_KEY_CERT_SIZE_MISMATCH, SsaCdd_KeyM_CertInterface/KEYM_E_PARAMETER_MISMATCH]
        5 x arg, all with direction=IN, server-argument-impl-policy=USE-ARGUMENT-TYPE:
          CertId: type=KeyM_CertificateIdType
          CertElementId: type=KeyM_CertElementIdType
          EncodingType: type=KeyM_CsrEncodingType
          ElementData: type=Ssa_ConstDataPtr
          ElementDataLength: type=uint32
      GetCertificate: possible-error=[SsaCdd_KeyM_CertInterface/E_NOT_OK, SsaCdd_KeyM_CertInterface/KEYM_E_KEY_CERT_EMPTY, SsaCdd_KeyM_CertInterface/KEYM_E_KEY_CERT_READ_FAIL, SsaCdd_KeyM_CertInterface/KEYM_E_KEY_CERT_SIZE_MISMATCH, SsaCdd_KeyM_CertInterface/KEYM_E_PARAMETER_MISMATCH]
        arg CertId: type=KeyM_CertificateIdType, direction=IN, server-argument-impl-policy=USE-ARGUMENT-TYPE
        arg CertData: type=Ssa_DataPtr, direction=IN, server-argument-impl-policy=USE-ARGUMENT-TYPE
        arg CertDataLength: type=Ssa_LengthPtr, direction=IN, server-argument-impl-policy=USE-ARGUMENT-TYPE
      ServiceCertificate: possible-error=[SsaCdd_KeyM_CertInterface/E_NOT_OK, SsaCdd_KeyM_CertInterface/KEYM_E_BUSY, SsaCdd_KeyM_CertInterface/KEYM_E_CERT_INVALID_CHAIN_OF_TRUST, SsaCdd_KeyM_CertInterface/KEYM_E_KEY_CERT_EMPTY, SsaCdd_KeyM_CertInterface/KEYM_E_KEY_CERT_SIZE_MISMATCH, SsaCdd_KeyM_CertInterface/KEYM_E_PARAMETER_MISMATCH]
        7 x arg, all with direction=IN, server-argument-impl-policy=USE-ARGUMENT-TYPE:
          Service: type=KeyM_ServiceCertificateType
          CertNamePtr: type=Ssa_ConstDataPtr
          CertNameLength: type=uint32
          RequestData: type=Ssa_ConstDataPtr
          RequestDataLength: type=uint32
          ResponseData: type=Ssa_DataPtr
          ResponseDataLength: type=uint32
      SetCertificate: possible-error=[SsaCdd_KeyM_CertInterface/E_NOT_OK, SsaCdd_KeyM_CertInterface/KEYM_E_KEY_CERT_SIZE_MISMATCH, SsaCdd_KeyM_CertInterface/KEYM_E_PARAMETER_MISMATCH]
        arg CertId: type=KeyM_CertificateIdType, direction=IN, server-argument-impl-policy=USE-ARGUMENT-TYPE
        arg CertData: type=Ssa_DataPtr, direction=IN, server-argument-impl-policy=USE-ARGUMENT-TYPE
        arg CertDataLength: type=uint32, direction=IN, server-argument-impl-policy=USE-ARGUMENT-TYPE
    9 x error:
      E_NOT_OK: error-code=1
      KEYM_E_BUSY: error-code=2
      KEYM_E_CERT_INVALID_CHAIN_OF_TRUST: error-code=9
      KEYM_E_KEY_CERT_EMPTY: error-code=8
      KEYM_E_KEY_CERT_INVALID: error-code=6
      KEYM_E_KEY_CERT_READ_FAIL: error-code=7
      KEYM_E_KEY_CERT_SIZE_MISMATCH: error-code=4
      KEYM_E_PARAMETER_MISMATCH: error-code=5
      KEYM_E_PENDING: error-code=3
  sender receiver interface Coding_ReceiveVINTimeout
    data state: type=uint8
  5 x client server interface:
    DiagnosticService_Authentication_0x29
      operation Authenticate: possible-error=[DiagnosticService_Authentication_0x29/DCM_E_FORCE_RCRRP, DiagnosticService_Authentication_0x29/DCM_E_PENDING, DiagnosticService_Authentication_0x29/E_NOT_OK]
        8 x arg, all with server-argument-impl-policy=USE-ARGUMENT-TYPE:
          OpStatus: type=Dcm_OpStatusType, direction=IN
          ReqData: type=Ssa_ConstDataPtr, direction=IN
          ReqBufSize: type=uint32, direction=IN
          ReqDataLen: type=uint32, direction=IN
          ResData: type=Ssa_DataPtr, direction=IN
          ResBufSize: type=uint32, direction=IN
          ResDataLen: type=uint32, direction=OUT
          ErrorCode: type=Dcm_NegativeResponseCodeType, direction=OUT
      error DCM_E_FORCE_RCRRP: error-code=12
      error DCM_E_PENDING: error-code=10
      error E_NOT_OK: error-code=1
    RoutineServices_Inject_Seed
      operation Start: possible-error=[RoutineServices_Inject_Seed/DCM_E_FORCE_RCRRP, RoutineServices_Inject_Seed/DCM_E_PENDING, RoutineServices_Inject_Seed/E_NOT_OK]
        8 x arg, all with server-argument-impl-policy=USE-ARGUMENT-TYPE:
          Ephemeral_Backend_Public_Key_In: type=Dcm_Data32ByteType, direction=IN
          Data_Signature_In: type=Dcm_Data64ByteType, direction=IN
          Encrypted_Seed_In: type=Dcm_Data1058ByteType, direction=IN
          OpStatus: type=Dcm_OpStatusType, direction=IN
          routineInfo_Out: type=uint8, direction=OUT
          Verification_Result_Out: type=uint8, direction=OUT
          DataLength: type=uint16, direction=IN
          ErrorCode: type=Dcm_NegativeResponseCodeType, direction=OUT
      error DCM_E_FORCE_RCRRP: error-code=12
      error DCM_E_PENDING: error-code=10
      error E_NOT_OK: error-code=1
    RoutineServices_Trust_Model_Generate_Key_Pair
      operation Start: possible-error=[RoutineServices_Trust_Model_Generate_Key_Pair/DCM_E_FORCE_RCRRP, RoutineServices_Trust_Model_Generate_Key_Pair/DCM_E_PENDING, RoutineServices_Trust_Model_Generate_Key_Pair/E_NOT_OK]
        7 x arg, all with server-argument-impl-policy=USE-ARGUMENT-TYPE:
          OpStatus: type=Dcm_OpStatusType, direction=IN
          routineInfo_Out: type=uint8, direction=OUT
          Verification_Result_Out: type=uint8, direction=OUT
          CSR_Signature_Out: type=Dcm_Data64ByteType, direction=OUT
          Trust_Model_ECU_CSR_Out: type=Dcm_Data1002ByteType, direction=OUT
          DataLength: type=uint16, direction=OUT
          ErrorCode: type=Dcm_NegativeResponseCodeType, direction=OUT
      error DCM_E_FORCE_RCRRP: error-code=12
      error DCM_E_PENDING: error-code=10
      error E_NOT_OK: error-code=1
    Ssa_KeyProc  # Requests for preparing the key exchange operation, e.g. for generating the private key.
      operation GenerateKeyPair: possible-error=[Ssa_KeyProc/E_NOT_OK, Ssa_KeyProc/E_PENDING]
        arg privateKeyId: type=uint32, direction=IN, server-argument-impl-policy=USE-ARGUMENT-TYPE
        arg publicKeyId: type=uint32, direction=IN, server-argument-impl-policy=USE-ARGUMENT-TYPE
      operation PrepareKeyExchange: possible-error=[Ssa_KeyProc/E_NOT_OK, Ssa_KeyProc/E_PENDING]
        arg opStatus: type=Ssa_OpStatusType, direction=IN, server-argument-impl-policy=USE-ARGUMENT-TYPE
        arg keyId: type=uint32, direction=IN, server-argument-impl-policy=USE-ARGUMENT-TYPE
      error E_NOT_OK: error-code=1
      error E_PENDING: error-code=2
    Ssa_VeDocRelevantInfo  # Requests for the VeDoc relevant information, e.g., to be used as common name in the Trust Model CSR.
      operation GetData: possible-error=Ssa_VeDocRelevantInfo/E_NOT_OK
        arg data: type=Ssa_Data64ByteType, direction=OUT, server-argument-impl-policy=USE-ARGUMENT-TYPE
        arg dataLength: type=uint16, direction=INOUT, server-argument-impl-policy=USE-ARGUMENT-TYPE
      error E_NOT_OK: error-code=1
  mode switch interface Ssa_MacKeyGeneration_State
    mode group State: type=Ssa_MacKeyGeneration_State
package /SecurityArchitecture/ModeDeclarationGroups
  5 x mode declaration group, all with category=ALPHABETIC_ORDER:
    Coding_MemoryStatus: initial-mode=CODING_MEMSTAT_OK  # Notifies the Ssa of memory status changes while storing or restoring the Variant Coding Data to or from non-volatile memory.
      mode CODING_MEMSTAT_PENDING
      mode CODING_MEMSTAT_FAILED
      mode CODING_MEMSTAT_OK
    Coding_Mode: initial-mode=Coding_Mode/CODING_OK  # Notifies application about an ongoing, successful or failed coding attempt.
      mode CODING_ACTIVE
      mode CODING_FAILED
      mode CODING_OK
    RightsM_AuthenticationMode: initial-mode=RIGHTSM_UNAUTHENTICATED  # RIGHTSM_AUTHENTICATED - A Tester was successfully authenticated RIGHTSM_UNAUTHENTICATED - No tester was authenticated
      mode RIGHTSM_AUTHENTICATED
      mode RIGHTSM_UNAUTHENTICATED
    Ssa_OperationMode: initial-mode=SSA_ACTIVE
      mode SSA_INACTIVE
      mode SSA_ACTIVE
    Ssa_MacKeyGeneration_State: initial-mode=SSA_MAC_KEY_GEN_STATE_OFF  # Notifies application of whether the generation of the symmetric MAC keys is OFF or ON.
      mode SSA_MAC_KEY_GEN_STATE_ON
      mode SSA_MAC_KEY_GEN_STATE_OFF
package /Daimler/SwcDiag/PortInterfaces
  sender receiver interface RoERecordSRI
    data Data: type=SwcDiag_RoERecordType
  sender receiver interface SecurityEventIndicationSRI  # Notifies SwcDiag about on occurred security event which shall trigger an ROE.
    data Data: type=SwcDiag_SecurityEventDataArrayType
  client server interface AvailabilityDataCSI  # The implementation runnable of the operation RegisterData shall be re-entrant but not for the same function number, i.e. the integrator should ensure that for the same function number the operation should not be invoked concurrently.
    operation RegisterData: possible-error=[AvailabilityDataCSI/E_BUFFER_BUSY, AvailabilityDataCSI/E_NOT_OK]
      arg FunctionNumber: type=SwcDiag_FunctionNumberType, direction=IN, server-argument-impl-policy=USE-ARGUMENT-TYPE
      arg Category: type=SwcDiag_AvailabilityCategoryType, direction=IN, server-argument-impl-policy=USE-ARGUMENT-TYPE
    error E_BUFFER_BUSY: error-code=2  # Returned when all buffer slots for RoELite data are full
    error E_NOT_OK: error-code=1  # Returned when SwcDiag is not initialized or incorrect parameters are passed
  client server interface ConsumableAndObsolescenceDataCSI  # The implementation runnable of the operation RegisterData shall be re-entrant but not for the same block number, i.e. the integrator should ensure that for the same block number the operation should not be invoked concurrently.
    operation RegisterData: possible-error=[ConsumableAndObsolescenceDataCSI/E_BUFFER_BUSY, ConsumableAndObsolescenceDataCSI/E_NOT_OK]
      4 x arg, all with direction=IN, server-argument-impl-policy=USE-ARGUMENT-TYPE:
        BlockNumber: type=SwcDiag_BlockNumberType
        CurrentValue: type=SwcDiag_CnsmblObslscncType
        ThresholdGreenToYellow: type=SwcDiag_CnsmblObslscncType
        ThresholdYellowToRed: type=SwcDiag_CnsmblObslscncType
    error E_BUFFER_BUSY: error-code=2  # Returned when all buffer slots for RoELite data are full
    error E_NOT_OK: error-code=1  # Returned when SwcDiag is not initialized or parameters inconsistent, i.e. ThresholdGreenToYellow is less than ThresholdYellowToRed, note that they could be equal indicating that there is no Yellow
  mode switch interface InitStateMSI
    mode group Mode: type=InitStateMDG
  8 x sender receiver interface:
    BusIgnitionStatusSRI
      data BusIgnitionStatusRecord: type=SwcDiag_BusIgnitionStatusRecordType
    BusOdometerSRI  # This is a sender receiver interface for communicaton of the bus odometer value
      data BusOdometerRecord: type=SwcDiag_OdometerRecordType
    ExternalTesterPresentSRI
      data Status: type=SwcDiag_ExtTesterStatusType
    HardwireIgnitionStatusSRI
      data Status: type=SwcDiag_IgnitionStatusType
    ProductionModeSRI
      data Mode: type=SwcDiag_ProductionModeType
    TransportationModeSRI
      data Mode: type=SwcDiag_TransportationModeType
    VehicleStartupSRI
      data VehicleStartUpRecord: type=SwcDiag_VehicleStartupRecordType
    VoltageSRI
      data Value: type=SwcDiag_VoltageType
  client server interface ExternalTesterPresentDataServicesCSI: is-service=true
    operation ReadData: possible-error=[ExternalTesterPresentDataServicesCSI/E_NOT_OK, ExternalTesterPresentDataServicesCSI/E_OK]
      arg Data: type=SwcDiag_ExtTesterDataArrayType, direction=OUT, server-argument-impl-policy=USE-ARRAY-BASE-TYPE
    error E_NOT_OK: error-code=1
    error E_OK: error-code=0
  client server interface OdometerDataServicesCSI: is-service=true
    operation ReadData: possible-error=[OdometerDataServicesCSI/E_NOT_OK, OdometerDataServicesCSI/E_OK]
      arg Data: type=SwcDiag_OdometerDataArrayType, direction=OUT, server-argument-impl-policy=USE-ARRAY-BASE-TYPE
    error E_NOT_OK: error-code=1
    error E_OK: error-code=0
  client server interface OperatingTimeDataServicesCSI: is-service=true
    operation ReadData: possible-error=[OperatingTimeDataServicesCSI/E_NOT_OK, OperatingTimeDataServicesCSI/E_OK]
      arg Data: type=SwcDiag_TimestampDataArrayType, direction=OUT, server-argument-impl-policy=USE-ARRAY-BASE-TYPE
    error E_NOT_OK: error-code=1
    error E_OK: error-code=0
  mode switch interface CommunicationModeMSI: is-service=true
    mode group Mode: type=CommunicationMode
  mode switch interface ControlDTCSettingMSI: is-service=true
    mode group Mode: type=ControlDtcSetting
package /Daimler/SwcDiag/ModeDeclarationGroups
  mode declaration group InitStateMDG: category=EXPLICIT_ORDER, initial-mode=UNINITIALIZED, on-transition-value=2
    mode INITIALIZED: value=90
    mode UNINITIALIZED: value=0
  mode declaration group CommunicationMode: category=EXPLICIT_ORDER, initial-mode=COMM_NO_COMMUNICATION, on-transition-value=3
    mode COMM_FULL_COMMUNICATION: value=2
    mode COMM_NO_COMMUNICATION: value=0
    mode COMM_SILENT_COMMUNICATION: value=1
  mode declaration group ControlDtcSetting: category=EXPLICIT_ORDER, initial-mode=ENABLEDTCSETTING, on-transition-value=2
    mode DISABLEDTCSETTING: value=1
    mode ENABLEDTCSETTING: value=0
package /Daimler/Platform/Dcm/PortInterfaces
  client server interface DCMServices: is-service=true, service-kind=DIAGNOSTIC-COMMUNICATION-MANAGER
    operation GetSesCtrlType: possible-error=[DCMServices/E_NOT_OK, DCMServices/E_OK]
      arg SesCtrlType: type=Dcm_SesCtrlType, direction=OUT, server-argument-impl-policy=USE-ARGUMENT-TYPE
    error E_NOT_OK: error-code=1
    error E_OK: error-code=0
package /Daimler/Platform/Dem/PortInterfaces
  client server interface CallbackDTCStatusChange: is-service=true
    operation DTCStatusChanged: possible-error=[CallbackDTCStatusChange/E_NOT_OK, CallbackDTCStatusChange/E_OK]
      arg DTC: type=uint32, direction=IN, server-argument-impl-policy=USE-ARGUMENT-TYPE
      arg DTCStatusOld: type=Dem_UdsStatusByteType, direction=IN, server-argument-impl-policy=USE-ARGUMENT-TYPE
      arg DTCStatusNew: type=Dem_UdsStatusByteType, direction=IN, server-argument-impl-policy=USE-ARGUMENT-TYPE
    error E_NOT_OK: error-code=1
    error E_OK: error-code=0
  client server interface EnableCondition: is-service=true, service-kind=DIAGNOSTIC-EVENT-MANAGER
    operation SetEnableCondition: possible-error=[EnableCondition/E_NOT_OK, EnableCondition/E_OK]
      arg ConditionFulfilled: type=boolean, direction=IN, server-argument-impl-policy=USE-ARGUMENT-TYPE
    error E_NOT_OK: error-code=1
    error E_OK: error-code=0
  client server interface OperationCycle: is-service=true, service-kind=DIAGNOSTIC-EVENT-MANAGER
    operation SetOperationCycleState: possible-error=OperationCycle/E_NOT_OK
      arg CycleState: type=Dem_OperationCycleStateType, direction=IN, server-argument-impl-policy=USE-ARGUMENT-TYPE
    error E_NOT_OK: error-code=1
    error E_OK: error-code=0
package /Predefined_DEV/PortInterfaces
  43 x client server interface:
    NvMAdministration: is-service=true
      operation SetBlockProtection: possible-error=NvMAdministration/E_NOT_OK
        arg ProtectionEnabled: type=boolean, direction=IN, server-argument-impl-policy=USE-ARGUMENT-TYPE
      error E_NOT_OK: error-code=1
    NvMNotifyInitBlock: is-service=true
      operation InitBlock
    NvMNotifyJobFinished: is-service=true
      operation JobFinished
        arg ServiceId: type=NvM_ServiceIdType, direction=IN, server-argument-impl-policy=USE-ARGUMENT-TYPE
        arg JobResult: type=NvM_RequestResultType, direction=IN, server-argument-impl-policy=USE-ARGUMENT-TYPE
    NvMService: is-service=true
      operation GetErrorStatus: possible-error=NvMService/E_NOT_OK
        arg ErrorStatus: type=NvM_RequestResultType, direction=OUT, server-argument-impl-policy=USE-ARGUMENT-TYPE
      error E_NOT_OK: error-code=1
    NvMService_AC2: is-service=true
      operation GetErrorStatus: possible-error=NvMService_AC2/E_NOT_OK
        arg ErrorStatus: type=NvM_RequestResultType, direction=OUT, server-argument-impl-policy=USE-ARGUMENT-TYPE
      operation ReadBlock: possible-error=NvMService_AC2/E_NOT_OK
        arg DstPtr: type=dtRef_VOID, direction=IN, server-argument-impl-policy=USE-ARGUMENT-TYPE
      operation WriteBlock: possible-error=NvMService_AC2/E_NOT_OK
        arg SrcPtr: type=dtRef_const_VOID, direction=IN, server-argument-impl-policy=USE-ARGUMENT-TYPE
      error E_NOT_OK: error-code=1
    NvMService_AC2_Defs: is-service=true
      4 x operation, all with possible-error=NvMService_AC2_Defs/E_NOT_OK:
        GetErrorStatus
          arg ErrorStatus: type=NvM_RequestResultType, direction=OUT, server-argument-impl-policy=USE-ARGUMENT-TYPE
        ReadBlock
          arg DstPtr: type=dtRef_VOID, direction=IN, server-argument-impl-policy=USE-ARGUMENT-TYPE
        RestoreBlockDefaults
          arg DstPtr: type=dtRef_VOID, direction=IN, server-argument-impl-policy=USE-ARGUMENT-TYPE
        WriteBlock
          arg SrcPtr: type=dtRef_const_VOID, direction=IN, server-argument-impl-policy=USE-ARGUMENT-TYPE
      error E_NOT_OK: error-code=1
    NvMService_AC2_DS: is-service=true
      5 x operation, all with possible-error=NvMService_AC2_DS/E_NOT_OK:
        GetDataIndex
          arg DataIndex: type=uint8, direction=OUT, server-argument-impl-policy=USE-ARGUMENT-TYPE
        GetErrorStatus
          arg ErrorStatus: type=NvM_RequestResultType, direction=OUT, server-argument-impl-policy=USE-ARGUMENT-TYPE
        ReadBlock
          arg DstPtr: type=dtRef_VOID, direction=IN, server-argument-impl-policy=USE-ARGUMENT-TYPE
        SetDataIndex
          arg DataIndex: type=uint8, direction=IN, server-argument-impl-policy=USE-ARGUMENT-TYPE
        WriteBlock
          arg SrcPtr: type=dtRef_const_VOID, direction=IN, server-argument-impl-policy=USE-ARGUMENT-TYPE
      error E_NOT_OK: error-code=1
    NvMService_AC2_DS_Defs: is-service=true
      6 x operation, all with possible-error=NvMService_AC2_DS_Defs/E_NOT_OK:
        GetDataIndex
          arg DataIndex: type=uint8, direction=OUT, server-argument-impl-policy=USE-ARGUMENT-TYPE
        GetErrorStatus
          arg ErrorStatus: type=NvM_RequestResultType, direction=OUT, server-argument-impl-policy=USE-ARGUMENT-TYPE
        ReadBlock
          arg DstPtr: type=dtRef_VOID, direction=IN, server-argument-impl-policy=USE-ARGUMENT-TYPE
        RestoreBlockDefaults
          arg DstPtr: type=dtRef_VOID, direction=IN, server-argument-impl-policy=USE-ARGUMENT-TYPE
        SetDataIndex
          arg DataIndex: type=uint8, direction=IN, server-argument-impl-policy=USE-ARGUMENT-TYPE
        WriteBlock
          arg SrcPtr: type=dtRef_const_VOID, direction=IN, server-argument-impl-policy=USE-ARGUMENT-TYPE
      error E_NOT_OK: error-code=1
    NvMService_AC2_SRBS: is-service=true
      4 x operation, all with possible-error=NvMService_AC2_SRBS/E_NOT_OK:
        GetErrorStatus
          arg ErrorStatus: type=NvM_RequestResultType, direction=OUT, server-argument-impl-policy=USE-ARGUMENT-TYPE
        ReadBlock
          arg DstPtr: type=dtRef_VOID, direction=IN, server-argument-impl-policy=USE-ARGUMENT-TYPE
        SetRamBlockStatus
          arg RamBlockStatus: type=boolean, direction=IN, server-argument-impl-policy=USE-ARGUMENT-TYPE
        WriteBlock
          arg SrcPtr: type=dtRef_const_VOID, direction=IN, server-argument-impl-policy=USE-ARGUMENT-TYPE
      error E_NOT_OK: error-code=1
    NvMService_AC2_SRBS_Defs: is-service=true
      5 x operation, all with possible-error=NvMService_AC2_SRBS_Defs/E_NOT_OK:
        GetErrorStatus
          arg ErrorStatus: type=NvM_RequestResultType, direction=OUT, server-argument-impl-policy=USE-ARGUMENT-TYPE
        ReadBlock
          arg DstPtr: type=dtRef_VOID, direction=IN, server-argument-impl-policy=USE-ARGUMENT-TYPE
        RestoreBlockDefaults
          arg DstPtr: type=dtRef_VOID, direction=IN, server-argument-impl-policy=USE-ARGUMENT-TYPE
        SetRamBlockStatus
          arg RamBlockStatus: type=boolean, direction=IN, server-argument-impl-policy=USE-ARGUMENT-TYPE
        WriteBlock
          arg SrcPtr: type=dtRef_const_VOID, direction=IN, server-argument-impl-policy=USE-ARGUMENT-TYPE
      error E_NOT_OK: error-code=1
    NvMService_AC2_SRBS_DS: is-service=true
      6 x operation, all with possible-error=NvMService_AC2_SRBS_DS/E_NOT_OK:
        GetDataIndex
          arg DataIndex: type=uint8, direction=OUT, server-argument-impl-policy=USE-ARGUMENT-TYPE
        GetErrorStatus
          arg ErrorStatus: type=NvM_RequestResultType, direction=OUT, server-argument-impl-policy=USE-ARGUMENT-TYPE
        ReadBlock
          arg DstPtr: type=dtRef_VOID, direction=IN, server-argument-impl-policy=USE-ARGUMENT-TYPE
        SetDataIndex
          arg DataIndex: type=uint8, direction=IN, server-argument-impl-policy=USE-ARGUMENT-TYPE
        SetRamBlockStatus
          arg RamBlockStatus: type=boolean, direction=IN, server-argument-impl-policy=USE-ARGUMENT-TYPE
        WriteBlock
          arg SrcPtr: type=dtRef_const_VOID, direction=IN, server-argument-impl-policy=USE-ARGUMENT-TYPE
      error E_NOT_OK: error-code=1
    NvMService_AC2_SRBS_DS_Defs: is-service=true
      7 x operation, all with possible-error=NvMService_AC2_SRBS_DS_Defs/E_NOT_OK:
        GetDataIndex
          arg DataIndex: type=uint8, direction=OUT, server-argument-impl-policy=USE-ARGUMENT-TYPE
        GetErrorStatus
          arg ErrorStatus: type=NvM_RequestResultType, direction=OUT, server-argument-impl-policy=USE-ARGUMENT-TYPE
        ReadBlock
          arg DstPtr: type=dtRef_VOID, direction=IN, server-argument-impl-policy=USE-ARGUMENT-TYPE
        RestoreBlockDefaults
          arg DstPtr: type=dtRef_VOID, direction=IN, server-argument-impl-policy=USE-ARGUMENT-TYPE
        SetDataIndex
          arg DataIndex: type=uint8, direction=IN, server-argument-impl-policy=USE-ARGUMENT-TYPE
        SetRamBlockStatus
          arg RamBlockStatus: type=boolean, direction=IN, server-argument-impl-policy=USE-ARGUMENT-TYPE
        WriteBlock
          arg SrcPtr: type=dtRef_const_VOID, direction=IN, server-argument-impl-policy=USE-ARGUMENT-TYPE
      error E_NOT_OK: error-code=1
    NvMService_AC3: is-service=true
      5 x operation, all with possible-error=NvMService_AC3/E_NOT_OK:
        EraseBlock
        GetErrorStatus
          arg ErrorStatus: type=NvM_RequestResultType, direction=OUT, server-argument-impl-policy=USE-ARGUMENT-TYPE
        InvalidateNvBlock
        ReadBlock
          arg DstPtr: type=dtRef_VOID, direction=IN, server-argument-impl-policy=USE-ARGUMENT-TYPE
        WriteBlock
          arg SrcPtr: type=dtRef_const_VOID, direction=IN, server-argument-impl-policy=USE-ARGUMENT-TYPE
      error E_NOT_OK: error-code=1
    NvMService_AC3_Defs: is-service=true
      6 x operation, all with possible-error=NvMService_AC3_Defs/E_NOT_OK:
        EraseBlock
        GetErrorStatus
          arg ErrorStatus: type=NvM_RequestResultType, direction=OUT, server-argument-impl-policy=USE-ARGUMENT-TYPE
        InvalidateNvBlock
        ReadBlock
          arg DstPtr: type=dtRef_VOID, direction=IN, server-argument-impl-policy=USE-ARGUMENT-TYPE
        RestoreBlockDefaults
          arg DstPtr: type=dtRef_VOID, direction=IN, server-argument-impl-policy=USE-ARGUMENT-TYPE
        WriteBlock
          arg SrcPtr: type=dtRef_const_VOID, direction=IN, server-argument-impl-policy=USE-ARGUMENT-TYPE
      error E_NOT_OK: error-code=1
    NvMService_AC3_DS: is-service=true
      7 x operation, all with possible-error=NvMService_AC3_DS/E_NOT_OK:
        EraseBlock
        GetDataIndex
          arg DataIndex: type=uint8, direction=OUT, server-argument-impl-policy=USE-ARGUMENT-TYPE
        GetErrorStatus
          arg ErrorStatus: type=NvM_RequestResultType, direction=OUT, server-argument-impl-policy=USE-ARGUMENT-TYPE
        InvalidateNvBlock
        ReadBlock
          arg DstPtr: type=dtRef_VOID, direction=IN, server-argument-impl-policy=USE-ARGUMENT-TYPE
        SetDataIndex
          arg DataIndex: type=uint8, direction=IN, server-argument-impl-policy=USE-ARGUMENT-TYPE
        WriteBlock
          arg SrcPtr: type=dtRef_const_VOID, direction=IN, server-argument-impl-policy=USE-ARGUMENT-TYPE
      error E_NOT_OK: error-code=1
    NvMService_AC3_DS_Defs: is-service=true
      8 x operation, all with possible-error=NvMService_AC3_DS_Defs/E_NOT_OK:
        EraseBlock
        GetDataIndex
          arg DataIndex: type=uint8, direction=OUT, server-argument-impl-policy=USE-ARGUMENT-TYPE
        GetErrorStatus
          arg ErrorStatus: type=NvM_RequestResultType, direction=OUT, server-argument-impl-policy=USE-ARGUMENT-TYPE
        InvalidateNvBlock
        ReadBlock
          arg DstPtr: type=dtRef_VOID, direction=IN, server-argument-impl-policy=USE-ARGUMENT-TYPE
        RestoreBlockDefaults
          arg DstPtr: type=dtRef_VOID, direction=IN, server-argument-impl-policy=USE-ARGUMENT-TYPE
        SetDataIndex
          arg DataIndex: type=uint8, direction=IN, server-argument-impl-policy=USE-ARGUMENT-TYPE
        WriteBlock
          arg SrcPtr: type=dtRef_const_VOID, direction=IN, server-argument-impl-policy=USE-ARGUMENT-TYPE
      error E_NOT_OK: error-code=1
    NvMService_AC3_SRBS: is-service=true
      6 x operation, all with possible-error=NvMService_AC3_SRBS/E_NOT_OK:
        EraseBlock
        GetErrorStatus
          arg ErrorStatus: type=NvM_RequestResultType, direction=OUT, server-argument-impl-policy=USE-ARGUMENT-TYPE
        InvalidateNvBlock
        ReadBlock
          arg DstPtr: type=dtRef_VOID, direction=IN, server-argument-impl-policy=USE-ARGUMENT-TYPE
        SetRamBlockStatus
          arg RamBlockStatus: type=boolean, direction=IN, server-argument-impl-policy=USE-ARGUMENT-TYPE
        WriteBlock
          arg SrcPtr: type=dtRef_const_VOID, direction=IN, server-argument-impl-policy=USE-ARGUMENT-TYPE
      error E_NOT_OK: error-code=1
    NvMService_AC3_SRBS_Defs: is-service=true
      7 x operation, all with possible-error=NvMService_AC3_SRBS_Defs/E_NOT_OK:
        EraseBlock
        GetErrorStatus
          arg ErrorStatus: type=NvM_RequestResultType, direction=OUT, server-argument-impl-policy=USE-ARGUMENT-TYPE
        InvalidateNvBlock
        ReadBlock
          arg DstPtr: type=dtRef_VOID, direction=IN, server-argument-impl-policy=USE-ARGUMENT-TYPE
        RestoreBlockDefaults
          arg DstPtr: type=dtRef_VOID, direction=IN, server-argument-impl-policy=USE-ARGUMENT-TYPE
        SetRamBlockStatus
          arg RamBlockStatus: type=boolean, direction=IN, server-argument-impl-policy=USE-ARGUMENT-TYPE
        WriteBlock
          arg SrcPtr: type=dtRef_const_VOID, direction=IN, server-argument-impl-policy=USE-ARGUMENT-TYPE
      error E_NOT_OK: error-code=1
    NvMService_AC3_SRBS_DS: is-service=true
      8 x operation, all with possible-error=NvMService_AC3_SRBS_DS/E_NOT_OK:
        EraseBlock
        GetDataIndex
          arg DataIndex: type=uint8, direction=OUT, server-argument-impl-policy=USE-ARGUMENT-TYPE
        GetErrorStatus
          arg ErrorStatus: type=NvM_RequestResultType, direction=OUT, server-argument-impl-policy=USE-ARGUMENT-TYPE
        InvalidateNvBlock
        ReadBlock
          arg DstPtr: type=dtRef_VOID, direction=IN, server-argument-impl-policy=USE-ARGUMENT-TYPE
        SetDataIndex
          arg DataIndex: type=uint8, direction=IN, server-argument-impl-policy=USE-ARGUMENT-TYPE
        SetRamBlockStatus
          arg RamBlockStatus: type=boolean, direction=IN, server-argument-impl-policy=USE-ARGUMENT-TYPE
        WriteBlock
          arg SrcPtr: type=dtRef_const_VOID, direction=IN, server-argument-impl-policy=USE-ARGUMENT-TYPE
      error E_NOT_OK: error-code=1
    NvMService_AC3_SRBS_DS_Defs: is-service=true
      9 x operation, all with possible-error=NvMService_AC3_SRBS_DS_Defs/E_NOT_OK:
        EraseBlock
        GetDataIndex
          arg DataIndex: type=uint8, direction=OUT, server-argument-impl-policy=USE-ARGUMENT-TYPE
        GetErrorStatus
          arg ErrorStatus: type=NvM_RequestResultType, direction=OUT, server-argument-impl-policy=USE-ARGUMENT-TYPE
        InvalidateNvBlock
        ReadBlock
          arg DstPtr: type=dtRef_VOID, direction=IN, server-argument-impl-policy=USE-ARGUMENT-TYPE
        RestoreBlockDefaults
          arg DstPtr: type=dtRef_VOID, direction=IN, server-argument-impl-policy=USE-ARGUMENT-TYPE
        SetDataIndex
          arg DataIndex: type=uint8, direction=IN, server-argument-impl-policy=USE-ARGUMENT-TYPE
        SetRamBlockStatus
          arg RamBlockStatus: type=boolean, direction=IN, server-argument-impl-policy=USE-ARGUMENT-TYPE
        WriteBlock
          arg SrcPtr: type=dtRef_const_VOID, direction=IN, server-argument-impl-policy=USE-ARGUMENT-TYPE
      error E_NOT_OK: error-code=1
    NvMService_SRBS: is-service=true
      operation GetErrorStatus: possible-error=NvMService_SRBS/E_NOT_OK
        arg ErrorStatus: type=NvM_RequestResultType, direction=OUT, server-argument-impl-policy=USE-ARGUMENT-TYPE
      operation SetRamBlockStatus: possible-error=NvMService_SRBS/E_NOT_OK
        arg RamBlockStatus: type=boolean, direction=IN, server-argument-impl-policy=USE-ARGUMENT-TYPE
      error E_NOT_OK: error-code=1
    CallbackDTCStatusChange: is-service=true, service-kind=DIAGNOSTIC-EVENT-MANAGER
      operation DTCStatusChanged: possible-error=CallbackDTCStatusChange/E_NOT_OK
        arg DTC: type=uint32, direction=IN, server-argument-impl-policy=USE-ARGUMENT-TYPE
        arg DTCStatusOld: type=Dem_UdsStatusByteType, direction=IN, server-argument-impl-policy=USE-ARGUMENT-TYPE
        arg DTCStatusNew: type=Dem_UdsStatusByteType, direction=IN, server-argument-impl-policy=USE-ARGUMENT-TYPE
      error E_NOT_OK: error-code=1
    NvSWC_NvMAdministration
      operation SetBlockProtection: possible-error=NvSWC_NvMAdministration/E_NOT_OK
        arg ProtectionEnabled: type=boolean, direction=IN, server-argument-impl-policy=USE-ARGUMENT-TYPE
      error E_NOT_OK: error-code=1
    NvSWC_NvMNotifyInitBlock
      operation InitBlock
    NvSWC_NvMNotifyJobFinished
      operation JobFinished
        arg ServiceId: type=NvM_ServiceIdType, direction=IN, server-argument-impl-policy=USE-ARGUMENT-TYPE
        arg JobResult: type=NvM_RequestResultType, direction=IN, server-argument-impl-policy=USE-ARGUMENT-TYPE
    NvSWC_NvMService
      operation GetErrorStatus: possible-error=NvSWC_NvMService/E_NOT_OK
        arg ErrorStatus: type=NvM_RequestResultType, direction=OUT, server-argument-impl-policy=USE-ARGUMENT-TYPE
      error E_NOT_OK: error-code=1
    NvSWC_NvMService_AC2
      operation GetErrorStatus: possible-error=NvSWC_NvMService_AC2/E_NOT_OK
        arg ErrorStatus: type=NvM_RequestResultType, direction=OUT, server-argument-impl-policy=USE-ARGUMENT-TYPE
      operation ReadBlock: possible-error=NvSWC_NvMService_AC2/E_NOT_OK
        arg DstPtr: type=dtRef_VOID, direction=IN, server-argument-impl-policy=USE-ARGUMENT-TYPE
      operation WriteBlock: possible-error=NvSWC_NvMService_AC2/E_NOT_OK
        arg SrcPtr: type=dtRef_const_VOID, direction=IN, server-argument-impl-policy=USE-ARGUMENT-TYPE
      error E_NOT_OK: error-code=1
    NvSWC_NvMService_AC2_Defs
      4 x operation, all with possible-error=NvSWC_NvMService_AC2_Defs/E_NOT_OK:
        GetErrorStatus
          arg ErrorStatus: type=NvM_RequestResultType, direction=OUT, server-argument-impl-policy=USE-ARGUMENT-TYPE
        ReadBlock
          arg DstPtr: type=dtRef_VOID, direction=IN, server-argument-impl-policy=USE-ARGUMENT-TYPE
        RestoreBlockDefaults
          arg DstPtr: type=dtRef_VOID, direction=IN, server-argument-impl-policy=USE-ARGUMENT-TYPE
        WriteBlock
          arg SrcPtr: type=dtRef_const_VOID, direction=IN, server-argument-impl-policy=USE-ARGUMENT-TYPE
      error E_NOT_OK: error-code=1
    NvSWC_NvMService_AC2_DS
      5 x operation, all with possible-error=NvSWC_NvMService_AC2_DS/E_NOT_OK:
        GetDataIndex
          arg DataIndex: type=uint8, direction=OUT, server-argument-impl-policy=USE-ARGUMENT-TYPE
        GetErrorStatus
          arg ErrorStatus: type=NvM_RequestResultType, direction=OUT, server-argument-impl-policy=USE-ARGUMENT-TYPE
        ReadBlock
          arg DstPtr: type=dtRef_VOID, direction=IN, server-argument-impl-policy=USE-ARGUMENT-TYPE
        SetDataIndex
          arg DataIndex: type=uint8, direction=IN, server-argument-impl-policy=USE-ARGUMENT-TYPE
        WriteBlock
          arg SrcPtr: type=dtRef_const_VOID, direction=IN, server-argument-impl-policy=USE-ARGUMENT-TYPE
      error E_NOT_OK: error-code=1
    NvSWC_NvMService_AC2_DS_Defs
      6 x operation, all with possible-error=NvSWC_NvMService_AC2_DS_Defs/E_NOT_OK:
        GetDataIndex
          arg DataIndex: type=uint8, direction=OUT, server-argument-impl-policy=USE-ARGUMENT-TYPE
        GetErrorStatus
          arg ErrorStatus: type=NvM_RequestResultType, direction=OUT, server-argument-impl-policy=USE-ARGUMENT-TYPE
        ReadBlock
          arg DstPtr: type=dtRef_VOID, direction=IN, server-argument-impl-policy=USE-ARGUMENT-TYPE
        RestoreBlockDefaults
          arg DstPtr: type=dtRef_VOID, direction=IN, server-argument-impl-policy=USE-ARGUMENT-TYPE
        SetDataIndex
          arg DataIndex: type=uint8, direction=IN, server-argument-impl-policy=USE-ARGUMENT-TYPE
        WriteBlock
          arg SrcPtr: type=dtRef_const_VOID, direction=IN, server-argument-impl-policy=USE-ARGUMENT-TYPE
      error E_NOT_OK: error-code=1
    NvSWC_NvMService_AC2_SRBS
      4 x operation, all with possible-error=NvSWC_NvMService_AC2_SRBS/E_NOT_OK:
        GetErrorStatus
          arg ErrorStatus: type=NvM_RequestResultType, direction=OUT, server-argument-impl-policy=USE-ARGUMENT-TYPE
        ReadBlock
          arg DstPtr: type=dtRef_VOID, direction=IN, server-argument-impl-policy=USE-ARGUMENT-TYPE
        SetRamBlockStatus
          arg RamBlockStatus: type=boolean, direction=IN, server-argument-impl-policy=USE-ARGUMENT-TYPE
        WriteBlock
          arg SrcPtr: type=dtRef_const_VOID, direction=IN, server-argument-impl-policy=USE-ARGUMENT-TYPE
      error E_NOT_OK: error-code=1
    NvSWC_NvMService_AC2_SRBS_Defs
      5 x operation, all with possible-error=NvSWC_NvMService_AC2_SRBS_Defs/E_NOT_OK:
        GetErrorStatus
          arg ErrorStatus: type=NvM_RequestResultType, direction=OUT, server-argument-impl-policy=USE-ARGUMENT-TYPE
        ReadBlock
          arg DstPtr: type=dtRef_VOID, direction=IN, server-argument-impl-policy=USE-ARGUMENT-TYPE
        RestoreBlockDefaults
          arg DstPtr: type=dtRef_VOID, direction=IN, server-argument-impl-policy=USE-ARGUMENT-TYPE
        SetRamBlockStatus
          arg RamBlockStatus: type=boolean, direction=IN, server-argument-impl-policy=USE-ARGUMENT-TYPE
        WriteBlock
          arg SrcPtr: type=dtRef_const_VOID, direction=IN, server-argument-impl-policy=USE-ARGUMENT-TYPE
      error E_NOT_OK: error-code=1
    NvSWC_NvMService_AC2_SRBS_DS
      6 x operation, all with possible-error=NvSWC_NvMService_AC2_SRBS_DS/E_NOT_OK:
        GetDataIndex
          arg DataIndex: type=uint8, direction=OUT, server-argument-impl-policy=USE-ARGUMENT-TYPE
        GetErrorStatus
          arg ErrorStatus: type=NvM_RequestResultType, direction=OUT, server-argument-impl-policy=USE-ARGUMENT-TYPE
        ReadBlock
          arg DstPtr: type=dtRef_VOID, direction=IN, server-argument-impl-policy=USE-ARGUMENT-TYPE
        SetDataIndex
          arg DataIndex: type=uint8, direction=IN, server-argument-impl-policy=USE-ARGUMENT-TYPE
        SetRamBlockStatus
          arg RamBlockStatus: type=boolean, direction=IN, server-argument-impl-policy=USE-ARGUMENT-TYPE
        WriteBlock
          arg SrcPtr: type=dtRef_const_VOID, direction=IN, server-argument-impl-policy=USE-ARGUMENT-TYPE
      error E_NOT_OK: error-code=1
    NvSWC_NvMService_AC2_SRBS_DS_Defs
      7 x operation, all with possible-error=NvSWC_NvMService_AC2_SRBS_DS_Defs/E_NOT_OK:
        GetDataIndex
          arg DataIndex: type=uint8, direction=OUT, server-argument-impl-policy=USE-ARGUMENT-TYPE
        GetErrorStatus
          arg ErrorStatus: type=NvM_RequestResultType, direction=OUT, server-argument-impl-policy=USE-ARGUMENT-TYPE
        ReadBlock
          arg DstPtr: type=dtRef_VOID, direction=IN, server-argument-impl-policy=USE-ARGUMENT-TYPE
        RestoreBlockDefaults
          arg DstPtr: type=dtRef_VOID, direction=IN, server-argument-impl-policy=USE-ARGUMENT-TYPE
        SetDataIndex
          arg DataIndex: type=uint8, direction=IN, server-argument-impl-policy=USE-ARGUMENT-TYPE
        SetRamBlockStatus
          arg RamBlockStatus: type=boolean, direction=IN, server-argument-impl-policy=USE-ARGUMENT-TYPE
        WriteBlock
          arg SrcPtr: type=dtRef_const_VOID, direction=IN, server-argument-impl-policy=USE-ARGUMENT-TYPE
      error E_NOT_OK: error-code=1
    NvSWC_NvMService_AC3
      5 x operation, all with possible-error=NvSWC_NvMService_AC3/E_NOT_OK:
        EraseBlock
        GetErrorStatus
          arg ErrorStatus: type=NvM_RequestResultType, direction=OUT, server-argument-impl-policy=USE-ARGUMENT-TYPE
        InvalidateNvBlock
        ReadBlock
          arg DstPtr: type=dtRef_VOID, direction=IN, server-argument-impl-policy=USE-ARGUMENT-TYPE
        WriteBlock
          arg SrcPtr: type=dtRef_const_VOID, direction=IN, server-argument-impl-policy=USE-ARGUMENT-TYPE
      error E_NOT_OK: error-code=1
    NvSWC_NvMService_AC3_Defs
      6 x operation, all with possible-error=NvSWC_NvMService_AC3_Defs/E_NOT_OK:
        EraseBlock
        GetErrorStatus
          arg ErrorStatus: type=NvM_RequestResultType, direction=OUT, server-argument-impl-policy=USE-ARGUMENT-TYPE
        InvalidateNvBlock
        ReadBlock
          arg DstPtr: type=dtRef_VOID, direction=IN, server-argument-impl-policy=USE-ARGUMENT-TYPE
        RestoreBlockDefaults
          arg DstPtr: type=dtRef_VOID, direction=IN, server-argument-impl-policy=USE-ARGUMENT-TYPE
        WriteBlock
          arg SrcPtr: type=dtRef_const_VOID, direction=IN, server-argument-impl-policy=USE-ARGUMENT-TYPE
      error E_NOT_OK: error-code=1
    NvSWC_NvMService_AC3_DS
      7 x operation, all with possible-error=NvSWC_NvMService_AC3_DS/E_NOT_OK:
        EraseBlock
        GetDataIndex
          arg DataIndex: type=uint8, direction=OUT, server-argument-impl-policy=USE-ARGUMENT-TYPE
        GetErrorStatus
          arg ErrorStatus: type=NvM_RequestResultType, direction=OUT, server-argument-impl-policy=USE-ARGUMENT-TYPE
        InvalidateNvBlock
        ReadBlock
          arg DstPtr: type=dtRef_VOID, direction=IN, server-argument-impl-policy=USE-ARGUMENT-TYPE
        SetDataIndex
          arg DataIndex: type=uint8, direction=IN, server-argument-impl-policy=USE-ARGUMENT-TYPE
        WriteBlock
          arg SrcPtr: type=dtRef_const_VOID, direction=IN, server-argument-impl-policy=USE-ARGUMENT-TYPE
      error E_NOT_OK: error-code=1
    NvSWC_NvMService_AC3_DS_Defs
      8 x operation, all with possible-error=NvSWC_NvMService_AC3_DS_Defs/E_NOT_OK:
        EraseBlock
        GetDataIndex
          arg DataIndex: type=uint8, direction=OUT, server-argument-impl-policy=USE-ARGUMENT-TYPE
        GetErrorStatus
          arg ErrorStatus: type=NvM_RequestResultType, direction=OUT, server-argument-impl-policy=USE-ARGUMENT-TYPE
        InvalidateNvBlock
        ReadBlock
          arg DstPtr: type=dtRef_VOID, direction=IN, server-argument-impl-policy=USE-ARGUMENT-TYPE
        RestoreBlockDefaults
          arg DstPtr: type=dtRef_VOID, direction=IN, server-argument-impl-policy=USE-ARGUMENT-TYPE
        SetDataIndex
          arg DataIndex: type=uint8, direction=IN, server-argument-impl-policy=USE-ARGUMENT-TYPE
        WriteBlock
          arg SrcPtr: type=dtRef_const_VOID, direction=IN, server-argument-impl-policy=USE-ARGUMENT-TYPE
      error E_NOT_OK: error-code=1
    NvSWC_NvMService_AC3_SRBS
      6 x operation, all with possible-error=NvSWC_NvMService_AC3_SRBS/E_NOT_OK:
        EraseBlock
        GetErrorStatus
          arg ErrorStatus: type=NvM_RequestResultType, direction=OUT, server-argument-impl-policy=USE-ARGUMENT-TYPE
        InvalidateNvBlock
        ReadBlock
          arg DstPtr: type=dtRef_VOID, direction=IN, server-argument-impl-policy=USE-ARGUMENT-TYPE
        SetRamBlockStatus
          arg RamBlockStatus: type=boolean, direction=IN, server-argument-impl-policy=USE-ARGUMENT-TYPE
        WriteBlock
          arg SrcPtr: type=dtRef_const_VOID, direction=IN, server-argument-impl-policy=USE-ARGUMENT-TYPE
      error E_NOT_OK: error-code=1
    NvSWC_NvMService_AC3_SRBS_Defs
      7 x operation, all with possible-error=NvSWC_NvMService_AC3_SRBS_Defs/E_NOT_OK:
        EraseBlock
        GetErrorStatus
          arg ErrorStatus: type=NvM_RequestResultType, direction=OUT, server-argument-impl-policy=USE-ARGUMENT-TYPE
        InvalidateNvBlock
        ReadBlock
          arg DstPtr: type=dtRef_VOID, direction=IN, server-argument-impl-policy=USE-ARGUMENT-TYPE
        RestoreBlockDefaults
          arg DstPtr: type=dtRef_VOID, direction=IN, server-argument-impl-policy=USE-ARGUMENT-TYPE
        SetRamBlockStatus
          arg RamBlockStatus: type=boolean, direction=IN, server-argument-impl-policy=USE-ARGUMENT-TYPE
        WriteBlock
          arg SrcPtr: type=dtRef_const_VOID, direction=IN, server-argument-impl-policy=USE-ARGUMENT-TYPE
      error E_NOT_OK: error-code=1
    NvSWC_NvMService_AC3_SRBS_DS
      8 x operation, all with possible-error=NvSWC_NvMService_AC3_SRBS_DS/E_NOT_OK:
        EraseBlock
        GetDataIndex
          arg DataIndex: type=uint8, direction=OUT, server-argument-impl-policy=USE-ARGUMENT-TYPE
        GetErrorStatus
          arg ErrorStatus: type=NvM_RequestResultType, direction=OUT, server-argument-impl-policy=USE-ARGUMENT-TYPE
        InvalidateNvBlock
        ReadBlock
          arg DstPtr: type=dtRef_VOID, direction=IN, server-argument-impl-policy=USE-ARGUMENT-TYPE
        SetDataIndex
          arg DataIndex: type=uint8, direction=IN, server-argument-impl-policy=USE-ARGUMENT-TYPE
        SetRamBlockStatus
          arg RamBlockStatus: type=boolean, direction=IN, server-argument-impl-policy=USE-ARGUMENT-TYPE
        WriteBlock
          arg SrcPtr: type=dtRef_const_VOID, direction=IN, server-argument-impl-policy=USE-ARGUMENT-TYPE
      error E_NOT_OK: error-code=1
    NvSWC_NvMService_AC3_SRBS_DS_Defs
      9 x operation, all with possible-error=NvSWC_NvMService_AC3_SRBS_DS_Defs/E_NOT_OK:
        EraseBlock
        GetDataIndex
          arg DataIndex: type=uint8, direction=OUT, server-argument-impl-policy=USE-ARGUMENT-TYPE
        GetErrorStatus
          arg ErrorStatus: type=NvM_RequestResultType, direction=OUT, server-argument-impl-policy=USE-ARGUMENT-TYPE
        InvalidateNvBlock
        ReadBlock
          arg DstPtr: type=dtRef_VOID, direction=IN, server-argument-impl-policy=USE-ARGUMENT-TYPE
        RestoreBlockDefaults
          arg DstPtr: type=dtRef_VOID, direction=IN, server-argument-impl-policy=USE-ARGUMENT-TYPE
        SetDataIndex
          arg DataIndex: type=uint8, direction=IN, server-argument-impl-policy=USE-ARGUMENT-TYPE
        SetRamBlockStatus
          arg RamBlockStatus: type=boolean, direction=IN, server-argument-impl-policy=USE-ARGUMENT-TYPE
        WriteBlock
          arg SrcPtr: type=dtRef_const_VOID, direction=IN, server-argument-impl-policy=USE-ARGUMENT-TYPE
      error E_NOT_OK: error-code=1
    NvSWC_NvMService_SRBS
      operation GetErrorStatus: possible-error=NvSWC_NvMService_SRBS/E_NOT_OK
        arg ErrorStatus: type=NvM_RequestResultType, direction=OUT, server-argument-impl-policy=USE-ARGUMENT-TYPE
      operation SetRamBlockStatus: possible-error=NvSWC_NvMService_SRBS/E_NOT_OK
        arg RamBlockStatus: type=boolean, direction=IN, server-argument-impl-policy=USE-ARGUMENT-TYPE
      error E_NOT_OK: error-code=1
package /AUTOSAR_Dem/ASR42/PortInterfaces
  client server interface Dem_ASR42_DiagnosticInfo: is-service=true
    10 x operation:
      GetDTCOfEvent: possible-error=[Dem_ASR42_DiagnosticInfo/DEM_E_NO_DTC_AVAILABLE, Dem_ASR42_DiagnosticInfo/E_NOT_OK]
        arg DTCFormat: type=Dem_ASR42_DTCFormatType, direction=IN, server-argument-impl-policy=USE-ARGUMENT-TYPE
        arg DTCOfEvent: type=uint32, direction=OUT, server-argument-impl-policy=USE-ARGUMENT-TYPE
      GetDebouncingOfEvent: possible-error=Dem_ASR42_DiagnosticInfo/E_NOT_OK
        arg DebouncingState: type=Dem_DebouncingStateType, direction=OUT, server-argument-impl-policy=USE-ARGUMENT-TYPE
      GetEventExtendedDataRecord: possible-error=Dem_ASR42_DiagnosticInfo/E_NOT_OK
        arg RecordNumber: type=uint8, direction=IN, server-argument-impl-policy=USE-ARGUMENT-TYPE
        arg DestBuffer: type=Dem_ASR42_MaxDataValueType, direction=OUT, server-argument-impl-policy=USE-ARGUMENT-TYPE
      GetEventExtendedDataRecordEx: possible-error=[Dem_ASR42_DiagnosticInfo/DEM_E_NODATAAVAILABLE, Dem_ASR42_DiagnosticInfo/DEM_E_WRONG_BUFFERSIZE, Dem_ASR42_DiagnosticInfo/DEM_E_WRONG_RECORDNUMBER, Dem_ASR42_DiagnosticInfo/E_NOT_OK]
        arg RecordNumber: type=uint8, direction=IN, server-argument-impl-policy=USE-ARGUMENT-TYPE
        arg DestBuffer: type=uint8, direction=OUT, server-argument-impl-policy=USE-ARGUMENT-TYPE
        arg BufSize: type=uint16, direction=INOUT, server-argument-impl-policy=USE-ARGUMENT-TYPE
      GetEventFailed: possible-error=Dem_ASR42_DiagnosticInfo/E_NOT_OK
        arg EventFailed: type=boolean, direction=OUT, server-argument-impl-policy=USE-ARGUMENT-TYPE
      GetEventFreezeFrameData: possible-error=[Dem_ASR42_DiagnosticInfo/DEM_E_NODATAAVAILABLE, Dem_ASR42_DiagnosticInfo/DEM_E_WRONG_DIDNUMBER, Dem_ASR42_DiagnosticInfo/DEM_E_WRONG_RECORDNUMBER]
        4 x arg, all with server-argument-impl-policy=USE-ARGUMENT-TYPE:
          RecordNumber: type=uint8, direction=IN
          ReportTotalRecord: type=boolean, direction=IN
          DataId: type=uint16, direction=IN
          DestBuffer: type=Dem_ASR42_MaxDataValueType, direction=OUT
      GetEventFreezeFrameDataEx: possible-error=[Dem_ASR42_DiagnosticInfo/DEM_E_NODATAAVAILABLE, Dem_ASR42_DiagnosticInfo/DEM_E_WRONG_BUFFERSIZE, Dem_ASR42_DiagnosticInfo/DEM_E_WRONG_DIDNUMBER, Dem_ASR42_DiagnosticInfo/DEM_E_WRONG_RECORDNUMBER, Dem_ASR42_DiagnosticInfo/E_NOT_OK]
        4 x arg, all with server-argument-impl-policy=USE-ARGUMENT-TYPE:
          RecordNumber: type=uint8, direction=IN
          DataId: type=uint16, direction=IN
          DestBuffer: type=uint8, direction=OUT
          BufSize: type=uint16, direction=INOUT
      GetEventStatus: possible-error=Dem_ASR42_DiagnosticInfo/E_NOT_OK
        arg EventStatusExtended: type=Dem_ASR42_EventStatusExtendedType, direction=OUT, server-argument-impl-policy=USE-ARGUMENT-TYPE
      GetEventTested: possible-error=Dem_ASR42_DiagnosticInfo/E_NOT_OK
        arg EventTested: type=boolean, direction=OUT, server-argument-impl-policy=USE-ARGUMENT-TYPE
      GetFaultDetectionCounter: possible-error=Dem_ASR42_DiagnosticInfo/E_NOT_OK
        arg FaultDetectionCounter: type=sint8, direction=OUT, server-argument-impl-policy=USE-ARGUMENT-TYPE
    7 x error:
      DEM_E_NODATAAVAILABLE: error-code=48
      DEM_E_NO_DTC_AVAILABLE: error-code=2
      DEM_E_NO_FDC_AVAILABLE: error-code=3
      DEM_E_WRONG_BUFFERSIZE: error-code=21
      DEM_E_WRONG_DIDNUMBER: error-code=50
      DEM_E_WRONG_RECORDNUMBER: error-code=49
      E_NOT_OK: error-code=1
  client server interface Dem_ASR42_DiagnosticMonitor: is-service=true
    5 x operation, all with possible-error=Dem_ASR42_DiagnosticMonitor/E_NOT_OK:
      ClearPrestoredFreezeFrame
      PrestoreFreezeFrame
      ResetEventDebounceStatus
        arg DebounceResetStatus: type=Dem_ASR42_DebounceResetStatusType, direction=IN, server-argument-impl-policy=USE-ARGUMENT-TYPE
      ResetEventStatus
      SetEventStatus
        arg EventStatus: type=Dem_ASR42_EventStatusType, direction=IN, server-argument-impl-policy=USE-ARGUMENT-TYPE
    error E_NOT_OK: error-code=1
  client server interface Dem_ASR42_GeneralDiagnosticInfo: is-service=true
    10 x operation:
      GetDTCOfEvent: possible-error=[Dem_ASR42_GeneralDiagnosticInfo/DEM_E_NO_DTC_AVAILABLE, Dem_ASR42_GeneralDiagnosticInfo/E_NOT_OK]
        arg EventId: type=Dem_ASR42_EventIdType, direction=IN, server-argument-impl-policy=USE-ARGUMENT-TYPE
        arg DTCFormat: type=Dem_ASR42_DTCFormatType_3, direction=IN, server-argument-impl-policy=USE-ARGUMENT-TYPE
        arg DTCOfEvent: type=uint32, direction=OUT, server-argument-impl-policy=USE-ARGUMENT-TYPE
      GetDebouncingOfEvent: possible-error=Dem_ASR42_GeneralDiagnosticInfo/E_NOT_OK
        arg EventId: type=Dem_ASR42_EventIdType, direction=IN, server-argument-impl-policy=USE-ARGUMENT-TYPE
        arg DebouncingState: type=Dem_DebouncingStateType_3, direction=OUT, server-argument-impl-policy=USE-ARGUMENT-TYPE
      GetEventExtendedDataRecord: possible-error=Dem_ASR42_GeneralDiagnosticInfo/E_NOT_OK
        arg EventId: type=Dem_ASR42_EventIdType, direction=IN, server-argument-impl-policy=USE-ARGUMENT-TYPE
        arg RecordNumber: type=uint8, direction=IN, server-argument-impl-policy=USE-ARGUMENT-TYPE
        arg DestBuffer: type=Dem_ASR42_MaxDataValueType_3, direction=OUT, server-argument-impl-policy=USE-ARGUMENT-TYPE
      GetEventExtendedDataRecordEx: possible-error=[Dem_ASR42_GeneralDiagnosticInfo/DEM_E_NODATAAVAILABLE, Dem_ASR42_GeneralDiagnosticInfo/DEM_E_WRONG_BUFFERSIZE, Dem_ASR42_GeneralDiagnosticInfo/DEM_E_WRONG_RECORDNUMBER, Dem_ASR42_GeneralDiagnosticInfo/E_NOT_OK]
        4 x arg, all with server-argument-impl-policy=USE-ARGUMENT-TYPE:
          EventId: type=Dem_ASR42_EventIdType, direction=IN
          RecordNumber: type=uint8, direction=IN
          DestBuffer: type=uint8, direction=OUT
          BufSize: type=uint16, direction=INOUT
      GetEventFailed: possible-error=Dem_ASR42_GeneralDiagnosticInfo/E_NOT_OK
        arg EventId: type=Dem_ASR42_EventIdType, direction=IN, server-argument-impl-policy=USE-ARGUMENT-TYPE
        arg EventFailed: type=boolean, direction=OUT, server-argument-impl-policy=USE-ARGUMENT-TYPE
      GetEventFreezeFrameData: possible-error=[Dem_ASR42_GeneralDiagnosticInfo/DEM_E_NODATAAVAILABLE, Dem_ASR42_GeneralDiagnosticInfo/DEM_E_WRONG_DIDNUMBER, Dem_ASR42_GeneralDiagnosticInfo/DEM_E_WRONG_RECORDNUMBER]
        5 x arg, all with server-argument-impl-policy=USE-ARGUMENT-TYPE:
          EventId: type=Dem_ASR42_EventIdType, direction=IN
          RecordNumber: type=uint8, direction=IN
          ReportTotalRecord: type=boolean, direction=IN
          DataId: type=uint16, direction=IN
          DestBuffer: type=Dem_ASR42_MaxDataValueType_3, direction=OUT
      GetEventFreezeFrameDataEx: possible-error=[Dem_ASR42_GeneralDiagnosticInfo/DEM_E_NODATAAVAILABLE, Dem_ASR42_GeneralDiagnosticInfo/DEM_E_WRONG_BUFFERSIZE, Dem_ASR42_GeneralDiagnosticInfo/DEM_E_WRONG_DIDNUMBER, Dem_ASR42_GeneralDiagnosticInfo/DEM_E_WRONG_RECORDNUMBER, Dem_ASR42_GeneralDiagnosticInfo/E_NOT_OK]
        5 x arg, all with server-argument-impl-policy=USE-ARGUMENT-TYPE:
          EventId: type=Dem_ASR42_EventIdType, direction=IN
          RecordNumber: type=uint8, direction=IN
          DataId: type=uint16, direction=IN
          DestBuffer: type=uint8, direction=OUT
          BufSize: type=uint16, direction=INOUT
      GetEventStatus: possible-error=Dem_ASR42_GeneralDiagnosticInfo/E_NOT_OK
        arg EventId: type=Dem_ASR42_EventIdType, direction=IN, server-argument-impl-policy=USE-ARGUMENT-TYPE
        arg EventStatusExtended: type=Dem_ASR42_EventStatusExtendedType_3, direction=OUT, server-argument-impl-policy=USE-ARGUMENT-TYPE
      GetEventTested: possible-error=Dem_ASR42_GeneralDiagnosticInfo/E_NOT_OK
        arg EventId: type=Dem_ASR42_EventIdType, direction=IN, server-argument-impl-policy=USE-ARGUMENT-TYPE
        arg EventTested: type=boolean, direction=OUT, server-argument-impl-policy=USE-ARGUMENT-TYPE
      GetFaultDetectionCounter: possible-error=Dem_ASR42_GeneralDiagnosticInfo/E_NOT_OK
        arg EventId: type=Dem_ASR42_EventIdType, direction=IN, server-argument-impl-policy=USE-ARGUMENT-TYPE
        arg FaultDetectionCounter: type=sint8, direction=OUT, server-argument-impl-policy=USE-ARGUMENT-TYPE
    7 x error:
      DEM_E_NODATAAVAILABLE: error-code=48
      DEM_E_NO_DTC_AVAILABLE: error-code=2
      DEM_E_NO_FDC_AVAILABLE: error-code=3
      DEM_E_WRONG_BUFFERSIZE: error-code=21
      DEM_E_WRONG_DIDNUMBER: error-code=50
      DEM_E_WRONG_RECORDNUMBER: error-code=49
      E_NOT_OK: error-code=1
package /AUTOSAR_Dem/PortInterfaces
  client server interface CddIf: is-service=true
    operation ClearDTC: possible-error=[DEM_CLEAR_BUSY, DEM_CLEAR_FAILED, DEM_CLEAR_PENDING, DEM_CLEAR_WRONG_DTC, DEM_CLEAR_WRONG_DTCORIGIN]
      arg DTC: type=uint32, direction=IN, server-argument-impl-policy=USE-ARGUMENT-TYPE
      arg DTCFormat: type=Dem_DTCFormatType, direction=IN, server-argument-impl-policy=USE-ARGUMENT-TYPE
      arg DTCOrigin: type=Dem_DTCOriginTypeALV, direction=IN, server-argument-impl-policy=USE-ARGUMENT-TYPE
    5 x error:
      DEM_CLEAR_BUSY: error-code=5
      DEM_CLEAR_FAILED: error-code=3
      DEM_CLEAR_PENDING: error-code=4
      DEM_CLEAR_WRONG_DTC: error-code=1
      DEM_CLEAR_WRONG_DTCORIGIN: error-code=2
  client server interface DiagnosticInfo: is-service=true
    10 x operation:
      GetDTCOfEvent: possible-error=[DiagnosticInfo/DEM_E_NO_DTC_AVAILABLE, DiagnosticInfo/E_NOT_OK]
        arg DTCFormat: type=Dem_DTCFormatType, direction=IN, server-argument-impl-policy=USE-ARGUMENT-TYPE
        arg DTCOfEvent: type=uint32, direction=OUT, server-argument-impl-policy=USE-ARGUMENT-TYPE
      GetDebouncingOfEvent: possible-error=DiagnosticInfo/E_NOT_OK
        arg DebouncingState: type=Dem_DebouncingStateType, direction=OUT, server-argument-impl-policy=USE-ARGUMENT-TYPE
      GetEventExtendedDataRecord: possible-error=DiagnosticInfo/E_NOT_OK
        arg RecordNumber: type=uint8, direction=IN, server-argument-impl-policy=USE-ARGUMENT-TYPE
        arg DestBuffer: type=Dem_MaxDataValueTypeAlv, direction=OUT, server-argument-impl-policy=USE-ARGUMENT-TYPE
      GetEventExtendedDataRecordEx: possible-error=[DiagnosticInfo/DEM_E_NODATAAVAILABLE, DiagnosticInfo/DEM_E_WRONG_BUFFERSIZE, DiagnosticInfo/DEM_E_WRONG_RECORDNUMBER, DiagnosticInfo/E_NOT_OK]
        arg RecordNumber: type=uint8, direction=IN, server-argument-impl-policy=USE-ARGUMENT-TYPE
        arg DestBuffer: type=uint8, direction=OUT, server-argument-impl-policy=USE-ARGUMENT-TYPE
        arg BufSize: type=uint16, direction=INOUT, server-argument-impl-policy=USE-ARGUMENT-TYPE
      GetEventFailed: possible-error=DiagnosticInfo/E_NOT_OK
        arg EventFailed: type=boolean, direction=OUT, server-argument-impl-policy=USE-ARGUMENT-TYPE
      GetEventFreezeFrameData: possible-error=[DiagnosticInfo/DEM_E_NODATAAVAILABLE, DiagnosticInfo/DEM_E_WRONG_DIDNUMBER, DiagnosticInfo/DEM_E_WRONG_RECORDNUMBER]
        4 x arg, all with server-argument-impl-policy=USE-ARGUMENT-TYPE:
          RecordNumber: type=uint8, direction=IN
          ReportTotalRecord: type=boolean, direction=IN
          DataId: type=uint16, direction=IN
          DestBuffer: type=Dem_MaxDataValueTypeAlv, direction=OUT
      GetEventFreezeFrameDataEx: possible-error=[DiagnosticInfo/DEM_E_NODATAAVAILABLE, DiagnosticInfo/DEM_E_WRONG_BUFFERSIZE, DiagnosticInfo/DEM_E_WRONG_DIDNUMBER, DiagnosticInfo/DEM_E_WRONG_RECORDNUMBER, DiagnosticInfo/E_NOT_OK]
        4 x arg, all with server-argument-impl-policy=USE-ARGUMENT-TYPE:
          RecordNumber: type=uint8, direction=IN
          DataId: type=uint16, direction=IN
          DestBuffer: type=uint8, direction=OUT
          BufSize: type=uint16, direction=INOUT
      GetEventStatus: possible-error=DiagnosticInfo/E_NOT_OK
        arg EventStatusExtended: type=Dem_EventStatusExtendedType, direction=OUT, server-argument-impl-policy=USE-ARGUMENT-TYPE
      GetEventTested: possible-error=DiagnosticInfo/E_NOT_OK
        arg EventTested: type=boolean, direction=OUT, server-argument-impl-policy=USE-ARGUMENT-TYPE
      GetFaultDetectionCounter: possible-error=DiagnosticInfo/E_NOT_OK
        arg FaultDetectionCounter: type=sint8, direction=OUT, server-argument-impl-policy=USE-ARGUMENT-TYPE
    7 x error:
      DEM_E_NODATAAVAILABLE: error-code=48
      DEM_E_NO_DTC_AVAILABLE: error-code=2
      DEM_E_NO_FDC_AVAILABLE: error-code=3
      DEM_E_WRONG_BUFFERSIZE: error-code=21
      DEM_E_WRONG_DIDNUMBER: error-code=50
      DEM_E_WRONG_RECORDNUMBER: error-code=49
      E_NOT_OK: error-code=1
package /AUTOSAR_NvM/ASR42/PortInterfaces
  client server interface NvM_ASR42_Service: is-service=true
    12 x operation, all with possible-error=NvM_ASR42_Service/E_NOT_OK:
      EraseBlock
      GetDataIndex
        arg DataIndexPtr: type=uint8, direction=OUT, server-argument-impl-policy=USE-ARGUMENT-TYPE
      GetErrorStatus
        arg RequestResultPtr: type=NvM_ASR42_RequestResultType, direction=OUT, server-argument-impl-policy=USE-ARGUMENT-TYPE
      InvalidateNvBlock
      ReadBlock
        arg DstPtr: type=NvM_ASR42_DstPtrType, direction=IN, server-argument-impl-policy=USE-ARGUMENT-TYPE
      ReadPRAMBlock
      RestoreBlockDefaults
        arg DstPtr: type=NvM_ASR42_DstPtrType, direction=IN, server-argument-impl-policy=USE-ARGUMENT-TYPE
      RestorePRAMBlockDefaults
      SetDataIndex
        arg DataIndex: type=uint8, direction=IN, server-argument-impl-policy=USE-ARGUMENT-TYPE
      SetRamBlockStatus
        arg BlockChanged: type=boolean, direction=IN, server-argument-impl-policy=USE-ARGUMENT-TYPE
      WriteBlock
        arg SrcPtr: type=NvM_ASR42_SrcPtrType, direction=IN, server-argument-impl-policy=USE-ARGUMENT-TYPE
      WritePRAMBlock
    error E_NOT_OK: error-code=1
package /AUTOSAR_NvM/PortInterfaces
  client server interface NvMService: is-service=true
    12 x operation, all with possible-error=NvMService/E_NOT_OK:
      EraseBlock
      GetDataIndex
        arg DataIndexPtr: type=uint8, direction=OUT, server-argument-impl-policy=USE-ARGUMENT-TYPE
      GetErrorStatus
        arg RequestResultPtr: type=NvM_RequestResultType, direction=OUT, server-argument-impl-policy=USE-ARGUMENT-TYPE
      InvalidateNvBlock
      ReadBlock
        arg DstPtr: type=NvM_DstPtrType, direction=IN, server-argument-impl-policy=USE-ARGUMENT-TYPE
      ReadPRAMBlock
      RestoreBlockDefaults
        arg DstPtr: type=NvM_DstPtrType, direction=IN, server-argument-impl-policy=USE-ARGUMENT-TYPE
      RestorePRAMBlockDefaults
      SetDataIndex
        arg DataIndex: type=uint8, direction=IN, server-argument-impl-policy=USE-ARGUMENT-TYPE
      SetRamBlockStatus
        arg BlockChanged: type=boolean, direction=IN, server-argument-impl-policy=USE-ARGUMENT-TYPE
      WriteBlock
        arg SrcPtr: type=NvM_SrcPtrType, direction=IN, server-argument-impl-policy=USE-ARGUMENT-TYPE
      WritePRAMBlock
    error E_NOT_OK: error-code=1
package /AUTOSAR_Dcm/ASR42/PortInterfaces
  client server interface Dcm_ASR42_DCMServices: is-service=true
    4 x operation, all with possible-error=Dcm_ASR42_DCMServices/E_NOT_OK:
      GetActiveProtocol
        arg ActiveProtocol: type=Dcm_ASR42_ProtocolType, direction=OUT, server-argument-impl-policy=USE-ARGUMENT-TYPE
      GetSecurityLevel
        arg SecLevel: type=Dcm_ASR42_SecLevelType, direction=OUT, server-argument-impl-policy=USE-ARGUMENT-TYPE
      GetSesCtrlType
        arg SesCtrlType: type=Dcm_ASR42_SesCtrlType, direction=OUT, server-argument-impl-policy=USE-ARGUMENT-TYPE
      ResetToDefaultSession
    error E_NOT_OK: error-code=1
package /AUTOSAR_Dcm/PortInterfaces
  5 x client server interface, all with is-service=true:
    DataServices_DID_F18C_BeltAssemblySerialNumberData
      operation ReadData: possible-error=[DataServices_DID_F18C_BeltAssemblySerialNumberData/DCM_E_PENDING, DataServices_DID_F18C_BeltAssemblySerialNumberData/E_NOT_OK]
        arg OpStatus: type=Dcm_OpStatusType, direction=IN, server-argument-impl-policy=USE-ARGUMENT-TYPE
        arg Data: type=Dcm_DataDID_F18C_BeltAssemblySerialNumberData_ArrayType, direction=OUT, server-argument-impl-policy=USE-ARGUMENT-TYPE
      operation WriteData: possible-error=[DataServices_DID_F18C_BeltAssemblySerialNumberData/DCM_E_PENDING, DataServices_DID_F18C_BeltAssemblySerialNumberData/E_NOT_OK]
        arg Data: type=Dcm_DataDID_F18C_BeltAssemblySerialNumberData_ArrayType, direction=IN, server-argument-impl-policy=USE-ARGUMENT-TYPE
        arg OpStatus: type=Dcm_OpStatusType, direction=IN, server-argument-impl-policy=USE-ARGUMENT-TYPE
        arg ErrorCode: type=Dcm_NegativeResponseCodeType, direction=OUT, server-argument-impl-policy=USE-ARGUMENT-TYPE
      error DCM_E_PENDING: error-code=10
      error E_NOT_OK: error-code=1
    DataServices_DID_FD8C_BeltAssemblySerialNumberData
      operation ReadData: possible-error=[DataServices_DID_FD8C_BeltAssemblySerialNumberData/DCM_E_PENDING, DataServices_DID_FD8C_BeltAssemblySerialNumberData/E_NOT_OK]
        arg OpStatus: type=Dcm_OpStatusType, direction=IN, server-argument-impl-policy=USE-ARGUMENT-TYPE
        arg Data: type=Dcm_DataDID_FD8C_BeltAssemblySerialNumberData_ArrayType, direction=OUT, server-argument-impl-policy=USE-ARGUMENT-TYPE
      operation WriteData: possible-error=[DataServices_DID_FD8C_BeltAssemblySerialNumberData/DCM_E_PENDING, DataServices_DID_FD8C_BeltAssemblySerialNumberData/E_NOT_OK]
        arg Data: type=Dcm_DataDID_FD8C_BeltAssemblySerialNumberData_ArrayType, direction=IN, server-argument-impl-policy=USE-ARGUMENT-TYPE
        arg OpStatus: type=Dcm_OpStatusType, direction=IN, server-argument-impl-policy=USE-ARGUMENT-TYPE
        arg ErrorCode: type=Dcm_NegativeResponseCodeType, direction=OUT, server-argument-impl-policy=USE-ARGUMENT-TYPE
      error DCM_E_PENDING: error-code=10
      error E_NOT_OK: error-code=1
    DataServices_DID_FD03_AEETraceabilityNumberData
      operation ReadData: possible-error=[DataServices_DID_FD03_AEETraceabilityNumberData/DCM_E_PENDING, DataServices_DID_FD03_AEETraceabilityNumberData/E_NOT_OK]
        arg OpStatus: type=Dcm_OpStatusType_1, direction=IN, server-argument-impl-policy=USE-ARGUMENT-TYPE
        arg Data: type=Dcm_DataDID_FD03_AEETraceabilityNumberData_ArrayType, direction=OUT, server-argument-impl-policy=USE-ARGUMENT-TYPE
      operation WriteData: possible-error=[DataServices_DID_FD03_AEETraceabilityNumberData/DCM_E_PENDING, DataServices_DID_FD03_AEETraceabilityNumberData/E_NOT_OK]
        arg Data: type=Dcm_DataDID_FD03_AEETraceabilityNumberData_ArrayType, direction=IN, server-argument-impl-policy=USE-ARGUMENT-TYPE
        arg OpStatus: type=Dcm_OpStatusType_1, direction=IN, server-argument-impl-policy=USE-ARGUMENT-TYPE
        arg ErrorCode: type=Dcm_NegativeResponseCodeType_1, direction=OUT, server-argument-impl-policy=USE-ARGUMENT-TYPE
      error DCM_E_PENDING: error-code=10
      error E_NOT_OK: error-code=1
    DataServices_DID_FD2F_EcuLocationData
      operation ReadData: possible-error=[DataServices_DID_FD2F_EcuLocationData/DCM_E_PENDING, DataServices_DID_FD2F_EcuLocationData/E_NOT_OK]
        arg OpStatus: type=Dcm_OpStatusType_1, direction=IN, server-argument-impl-policy=USE-ARGUMENT-TYPE
        arg Data: type=Dcm_DataDID_FD2F_EcuLocationData_ArrayType, direction=OUT, server-argument-impl-policy=USE-ARGUMENT-TYPE
      operation WriteData: possible-error=[DataServices_DID_FD2F_EcuLocationData/DCM_E_PENDING, DataServices_DID_FD2F_EcuLocationData/E_NOT_OK]
        arg Data: type=Dcm_DataDID_FD2F_EcuLocationData_ArrayType, direction=IN, server-argument-impl-policy=USE-ARGUMENT-TYPE
        arg OpStatus: type=Dcm_OpStatusType_1, direction=IN, server-argument-impl-policy=USE-ARGUMENT-TYPE
        arg ErrorCode: type=Dcm_NegativeResponseCodeType_1, direction=OUT, server-argument-impl-policy=USE-ARGUMENT-TYPE
      error DCM_E_PENDING: error-code=10
      error E_NOT_OK: error-code=1
    DataServices_DID_FD8B_BeltAssemblyManufDateData
      operation ReadData: possible-error=[DataServices_DID_FD8B_BeltAssemblyManufDateData/DCM_E_PENDING, DataServices_DID_FD8B_BeltAssemblyManufDateData/E_NOT_OK]
        arg OpStatus: type=Dcm_OpStatusType_1, direction=IN, server-argument-impl-policy=USE-ARGUMENT-TYPE
        arg Data: type=Dcm_DataDID_FD8B_BeltAssemblyManufDateData_ArrayType, direction=OUT, server-argument-impl-policy=USE-ARGUMENT-TYPE
      operation WriteData: possible-error=[DataServices_DID_FD8B_BeltAssemblyManufDateData/DCM_E_PENDING, DataServices_DID_FD8B_BeltAssemblyManufDateData/E_NOT_OK]
        arg Data: type=Dcm_DataDID_FD8B_BeltAssemblyManufDateData_ArrayType, direction=IN, server-argument-impl-policy=USE-ARGUMENT-TYPE
        arg OpStatus: type=Dcm_OpStatusType_1, direction=IN, server-argument-impl-policy=USE-ARGUMENT-TYPE
        arg ErrorCode: type=Dcm_NegativeResponseCodeType_1, direction=OUT, server-argument-impl-policy=USE-ARGUMENT-TYPE
      error DCM_E_PENDING: error-code=10
      error E_NOT_OK: error-code=1
package /ModeDclrGroups
  mode declaration group Mdcl_MBBL_ApplicationResetPermission: category=ALPHABETIC_ORDER, initial-mode=RESET_NOT_PERMITTED
    mode RESET_NOT_PERMITTED: value=0
    mode RESET_PERMITTED: value=1
  mode declaration group Mdcl_MBBL_ApplicationResetRequest: category=ALPHABETIC_ORDER, initial-mode=RESET_NOT_REQUESTED
    mode RESET_NOT_REQUESTED: value=0
    mode RESET_REQUESTED: value=1
