AUTOSAR XML (schema 00049)
package /ActiveEcuC
  module config Gpt: implementation-config-variant=VARIANT-POST-BUILD, module-description=Gpt_Impl
    GptChannelConfigSet
      3 x GptChannelConfiguration, all with GptTimerChannelUsage=GPT_TIMER_CHANNEL_NORMAL, GptEnableWakeup=false, GptChannelClkSrcRef=GptClockReferencePoint:
        GptChannelConfiguration_StbM_LocalTime: GptChannelId=0, GptAssignedHwUnit=GTM, GptChannelMode=GPT_CH_MODE_CONTINUOUS, GptChannelTickFrequency=40000000, GptChannelTickValueMax=16777215
          GtmTimerOutputModuleConfiguration: GtmTimerClockSelect=GTM_CONFIGURABLE_CLOCK_0, GtmTimerUsed=McuGtmAtomChannelAllocationConf_0
        GptChannelConfiguration_T3: GptChannelId=1, GptAssignedHwUnit=GPT12, GptChannelMode=GPT_CH_MODE_ONESHOT, GptChannelTickFrequency=1, GptChannelTickValueMax=65535
          Gpt12TimerOutputModuleConfiguration: Gpt12ChannelClockDivider=0, Gpt12TimerUsed=McuGpt12ModuleAllocationConf_1
        GptChannelConfiguration_T5: GptChannelId=2, GptAssignedHwUnit=GPT12, GptChannelMode=GPT_CH_MODE_ONESHOT, GptChannelTickFrequency=1, GptChannelTickValueMax=65535
          Gpt12TimerOutputModuleConfiguration: Gpt12ChannelClockDivider=7, Gpt12TimerUsed=McuGpt12ModuleAllocationConf_3
    GptConfigurationOfOptApiServices:
      GptDeinitApi = false
      GptEnableDisableNotificationApi = false
      GptTimeElapsedApi = true
      GptTimeRemainingApi = false
      GptVersionInfoApi = false
      GptWakeupFunctionalityApi = false
    GptDriverConfiguration:
      GptDevErrorDetect = false
      GptMultiCoreErrorDetect = false
      GptRunTimeErrorDetect = false
      GptReportWakeupSource = false
      GptPredefTimer100us32bitEnable = false
      GptPredefTimer1usEnablingGrade = GPT_PREDEF_TIMER_1US_DISABLED
      GptSafetyEnable = false
      GptReadAcrossCores = false
      GptInitCheckApi = false
      GptClockReferencePoint: GptClockReference=McuClockReferencePoint_GTM, GptClockReferenceConfig=McuClockReferencePointConfig
    CommonPublishedInformation:
      ArMajorVersion = 4
      ArMinorVersion = 4
      ArPatchVersion = 0
      SwMajorVersion = 20
      SwMinorVersion = 0
      SwPatchVersion = 1
      ModuleId = 100
      VendorId = 17
      Release = _TRICORE_TC332
