AUTOSAR XML (schema 00049)
package /ActiveEcuC
  module config KeyM: implementation-config-variant=VARIANT-PRE-COMPILE, module-description=KeyM_Impl
    8 x KeyMCertificate, all with KeyMCertAlgorithmType=ECC, KeyMCertFormatType=X509, KeyMCertificateMaxLength=1000, KeyMCertUsePort=true, KeyMCertAlgorithmFamily=EDDSA, KeyMCertificateGetCurrentTimeCalloutFunc=TscAppl_KeyMCertificateGetCurrentTimeCalloutFunc, KeyMCertUpperHierarchicalType=PRESET_ISSUER, KeyMCertAllowUnconfiguredElements=true, KeyMCertAllowFlexibleElementOrder=true, KeyMCertificateSwcInterfaceVersion=KEYM_SWCVER_ASR_4_4_0_A:
      Ssa_TrustModelEcuCert: KeyMCertificateId=2, KeyMCertificateName=TrustModelEcuCert, KeyMCertificateStorage=KEYM_STORAGE_IN_CSM, KeyMCertStartUpHandling=NONE, KeyMCertCsmSignatureVerifyJobRef=KeyM_SigVerify_TrustModelEcu, KeyMCertUpperHierarchicalCertRef=Ssa_TrustModelIntermediateCert, KeyMCertificateCsmKeyTargetRef=CsmKey_Ssa_TrustModelEcuCert_inHSM, KeyMCertCsmSignatureVerifyKeyRef=CsmKey_Ssa_TrustModelEcuPublic_LiveKey
        17 x KeyMCertificateElement, all with KeyMCertificateElementSuppressPort=false:
          ext_authKeyId_005: KeyMCertificateElementHasIteration=false, KeyMCertificateElementId=11, KeyMCertificateElementMaxLength=20, KeyMCertificateElementOfStructure=CertificateExtension, KeyMCertificateElementObjectType=128, KeyMCertificateElementObjectId=2.5.29.35, KeyMCertificateElementOptional=false
          ext_subKeyId_005: KeyMCertificateElementHasIteration=false, KeyMCertificateElementId=10, KeyMCertificateElementMaxLength=20, KeyMCertificateElementOfStructure=CertificateExtension, KeyMCertificateElementObjectType=4, KeyMCertificateElementObjectId=2.5.29.14, KeyMCertificateElementOptional=false
          ext_keyUsage_005: KeyMCertificateElementHasIteration=false, KeyMCertificateElementId=9, KeyMCertificateElementMaxLength=1, KeyMCertificateElementOfStructure=CertificateExtension, KeyMCertificateElementObjectType=3, KeyMCertificateElementObjectId=2.5.29.15, KeyMCertificateElementOptional=true
          ext_pkiRole_006: KeyMCertificateElementHasIteration=false, KeyMCertificateElementId=12, KeyMCertificateElementMaxLength=1, KeyMCertificateElementOfStructure=CertificateExtension, KeyMCertificateElementObjectType=4, KeyMCertificateElementObjectId=1.3.6.1.4.1.2916.3.6.509.5.101, KeyMCertificateElementOptional=true
          Version_005: KeyMCertificateElementHasIteration=false, KeyMCertificateElementId=0, KeyMCertificateElementMaxLength=1, KeyMCertificateElementOfStructure=CertificateVersionNumber, KeyMCertificateElementObjectType=2, KeyMCertificateElementOptional=false
          SerialNo_005: KeyMCertificateElementHasIteration=false, KeyMCertificateElementId=1, KeyMCertificateElementMaxLength=16, KeyMCertificateElementOfStructure=CertificateSerialNumber, KeyMCertificateElementObjectType=2, KeyMCertificateElementOptional=false
          SigAlgoId_005: KeyMCertificateElementHasIteration=false, KeyMCertificateElementId=2, KeyMCertificateElementMaxLength=3, KeyMCertificateElementOfStructure=CertificateSignatureAlgorithmID, KeyMCertificateElementObjectType=6, KeyMCertificateElementObjectId=1.3.101.112, KeyMCertificateElementOptional=false
          validityNotBefore_005: KeyMCertificateElementHasIteration=false, KeyMCertificateElementId=4, KeyMCertificateElementMaxLength=13, KeyMCertificateElementOfStructure=CertificateValidityPeriodNotBefore, KeyMCertificateElementObjectType=23, KeyMCertificateElementOptional=false
          validityNotAfter_005: KeyMCertificateElementHasIteration=false, KeyMCertificateElementId=5, KeyMCertificateElementMaxLength=15, KeyMCertificateElementOfStructure=CertificateValidityPeriodNotAfter, KeyMCertificateElementObjectType=23, KeyMCertificateElementOptional=false
          subject_005: KeyMCertificateElementHasIteration=false, KeyMCertificateElementId=6, KeyMCertificateElementMaxLength=30, KeyMCertificateElementOfStructure=CertificateSubjectName, KeyMCertificateElementObjectType=12, KeyMCertificateElementOptional=false, KeyMCertificateElementObjectId=2.5.4.3
          SubjectPublicKeyInfoAlgo_005: KeyMCertificateElementHasIteration=false, KeyMCertificateElementId=7, KeyMCertificateElementMaxLength=3, KeyMCertificateElementOfStructure=CertificateSubjectPublicKeyInfo_PublicKeyAlgorithm, KeyMCertificateElementObjectType=6, KeyMCertificateElementOptional=false, KeyMCertificateElementObjectId=1.3.101.112
          SubjectPublicKeyInfoKey_005: KeyMCertificateElementHasIteration=false, KeyMCertificateElementId=8, KeyMCertificateElementMaxLength=33, KeyMCertificateElementOfStructure=CertificateSubjectPublicKeyInfo_SubjectPublicKey, KeyMCertificateElementObjectType=3, KeyMCertificateElementOptional=false
          Issuer_005: KeyMCertificateElementHasIteration=false, KeyMCertificateElementId=3, KeyMCertificateElementMaxLength=15, KeyMCertificateElementOfStructure=CertificateIssuerName, KeyMCertificateElementObjectType=12, KeyMCertificateElementOptional=false, KeyMCertificateElementObjectId=2.5.4.3
          signatureAlgorithm_005: KeyMCertificateElementHasIteration=false, KeyMCertificateElementId=15, KeyMCertificateElementMaxLength=3, KeyMCertificateElementOfStructure=CertificateSignatureAlgorithm, KeyMCertificateElementObjectType=6, KeyMCertificateElementObjectId=1.3.101.112, KeyMCertificateElementOptional=false
          signatureValue_005: KeyMCertificateElementHasIteration=false, KeyMCertificateElementId=16, KeyMCertificateElementMaxLength=65, KeyMCertificateElementOfStructure=CertificateSignature, KeyMCertificateElementObjectType=3, KeyMCertificateElementOptional=false
          ext_uniqueECUID_005: KeyMCertificateElementHasIteration=true, KeyMCertificateElementId=13, KeyMCertificateElementMaxLength=170, KeyMCertificateElementOfStructure=CertificateExtension, KeyMCertificateElementOptional=false, KeyMCertificateElementObjectId=1.3.6.1.4.1.2916.3.6.509.5.108, KeyMCertificateElementObjectType=12
          ext_specialEcu_005: KeyMCertificateElementHasIteration=false, KeyMCertificateElementId=14, KeyMCertificateElementMaxLength=1, KeyMCertificateElementOfStructure=CertificateExtension, KeyMCertificateElementObjectType=4, KeyMCertificateElementObjectId=1.3.6.1.4.1.2916.3.6.509.5.109, KeyMCertificateElementOptional=true
      Ssa_TrustModelIntermediateCert: KeyMCertificateId=5, KeyMCertificateName=TrustModelIntermediateCert, KeyMCertificateStorage=KEYM_STORAGE_IN_CSM, KeyMCertStartUpHandling=NONE, KeyMCertCsmSignatureVerifyJobRef=KeyM_SigVerify_TrustModelIntermediate, KeyMCertUpperHierarchicalCertRef=Ssa_TrustModelBackendCert, KeyMCertCsmSignatureVerifyKeyRef=KeyM_SigVerifyKey_TrustModelIntermediate, KeyMCertificateCsmKeyTargetRef=CsmKey_Ssa_TrustModelIntermediateCert_inHSM
        16 x KeyMCertificateElement, all with KeyMCertificateElementHasIteration=false, KeyMCertificateElementSuppressPort=false:
          ext_authKeyId_003: KeyMCertificateElementId=10, KeyMCertificateElementMaxLength=20, KeyMCertificateElementOfStructure=CertificateExtension, KeyMCertificateElementObjectType=128, KeyMCertificateElementObjectId=2.5.29.35, KeyMCertificateElementOptional=false
          ext_subKeyId_003: KeyMCertificateElementId=9, KeyMCertificateElementMaxLength=20, KeyMCertificateElementOfStructure=CertificateExtension, KeyMCertificateElementObjectType=4, KeyMCertificateElementObjectId=2.5.29.14, KeyMCertificateElementOptional=false
          ext_basicConstraints_003: KeyMCertificateElementId=11, KeyMCertificateElementMaxLength=1, KeyMCertificateElementOfStructure=CertificateExtension, KeyMCertificateElementObjectType=2, KeyMCertificateElementObjectId=2.5.29.19, KeyMCertificateElementOptional=false
          ext_keyUsage_003: KeyMCertificateElementId=12, KeyMCertificateElementMaxLength=1, KeyMCertificateElementOfStructure=CertificateExtension, KeyMCertificateElementObjectType=3, KeyMCertificateElementObjectId=2.5.29.15, KeyMCertificateElementOptional=false
          ext_pkiRole_003: KeyMCertificateElementId=13, KeyMCertificateElementMaxLength=1, KeyMCertificateElementOfStructure=CertificateExtension, KeyMCertificateElementObjectType=4, KeyMCertificateElementObjectId=1.3.6.1.4.1.2916.3.6.509.5.101, KeyMCertificateElementOptional=true
          Version_003: KeyMCertificateElementId=0, KeyMCertificateElementMaxLength=1, KeyMCertificateElementOfStructure=CertificateVersionNumber, KeyMCertificateElementObjectType=2, KeyMCertificateElementOptional=false, KeyMCertificateElementVerificationCalloutFunc=Tsc_Appl_CertificateElementVerificationCallout
          SerialNo_003: KeyMCertificateElementId=1, KeyMCertificateElementMaxLength=16, KeyMCertificateElementOfStructure=CertificateSerialNumber, KeyMCertificateElementObjectType=2, KeyMCertificateElementOptional=false, KeyMCertificateElementVerificationCalloutFunc=Tsc_Appl_CertificateElementVerificationCallout
          SigAlgoId_003: KeyMCertificateElementId=2, KeyMCertificateElementMaxLength=3, KeyMCertificateElementOfStructure=CertificateSignatureAlgorithmID, KeyMCertificateElementObjectType=6, KeyMCertificateElementObjectId=1.3.101.112, KeyMCertificateElementOptional=false
          validityNotBefore_003: KeyMCertificateElementId=4, KeyMCertificateElementMaxLength=13, KeyMCertificateElementOfStructure=CertificateValidityPeriodNotBefore, KeyMCertificateElementObjectType=23, KeyMCertificateElementOptional=false
          validityNotAfter_003: KeyMCertificateElementId=5, KeyMCertificateElementMaxLength=15, KeyMCertificateElementOfStructure=CertificateValidityPeriodNotAfter, KeyMCertificateElementObjectType=23, KeyMCertificateElementOptional=false
          subject_003: KeyMCertificateElementId=6, KeyMCertificateElementMaxLength=30, KeyMCertificateElementOfStructure=CertificateSubjectName, KeyMCertificateElementObjectType=12, KeyMCertificateElementOptional=false, KeyMCertificateElementObjectId=2.5.4.3
          SubjectPublicKeyInfoAlgo_003: KeyMCertificateElementId=7, KeyMCertificateElementMaxLength=3, KeyMCertificateElementOfStructure=CertificateSubjectPublicKeyInfo_PublicKeyAlgorithm, KeyMCertificateElementObjectType=6, KeyMCertificateElementOptional=false, KeyMCertificateElementObjectId=1.3.101.112
          SubjectPublicKeyInfoKey_003: KeyMCertificateElementId=8, KeyMCertificateElementMaxLength=33, KeyMCertificateElementOfStructure=CertificateSubjectPublicKeyInfo_SubjectPublicKey, KeyMCertificateElementObjectType=3, KeyMCertificateElementOptional=false
          Issuer_003: KeyMCertificateElementId=3, KeyMCertificateElementMaxLength=15, KeyMCertificateElementOfStructure=CertificateIssuerName, KeyMCertificateElementObjectType=12, KeyMCertificateElementOptional=false, KeyMCertificateElementObjectId=2.5.4.3
          signatureAlgorithm_003: KeyMCertificateElementId=14, KeyMCertificateElementMaxLength=3, KeyMCertificateElementOfStructure=CertificateSignatureAlgorithm, KeyMCertificateElementObjectType=6, KeyMCertificateElementObjectId=1.3.101.112, KeyMCertificateElementOptional=false
          signatureValue_003: KeyMCertificateElementId=15, KeyMCertificateElementMaxLength=65, KeyMCertificateElementOfStructure=CertificateSignature, KeyMCertificateElementObjectType=3, KeyMCertificateElementOptional=false
      Ssa_TrustModelBackendCert: KeyMCertificateId=0, KeyMCertificateName=TrustModelBackendCert, KeyMCertificateStorage=KEYM_STORAGE_IN_CSM, KeyMCertStartUpHandling=NONE, KeyMCertCsmSignatureVerifyJobRef=KeyM_SigVerify_TrustModelBackend, KeyMCertUpperHierarchicalCertRef=Ssa_TrustModelRootCert, KeyMCertCsmSignatureVerifyKeyRef=KeyM_SigVerifyKey_TrustModelBackend, KeyMCertificateCsmKeyTargetRef=CsmKey_Ssa_TrustModelBackendCert_inHSM
        16 x KeyMCertificateElement, all with KeyMCertificateElementHasIteration=false, KeyMCertificateElementSuppressPort=false:
          ext_authKeyId_002: KeyMCertificateElementId=10, KeyMCertificateElementMaxLength=20, KeyMCertificateElementOfStructure=CertificateExtension, KeyMCertificateElementObjectType=128, KeyMCertificateElementObjectId=2.5.29.35, KeyMCertificateElementOptional=false
          ext_subKeyId_002: KeyMCertificateElementId=9, KeyMCertificateElementMaxLength=20, KeyMCertificateElementOfStructure=CertificateExtension, KeyMCertificateElementObjectType=4, KeyMCertificateElementObjectId=2.5.29.14, KeyMCertificateElementOptional=false
          ext_basicConstraints_002: KeyMCertificateElementId=11, KeyMCertificateElementMaxLength=1, KeyMCertificateElementOfStructure=CertificateExtension, KeyMCertificateElementObjectType=2, KeyMCertificateElementObjectId=2.5.29.19, KeyMCertificateElementOptional=false
          ext_keyUsage_002: KeyMCertificateElementId=12, KeyMCertificateElementMaxLength=1, KeyMCertificateElementOfStructure=CertificateExtension, KeyMCertificateElementObjectType=3, KeyMCertificateElementObjectId=2.5.29.15, KeyMCertificateElementOptional=false
          ext_pkiRole_002: KeyMCertificateElementId=13, KeyMCertificateElementMaxLength=1, KeyMCertificateElementOfStructure=CertificateExtension, KeyMCertificateElementObjectType=4, KeyMCertificateElementObjectId=1.3.6.1.4.1.2916.3.6.509.5.101, KeyMCertificateElementOptional=true
          Version_002: KeyMCertificateElementId=0, KeyMCertificateElementMaxLength=1, KeyMCertificateElementOfStructure=CertificateVersionNumber, KeyMCertificateElementObjectType=2, KeyMCertificateElementOptional=false, KeyMCertificateElementVerificationCalloutFunc=Tsc_Appl_CertificateElementVerificationCallout
          SerialNo_002: KeyMCertificateElementId=1, KeyMCertificateElementMaxLength=16, KeyMCertificateElementOfStructure=CertificateSerialNumber, KeyMCertificateElementObjectType=2, KeyMCertificateElementOptional=false, KeyMCertificateElementVerificationCalloutFunc=Tsc_Appl_CertificateElementVerificationCallout
          SigAlgoId_002: KeyMCertificateElementId=2, KeyMCertificateElementMaxLength=3, KeyMCertificateElementOfStructure=CertificateSignatureAlgorithmID, KeyMCertificateElementObjectType=6, KeyMCertificateElementObjectId=1.3.101.112, KeyMCertificateElementOptional=false
          validityNotBefore_002: KeyMCertificateElementId=4, KeyMCertificateElementMaxLength=13, KeyMCertificateElementOfStructure=CertificateValidityPeriodNotBefore, KeyMCertificateElementObjectType=23, KeyMCertificateElementOptional=false
          validityNotAfter_002: KeyMCertificateElementId=5, KeyMCertificateElementMaxLength=15, KeyMCertificateElementOfStructure=CertificateValidityPeriodNotAfter, KeyMCertificateElementObjectType=23, KeyMCertificateElementOptional=false
          subject_002: KeyMCertificateElementId=6, KeyMCertificateElementMaxLength=30, KeyMCertificateElementOfStructure=CertificateSubjectName, KeyMCertificateElementObjectType=12, KeyMCertificateElementOptional=false, KeyMCertificateElementObjectId=2.5.4.3
          SubjectPublicKeyInfoAlgo_002: KeyMCertificateElementId=7, KeyMCertificateElementMaxLength=3, KeyMCertificateElementOfStructure=CertificateSubjectPublicKeyInfo_PublicKeyAlgorithm, KeyMCertificateElementObjectType=6, KeyMCertificateElementOptional=false, KeyMCertificateElementObjectId=1.3.101.112
          SubjectPublicKeyInfoKey_002: KeyMCertificateElementId=8, KeyMCertificateElementMaxLength=33, KeyMCertificateElementOfStructure=CertificateSubjectPublicKeyInfo_SubjectPublicKey, KeyMCertificateElementObjectType=3, KeyMCertificateElementOptional=false
          Issuer_002: KeyMCertificateElementId=3, KeyMCertificateElementMaxLength=15, KeyMCertificateElementOfStructure=CertificateIssuerName, KeyMCertificateElementObjectType=12, KeyMCertificateElementOptional=false, KeyMCertificateElementObjectId=2.5.4.3
          signatureAlgorithm_002: KeyMCertificateElementId=14, KeyMCertificateElementMaxLength=3, KeyMCertificateElementOfStructure=CertificateSignatureAlgorithm, KeyMCertificateElementObjectType=6, KeyMCertificateElementObjectId=1.3.101.112, KeyMCertificateElementOptional=false
          signatureValue_002: KeyMCertificateElementId=15, KeyMCertificateElementMaxLength=65, KeyMCertificateElementOfStructure=CertificateSignature, KeyMCertificateElementObjectType=3, KeyMCertificateElementOptional=false
      Ssa_TrustModelRootCert: KeyMCertificateId=7, KeyMCertificateName=TrustModelRootCert, KeyMCertificateStorage=KEYM_STORAGE_IN_CSM, KeyMCertStartUpHandling=PARSE_AND_VERIFY, KeyMCertCsmSignatureVerifyJobRef=KeyM_SigVerify_TrustModelRoot, KeyMCertUpperHierarchicalCertRef=Ssa_TrustModelRootCert, KeyMCertCsmSignatureVerifyKeyRef=KeyM_SigVerifyKey_TrustModelRoot, KeyMCertificateCsmKeyTargetRef=CsmKey_Ssa_TrustModelRootCert_inHSM
        16 x KeyMCertificateElement, all with KeyMCertificateElementHasIteration=false, KeyMCertificateElementSuppressPort=false:
          ext_authKeyId_009: KeyMCertificateElementId=12, KeyMCertificateElementMaxLength=20, KeyMCertificateElementOfStructure=CertificateExtension, KeyMCertificateElementObjectType=128, KeyMCertificateElementObjectId=2.5.29.35, KeyMCertificateElementOptional=true
          Version: KeyMCertificateElementId=0, KeyMCertificateElementMaxLength=1, KeyMCertificateElementOfStructure=CertificateVersionNumber, KeyMCertificateElementObjectType=2, KeyMCertificateElementOptional=false
          SerialNo: KeyMCertificateElementId=1, KeyMCertificateElementMaxLength=16, KeyMCertificateElementOfStructure=CertificateSerialNumber, KeyMCertificateElementObjectType=2, KeyMCertificateElementOptional=false
          SigAlgoId: KeyMCertificateElementId=2, KeyMCertificateElementMaxLength=3, KeyMCertificateElementOfStructure=CertificateSignatureAlgorithmID, KeyMCertificateElementObjectType=6, KeyMCertificateElementObjectId=1.3.101.112, KeyMCertificateElementOptional=false
          validityNotBefore: KeyMCertificateElementId=4, KeyMCertificateElementMaxLength=13, KeyMCertificateElementOfStructure=CertificateValidityPeriodNotBefore, KeyMCertificateElementObjectType=23, KeyMCertificateElementOptional=false
          validityNotAfter: KeyMCertificateElementId=5, KeyMCertificateElementMaxLength=15, KeyMCertificateElementOfStructure=CertificateValidityPeriodNotAfter, KeyMCertificateElementObjectType=23, KeyMCertificateElementOptional=false
          subject: KeyMCertificateElementId=6, KeyMCertificateElementMaxLength=30, KeyMCertificateElementOfStructure=CertificateSubjectName, KeyMCertificateElementObjectType=12, KeyMCertificateElementOptional=false, KeyMCertificateElementObjectId=2.5.4.3
          SubjectPublicKeyInfoAlgo: KeyMCertificateElementId=7, KeyMCertificateElementMaxLength=3, KeyMCertificateElementOfStructure=CertificateSubjectPublicKeyInfo_PublicKeyAlgorithm, KeyMCertificateElementObjectType=6, KeyMCertificateElementOptional=false, KeyMCertificateElementObjectId=1.3.101.112
          SubjectPublicKeyInfoKey: KeyMCertificateElementId=8, KeyMCertificateElementMaxLength=33, KeyMCertificateElementOfStructure=CertificateSubjectPublicKeyInfo_SubjectPublicKey, KeyMCertificateElementObjectType=3, KeyMCertificateElementOptional=false
          Issuer: KeyMCertificateElementId=3, KeyMCertificateElementMaxLength=15, KeyMCertificateElementOfStructure=CertificateIssuerName, KeyMCertificateElementObjectType=12, KeyMCertificateElementOptional=false, KeyMCertificateElementObjectId=2.5.4.3
          signatureAlgorithm: KeyMCertificateElementId=14, KeyMCertificateElementMaxLength=3, KeyMCertificateElementOfStructure=CertificateSignatureAlgorithm, KeyMCertificateElementObjectType=6, KeyMCertificateElementObjectId=1.3.101.112, KeyMCertificateElementOptional=false
          signatureValue: KeyMCertificateElementId=15, KeyMCertificateElementMaxLength=65, KeyMCertificateElementOfStructure=CertificateSignature, KeyMCertificateElementObjectType=3, KeyMCertificateElementOptional=false
          ext_subKeyId: KeyMCertificateElementId=9, KeyMCertificateElementMaxLength=20, KeyMCertificateElementOfStructure=CertificateExtension, KeyMCertificateElementObjectType=4, KeyMCertificateElementObjectId=2.5.29.14, KeyMCertificateElementOptional=false
          ext_basicConstraints: KeyMCertificateElementId=10, KeyMCertificateElementMaxLength=1, KeyMCertificateElementOfStructure=CertificateExtension, KeyMCertificateElementObjectType=2, KeyMCertificateElementObjectId=2.5.29.19, KeyMCertificateElementOptional=false
          ext_keyUsage: KeyMCertificateElementId=11, KeyMCertificateElementMaxLength=2, KeyMCertificateElementOfStructure=CertificateExtension, KeyMCertificateElementObjectType=3, KeyMCertificateElementObjectId=2.5.29.15, KeyMCertificateElementOptional=false
          ext_pkiRole: KeyMCertificateElementId=13, KeyMCertificateElementMaxLength=1, KeyMCertificateElementOfStructure=CertificateExtension, KeyMCertificateElementObjectType=4, KeyMCertificateElementObjectId=1.3.6.1.4.1.2916.3.6.509.5.101, KeyMCertificateElementOptional=true
        KeyMCertInit
          KeyMCertInitValue_Root (KeyMCertInitValue):
            KeyMCertInitValue = 0x30 0x82 0x01 0x20 0x30 0x81 0xD3 0xA0 0x03 0x02 0x01 0x02 0x02 0x08 0x69 0x43 0x9B 0x49 0x78 0x93 0x6D 0x4B 0x30 0x05 0x06 0x03 0x2B 0x65 0x70 0x30 0x12 0x31 0x10 0x30 0x0E 0x06 0x03 0x55 0x04 0x03 0x0C 0x07 0x45 0x41 0x30 0x30 0x30 0x30 0x31 0x30 0x20 0x17 0x0D 0x32 0x32 0x31 0x30 0x31 0x37 0x30 0x39 0x32 0x37 0x32 0x30 0x5A 0x18 0x0F 0x39 0x39 0x39 0x39 0x31 0x32 0x33 0x31 0x32 0x33 0x35 0x39 0x35 0x39 0x5A 0x30 0x12 0x31 0x10 0x30 0x0E 0x06 0x03 0x55 0x04 0x03 0x0C 0x07 0x45 0x41 0x30 0x30 0x30 0x30 0x31 0x30 0x2A 0x30 0x05 0x06 0x03 0x2B 0x65 0x70 0x03 0x21 0x00 0xE6 0x1F 0xA2 0x53 0x49 0xAF 0x0E 0x89 0xA4 0xFD 0x32 0x43 0x5B 0x21 0x3B 0x1F 0xCA 0x1A 0x02 0x06 0x3B 0x02 0xD5 0x50 0xBC 0x1D 0x1E 0x09 0x18 0xA7 0x2C 0xBA 0xA3 0x45 0x30 0x43 0x30 0x1D 0x06 0x03 0x55 0x1D 0x0E 0x04 0x16 0x04 0x14 0x68 0x35 0x0A 0x9E 0x2C 0xB7 0xE0 0x2A 0x6E 0x46 0xD4 0x29 0xD0 0x5D 0x47 0x84 0xA2 0x56 0x6E 0xF9 0x30 0x12 0x06 0x03 0x55 0x1D 0x13 0x01 0x01 0xFF 0x04 0x08 0x30 0x06 0x01 0x01 0xFF 0x02 0x01 0x02 0x30 0x0E 0x06 0x03 0x55 0x1D 0x0F 0x01 0x01 0xFF 0x04 0x04 0x03 0x02 0x02 0x04 0x30 0x05 0x06 0x03 0x2B 0x65 0x70 0x03 0x41 0x00 0x5A 0x4A 0x9D 0x20 0x50 0x6F 0xBC 0x00 0xF5 0xEB 0x16 0x81 0x9E 0xC1 0x0D 0x59 0x61 0xFD 0x03 0xB6 0xBD 0xC2 0x68 0x23 0x28 0xAE 0x74 0x7D 0x13 0x61 0x19 0x05 0xC8 0x1E 0xFD 0x4B 0xA2 0xF5 0x80 0x90 0x6E 0x74 0x33 0x96 0x43 0xDC 0x37 0x97 0xD7 0xB2 0xAD 0x1B 0x3E 0x14 0x5F 0xAD 0x08 0x51 0x70 0x95 0xF8 0x80 0x0F 0x0C
      Ssa_TrustModelEcuPeerCert: KeyMCertificateId=4, KeyMCertificateName=TrustModelEcuPeerCert, KeyMCertificateStorage=KEYM_STORAGE_IN_RAM, KeyMCertStartUpHandling=NONE, KeyMCertCsmSignatureVerifyJobRef=KeyM_SigVerify_TrustModelEcuPeer, KeyMCertUpperHierarchicalCertRef=Ssa_TrustModelIntermediatePeerCert, KeyMCertCsmSignatureVerifyKeyRef=KeyM_SigVerifyKey_TrustModelEcuPeer
        16 x KeyMCertificateElement, all with KeyMCertificateElementSuppressPort=false:
          ext_authKeyId_006: KeyMCertificateElementHasIteration=false, KeyMCertificateElementId=11, KeyMCertificateElementMaxLength=20, KeyMCertificateElementOfStructure=CertificateExtension, KeyMCertificateElementObjectType=128, KeyMCertificateElementObjectId=2.5.29.35, KeyMCertificateElementOptional=false
          ext_subKeyId_006: KeyMCertificateElementHasIteration=false, KeyMCertificateElementId=10, KeyMCertificateElementMaxLength=20, KeyMCertificateElementOfStructure=CertificateExtension, KeyMCertificateElementObjectType=4, KeyMCertificateElementObjectId=2.5.29.14, KeyMCertificateElementOptional=false
          ext_keyUsage_006: KeyMCertificateElementHasIteration=false, KeyMCertificateElementId=9, KeyMCertificateElementMaxLength=1, KeyMCertificateElementOfStructure=CertificateExtension, KeyMCertificateElementObjectType=3, KeyMCertificateElementObjectId=2.5.29.15, KeyMCertificateElementOptional=true
          Version_006: KeyMCertificateElementHasIteration=false, KeyMCertificateElementId=0, KeyMCertificateElementMaxLength=1, KeyMCertificateElementOfStructure=CertificateVersionNumber, KeyMCertificateElementObjectType=2, KeyMCertificateElementOptional=false
          SerialNo_006: KeyMCertificateElementHasIteration=false, KeyMCertificateElementId=1, KeyMCertificateElementMaxLength=16, KeyMCertificateElementOfStructure=CertificateSerialNumber, KeyMCertificateElementObjectType=2, KeyMCertificateElementOptional=false
          SigAlgoId_006: KeyMCertificateElementHasIteration=false, KeyMCertificateElementId=2, KeyMCertificateElementMaxLength=3, KeyMCertificateElementOfStructure=CertificateSignatureAlgorithmID, KeyMCertificateElementObjectType=6, KeyMCertificateElementObjectId=1.3.101.112, KeyMCertificateElementOptional=false
          validityNotBefore_006: KeyMCertificateElementHasIteration=false, KeyMCertificateElementId=4, KeyMCertificateElementMaxLength=13, KeyMCertificateElementOfStructure=CertificateValidityPeriodNotBefore, KeyMCertificateElementObjectType=23, KeyMCertificateElementOptional=false
          validityNotAfter_006: KeyMCertificateElementHasIteration=false, KeyMCertificateElementId=5, KeyMCertificateElementMaxLength=15, KeyMCertificateElementOfStructure=CertificateValidityPeriodNotAfter, KeyMCertificateElementObjectType=23, KeyMCertificateElementOptional=false
          subject_006: KeyMCertificateElementHasIteration=false, KeyMCertificateElementId=6, KeyMCertificateElementMaxLength=48, KeyMCertificateElementOfStructure=CertificateSubjectName, KeyMCertificateElementObjectType=12, KeyMCertificateElementOptional=false, KeyMCertificateElementObjectId=2.5.4.3
          SubjectPublicKeyInfoAlgo_006: KeyMCertificateElementHasIteration=false, KeyMCertificateElementId=7, KeyMCertificateElementMaxLength=3, KeyMCertificateElementOfStructure=CertificateSubjectPublicKeyInfo_PublicKeyAlgorithm, KeyMCertificateElementObjectType=6, KeyMCertificateElementOptional=false, KeyMCertificateElementObjectId=1.3.101.112
          SubjectPublicKeyInfoKey_006: KeyMCertificateElementHasIteration=false, KeyMCertificateElementId=8, KeyMCertificateElementMaxLength=33, KeyMCertificateElementOfStructure=CertificateSubjectPublicKeyInfo_SubjectPublicKey, KeyMCertificateElementObjectType=3, KeyMCertificateElementOptional=false
          Issuer_006: KeyMCertificateElementHasIteration=false, KeyMCertificateElementId=3, KeyMCertificateElementMaxLength=20, KeyMCertificateElementOfStructure=CertificateIssuerName, KeyMCertificateElementObjectType=12, KeyMCertificateElementOptional=false, KeyMCertificateElementObjectId=2.5.4.3
          signatureAlgorithm_006: KeyMCertificateElementHasIteration=false, KeyMCertificateElementId=14, KeyMCertificateElementMaxLength=3, KeyMCertificateElementOfStructure=CertificateSignatureAlgorithm, KeyMCertificateElementObjectType=6, KeyMCertificateElementObjectId=1.3.101.112, KeyMCertificateElementOptional=false
          signatureValue_006: KeyMCertificateElementHasIteration=false, KeyMCertificateElementId=15, KeyMCertificateElementMaxLength=65, KeyMCertificateElementOfStructure=CertificateSignature, KeyMCertificateElementObjectType=3, KeyMCertificateElementOptional=false
          ext_uniqueECUID_006: KeyMCertificateElementHasIteration=true, KeyMCertificateElementId=13, KeyMCertificateElementMaxLength=12, KeyMCertificateElementOfStructure=CertificateExtension, KeyMCertificateElementOptional=false, KeyMCertificateElementObjectId=1.3.6.1.4.1.2916.3.6.509.5.108, KeyMCertificateElementObjectType=12
          ext_specialEcu_006: KeyMCertificateElementHasIteration=false, KeyMCertificateElementId=12, KeyMCertificateElementMaxLength=1, KeyMCertificateElementOfStructure=CertificateExtension, KeyMCertificateElementObjectType=4, KeyMCertificateElementObjectId=1.3.6.1.4.1.2916.3.6.509.5.109, KeyMCertificateElementOptional=true
      Ssa_TrustModelBackendPeerCert: KeyMCertificateId=1, KeyMCertificateName=TrustModelBackendPeerCert, KeyMCertificateStorage=KEYM_STORAGE_IN_RAM, KeyMCertStartUpHandling=NONE, KeyMCertCsmSignatureVerifyJobRef=KeyM_SigVerify_TrustModelBackendPeer, KeyMCertUpperHierarchicalCertRef=Ssa_TrustModelRootCert, KeyMCertCsmSignatureVerifyKeyRef=KeyM_SigVerifyKey_TrustModelBackendPeer
        16 x KeyMCertificateElement, all with KeyMCertificateElementHasIteration=false, KeyMCertificateElementSuppressPort=false:
          ext_authKeyId_004: KeyMCertificateElementId=10, KeyMCertificateElementMaxLength=20, KeyMCertificateElementOfStructure=CertificateExtension, KeyMCertificateElementObjectType=128, KeyMCertificateElementObjectId=2.5.29.35, KeyMCertificateElementOptional=false
          ext_subKeyId_004: KeyMCertificateElementId=9, KeyMCertificateElementMaxLength=20, KeyMCertificateElementOfStructure=CertificateExtension, KeyMCertificateElementObjectType=4, KeyMCertificateElementObjectId=2.5.29.14, KeyMCertificateElementOptional=false
          ext_basicConstraints_004: KeyMCertificateElementId=11, KeyMCertificateElementMaxLength=1, KeyMCertificateElementOfStructure=CertificateExtension, KeyMCertificateElementObjectType=2, KeyMCertificateElementObjectId=2.5.29.19, KeyMCertificateElementOptional=false
          ext_keyUsage_004: KeyMCertificateElementId=12, KeyMCertificateElementMaxLength=1, KeyMCertificateElementOfStructure=CertificateExtension, KeyMCertificateElementObjectType=3, KeyMCertificateElementObjectId=2.5.29.15, KeyMCertificateElementOptional=false
          ext_pkiRole_004: KeyMCertificateElementId=13, KeyMCertificateElementMaxLength=1, KeyMCertificateElementOfStructure=CertificateExtension, KeyMCertificateElementObjectType=4, KeyMCertificateElementObjectId=1.3.6.1.4.1.2916.3.6.509.5.101, KeyMCertificateElementOptional=true
          Version_004: KeyMCertificateElementId=0, KeyMCertificateElementMaxLength=1, KeyMCertificateElementOfStructure=CertificateVersionNumber, KeyMCertificateElementObjectType=2, KeyMCertificateElementOptional=false, KeyMCertificateElementVerificationCalloutFunc=Tsc_Appl_CertificateElementVerificationCallout
          SerialNo_004: KeyMCertificateElementId=1, KeyMCertificateElementMaxLength=16, KeyMCertificateElementOfStructure=CertificateSerialNumber, KeyMCertificateElementObjectType=2, KeyMCertificateElementOptional=false, KeyMCertificateElementVerificationCalloutFunc=Tsc_Appl_CertificateElementVerificationCallout
          SigAlgoId_004: KeyMCertificateElementId=2, KeyMCertificateElementMaxLength=3, KeyMCertificateElementOfStructure=CertificateSignatureAlgorithmID, KeyMCertificateElementObjectType=6, KeyMCertificateElementObjectId=1.3.101.112, KeyMCertificateElementOptional=false
          validityNotBefore_004: KeyMCertificateElementId=4, KeyMCertificateElementMaxLength=13, KeyMCertificateElementOfStructure=CertificateValidityPeriodNotBefore, KeyMCertificateElementObjectType=23, KeyMCertificateElementOptional=false
          validityNotAfter_004: KeyMCertificateElementId=5, KeyMCertificateElementMaxLength=15, KeyMCertificateElementOfStructure=CertificateValidityPeriodNotAfter, KeyMCertificateElementObjectType=23, KeyMCertificateElementOptional=false
          subject_004: KeyMCertificateElementId=6, KeyMCertificateElementMaxLength=15, KeyMCertificateElementOfStructure=CertificateSubjectName, KeyMCertificateElementObjectType=12, KeyMCertificateElementOptional=false, KeyMCertificateElementObjectId=2.5.4.3
          SubjectPublicKeyInfoAlgo_004: KeyMCertificateElementId=7, KeyMCertificateElementMaxLength=3, KeyMCertificateElementOfStructure=CertificateSubjectPublicKeyInfo_PublicKeyAlgorithm, KeyMCertificateElementObjectType=6, KeyMCertificateElementOptional=false, KeyMCertificateElementObjectId=1.3.101.112
          SubjectPublicKeyInfoKey_004: KeyMCertificateElementId=8, KeyMCertificateElementMaxLength=33, KeyMCertificateElementOfStructure=CertificateSubjectPublicKeyInfo_SubjectPublicKey, KeyMCertificateElementObjectType=3, KeyMCertificateElementOptional=false
          Issuer_004: KeyMCertificateElementId=3, KeyMCertificateElementMaxLength=10, KeyMCertificateElementOfStructure=CertificateIssuerName, KeyMCertificateElementObjectType=12, KeyMCertificateElementOptional=false, KeyMCertificateElementObjectId=2.5.4.3
          signatureAlgorithm_004: KeyMCertificateElementId=14, KeyMCertificateElementMaxLength=3, KeyMCertificateElementOfStructure=CertificateSignatureAlgorithm, KeyMCertificateElementObjectType=6, KeyMCertificateElementObjectId=1.3.101.112, KeyMCertificateElementOptional=false
          signatureValue_004: KeyMCertificateElementId=15, KeyMCertificateElementMaxLength=65, KeyMCertificateElementOfStructure=CertificateSignature, KeyMCertificateElementObjectType=3, KeyMCertificateElementOptional=false
      Ssa_TrustModelIntermediatePeerCert: KeyMCertificateId=6, KeyMCertificateName=TrustModelIntermediatePeerCert, KeyMCertificateStorage=KEYM_STORAGE_IN_RAM, KeyMCertStartUpHandling=NONE, KeyMCertCsmSignatureVerifyJobRef=KeyM_SigVerify_TrustModelIntermediatePeer, KeyMCertUpperHierarchicalCertRef=Ssa_TrustModelBackendPeerCert, KeyMCertCsmSignatureVerifyKeyRef=KeyM_SigVerifyKey_TrustModelIntermediatePeer
        16 x KeyMCertificateElement, all with KeyMCertificateElementHasIteration=false, KeyMCertificateElementSuppressPort=false:
          ext_authKeyId_007: KeyMCertificateElementId=10, KeyMCertificateElementMaxLength=20, KeyMCertificateElementOfStructure=CertificateExtension, KeyMCertificateElementObjectType=128, KeyMCertificateElementObjectId=2.5.29.35, KeyMCertificateElementOptional=false
          ext_subKeyId_007: KeyMCertificateElementId=9, KeyMCertificateElementMaxLength=20, KeyMCertificateElementOfStructure=CertificateExtension, KeyMCertificateElementObjectType=4, KeyMCertificateElementObjectId=2.5.29.14, KeyMCertificateElementOptional=false
          ext_basicConstraints_005: KeyMCertificateElementId=11, KeyMCertificateElementMaxLength=1, KeyMCertificateElementOfStructure=CertificateExtension, KeyMCertificateElementObjectType=2, KeyMCertificateElementObjectId=2.5.29.19, KeyMCertificateElementOptional=false
          ext_keyUsage_007: KeyMCertificateElementId=12, KeyMCertificateElementMaxLength=1, KeyMCertificateElementOfStructure=CertificateExtension, KeyMCertificateElementObjectType=3, KeyMCertificateElementObjectId=2.5.29.15, KeyMCertificateElementOptional=false
          ext_pkiRole_005: KeyMCertificateElementId=13, KeyMCertificateElementMaxLength=1, KeyMCertificateElementOfStructure=CertificateExtension, KeyMCertificateElementObjectType=4, KeyMCertificateElementObjectId=1.3.6.1.4.1.2916.3.6.509.5.101, KeyMCertificateElementOptional=true
          Version_007: KeyMCertificateElementId=0, KeyMCertificateElementMaxLength=1, KeyMCertificateElementOfStructure=CertificateVersionNumber, KeyMCertificateElementObjectType=2, KeyMCertificateElementOptional=false, KeyMCertificateElementVerificationCalloutFunc=Tsc_Appl_CertificateElementVerificationCallout
          SerialNo_007: KeyMCertificateElementId=1, KeyMCertificateElementMaxLength=16, KeyMCertificateElementOfStructure=CertificateSerialNumber, KeyMCertificateElementObjectType=2, KeyMCertificateElementOptional=false, KeyMCertificateElementVerificationCalloutFunc=Tsc_Appl_CertificateElementVerificationCallout
          SigAlgoId_007: KeyMCertificateElementId=2, KeyMCertificateElementMaxLength=3, KeyMCertificateElementOfStructure=CertificateSignatureAlgorithmID, KeyMCertificateElementObjectType=6, KeyMCertificateElementObjectId=1.3.101.112, KeyMCertificateElementOptional=false
          validityNotBefore_007: KeyMCertificateElementId=4, KeyMCertificateElementMaxLength=13, KeyMCertificateElementOfStructure=CertificateValidityPeriodNotBefore, KeyMCertificateElementObjectType=23, KeyMCertificateElementOptional=false
          validityNotAfter_007: KeyMCertificateElementId=5, KeyMCertificateElementMaxLength=15, KeyMCertificateElementOfStructure=CertificateValidityPeriodNotAfter, KeyMCertificateElementObjectType=23, KeyMCertificateElementOptional=false
          subject_007: KeyMCertificateElementId=6, KeyMCertificateElementMaxLength=20, KeyMCertificateElementOfStructure=CertificateSubjectName, KeyMCertificateElementObjectType=12, KeyMCertificateElementOptional=false, KeyMCertificateElementObjectId=2.5.4.3
          SubjectPublicKeyInfoAlgo_007: KeyMCertificateElementId=7, KeyMCertificateElementMaxLength=3, KeyMCertificateElementOfStructure=CertificateSubjectPublicKeyInfo_PublicKeyAlgorithm, KeyMCertificateElementObjectType=6, KeyMCertificateElementOptional=false, KeyMCertificateElementObjectId=1.3.101.112
          SubjectPublicKeyInfoKey_007: KeyMCertificateElementId=8, KeyMCertificateElementMaxLength=33, KeyMCertificateElementOfStructure=CertificateSubjectPublicKeyInfo_SubjectPublicKey, KeyMCertificateElementObjectType=3, KeyMCertificateElementOptional=false
          Issuer_007: KeyMCertificateElementId=3, KeyMCertificateElementMaxLength=15, KeyMCertificateElementOfStructure=CertificateIssuerName, KeyMCertificateElementObjectType=12, KeyMCertificateElementOptional=false, KeyMCertificateElementObjectId=2.5.4.3
          signatureAlgorithm_007: KeyMCertificateElementId=14, KeyMCertificateElementMaxLength=3, KeyMCertificateElementOfStructure=CertificateSignatureAlgorithm, KeyMCertificateElementObjectType=6, KeyMCertificateElementObjectId=1.3.101.112, KeyMCertificateElementOptional=false
          signatureValue_007: KeyMCertificateElementId=15, KeyMCertificateElementMaxLength=65, KeyMCertificateElementOfStructure=CertificateSignature, KeyMCertificateElementObjectType=3, KeyMCertificateElementOptional=false
      Ssa_TrustModelEcuCsr: KeyMCertificateId=3, KeyMCertificateName=TrustModelEcuCsr, KeyMCertificateStorage=KEYM_STORAGE_IN_RAM, KeyMCertStartUpHandling=NONE, KeyMCertCsmSignatureVerifyJobRef=KeyM_SigVerify_TrustModelEcuCsr_with_changeableKeys, KeyMCertCsmSignatureGenerateJobRef=KeyM_SigGenerate_TrustModelEcuCsr_with_changeableKeys, KeyMCertUpperHierarchicalCertRef=Ssa_TrustModelEcuCsr, KeyMCertCsmSignatureVerifyKeyRef=CsmKey_Ssa_TrustModel_Ecu_CsrPublicKey
        21 x KeyMCertificateElement, all with KeyMCertificateElementSuppressPort=false:
          ext_authKeyId_008: KeyMCertificateElementHasIteration=false, KeyMCertificateElementId=10, KeyMCertificateElementMaxLength=1, KeyMCertificateElementOfStructure=CertificateExtension, KeyMCertificateElementObjectType=128, KeyMCertificateElementObjectId=2.5.29.35, KeyMCertificateElementOptional=false
          ext_subKeyId_008: KeyMCertificateElementHasIteration=false, KeyMCertificateElementId=9, KeyMCertificateElementMaxLength=20, KeyMCertificateElementOfStructure=CertificateExtension, KeyMCertificateElementObjectType=4, KeyMCertificateElementObjectId=2.5.29.14, KeyMCertificateElementOptional=false
          ext_keyUsage_008: KeyMCertificateElementHasIteration=false, KeyMCertificateElementId=11, KeyMCertificateElementMaxLength=1, KeyMCertificateElementOfStructure=CertificateExtension, KeyMCertificateElementObjectType=3, KeyMCertificateElementObjectId=2.5.29.15, KeyMCertificateElementOptional=false
          ext_pkiRole_008: KeyMCertificateElementHasIteration=false, KeyMCertificateElementId=16, KeyMCertificateElementMaxLength=1, KeyMCertificateElementOfStructure=CertificateExtension, KeyMCertificateElementObjectType=4, KeyMCertificateElementObjectId=1.3.6.1.4.1.2916.3.6.509.5.101, KeyMCertificateElementOptional=false
          Version_008: KeyMCertificateElementHasIteration=false, KeyMCertificateElementId=0, KeyMCertificateElementMaxLength=1, KeyMCertificateElementOfStructure=CertificateVersionNumber, KeyMCertificateElementObjectType=2, KeyMCertificateElementOptional=false
          SerialNo_008: KeyMCertificateElementHasIteration=false, KeyMCertificateElementId=1, KeyMCertificateElementMaxLength=16, KeyMCertificateElementOfStructure=CertificateSerialNumber, KeyMCertificateElementObjectType=2, KeyMCertificateElementOptional=false
          SigAlgoId_008: KeyMCertificateElementHasIteration=false, KeyMCertificateElementId=2, KeyMCertificateElementMaxLength=1, KeyMCertificateElementOfStructure=CertificateSignatureAlgorithmID, KeyMCertificateElementObjectType=6, KeyMCertificateElementObjectId=1.3.101.112, KeyMCertificateElementOptional=false
          validityNotBefore_008: KeyMCertificateElementHasIteration=false, KeyMCertificateElementId=4, KeyMCertificateElementMaxLength=1, KeyMCertificateElementOfStructure=CertificateValidityPeriodNotBefore, KeyMCertificateElementObjectType=23, KeyMCertificateElementOptional=false
          validityNotAfter_008: KeyMCertificateElementHasIteration=false, KeyMCertificateElementId=5, KeyMCertificateElementMaxLength=1, KeyMCertificateElementOfStructure=CertificateValidityPeriodNotAfter, KeyMCertificateElementObjectType=23, KeyMCertificateElementOptional=false
          subject_008: KeyMCertificateElementHasIteration=false, KeyMCertificateElementId=6, KeyMCertificateElementMaxLength=10, KeyMCertificateElementOfStructure=CertificateSubjectName, KeyMCertificateElementObjectType=12, KeyMCertificateElementOptional=false, KeyMCertificateElementObjectId=2.5.4.3
          SubjectPublicKeyInfoAlgo_008: KeyMCertificateElementHasIteration=false, KeyMCertificateElementId=7, KeyMCertificateElementMaxLength=1, KeyMCertificateElementOfStructure=CertificateSubjectPublicKeyInfo_PublicKeyAlgorithm, KeyMCertificateElementObjectType=6, KeyMCertificateElementOptional=false, KeyMCertificateElementObjectId=1.3.101.112
          SubjectPublicKeyInfoKey_008: KeyMCertificateElementHasIteration=false, KeyMCertificateElementId=8, KeyMCertificateElementMaxLength=33, KeyMCertificateElementOfStructure=CertificateSubjectPublicKeyInfo_SubjectPublicKey, KeyMCertificateElementObjectType=3, KeyMCertificateElementOptional=false
          Issuer_008: KeyMCertificateElementHasIteration=false, KeyMCertificateElementId=3, KeyMCertificateElementMaxLength=10, KeyMCertificateElementOfStructure=CertificateIssuerName, KeyMCertificateElementObjectType=12, KeyMCertificateElementOptional=false, KeyMCertificateElementObjectId=2.5.4.3
          signatureAlgorithm_008: KeyMCertificateElementHasIteration=false, KeyMCertificateElementId=19, KeyMCertificateElementMaxLength=1, KeyMCertificateElementOfStructure=CertificateSignatureAlgorithm, KeyMCertificateElementObjectType=6, KeyMCertificateElementObjectId=1.3.101.112, KeyMCertificateElementOptional=false
          signatureValue_008: KeyMCertificateElementHasIteration=false, KeyMCertificateElementId=20, KeyMCertificateElementMaxLength=65, KeyMCertificateElementOfStructure=CertificateSignature, KeyMCertificateElementObjectType=3, KeyMCertificateElementOptional=false
          ext_uniqueECUID_007: KeyMCertificateElementHasIteration=true, KeyMCertificateElementId=17, KeyMCertificateElementMaxLength=1, KeyMCertificateElementOfStructure=CertificateExtension, KeyMCertificateElementOptional=false, KeyMCertificateElementObjectId=1.3.6.1.4.1.2916.3.6.509.5.108, KeyMCertificateElementObjectType=12
          ext_specialEcu_007: KeyMCertificateElementHasIteration=false, KeyMCertificateElementId=18, KeyMCertificateElementMaxLength=1, KeyMCertificateElementOfStructure=CertificateExtension, KeyMCertificateElementObjectType=4, KeyMCertificateElementObjectId=1.3.6.1.4.1.2916.3.6.509.5.109, KeyMCertificateElementOptional=true
          ext_extKeyUsage_007: KeyMCertificateElementHasIteration=false, KeyMCertificateElementId=12, KeyMCertificateElementMaxLength=1, KeyMCertificateElementOfStructure=CertificateExtension, KeyMCertificateElementObjectType=6, KeyMCertificateElementObjectId=2.5.29.37, KeyMCertificateElementOptional=false
          ext_extKeyUsage_oid1_007: KeyMCertificateElementHasIteration=false, KeyMCertificateElementId=13, KeyMCertificateElementMaxLength=1, KeyMCertificateElementOfStructure=CertificateExtension, KeyMCertificateElementObjectType=6, KeyMCertificateElementObjectId=1.3.6.1.5.5.7.3.1, KeyMCertificateElementOptional=false
          ext_extKeyUsage_oid2_007: KeyMCertificateElementHasIteration=false, KeyMCertificateElementId=14, KeyMCertificateElementMaxLength=1, KeyMCertificateElementOfStructure=CertificateExtension, KeyMCertificateElementObjectType=6, KeyMCertificateElementObjectId=1.3.6.1.5.5.7.3.2, KeyMCertificateElementOptional=false
          ext_extKeyUsage_oid3_007: KeyMCertificateElementHasIteration=false, KeyMCertificateElementId=15, KeyMCertificateElementMaxLength=1, KeyMCertificateElementOfStructure=CertificateExtension, KeyMCertificateElementObjectType=6, KeyMCertificateElementObjectId=1.3.6.1.5.5.7.3.17, KeyMCertificateElementOptional=false
    KeyMGeneral:
      KeyMCertificateManagerEnabled = true
      KeyMCertificateChainMaxDepth = 4
      KeyMCryptoKeyHandlerPrepareEnabled = false
      KeyMCryptoKeyHandlerServiceCertificateEnabled = false
      KeyMCryptoKeyHandlerStartFinalizeEnabled = false
      KeyMCryptoKeyHandlerUpdateEnabled = false
      KeyMCryptoKeyHandlerVerifyEnabled = false
      KeyMCryptoKeyManagerEnabled = false
      KeyMDevErrorDetect = false
      KeyMKeyCertNameMaxLength = 30
      KeyMMainFunctionPeriod = 0.01
      KeyMVersionInfoApi = false
      KeyMNvWriteBlockFctName = NvM_WriteBlock
      KeyMParseMaxNestingLevel = 20
      KeyMCertificateSigningRequestEnabled = true
      KeyMCryptoKeyPrepareFunctionEnabled = false
      KeyMCryptoKeyStartFinalizeFunctionEnabled = false
      KeyMCryptoKeyVerifyAsyncMode = false
      KeyMCryptoKeyVerifyFunctionEnabled = false
      KeyMServiceCertificateFunctionEnabled = true
      KeyMSafeBswChecks = false
      KeyMRemoteHandlingCompatibility = KEYM_VERSION_4_3_0
      KeyMCertificateExtensionValidationEnabled = false
