AUTOSAR XML (schema 00049)
package /ActiveEcuC
  module config Nm: implementation-config-variant=VARIANT-POST-BUILD-SELECTABLE, module-description=Nm_Impl
    NmGlobalConfig
      NmGlobalFeatures:
        NmComControlEnabled = true
        NmComUserDataSupport = true
        NmRemoteSleepIndEnabled = true
        NmUserDataEnabled = false
        NmBusSynchronizationEnabled = false
        NmCarWakeUpRxEnabled = false
        NmCoordinatorSupportEnabled = false
        NmNodeDetectionEnabled = false
        NmNodeIdEnabled = false
        NmPduRxIndicationEnabled = false
        NmRepeatMsgIndEnabled = false
        NmStateChangeIndEnabled = true
        NmMacroLayerEnabled = false
        NmCoordinatorSyncSupport = false
        NmRuntimeMeasurementSupport = true
        NmCoordinatorRequestChannelsInBusSleep = false
        NmCoordinatorPassiveStartUpForwarding = false
        NmCallbacksPrototypeHeader = App_Nm.h
        NmCallbacksPrototypeHeader = Cdd_MBBL_EcuStatHandler.h
        NmStateChangeIndCallback = EcuStatHandler_NmStateChangeInd
      NmGeneration:
        NmOutOfBoundsWriteSanitizer = false
        NmOutOfBoundsReadSanitizer = false
        NmShortSymbols = false
        NmInterfacesForDeactivatedData = false
        NmReferringKeysInComments = false
      NmGlobalProperties: NmDevErrorDetect=false, NmVersionInfoApi=false, NmSafeBswChecks=true, NmCycletimeMainFunction=0.005
      NmGlobalConstants
    RBTM_FL_BODY3_8uqv9blm85ehm0msat385m76v_03d5f5f6 (NmChannelConfig):
      NmChannelSleepMaster = false
      NmSynchronizingNetwork = false
      NmChannelId = 0
      NmStateReportEnabled = false
      NmPassiveModeEnabled = false
      NmComMChannelRef = RBTM_FL_BODY3_8uqv9blm85ehm0msat385m76v_03d5f5f6
      variation-point = post-build-variant-condition{matching-criterion=SideAllocation, value=0}
      BODY3_8b033453 (NmBusType)
        NmStandardBusNmConfig: NmStandardBusType=NM_BUSNM_CANNM  # BODY3
    RBTM_FR_BODY3_4xwwtd59665s787n6ctawh7k8_23a94727 (NmChannelConfig):
      NmChannelSleepMaster = false
      NmSynchronizingNetwork = false
      NmChannelId = 1
      NmStateReportEnabled = false
      NmPassiveModeEnabled = false
      NmComMChannelRef = RBTM_FR_BODY3_4xwwtd59665s787n6ctawh7k8_23a94727
      variation-point = post-build-variant-condition{matching-criterion=SideAllocation, value=1}
      BODY3_8b033453 (NmBusType)
        NmStandardBusNmConfig: NmStandardBusType=NM_BUSNM_CANNM  # BODY3
