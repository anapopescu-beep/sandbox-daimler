AUTOSAR XML (schema 00049)
package /Wdg
  module config Wdg: implementation-config-variant=VARIANT-POST-BUILD, module-description=Wdg_Impl
    CommonPublishedInformation:
      ArMajorVersion = 4
      ArMinorVersion = 4
      ArPatchVersion = 0
      ModuleId = 102
      Release = _TRICORE_TC332
      SwMajorVersion = 20
      SwMinorVersion = 0
      SwPatchVersion = 1
      VendorApiInfix = Scu
      VendorId = 17
    WdgGeneral:
      WdgDevErrorDetect = true
      WdgDisableAllowed = false
      WdgIndex = 0
      WdgInitApiMode = WDG_MCAL_SUPERVISOR
      WdgInitCheckApi = false
      WdgInitialTimeout = 5
      WdgMaxTimeout = 32
      WdgRunArea = ROM
      WdgRuntimeApiMode = WDG_MCAL_SUPERVISOR
      WdgSafetyEnable = false
      WdgTriggerLocation = NULL_PTR
      WdgTriggerTimerSelection = STM_TIMER
      WdgVersionInfoApi = false
    WdgPublishedInformation: WdgTriggerMode=WDG_WINDOW
    WdgSettingsConfig_0 (WdgSettingsConfig):
      WdgCPUDisableAllowed = true
      WdgCPUInitialPassword = 60
      WdgCPUInitialTimeout = 5
      WdgCPUMaxTimeout = 32
      WdgCoreId = 0
      WdgDefaultMode = WDGIF_OFF_MODE
      WdgSystemClockRef = McuClockReferencePointConfig
      WdgSettingsFast: WdgFastModeTimeoutValue=0.01
      WdgSettingsOff
      WdgSettingsSlow: WdgSlowModeTimeoutValue=0.02
      WdgTriggerTimerSetting: WdgFastRefreshTime=0.007, WdgSlowRefreshTime=0.015
