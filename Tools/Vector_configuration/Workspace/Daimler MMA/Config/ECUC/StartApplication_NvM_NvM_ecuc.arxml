AUTOSAR XML (schema 00049)
package /ActiveEcuC
  module config NvM: implementation-config-variant=VARIANT-PRE-COMPILE, module-description=NvM_Impl
    Cp_MBBL_SsaAppl_CodingNvBlockNeed_CodingData (NvMBlockDescriptor):
      NvMBlockCrcType = NVM_CRC16
      NvMBlockManagementType = NVM_BLOCK_NATIVE
      NvMInitBlockCallback = NULL_PTR
      NvMResistantToChangedSw = true
      NvMSelectBlockForReadAll = false
      NvMSelectBlockForWriteAll = false
      NvMWriteRamBlockToNvCallback = NULL_PTR
      NvMUseInitCallback = false
      NvMUseJobendCallback = false
      NvMSingleBlockCallback = NULL_PTR
      NvMBswMBlockStatusInformation = false
      NvMBlockUseCrc = false
      NvMBlockUseSyncMechanism = false
      NvMCalcRamBlockCrc = false
      NvMBlockJobPriority = 127
      NvMBlockWriteProt = false
      NvMNvBlockLength = 12
      NvMNvBlockNum = 1
      NvMNvramBlockIdentifier = 2
      NvMWriteBlockOnce = false
      NvMUseServicePorts = false
      NvMBlockUseCRCCompMechanism = false
      NvMBlockUseSetRamBlockStatus = true
      NvMInvokeCallbacksForReadAll = true
      NvMInvokeCallbacksForWriteAll = true
      NvMCheckLossOfRedundancy = false
      NvMReadRamBlockFromNvCallback = NULL_PTR
      NvMRamBlockDataAddress = Rte_Ct_MBBL_SsaAppl_Coding_PIM_CodingData
      NvMTargetBlockReference
        NvMFeeRef: NvMNameOfFeeBlock=FeeCp_MBBL_SsaAppl_CodingNvBlockNeed_CodingData
    NvMCommon:
      NvMSafeBswChecks = true
      NvMDevErrorDetect = false
      NvMVersionInfoApi = true
      NvMApiConfigClass = NVM_API_CONFIG_CLASS_3
      NvMBswMMultiBlockJobStatusInformation = true
      NvMCompiledConfigId = 1
      NvMCrcNumOfBytes = 64
      NvMDatasetSelectionBits = 2
      NvMDrvModeSwitch = true
      NvMDynamicConfiguration = false
      NvMJobPrioritization = false
      NvMPollingMode = true
      NvMSetRamBlockStatusApi = true
      NvMSizeStandardJobQueue = 32
      NvMMaxNoOfWriteRetries = 2
      NvMMainFunctionPeriod = 0.01
      NvMUseBlockIdCheck = false
      NvMRepairRedundantBlocksApi = true
      NvMDetectedLossOfRedundancyCallback = NULL_PTR
    NvMConfigBlock (NvMBlockDescriptor):
      NvMUseJobendCallback = false
      NvMBlockUseCrc = true
      NvMBlockCrcType = NVM_CRC16
      NvMNvramBlockIdentifier = 1
      NvMBlockManagementType = NVM_BLOCK_REDUNDANT
      NvMNvBlockNum = 2
      NvMNvBlockLength = 2
      NvMSelectBlockForReadAll = true
      NvMResistantToChangedSw = true
      NvMUseInitCallback = false
      NvMSelectBlockForWriteAll = true
      NvMCalcRamBlockCrc = false
      NvMRomBlockDataAddress = NULL_PTR
      NvMBlockPostReadTransformCallback = NULL_PTR
      NvMBlockPreWriteTransformCallback = NULL_PTR
      NvMBlockUseSetRamBlockStatus = true
      NvMBlockJobPriority = 127
      NvMBlockUseSyncMechanism = false
      NvMBlockWriteProt = false
      NvMBswMBlockStatusInformation = false
      NvMWriteBlockOnce = false
      NvMUseServicePorts = false
      NvMBlockUseCRCCompMechanism = false
      NvMInvokeCallbacksForReadAll = true
      NvMInvokeCallbacksForWriteAll = true
      NvMCheckLossOfRedundancy = false
      NvMTargetBlockReference
        NvMFeeRef: NvMNameOfFeeBlock=FeeBlockConfiguration
    NvMCommonVendorParams:
      NvMKillWriteAllApi = true
      NvMCfgCbkIncludeList = Crypto_30_LibCv.h
      NvMCfgCbkIncludeList = Nvp_Generated.h
      NvMDataIntegrityIntBuffer = true
      NvMCfgCbkIncludeList = DiagFunction_Public.h
      NvMCfgCbkIncludeList = Dem_Cbk.h
      NvMCfgCbkIncludeList = Rtm.h
      NvMPreReadAllApi = false
      NvMJobForwardingToMemoryCore = false
    100 x NvMBlockDescriptor, all with NvMUseInitCallback=false, NvMBswMBlockStatusInformation=false, NvMBlockUseSyncMechanism=false, NvMBlockWriteProt=false, NvMWriteBlockOnce=false, NvMBlockUseCRCCompMechanism=false, NvMInvokeCallbacksForReadAll=true, NvMInvokeCallbacksForWriteAll=true, NvMCheckLossOfRedundancy=false:
      Ssa_CodingNvM_Coding_CodingVIN: NvMBlockCrcType=NVM_CRC16, NvMBlockManagementType=NVM_BLOCK_NATIVE, NvMInitBlockCallback=NULL_PTR, NvMResistantToChangedSw=true, NvMSelectBlockForReadAll=true, NvMSelectBlockForWriteAll=false, NvMWriteRamBlockToNvCallback=NULL_PTR, NvMUseJobendCallback=false, NvMSingleBlockCallback=NULL_PTR, NvMBlockUseCrc=true, NvMCalcRamBlockCrc=false, NvMBlockJobPriority=127, NvMNvBlockLength=18, NvMNvBlockNum=1, NvMNvramBlockIdentifier=3, NvMUseServicePorts=true, NvMBlockUseSetRamBlockStatus=true, NvMRamBlockDataAddress=Rte_Ssa_Coding_CodingVIN, NvMRomBlockDataAddress=Rte_Ssa_Coding_Coding_Storage_DefaultValue  # UC:Derived from NvBlockNeeds
        NvMTargetBlockReference
          NvMFeeRef: NvMNameOfFeeBlock=FeeSsa_CodingNvM_Coding_CodingVIN
      Ssa_CodingNvM_Coding_CurrentVIN: NvMBlockCrcType=NVM_CRC16, NvMBlockManagementType=NVM_BLOCK_NATIVE, NvMInitBlockCallback=NULL_PTR, NvMResistantToChangedSw=true, NvMSelectBlockForReadAll=true, NvMSelectBlockForWriteAll=false, NvMWriteRamBlockToNvCallback=NULL_PTR, NvMUseJobendCallback=false, NvMSingleBlockCallback=NULL_PTR, NvMBlockUseCrc=true, NvMCalcRamBlockCrc=false, NvMBlockJobPriority=127, NvMNvBlockLength=18, NvMNvBlockNum=1, NvMNvramBlockIdentifier=4, NvMUseServicePorts=true, NvMBlockUseSetRamBlockStatus=true, NvMRamBlockDataAddress=Rte_Ssa_Coding_CurrentVIN, NvMRomBlockDataAddress=Rte_Ssa_Coding_Coding_Storage_DefaultValue  # UC:Derived from NvBlockNeeds
        NvMTargetBlockReference
          NvMFeeRef: NvMNameOfFeeBlock=FeeSsa_CodingNvM_Coding_CurrentVIN
      Ssa_RightsM_NvM_RightsM_AclVersion: NvMBlockCrcType=NVM_CRC16, NvMBlockManagementType=NVM_BLOCK_NATIVE, NvMInitBlockCallback=NULL_PTR, NvMResistantToChangedSw=true, NvMSelectBlockForReadAll=true, NvMSelectBlockForWriteAll=false, NvMWriteRamBlockToNvCallback=NULL_PTR, NvMUseJobendCallback=false, NvMSingleBlockCallback=NULL_PTR, NvMBlockUseCrc=true, NvMCalcRamBlockCrc=false, NvMBlockJobPriority=127, NvMNvBlockLength=11, NvMNvBlockNum=1, NvMNvramBlockIdentifier=5, NvMUseServicePorts=true, NvMBlockUseSetRamBlockStatus=true, NvMRamBlockDataAddress=Rte_Ssa_RightsM_RightsMAclVersion, NvMRomBlockDataAddress=Rte_Ssa_RightsM_NvM_RightsM_AclVersion_DefaultValue  # UC:Derived from NvBlockNeeds
        NvMTargetBlockReference
          NvMFeeRef: NvMNameOfFeeBlock=FeeSsa_RightsM_NvM_RightsM_AclVersion
      Ssa_RightsM_NvM_RightsM_Nonce: NvMBlockCrcType=NVM_CRC16, NvMBlockManagementType=NVM_BLOCK_NATIVE, NvMInitBlockCallback=NULL_PTR, NvMResistantToChangedSw=true, NvMSelectBlockForReadAll=true, NvMSelectBlockForWriteAll=false, NvMWriteRamBlockToNvCallback=NULL_PTR, NvMUseJobendCallback=false, NvMSingleBlockCallback=NULL_PTR, NvMBlockUseCrc=true, NvMCalcRamBlockCrc=false, NvMBlockJobPriority=127, NvMNvBlockLength=48, NvMNvBlockNum=1, NvMNvramBlockIdentifier=6, NvMUseServicePorts=true, NvMBlockUseSetRamBlockStatus=true, NvMRamBlockDataAddress=Rte_Ssa_RightsM_RightsMNonce, NvMRomBlockDataAddress=Rte_Ssa_RightsM_NvM_RightsM_Nonce_DefaultValue  # UC:Derived from NvBlockNeeds
        NvMTargetBlockReference
          NvMFeeRef: NvMNameOfFeeBlock=FeeSsa_RightsM_NvM_RightsM_Nonce
      Ssa_RightsM_NvM_RightsM_PostProductionStatus: NvMBlockCrcType=NVM_CRC16, NvMBlockManagementType=NVM_BLOCK_NATIVE, NvMInitBlockCallback=NULL_PTR, NvMResistantToChangedSw=true, NvMSelectBlockForReadAll=true, NvMSelectBlockForWriteAll=false, NvMWriteRamBlockToNvCallback=NULL_PTR, NvMUseJobendCallback=false, NvMSingleBlockCallback=NULL_PTR, NvMBlockUseCrc=false, NvMCalcRamBlockCrc=false, NvMBlockJobPriority=127, NvMNvBlockNum=1, NvMNvramBlockIdentifier=7, NvMUseServicePorts=true, NvMBlockUseSetRamBlockStatus=true, NvMRamBlockDataAddress=Rte_Ssa_RightsM_RightsMPostProductionStatus, NvMRomBlockDataAddress=Rte_Ssa_RightsM_NvM_RightsM_PostProductionStatus_DefaultValue, NvMNvBlockLength=1  # UC:Derived from NvBlockNeeds
        NvMTargetBlockReference
          NvMFeeRef: NvMNameOfFeeBlock=FeeSsa_RightsM_NvM_RigthsM_CentralAuthStatusProduction
      Ssa_SecLogNvM_SecLog_LogDataEvnt10_FailedPduMacVerif: NvMBlockCrcType=NVM_CRC16, NvMBlockManagementType=NVM_BLOCK_NATIVE, NvMInitBlockCallback=NULL_PTR, NvMResistantToChangedSw=true, NvMSelectBlockForReadAll=true, NvMSelectBlockForWriteAll=true, NvMWriteRamBlockToNvCallback=NULL_PTR, NvMUseJobendCallback=false, NvMSingleBlockCallback=NULL_PTR, NvMBlockUseCrc=true, NvMCalcRamBlockCrc=false, NvMBlockJobPriority=127, NvMNvBlockLength=128, NvMNvBlockNum=1, NvMNvramBlockIdentifier=8, NvMUseServicePorts=true, NvMBlockUseSetRamBlockStatus=true, NvMRamBlockDataAddress=Rte_Ssa_SecLog_LogDataEvnt10_FailedPduMacVerif, NvMRomBlockDataAddress=NULL_PTR  # UC:Derived from NvBlockNeeds
        NvMTargetBlockReference
          NvMFeeRef: NvMNameOfFeeBlock=FeeSsa_SecLogNvM_SecLog_LogDataEvnt10_FailedPduMacVerif
      Ssa_SecLogNvM_SecLog_LogDataEvnt11_SecOrAuthBoot: NvMBlockCrcType=NVM_CRC16, NvMBlockManagementType=NVM_BLOCK_NATIVE, NvMInitBlockCallback=NULL_PTR, NvMResistantToChangedSw=true, NvMSelectBlockForReadAll=true, NvMSelectBlockForWriteAll=true, NvMWriteRamBlockToNvCallback=NULL_PTR, NvMUseJobendCallback=false, NvMSingleBlockCallback=NULL_PTR, NvMBlockUseCrc=true, NvMCalcRamBlockCrc=false, NvMBlockJobPriority=127, NvMNvBlockLength=59, NvMNvBlockNum=1, NvMNvramBlockIdentifier=9, NvMUseServicePorts=true, NvMBlockUseSetRamBlockStatus=true, NvMRamBlockDataAddress=Rte_Ssa_SecLog_LogDataEvnt11_SecOrAuthBoot, NvMRomBlockDataAddress=NULL_PTR  # UC:Derived from NvBlockNeeds
        NvMTargetBlockReference
          NvMFeeRef: NvMNameOfFeeBlock=FeeSsa_SecLogNvM_SecLog_LogDataEvnt11_SecOrAuthBoot
      Ssa_SecLogNvM_SecLog_LogDataEvnt12_ChangeOfVin: NvMBlockCrcType=NVM_CRC16, NvMBlockManagementType=NVM_BLOCK_NATIVE, NvMInitBlockCallback=NULL_PTR, NvMResistantToChangedSw=true, NvMSelectBlockForReadAll=true, NvMSelectBlockForWriteAll=true, NvMWriteRamBlockToNvCallback=NULL_PTR, NvMUseJobendCallback=false, NvMSingleBlockCallback=NULL_PTR, NvMBlockUseCrc=true, NvMCalcRamBlockCrc=false, NvMBlockJobPriority=127, NvMNvBlockLength=76, NvMNvBlockNum=1, NvMNvramBlockIdentifier=10, NvMUseServicePorts=true, NvMBlockUseSetRamBlockStatus=true, NvMRamBlockDataAddress=Rte_Ssa_SecLog_LogDataEvnt12_ChangeOfVin, NvMRomBlockDataAddress=NULL_PTR  # UC:Derived from NvBlockNeeds
        NvMTargetBlockReference
          NvMFeeRef: NvMNameOfFeeBlock=FeeSsa_SecLogNvM_SecLog_LogDataEvnt12_ChangeOfVin
      Ssa_SecLogNvM_SecLog_LogDataEvnt13_AclReplacement: NvMBlockCrcType=NVM_CRC16, NvMBlockManagementType=NVM_BLOCK_NATIVE, NvMInitBlockCallback=NULL_PTR, NvMResistantToChangedSw=true, NvMSelectBlockForReadAll=true, NvMSelectBlockForWriteAll=true, NvMWriteRamBlockToNvCallback=NULL_PTR, NvMUseJobendCallback=false, NvMSingleBlockCallback=NULL_PTR, NvMBlockUseCrc=true, NvMCalcRamBlockCrc=false, NvMBlockJobPriority=127, NvMNvBlockLength=95, NvMNvBlockNum=1, NvMNvramBlockIdentifier=11, NvMUseServicePorts=true, NvMBlockUseSetRamBlockStatus=true, NvMRamBlockDataAddress=Rte_Ssa_SecLog_LogDataEvnt13_AclReplacement, NvMRomBlockDataAddress=NULL_PTR  # UC:Derived from NvBlockNeeds
        NvMTargetBlockReference
          NvMFeeRef: NvMNameOfFeeBlock=FeeSsa_SecLogNvM_SecLog_LogDataEvnt13_AclReplacement
      Ssa_SecLogNvM_SecLog_LogDataEvnt1_FailedCertVerif: NvMBlockCrcType=NVM_CRC16, NvMBlockManagementType=NVM_BLOCK_NATIVE, NvMInitBlockCallback=NULL_PTR, NvMResistantToChangedSw=true, NvMSelectBlockForReadAll=true, NvMSelectBlockForWriteAll=true, NvMWriteRamBlockToNvCallback=NULL_PTR, NvMUseJobendCallback=false, NvMSingleBlockCallback=NULL_PTR, NvMBlockUseCrc=true, NvMCalcRamBlockCrc=false, NvMBlockJobPriority=127, NvMNvBlockLength=176, NvMNvBlockNum=1, NvMNvramBlockIdentifier=12, NvMUseServicePorts=true, NvMBlockUseSetRamBlockStatus=true, NvMRamBlockDataAddress=Rte_Ssa_SecLog_LogDataEvnt1_FailedCertVerif, NvMRomBlockDataAddress=NULL_PTR  # UC:Derived from NvBlockNeeds
        NvMTargetBlockReference
          NvMFeeRef: NvMNameOfFeeBlock=FeeSsa_SecLogNvM_SecLog_LogDataEvnt1_FailedCertVerif
      Ssa_SecLogNvM_SecLog_LogDataEvnt2_SucCertVerif: NvMBlockCrcType=NVM_CRC16, NvMBlockManagementType=NVM_BLOCK_NATIVE, NvMInitBlockCallback=NULL_PTR, NvMResistantToChangedSw=true, NvMSelectBlockForReadAll=true, NvMSelectBlockForWriteAll=true, NvMWriteRamBlockToNvCallback=NULL_PTR, NvMUseJobendCallback=false, NvMSingleBlockCallback=NULL_PTR, NvMBlockUseCrc=true, NvMCalcRamBlockCrc=false, NvMBlockJobPriority=127, NvMNvBlockLength=244, NvMNvBlockNum=1, NvMNvramBlockIdentifier=13, NvMUseServicePorts=true, NvMBlockUseSetRamBlockStatus=true, NvMRamBlockDataAddress=Rte_Ssa_SecLog_LogDataEvnt2_SucCertVerif, NvMRomBlockDataAddress=NULL_PTR  # UC:Derived from NvBlockNeeds
        NvMTargetBlockReference
          NvMFeeRef: NvMNameOfFeeBlock=FeeSsa_SecLogNvM_SecLog_LogDataEvnt2_SucCertVerif
      Ssa_SecLogNvM_SecLog_LogDataEvnt3_SucAuthAndEnhanceRights: NvMBlockCrcType=NVM_CRC16, NvMBlockManagementType=NVM_BLOCK_NATIVE, NvMInitBlockCallback=NULL_PTR, NvMResistantToChangedSw=true, NvMSelectBlockForReadAll=true, NvMSelectBlockForWriteAll=true, NvMWriteRamBlockToNvCallback=NULL_PTR, NvMUseJobendCallback=false, NvMSingleBlockCallback=NULL_PTR, NvMBlockUseCrc=true, NvMCalcRamBlockCrc=false, NvMBlockJobPriority=127, NvMNvBlockLength=391, NvMNvBlockNum=1, NvMNvramBlockIdentifier=14, NvMUseServicePorts=true, NvMBlockUseSetRamBlockStatus=true, NvMRamBlockDataAddress=Rte_Ssa_SecLog_LogDataEvnt3_SucAuthAndEnhanceRights, NvMRomBlockDataAddress=NULL_PTR  # UC:Derived from NvBlockNeeds
        NvMTargetBlockReference
          NvMFeeRef: NvMNameOfFeeBlock=FeeSsa_SecLogNvM_SecLog_LogDataEvnt3_SucAuthAndEnhanceRights
      Ssa_SecLogNvM_SecLog_LogDataEvnt4_AuthBySecAccess: NvMBlockCrcType=NVM_CRC16, NvMBlockManagementType=NVM_BLOCK_NATIVE, NvMInitBlockCallback=NULL_PTR, NvMResistantToChangedSw=true, NvMSelectBlockForReadAll=true, NvMSelectBlockForWriteAll=true, NvMWriteRamBlockToNvCallback=NULL_PTR, NvMUseJobendCallback=false, NvMSingleBlockCallback=NULL_PTR, NvMBlockUseCrc=true, NvMCalcRamBlockCrc=false, NvMBlockJobPriority=127, NvMNvBlockLength=68, NvMNvBlockNum=1, NvMNvramBlockIdentifier=15, NvMUseServicePorts=true, NvMBlockUseSetRamBlockStatus=true, NvMRamBlockDataAddress=Rte_Ssa_SecLog_LogDataEvnt4_AuthBySecAccess, NvMRomBlockDataAddress=NULL_PTR  # UC:Derived from NvBlockNeeds
        NvMTargetBlockReference
          NvMFeeRef: NvMNameOfFeeBlock=FeeSsa_SecLogNvM_SecLog_LogDataEvnt4_AuthBySecAccess
      Ssa_SecLogNvM_SecLog_LogDataEvnt5_SucDiagServiceExec: NvMBlockCrcType=NVM_CRC16, NvMBlockManagementType=NVM_BLOCK_NATIVE, NvMInitBlockCallback=NULL_PTR, NvMResistantToChangedSw=true, NvMSelectBlockForReadAll=true, NvMSelectBlockForWriteAll=true, NvMWriteRamBlockToNvCallback=NULL_PTR, NvMUseJobendCallback=false, NvMSingleBlockCallback=NULL_PTR, NvMBlockUseCrc=true, NvMCalcRamBlockCrc=false, NvMBlockJobPriority=127, NvMNvBlockLength=138, NvMNvBlockNum=1, NvMNvramBlockIdentifier=16, NvMUseServicePorts=true, NvMBlockUseSetRamBlockStatus=true, NvMRamBlockDataAddress=Rte_Ssa_SecLog_LogDataEvnt5_SucDiagServiceExec, NvMRomBlockDataAddress=NULL_PTR  # UC:Derived from NvBlockNeeds
        NvMTargetBlockReference
          NvMFeeRef: NvMNameOfFeeBlock=FeeSsa_SecLogNvM_SecLog_LogDataEvnt5_SucDiagServiceExec
      Ssa_SecLogNvM_SecLog_LogDataEvnt6_RightsMgmt: NvMBlockCrcType=NVM_CRC16, NvMBlockManagementType=NVM_BLOCK_NATIVE, NvMInitBlockCallback=NULL_PTR, NvMResistantToChangedSw=true, NvMSelectBlockForReadAll=true, NvMSelectBlockForWriteAll=true, NvMWriteRamBlockToNvCallback=NULL_PTR, NvMUseJobendCallback=false, NvMSingleBlockCallback=NULL_PTR, NvMBlockUseCrc=true, NvMCalcRamBlockCrc=false, NvMBlockJobPriority=127, NvMNvBlockLength=216, NvMNvBlockNum=1, NvMNvramBlockIdentifier=17, NvMUseServicePorts=true, NvMBlockUseSetRamBlockStatus=true, NvMRamBlockDataAddress=Rte_Ssa_SecLog_LogDataEvnt6_RightsMgmt, NvMRomBlockDataAddress=NULL_PTR  # UC:Derived from NvBlockNeeds
        NvMTargetBlockReference
          NvMFeeRef: NvMNameOfFeeBlock=FeeSsa_SecLogNvM_SecLog_LogDataEvnt6_RightsMgmt
      Ssa_SecLogNvM_SecLog_LogDataEvnt7_SigVerif: NvMBlockCrcType=NVM_CRC16, NvMBlockManagementType=NVM_BLOCK_NATIVE, NvMInitBlockCallback=NULL_PTR, NvMResistantToChangedSw=true, NvMSelectBlockForReadAll=true, NvMSelectBlockForWriteAll=true, NvMWriteRamBlockToNvCallback=NULL_PTR, NvMUseJobendCallback=false, NvMSingleBlockCallback=NULL_PTR, NvMBlockUseCrc=true, NvMCalcRamBlockCrc=false, NvMBlockJobPriority=127, NvMNvBlockLength=94, NvMNvBlockNum=1, NvMNvramBlockIdentifier=18, NvMUseServicePorts=true, NvMBlockUseSetRamBlockStatus=true, NvMRamBlockDataAddress=Rte_Ssa_SecLog_LogDataEvnt7_SigVerif, NvMRomBlockDataAddress=NULL_PTR  # UC:Derived from NvBlockNeeds
        NvMTargetBlockReference
          NvMFeeRef: NvMNameOfFeeBlock=FeeSsa_SecLogNvM_SecLog_LogDataEvnt7_SigVerif
      Ssa_SecLogNvM_SecLog_LogDataEvnt8_TickCountDateAndTime: NvMBlockCrcType=NVM_CRC16, NvMBlockManagementType=NVM_BLOCK_NATIVE, NvMInitBlockCallback=NULL_PTR, NvMResistantToChangedSw=true, NvMSelectBlockForReadAll=true, NvMSelectBlockForWriteAll=true, NvMWriteRamBlockToNvCallback=NULL_PTR, NvMUseJobendCallback=false, NvMSingleBlockCallback=NULL_PTR, NvMBlockUseCrc=true, NvMCalcRamBlockCrc=false, NvMBlockJobPriority=127, NvMNvBlockLength=232, NvMNvBlockNum=1, NvMNvramBlockIdentifier=19, NvMUseServicePorts=true, NvMBlockUseSetRamBlockStatus=true, NvMRamBlockDataAddress=Rte_Ssa_SecLog_LogDataEvnt8_TickCountDateAndTime, NvMRomBlockDataAddress=NULL_PTR  # UC:Derived from NvBlockNeeds
        NvMTargetBlockReference
          NvMFeeRef: NvMNameOfFeeBlock=FeeSsa_SecLogNvM_SecLog_LogDataEvnt8_TickCountDateAndTime
      Ssa_SecLogNvM_SecLog_LogDataEvnt9_SecOcMisconfig: NvMBlockCrcType=NVM_CRC16, NvMBlockManagementType=NVM_BLOCK_NATIVE, NvMInitBlockCallback=NULL_PTR, NvMResistantToChangedSw=true, NvMSelectBlockForReadAll=true, NvMSelectBlockForWriteAll=true, NvMWriteRamBlockToNvCallback=NULL_PTR, NvMUseJobendCallback=false, NvMSingleBlockCallback=NULL_PTR, NvMBlockUseCrc=true, NvMCalcRamBlockCrc=false, NvMBlockJobPriority=127, NvMNvBlockLength=62, NvMNvBlockNum=1, NvMNvramBlockIdentifier=20, NvMUseServicePorts=true, NvMBlockUseSetRamBlockStatus=true, NvMRamBlockDataAddress=Rte_Ssa_SecLog_LogDataEvnt9_SecOcMisconfig, NvMRomBlockDataAddress=NULL_PTR  # UC:Derived from NvBlockNeeds
        NvMTargetBlockReference
          NvMFeeRef: NvMNameOfFeeBlock=FeeSsa_SecLogNvM_SecLog_LogDataEvnt9_SecOcMisconfig
      Ssa_SecLogNvM_SecLog_LogFailedMacVerifCount_ExceededTh1: NvMBlockCrcType=NVM_CRC16, NvMBlockManagementType=NVM_BLOCK_NATIVE, NvMInitBlockCallback=NULL_PTR, NvMResistantToChangedSw=true, NvMSelectBlockForReadAll=true, NvMSelectBlockForWriteAll=true, NvMWriteRamBlockToNvCallback=NULL_PTR, NvMUseJobendCallback=false, NvMSingleBlockCallback=NULL_PTR, NvMBlockUseCrc=true, NvMCalcRamBlockCrc=false, NvMBlockJobPriority=127, NvMNvBlockLength=200, NvMNvBlockNum=1, NvMNvramBlockIdentifier=21, NvMUseServicePorts=true, NvMBlockUseSetRamBlockStatus=true, NvMRamBlockDataAddress=Rte_Ssa_SecLog_LogFailedMacVerifCount_ExceededTh1, NvMRomBlockDataAddress=NULL_PTR  # UC:Derived from NvBlockNeeds
        NvMTargetBlockReference
          NvMFeeRef: NvMNameOfFeeBlock=FeeSsa_SecLogNvM_SecLog_LogFailedMacVerifCount_ExceededTh1
      Ssa_SecLogNvM_SecLog_LogFailedMacVerifCount_ExceededTh2: NvMBlockCrcType=NVM_CRC16, NvMBlockManagementType=NVM_BLOCK_NATIVE, NvMInitBlockCallback=NULL_PTR, NvMResistantToChangedSw=true, NvMSelectBlockForReadAll=true, NvMSelectBlockForWriteAll=true, NvMWriteRamBlockToNvCallback=NULL_PTR, NvMUseJobendCallback=false, NvMSingleBlockCallback=NULL_PTR, NvMBlockUseCrc=true, NvMCalcRamBlockCrc=false, NvMBlockJobPriority=127, NvMNvBlockLength=200, NvMNvBlockNum=1, NvMNvramBlockIdentifier=22, NvMUseServicePorts=true, NvMBlockUseSetRamBlockStatus=true, NvMRamBlockDataAddress=Rte_Ssa_SecLog_LogFailedMacVerifCount_ExceededTh2, NvMRomBlockDataAddress=NULL_PTR  # UC:Derived from NvBlockNeeds
        NvMTargetBlockReference
          NvMFeeRef: NvMNameOfFeeBlock=FeeSsa_SecLogNvM_SecLog_LogFailedMacVerifCount_ExceededTh2
      Ssa_SecLogNvM_SecLog_LogFailedMacVerifCount_ExceededTh3: NvMBlockCrcType=NVM_CRC16, NvMBlockManagementType=NVM_BLOCK_NATIVE, NvMInitBlockCallback=NULL_PTR, NvMResistantToChangedSw=true, NvMSelectBlockForReadAll=true, NvMSelectBlockForWriteAll=true, NvMWriteRamBlockToNvCallback=NULL_PTR, NvMUseJobendCallback=false, NvMSingleBlockCallback=NULL_PTR, NvMBlockUseCrc=true, NvMCalcRamBlockCrc=false, NvMBlockJobPriority=127, NvMNvBlockLength=200, NvMNvBlockNum=1, NvMNvramBlockIdentifier=23, NvMUseServicePorts=true, NvMBlockUseSetRamBlockStatus=true, NvMRamBlockDataAddress=Rte_Ssa_SecLog_LogFailedMacVerifCount_ExceededTh3, NvMRomBlockDataAddress=NULL_PTR  # UC:Derived from NvBlockNeeds
        NvMTargetBlockReference
          NvMFeeRef: NvMNameOfFeeBlock=FeeSsa_SecLogNvM_SecLog_LogFailedMacVerifCount_ExceededTh3
      Ssa_TimeM_NvM_TimeM_RealTimeOffset: NvMBlockCrcType=NVM_CRC16, NvMBlockManagementType=NVM_BLOCK_NATIVE, NvMInitBlockCallback=NULL_PTR, NvMResistantToChangedSw=true, NvMSelectBlockForReadAll=true, NvMSelectBlockForWriteAll=false, NvMWriteRamBlockToNvCallback=NULL_PTR, NvMUseJobendCallback=false, NvMSingleBlockCallback=NULL_PTR, NvMBlockUseCrc=true, NvMCalcRamBlockCrc=false, NvMBlockJobPriority=127, NvMNvBlockLength=16, NvMNvBlockNum=1, NvMNvramBlockIdentifier=24, NvMUseServicePorts=true, NvMBlockUseSetRamBlockStatus=true, NvMRamBlockDataAddress=Rte_Ssa_TimeM_RealTimeOffset, NvMRomBlockDataAddress=Rte_Ssa_TimeM_NvM_TimeM_RealTimeOffset_DefaultValue  # UC:Derived from NvBlockNeeds
        NvMTargetBlockReference
          NvMFeeRef: NvMNameOfFeeBlock=FeeSsa_TimeM_NvM_TimeM_RealTimeOffset
      Ssa_TimeM_NvM_TimeM_TickCount: NvMBlockCrcType=NVM_CRC16, NvMBlockManagementType=NVM_BLOCK_NATIVE, NvMInitBlockCallback=NULL_PTR, NvMResistantToChangedSw=true, NvMSelectBlockForReadAll=true, NvMSelectBlockForWriteAll=true, NvMWriteRamBlockToNvCallback=NULL_PTR, NvMUseJobendCallback=false, NvMSingleBlockCallback=NULL_PTR, NvMBlockUseCrc=true, NvMCalcRamBlockCrc=false, NvMBlockJobPriority=127, NvMNvBlockLength=8, NvMNvBlockNum=1, NvMNvramBlockIdentifier=25, NvMUseServicePorts=true, NvMBlockUseSetRamBlockStatus=true, NvMRamBlockDataAddress=Rte_Ssa_TimeM_TickCount, NvMRomBlockDataAddress=Rte_Ssa_TimeM_NvM_TimeM_LocalTimeBase_DefaultValue  # UC:Derived from NvBlockNeeds
        NvMTargetBlockReference
          NvMFeeRef: NvMNameOfFeeBlock=FeeSsa_TimeM_NvM_TimeM_TickCount
      Ct_MBBL_SsaAppl_CodingNvBlockNeed_CodingData: NvMBlockCrcType=NVM_CRC16, NvMBlockManagementType=NVM_BLOCK_NATIVE, NvMInitBlockCallback=NULL_PTR, NvMResistantToChangedSw=true, NvMSelectBlockForReadAll=false, NvMSelectBlockForWriteAll=false, NvMWriteRamBlockToNvCallback=NULL_PTR, NvMUseJobendCallback=false, NvMSingleBlockCallback=NULL_PTR, NvMBlockUseCrc=false, NvMCalcRamBlockCrc=false, NvMBlockJobPriority=127, NvMNvBlockLength=12, NvMNvBlockNum=1, NvMNvramBlockIdentifier=26, NvMUseServicePorts=false, NvMBlockUseSetRamBlockStatus=true, NvMRamBlockDataAddress=Rte_Ct_MBBL_SsaAppl_Coding_PIM_CodingData, NvMRomBlockDataAddress=Rte_Ct_MBBL_SsaAppl_Coding_Cal_CodingDataInit  # UC:Derived from NvBlockNeeds
        NvMTargetBlockReference
          NvMFeeRef: NvMNameOfFeeBlock=FeeCt_MBBL_SsaAppl_CodingNvBlockNeed_CodingData
      Ct_MBBL_SsaAppl_CodingNvmCoding_CurrentVehicleEquipment: NvMBlockCrcType=NVM_CRC16, NvMBlockManagementType=NVM_BLOCK_NATIVE, NvMInitBlockCallback=NULL_PTR, NvMResistantToChangedSw=true, NvMSelectBlockForReadAll=true, NvMSelectBlockForWriteAll=false, NvMWriteRamBlockToNvCallback=NULL_PTR, NvMUseJobendCallback=false, NvMSingleBlockCallback=NULL_PTR, NvMBlockUseCrc=false, NvMCalcRamBlockCrc=false, NvMBlockJobPriority=127, NvMNvBlockLength=16, NvMNvBlockNum=1, NvMNvramBlockIdentifier=27, NvMUseServicePorts=true, NvMBlockUseSetRamBlockStatus=true, NvMRamBlockDataAddress=Rte_Ct_MBBL_SsaAppl_Coding_VehicleEquipment, NvMRomBlockDataAddress=NULL_PTR  # UC:Derived from NvBlockNeeds
        NvMTargetBlockReference
          NvMFeeRef: NvMNameOfFeeBlock=FeeCt_MBBL_SsaAppl_CodingNvmCoding_CurrentVehicleEquipment
      Ct_MBBL_SsaAppl_CodingNvmCoding_TensioningCycleBSR: NvMBlockCrcType=NVM_CRC16, NvMBlockManagementType=NVM_BLOCK_NATIVE, NvMInitBlockCallback=NULL_PTR, NvMResistantToChangedSw=true, NvMSelectBlockForReadAll=true, NvMSelectBlockForWriteAll=false, NvMWriteRamBlockToNvCallback=NULL_PTR, NvMUseJobendCallback=false, NvMSingleBlockCallback=NULL_PTR, NvMBlockUseCrc=true, NvMCalcRamBlockCrc=false, NvMBlockJobPriority=127, NvMNvBlockLength=233, NvMNvBlockNum=1, NvMNvramBlockIdentifier=28, NvMUseServicePorts=true, NvMBlockUseSetRamBlockStatus=true, NvMRamBlockDataAddress=Rte_Ct_MBBL_SsaAppl_Coding_TensioningCycleBSR, NvMRomBlockDataAddress=NULL_PTR  # UC:Derived from NvBlockNeeds
        NvMTargetBlockReference
          NvMFeeRef: NvMNameOfFeeBlock=FeeCt_MBBL_SsaAppl_CodingNvmCoding_TensioningCycleBSR
      Ct_MBBL_SsaAppl_CodingNvmCoding_PreSafeCyclesLevel: NvMBlockCrcType=NVM_CRC16, NvMBlockManagementType=NVM_BLOCK_NATIVE, NvMInitBlockCallback=NULL_PTR, NvMResistantToChangedSw=true, NvMSelectBlockForReadAll=true, NvMSelectBlockForWriteAll=false, NvMWriteRamBlockToNvCallback=NULL_PTR, NvMUseJobendCallback=false, NvMSingleBlockCallback=NULL_PTR, NvMBlockUseCrc=true, NvMCalcRamBlockCrc=false, NvMBlockJobPriority=127, NvMNvBlockLength=1073, NvMNvBlockNum=1, NvMNvramBlockIdentifier=29, NvMUseServicePorts=true, NvMBlockUseSetRamBlockStatus=true, NvMRamBlockDataAddress=Rte_Ct_MBBL_SsaAppl_Coding_PreSafeCyclesLevel, NvMRomBlockDataAddress=NULL_PTR  # UC:Derived from NvBlockNeeds
        NvMTargetBlockReference
          NvMFeeRef: NvMNameOfFeeBlock=FeeCt_MBBL_SsaAppl_CodingNvmCoding_PreSafeCyclesLevel
      Ct_MBBL_SsaAppl_CodingNvmCoding_ReleaseCyclesBsrAndPreSafe: NvMBlockCrcType=NVM_CRC16, NvMBlockManagementType=NVM_BLOCK_NATIVE, NvMInitBlockCallback=NULL_PTR, NvMResistantToChangedSw=true, NvMSelectBlockForReadAll=true, NvMSelectBlockForWriteAll=false, NvMWriteRamBlockToNvCallback=NULL_PTR, NvMUseJobendCallback=false, NvMSingleBlockCallback=NULL_PTR, NvMBlockUseCrc=true, NvMCalcRamBlockCrc=false, NvMBlockJobPriority=127, NvMNvBlockLength=144, NvMNvBlockNum=1, NvMNvramBlockIdentifier=30, NvMUseServicePorts=true, NvMBlockUseSetRamBlockStatus=true, NvMRamBlockDataAddress=Rte_Ct_MBBL_SsaAppl_Coding_ReleaseCyclesBsrAndPreSafe, NvMRomBlockDataAddress=NULL_PTR  # UC:Derived from NvBlockNeeds
        NvMTargetBlockReference
          NvMFeeRef: NvMNameOfFeeBlock=FeeCt_MBBL_SsaAppl_CodingNvmCoding_ReleaseCyclesBsrAndPreSafe
      Ct_MBBL_SsaAppl_CodingNvmCoding_ZZZVehicleEquipmentDevelopment: NvMBlockCrcType=NVM_CRC16, NvMBlockManagementType=NVM_BLOCK_NATIVE, NvMInitBlockCallback=NULL_PTR, NvMResistantToChangedSw=true, NvMSelectBlockForReadAll=true, NvMSelectBlockForWriteAll=false, NvMWriteRamBlockToNvCallback=NULL_PTR, NvMUseJobendCallback=false, NvMSingleBlockCallback=NULL_PTR, NvMBlockUseCrc=true, NvMCalcRamBlockCrc=false, NvMBlockJobPriority=127, NvMNvBlockLength=3, NvMNvBlockNum=1, NvMNvramBlockIdentifier=31, NvMUseServicePorts=true, NvMBlockUseSetRamBlockStatus=true, NvMRamBlockDataAddress=Rte_Ct_MBBL_SsaAppl_Coding_ZZZ_VehicleEquipment_Development, NvMRomBlockDataAddress=NULL_PTR  # UC:Derived from NvBlockNeeds
        NvMTargetBlockReference
          NvMFeeRef: NvMNameOfFeeBlock=FeeCt_MBBL_SsaAppl_CodingNvmCoding_ZZZVehicleEquipmentDevelopment
      Ct_MBBL_SsaAppl_CodingNvmCoding_CalibrationID: NvMBlockCrcType=NVM_CRC16, NvMBlockManagementType=NVM_BLOCK_NATIVE, NvMInitBlockCallback=NULL_PTR, NvMResistantToChangedSw=true, NvMSelectBlockForReadAll=true, NvMSelectBlockForWriteAll=false, NvMWriteRamBlockToNvCallback=NULL_PTR, NvMUseJobendCallback=false, NvMSingleBlockCallback=NULL_PTR, NvMBlockUseCrc=true, NvMCalcRamBlockCrc=false, NvMBlockJobPriority=127, NvMNvBlockLength=18, NvMNvBlockNum=1, NvMNvramBlockIdentifier=32, NvMUseServicePorts=true, NvMBlockUseSetRamBlockStatus=true, NvMRamBlockDataAddress=Rte_Ct_MBBL_SsaAppl_Coding_CalibrationID, NvMRomBlockDataAddress=NULL_PTR  # UC:Derived from NvBlockNeeds
        NvMTargetBlockReference
          NvMFeeRef: NvMNameOfFeeBlock=FeeCt_MBBL_SsaAppl_CodingNvmCoding_CalibrationID
      NvMBlockDescriptor_FblMetaData: NvMBlockCrcType=NVM_CRC16, NvMBlockManagementType=NVM_BLOCK_DATASET, NvMInitBlockCallback=NULL_PTR, NvMResistantToChangedSw=true, NvMSelectBlockForReadAll=false, NvMSelectBlockForWriteAll=false, NvMWriteRamBlockToNvCallback=NULL_PTR, NvMUseJobendCallback=false, NvMSingleBlockCallback=NULL_PTR, NvMBlockUseCrc=false, NvMCalcRamBlockCrc=false, NvMBlockJobPriority=0, NvMNvBlockLength=145, NvMNvBlockNum=3, NvMNvramBlockIdentifier=33, NvMUseServicePorts=true, NvMBlockUseSetRamBlockStatus=false, NvMBlockLengthCheck=false, NvMBlockLengthCheckType=false, NvMRamBlockDataAddress=NULL_PTR, NvMAutomaticBlockLength=false, NvMRomBlockDataAddress=NvMBlock_FblMetaData_DefaultValue
        NvMTargetBlockReference
          NvMFeeRef: NvMNameOfFeeBlock=FeeBlockDescriptor_FblMetaData
      NVP_BLOCK_ID_ECU_LOCATION: NvMBlockCrcType=NVM_CRC16, NvMBlockManagementType=NVM_BLOCK_NATIVE, NvMInitBlockCallback=NULL_PTR, NvMResistantToChangedSw=true, NvMSelectBlockForReadAll=true, NvMSelectBlockForWriteAll=false, NvMWriteRamBlockToNvCallback=NULL_PTR, NvMUseJobendCallback=false, NvMSingleBlockCallback=NULL_PTR, NvMBlockUseCrc=true, NvMCalcRamBlockCrc=false, NvMBlockJobPriority=127, NvMNvBlockLength=1, NvMNvBlockNum=1, NvMNvramBlockIdentifier=34, NvMUseServicePorts=true, NvMBlockUseSetRamBlockStatus=true, NvMRamBlockDataAddress=NVP_BLOCK_ID_ECU_LOCATION_RamBlockData, NvMRomBlockDataAddress=NVP_BLOCK_ID_ECU_LOCATION_DefaultData
        NvMTargetBlockReference
          NvMFeeRef: NvMNameOfFeeBlock=Fee_NVP_BLOCK_ID_ECU_LOCATION
      NVP_BLOCK_ID_BELT_ASSEMBLY_MANUF_DATE_AND_SN: NvMBlockCrcType=NVM_CRC16, NvMBlockManagementType=NVM_BLOCK_NATIVE, NvMInitBlockCallback=NULL_PTR, NvMResistantToChangedSw=true, NvMSelectBlockForReadAll=true, NvMSelectBlockForWriteAll=false, NvMWriteRamBlockToNvCallback=NULL_PTR, NvMUseJobendCallback=false, NvMSingleBlockCallback=NULL_PTR, NvMBlockUseCrc=true, NvMCalcRamBlockCrc=false, NvMBlockJobPriority=127, NvMNvBlockLength=28, NvMNvBlockNum=1, NvMNvramBlockIdentifier=35, NvMUseServicePorts=true, NvMBlockUseSetRamBlockStatus=true, NvMRamBlockDataAddress=NVP_BLOCK_ID_BELT_ASSEMBLY_MANUF_DATE_AND_SN_RamBlockData, NvMRomBlockDataAddress=NVP_BLOCK_ID_BELT_ASSEMBLY_MANUF_DATE_AND_SN_DefaultData
        NvMTargetBlockReference
          NvMFeeRef: NvMNameOfFeeBlock=Fee_NVP_BLOCK_ID_BELT_ASSEMBLY_MANUF_DATE_AND_SN
      NVP_BLOCK_ID_HB_CALIBRATION: NvMBlockCrcType=NVM_CRC16, NvMBlockManagementType=NVM_BLOCK_NATIVE, NvMInitBlockCallback=NULL_PTR, NvMResistantToChangedSw=true, NvMSelectBlockForReadAll=true, NvMSelectBlockForWriteAll=false, NvMWriteRamBlockToNvCallback=NULL_PTR, NvMUseJobendCallback=false, NvMSingleBlockCallback=NULL_PTR, NvMBlockUseCrc=true, NvMCalcRamBlockCrc=false, NvMBlockJobPriority=127, NvMNvBlockLength=40, NvMNvBlockNum=1, NvMNvramBlockIdentifier=36, NvMUseServicePorts=true, NvMBlockUseSetRamBlockStatus=true, NvMRamBlockDataAddress=NVP_BLOCK_ID_HB_CALIBRATION_RamBlockData, NvMRomBlockDataAddress=NVP_BLOCK_ID_HB_CALIBRATION_DefaultData
        NvMTargetBlockReference
          NvMFeeRef: NvMNameOfFeeBlock=Fee_NVP_BLOCK_ID_HB_CALIBRATION
      NVP_BLOCK_ID_AEE_TRACEABILITY: NvMBlockCrcType=NVM_CRC16, NvMBlockManagementType=NVM_BLOCK_NATIVE, NvMInitBlockCallback=NULL_PTR, NvMResistantToChangedSw=true, NvMSelectBlockForReadAll=true, NvMSelectBlockForWriteAll=false, NvMWriteRamBlockToNvCallback=NULL_PTR, NvMUseJobendCallback=false, NvMSingleBlockCallback=NULL_PTR, NvMBlockUseCrc=true, NvMCalcRamBlockCrc=false, NvMBlockJobPriority=127, NvMNvBlockLength=12, NvMNvBlockNum=1, NvMNvramBlockIdentifier=38, NvMUseServicePorts=true, NvMBlockUseSetRamBlockStatus=true, NvMRamBlockDataAddress=NVP_BLOCK_ID_AEE_TRACEABILITY_RamBlockData, NvMRomBlockDataAddress=NVP_BLOCK_ID_AEE_TRACEABILITY_DefaultData
        NvMTargetBlockReference
          NvMFeeRef: NvMNameOfFeeBlock=Fee_NVP_BLOCK_ID_AEE_TRACEABILITY
      NVP_BLOCK_ID_EXECUTION_COUNTERS: NvMBlockCrcType=NVM_CRC16, NvMBlockManagementType=NVM_BLOCK_NATIVE, NvMInitBlockCallback=NULL_PTR, NvMResistantToChangedSw=true, NvMSelectBlockForReadAll=true, NvMSelectBlockForWriteAll=true, NvMWriteRamBlockToNvCallback=NULL_PTR, NvMUseJobendCallback=false, NvMSingleBlockCallback=NULL_PTR, NvMBlockUseCrc=true, NvMCalcRamBlockCrc=false, NvMBlockJobPriority=127, NvMNvBlockLength=20, NvMNvBlockNum=1, NvMNvramBlockIdentifier=39, NvMUseServicePorts=true, NvMBlockUseSetRamBlockStatus=false, NvMRamBlockDataAddress=NVP_BLOCK_ID_EXECUTION_COUNTERS_RamBlockData, NvMRomBlockDataAddress=NVP_BLOCK_ID_EXECUTION_COUNTERS_DefaultData
        NvMTargetBlockReference
          NvMFeeRef: NvMNameOfFeeBlock=Fee_NVP_BLOCK_ID_EXECUTION_COUNTERS
      NVP_BLOCK_ID_TESTS_PARAM: NvMBlockCrcType=NVM_CRC16, NvMBlockManagementType=NVM_BLOCK_NATIVE, NvMInitBlockCallback=NULL_PTR, NvMResistantToChangedSw=true, NvMSelectBlockForReadAll=true, NvMSelectBlockForWriteAll=false, NvMWriteRamBlockToNvCallback=NULL_PTR, NvMUseJobendCallback=false, NvMSingleBlockCallback=NULL_PTR, NvMBlockUseCrc=true, NvMCalcRamBlockCrc=false, NvMBlockJobPriority=127, NvMNvBlockLength=97, NvMNvBlockNum=1, NvMNvramBlockIdentifier=40, NvMUseServicePorts=true, NvMBlockUseSetRamBlockStatus=false, NvMRamBlockDataAddress=NVP_BLOCK_ID_TESTS_PARAM_RamBlockData, NvMRomBlockDataAddress=NVP_BLOCK_ID_TESTS_PARAM_DefaultData
        NvMTargetBlockReference
          NvMFeeRef: NvMNameOfFeeBlock=Fee_NVP_BLOCK_ID_TESTS_PARAM
      NVP_BLOCK_ID_CYCLE: NvMBlockCrcType=NVM_CRC16, NvMBlockManagementType=NVM_BLOCK_NATIVE, NvMInitBlockCallback=NULL_PTR, NvMResistantToChangedSw=true, NvMSelectBlockForReadAll=true, NvMSelectBlockForWriteAll=false, NvMWriteRamBlockToNvCallback=NULL_PTR, NvMUseJobendCallback=false, NvMSingleBlockCallback=NULL_PTR, NvMBlockUseCrc=true, NvMCalcRamBlockCrc=false, NvMBlockJobPriority=127, NvMNvBlockLength=420, NvMNvBlockNum=1, NvMNvramBlockIdentifier=43, NvMUseServicePorts=true, NvMBlockUseSetRamBlockStatus=true, NvMRamBlockDataAddress=NVP_BLOCK_ID_CYCLE_0_RamBlockData, NvMRomBlockDataAddress=NVP_BLOCK_ID_CYCLE_0_DefaultData
        NvMTargetBlockReference
          NvMFeeRef: NvMNameOfFeeBlock=Fee_NVP_BLOCK_ID_CYCLE
      NVP_BLOCK_ID_STEP: NvMBlockCrcType=NVM_CRC32, NvMBlockManagementType=NVM_BLOCK_NATIVE, NvMInitBlockCallback=NULL_PTR, NvMResistantToChangedSw=true, NvMSelectBlockForReadAll=true, NvMSelectBlockForWriteAll=false, NvMWriteRamBlockToNvCallback=NULL_PTR, NvMUseJobendCallback=false, NvMSingleBlockCallback=NULL_PTR, NvMBlockUseCrc=true, NvMCalcRamBlockCrc=false, NvMBlockJobPriority=127, NvMNvBlockLength=1160, NvMNvBlockNum=1, NvMNvramBlockIdentifier=47, NvMUseServicePorts=true, NvMBlockUseSetRamBlockStatus=true, NvMRomBlockDataAddress=NVP_BLOCK_ID_STEP_0_DefaultData, NvMRamBlockDataAddress=NVP_BLOCK_ID_STEP_0_RamBlockData
        NvMTargetBlockReference
          NvMFeeRef: NvMNameOfFeeBlock=Fee_NVP_BLOCK_ID_STEP
      CALIB_BLOCK_ID_EOL_PARAM: NvMBlockCrcType=NVM_CRC16, NvMBlockManagementType=NVM_BLOCK_NATIVE, NvMInitBlockCallback=NULL_PTR, NvMResistantToChangedSw=true, NvMSelectBlockForReadAll=false, NvMSelectBlockForWriteAll=false, NvMWriteRamBlockToNvCallback=NULL_PTR, NvMUseJobendCallback=false, NvMSingleBlockCallback=NULL_PTR, NvMBlockUseCrc=true, NvMCalcRamBlockCrc=false, NvMBlockJobPriority=127, NvMNvBlockLength=40, NvMNvBlockNum=1, NvMNvramBlockIdentifier=48, NvMUseServicePorts=true, NvMBlockUseSetRamBlockStatus=false, NvMRamBlockDataAddress=NULL_PTR, NvMRomBlockDataAddress=CALIB_BLOCK_ID_EOL_PARAM_RomBlockData
        NvMTargetBlockReference
          NvMFeeRef: NvMNameOfFeeBlock=Fee_CALIB_BLOCK_ID_EOL_PARAM
      CALIB_BLOCK_ID_BFS_PRIO_PARAM: NvMBlockCrcType=NVM_CRC16, NvMBlockManagementType=NVM_BLOCK_NATIVE, NvMInitBlockCallback=NULL_PTR, NvMResistantToChangedSw=true, NvMSelectBlockForReadAll=false, NvMSelectBlockForWriteAll=false, NvMWriteRamBlockToNvCallback=NULL_PTR, NvMUseJobendCallback=false, NvMSingleBlockCallback=NULL_PTR, NvMBlockUseCrc=true, NvMCalcRamBlockCrc=false, NvMBlockJobPriority=127, NvMNvBlockLength=38, NvMNvBlockNum=1, NvMNvramBlockIdentifier=49, NvMUseServicePorts=true, NvMBlockUseSetRamBlockStatus=false, NvMRamBlockDataAddress=NULL_PTR, NvMRomBlockDataAddress=CALIB_BLOCK_ID_BFS_PRIO_PARAM_RomBlockData
        NvMTargetBlockReference
          NvMFeeRef: NvMNameOfFeeBlock=Fee_CALIB_BLOCK_ID_BFS_PRIO_PARAM
      CALIB_BLOCK_ID_PID_PARAM: NvMBlockCrcType=NVM_CRC16, NvMBlockManagementType=NVM_BLOCK_NATIVE, NvMInitBlockCallback=NULL_PTR, NvMResistantToChangedSw=true, NvMSelectBlockForReadAll=false, NvMSelectBlockForWriteAll=false, NvMWriteRamBlockToNvCallback=NULL_PTR, NvMUseJobendCallback=false, NvMSingleBlockCallback=NULL_PTR, NvMBlockUseCrc=true, NvMCalcRamBlockCrc=false, NvMBlockJobPriority=127, NvMNvBlockLength=6, NvMNvBlockNum=1, NvMNvramBlockIdentifier=50, NvMUseServicePorts=true, NvMBlockUseSetRamBlockStatus=false, NvMRamBlockDataAddress=NULL_PTR, NvMRomBlockDataAddress=CALIB_BLOCK_ID_PID_PARAM_RomBlockData
        NvMTargetBlockReference
          NvMFeeRef: NvMNameOfFeeBlock=Fee_CALIB_BLOCK_ID_PID_PARAM
      CALIB_BLOCK_ID_WEIGHT_REL_TABLE: NvMBlockCrcType=NVM_CRC16, NvMBlockManagementType=NVM_BLOCK_NATIVE, NvMInitBlockCallback=NULL_PTR, NvMResistantToChangedSw=true, NvMSelectBlockForReadAll=false, NvMSelectBlockForWriteAll=false, NvMWriteRamBlockToNvCallback=NULL_PTR, NvMUseJobendCallback=false, NvMSingleBlockCallback=NULL_PTR, NvMBlockUseCrc=true, NvMCalcRamBlockCrc=false, NvMBlockJobPriority=127, NvMNvBlockLength=21, NvMNvBlockNum=1, NvMNvramBlockIdentifier=51, NvMUseServicePorts=true, NvMBlockUseSetRamBlockStatus=false, NvMRamBlockDataAddress=NULL_PTR, NvMRomBlockDataAddress=CALIB_BLOCK_ID_WEIGHT_REL_TABLE_RomBlockData
        NvMTargetBlockReference
          NvMFeeRef: NvMNameOfFeeBlock=Fee_CALIB_BLOCK_ID_WEIGHT_REL_TABLE
      CALIB_BLOCK_ID_WEIGHT_TENS0_TABLE: NvMBlockCrcType=NVM_CRC16, NvMBlockManagementType=NVM_BLOCK_NATIVE, NvMInitBlockCallback=NULL_PTR, NvMResistantToChangedSw=true, NvMSelectBlockForReadAll=false, NvMSelectBlockForWriteAll=false, NvMWriteRamBlockToNvCallback=NULL_PTR, NvMUseJobendCallback=false, NvMSingleBlockCallback=NULL_PTR, NvMBlockUseCrc=true, NvMCalcRamBlockCrc=false, NvMBlockJobPriority=127, NvMNvBlockLength=21, NvMNvBlockNum=1, NvMNvramBlockIdentifier=52, NvMUseServicePorts=true, NvMBlockUseSetRamBlockStatus=false, NvMRamBlockDataAddress=NULL_PTR, NvMRomBlockDataAddress=CALIB_BLOCK_ID_WEIGHT_TENS0_TABLE_RomBlockData
        NvMTargetBlockReference
          NvMFeeRef: NvMNameOfFeeBlock=Fee_CALIB_BLOCK_ID_WEIGHT_TENS0_TABLE
      CALIB_BLOCK_ID_WEIGHT_TENS1_TABLE: NvMBlockCrcType=NVM_CRC16, NvMBlockManagementType=NVM_BLOCK_NATIVE, NvMInitBlockCallback=NULL_PTR, NvMResistantToChangedSw=true, NvMSelectBlockForReadAll=false, NvMSelectBlockForWriteAll=false, NvMWriteRamBlockToNvCallback=NULL_PTR, NvMUseJobendCallback=false, NvMSingleBlockCallback=NULL_PTR, NvMBlockUseCrc=true, NvMCalcRamBlockCrc=false, NvMBlockJobPriority=127, NvMNvBlockLength=21, NvMNvBlockNum=1, NvMNvramBlockIdentifier=53, NvMUseServicePorts=true, NvMBlockUseSetRamBlockStatus=false, NvMRamBlockDataAddress=NULL_PTR, NvMRomBlockDataAddress=CALIB_BLOCK_ID_WEIGHT_TENS1_TABLE_RomBlockData
        NvMTargetBlockReference
          NvMFeeRef: NvMNameOfFeeBlock=Fee_CALIB_BLOCK_ID_WEIGHT_TENS1_TABLE
      CALIB_BLOCK_ID_WEIGHT_TENS2_TABLE: NvMBlockCrcType=NVM_CRC16, NvMBlockManagementType=NVM_BLOCK_NATIVE, NvMInitBlockCallback=NULL_PTR, NvMResistantToChangedSw=true, NvMSelectBlockForReadAll=false, NvMSelectBlockForWriteAll=false, NvMWriteRamBlockToNvCallback=NULL_PTR, NvMUseJobendCallback=false, NvMSingleBlockCallback=NULL_PTR, NvMBlockUseCrc=true, NvMCalcRamBlockCrc=false, NvMBlockJobPriority=127, NvMNvBlockLength=21, NvMNvBlockNum=1, NvMNvramBlockIdentifier=54, NvMUseServicePorts=true, NvMBlockUseSetRamBlockStatus=false, NvMRamBlockDataAddress=NULL_PTR, NvMRomBlockDataAddress=CALIB_BLOCK_ID_WEIGHT_TENS2_TABLE_RomBlockData
        NvMTargetBlockReference
          NvMFeeRef: NvMNameOfFeeBlock=Fee_CALIB_BLOCK_ID_WEIGHT_TENS2_TABLE
      CALIB_BLOCK_ID_WEIGHT_TENS3_TABLE: NvMBlockCrcType=NVM_CRC16, NvMBlockManagementType=NVM_BLOCK_NATIVE, NvMInitBlockCallback=NULL_PTR, NvMResistantToChangedSw=true, NvMSelectBlockForReadAll=false, NvMSelectBlockForWriteAll=false, NvMWriteRamBlockToNvCallback=NULL_PTR, NvMUseJobendCallback=false, NvMSingleBlockCallback=NULL_PTR, NvMBlockUseCrc=true, NvMCalcRamBlockCrc=false, NvMBlockJobPriority=127, NvMNvBlockLength=21, NvMNvBlockNum=1, NvMNvramBlockIdentifier=55, NvMUseServicePorts=true, NvMBlockUseSetRamBlockStatus=false, NvMRamBlockDataAddress=NULL_PTR, NvMRomBlockDataAddress=CALIB_BLOCK_ID_WEIGHT_TENS3_TABLE_RomBlockData
        NvMTargetBlockReference
          NvMFeeRef: NvMNameOfFeeBlock=Fee_CALIB_BLOCK_ID_WEIGHT_TENS3_TABLE
      CALIB_BLOCK_ID_INT_CURRENT_CORR: NvMBlockCrcType=NVM_CRC16, NvMBlockManagementType=NVM_BLOCK_NATIVE, NvMInitBlockCallback=NULL_PTR, NvMResistantToChangedSw=true, NvMSelectBlockForReadAll=false, NvMSelectBlockForWriteAll=false, NvMWriteRamBlockToNvCallback=NULL_PTR, NvMUseJobendCallback=false, NvMSingleBlockCallback=NULL_PTR, NvMBlockUseCrc=true, NvMCalcRamBlockCrc=false, NvMBlockJobPriority=127, NvMNvBlockLength=21, NvMNvBlockNum=1, NvMNvramBlockIdentifier=56, NvMUseServicePorts=true, NvMBlockUseSetRamBlockStatus=false, NvMRamBlockDataAddress=NULL_PTR, NvMRomBlockDataAddress=CALIB_BLOCK_ID_INT_CURRENT_CORR_RomBlockData
        NvMTargetBlockReference
          NvMFeeRef: NvMNameOfFeeBlock=Fee_CALIB_BLOCK_ID_INT_CURRENT_CORR
      CALIB_BLOCK_ID_INT_CURRENT_TABLE: NvMBlockCrcType=NVM_CRC16, NvMBlockManagementType=NVM_BLOCK_NATIVE, NvMInitBlockCallback=NULL_PTR, NvMResistantToChangedSw=true, NvMSelectBlockForReadAll=false, NvMSelectBlockForWriteAll=false, NvMWriteRamBlockToNvCallback=NULL_PTR, NvMUseJobendCallback=false, NvMSingleBlockCallback=NULL_PTR, NvMBlockUseCrc=true, NvMCalcRamBlockCrc=false, NvMBlockJobPriority=127, NvMNvBlockLength=128, NvMNvBlockNum=1, NvMNvramBlockIdentifier=57, NvMUseServicePorts=true, NvMBlockUseSetRamBlockStatus=false, NvMRamBlockDataAddress=NULL_PTR, NvMRomBlockDataAddress=CALIB_BLOCK_ID_INT_CURRENT_TABLE_RomBlockData
        NvMTargetBlockReference
          NvMFeeRef: NvMNameOfFeeBlock=Fee_CALIB_BLOCK_ID_INT_CURRENT_TABLE
      CALIB_BLOCK_ID_ECPL_ALPHA_TABLE: NvMBlockCrcType=NVM_CRC16, NvMBlockManagementType=NVM_BLOCK_NATIVE, NvMInitBlockCallback=NULL_PTR, NvMResistantToChangedSw=true, NvMSelectBlockForReadAll=false, NvMSelectBlockForWriteAll=false, NvMWriteRamBlockToNvCallback=NULL_PTR, NvMUseJobendCallback=false, NvMSingleBlockCallback=NULL_PTR, NvMBlockUseCrc=true, NvMCalcRamBlockCrc=false, NvMBlockJobPriority=127, NvMNvBlockLength=9, NvMNvBlockNum=1, NvMNvramBlockIdentifier=58, NvMUseServicePorts=true, NvMBlockUseSetRamBlockStatus=false, NvMRamBlockDataAddress=NULL_PTR, NvMRomBlockDataAddress=CALIB_BLOCK_ID_ECPL_ALPHA_TABLE_RomBlockData
        NvMTargetBlockReference
          NvMFeeRef: NvMNameOfFeeBlock=Fee_CALIB_BLOCK_ID_ECPL_ALPHA_TABLE
      CALIB_BLOCK_ID_POWER_DEGRADATION: NvMBlockCrcType=NVM_CRC16, NvMBlockManagementType=NVM_BLOCK_NATIVE, NvMInitBlockCallback=NULL_PTR, NvMResistantToChangedSw=true, NvMSelectBlockForReadAll=false, NvMSelectBlockForWriteAll=false, NvMWriteRamBlockToNvCallback=NULL_PTR, NvMUseJobendCallback=false, NvMSingleBlockCallback=NULL_PTR, NvMBlockUseCrc=true, NvMCalcRamBlockCrc=false, NvMBlockJobPriority=127, NvMNvBlockLength=18, NvMNvBlockNum=1, NvMNvramBlockIdentifier=59, NvMUseServicePorts=true, NvMBlockUseSetRamBlockStatus=false, NvMRamBlockDataAddress=NULL_PTR, NvMRomBlockDataAddress=CALIB_BLOCK_ID_POWER_DEGRADATION_RomBlockData
        NvMTargetBlockReference
          NvMFeeRef: NvMNameOfFeeBlock=Fee_CALIB_BLOCK_ID_POWER_DEGRADATION
      CALIB_BLOCK_ID_ECPL_BETA_TABLE: NvMBlockCrcType=NVM_CRC16, NvMBlockManagementType=NVM_BLOCK_NATIVE, NvMInitBlockCallback=NULL_PTR, NvMResistantToChangedSw=true, NvMSelectBlockForReadAll=false, NvMSelectBlockForWriteAll=false, NvMWriteRamBlockToNvCallback=NULL_PTR, NvMUseJobendCallback=false, NvMSingleBlockCallback=NULL_PTR, NvMBlockUseCrc=true, NvMCalcRamBlockCrc=false, NvMBlockJobPriority=127, NvMNvBlockLength=9, NvMNvBlockNum=1, NvMNvramBlockIdentifier=60, NvMUseServicePorts=true, NvMBlockUseSetRamBlockStatus=false, NvMRamBlockDataAddress=NULL_PTR, NvMRomBlockDataAddress=CALIB_BLOCK_ID_ECPL_BETA_TABLE_RomBlockData
        NvMTargetBlockReference
          NvMFeeRef: NvMNameOfFeeBlock=Fee_CALIB_BLOCK_ID_ECPL_BETA_TABLE
      CALIB_BLOCK_ID_ECPL_OTHER_PARAM: NvMBlockCrcType=NVM_CRC16, NvMBlockManagementType=NVM_BLOCK_NATIVE, NvMInitBlockCallback=NULL_PTR, NvMResistantToChangedSw=true, NvMSelectBlockForReadAll=false, NvMSelectBlockForWriteAll=false, NvMWriteRamBlockToNvCallback=NULL_PTR, NvMUseJobendCallback=false, NvMSingleBlockCallback=NULL_PTR, NvMBlockUseCrc=true, NvMCalcRamBlockCrc=false, NvMBlockJobPriority=127, NvMNvBlockLength=7, NvMNvBlockNum=1, NvMNvramBlockIdentifier=61, NvMUseServicePorts=true, NvMBlockUseSetRamBlockStatus=false, NvMRamBlockDataAddress=NULL_PTR, NvMRomBlockDataAddress=CALIB_BLOCK_ID_ECPL_OTHER_PARAM_RomBlockData
        NvMTargetBlockReference
          NvMFeeRef: NvMNameOfFeeBlock=Fee_CALIB_BLOCK_ID_ECPL_OTHER_PARAM
      CALIB_BLOCK_ID_BPA_MOTOR_CURRENT: NvMBlockCrcType=NVM_CRC16, NvMBlockManagementType=NVM_BLOCK_NATIVE, NvMInitBlockCallback=NULL_PTR, NvMResistantToChangedSw=true, NvMSelectBlockForReadAll=false, NvMSelectBlockForWriteAll=false, NvMWriteRamBlockToNvCallback=NULL_PTR, NvMUseJobendCallback=false, NvMSingleBlockCallback=NULL_PTR, NvMBlockUseCrc=true, NvMCalcRamBlockCrc=false, NvMBlockJobPriority=127, NvMNvBlockLength=21, NvMNvBlockNum=1, NvMNvramBlockIdentifier=62, NvMUseServicePorts=true, NvMBlockUseSetRamBlockStatus=false, NvMRamBlockDataAddress=NULL_PTR, NvMRomBlockDataAddress=CALIB_BLOCK_ID_BPA_MOTOR_CURRENT_RomBlockData
        NvMTargetBlockReference
          NvMFeeRef: NvMNameOfFeeBlock=Fee_CALIB_BLOCK_ID_BPA_MOTOR_CURRENT
      CALIB_BLOCK_ID_VOLT_THRS: NvMBlockCrcType=NVM_CRC16, NvMBlockManagementType=NVM_BLOCK_NATIVE, NvMInitBlockCallback=NULL_PTR, NvMResistantToChangedSw=true, NvMSelectBlockForReadAll=false, NvMSelectBlockForWriteAll=false, NvMWriteRamBlockToNvCallback=NULL_PTR, NvMUseJobendCallback=false, NvMSingleBlockCallback=NULL_PTR, NvMBlockUseCrc=true, NvMCalcRamBlockCrc=false, NvMBlockJobPriority=127, NvMNvBlockLength=32, NvMNvBlockNum=1, NvMNvramBlockIdentifier=63, NvMUseServicePorts=true, NvMBlockUseSetRamBlockStatus=false, NvMRamBlockDataAddress=NULL_PTR, NvMRomBlockDataAddress=CALIB_BLOCK_ID_VOLT_THRS_RomBlockData
        NvMTargetBlockReference
          NvMFeeRef: NvMNameOfFeeBlock=Fee_CALIB_BLOCK_ID_VOLT_THRS
      CALIB_BLOCK_ID_BATTERY_LOSS_DETECTION_THRS: NvMBlockCrcType=NVM_CRC16, NvMBlockManagementType=NVM_BLOCK_NATIVE, NvMInitBlockCallback=NULL_PTR, NvMResistantToChangedSw=true, NvMSelectBlockForReadAll=false, NvMSelectBlockForWriteAll=false, NvMWriteRamBlockToNvCallback=NULL_PTR, NvMUseJobendCallback=false, NvMSingleBlockCallback=NULL_PTR, NvMBlockUseCrc=true, NvMCalcRamBlockCrc=false, NvMBlockJobPriority=127, NvMNvBlockLength=4, NvMNvBlockNum=1, NvMNvramBlockIdentifier=64, NvMUseServicePorts=true, NvMBlockUseSetRamBlockStatus=false, NvMRamBlockDataAddress=NULL_PTR, NvMRomBlockDataAddress=CALIB_BLOCK_ID_BATTERY_LOSS_DETECTION_THRS_RomBlockData
        NvMTargetBlockReference
          NvMFeeRef: NvMNameOfFeeBlock=Fee_CALIB_BLOCK_ID_BATTERY_LOSS_DETECTION_THRS
      CALIB_BLOCK_ID_BOOST: NvMBlockCrcType=NVM_CRC16, NvMBlockManagementType=NVM_BLOCK_NATIVE, NvMInitBlockCallback=NULL_PTR, NvMResistantToChangedSw=true, NvMSelectBlockForReadAll=false, NvMSelectBlockForWriteAll=false, NvMWriteRamBlockToNvCallback=NULL_PTR, NvMUseJobendCallback=false, NvMSingleBlockCallback=NULL_PTR, NvMBlockUseCrc=true, NvMCalcRamBlockCrc=false, NvMBlockJobPriority=127, NvMNvBlockLength=4, NvMNvBlockNum=1, NvMNvramBlockIdentifier=65, NvMUseServicePorts=true, NvMBlockUseSetRamBlockStatus=false, NvMRamBlockDataAddress=NULL_PTR, NvMRomBlockDataAddress=CALIB_BLOCK_ID_BOOST_RomBlockData
        NvMTargetBlockReference
          NvMFeeRef: NvMNameOfFeeBlock=Fee_CALIB_BLOCK_ID_BOOST
      CALIB_BLOCK_ID_ECU_PROPERTIES: NvMBlockCrcType=NVM_CRC16, NvMBlockManagementType=NVM_BLOCK_NATIVE, NvMInitBlockCallback=NULL_PTR, NvMResistantToChangedSw=true, NvMSelectBlockForReadAll=false, NvMSelectBlockForWriteAll=false, NvMWriteRamBlockToNvCallback=NULL_PTR, NvMUseJobendCallback=false, NvMSingleBlockCallback=NULL_PTR, NvMBlockUseCrc=true, NvMCalcRamBlockCrc=false, NvMBlockJobPriority=127, NvMNvBlockLength=10, NvMNvBlockNum=1, NvMNvramBlockIdentifier=66, NvMUseServicePorts=true, NvMBlockUseSetRamBlockStatus=false, NvMRamBlockDataAddress=NULL_PTR, NvMRomBlockDataAddress=CALIB_BLOCK_ID_ECU_PROPERTIES_RomBlockData
        NvMTargetBlockReference
          NvMFeeRef: NvMNameOfFeeBlock=Fee_CALIB_BLOCK_ID_ECU_PROPERTIES
      CALIB_BLOCK_ID_SW_SELF_PROTECTION_THRS: NvMBlockCrcType=NVM_CRC16, NvMBlockManagementType=NVM_BLOCK_NATIVE, NvMInitBlockCallback=NULL_PTR, NvMResistantToChangedSw=true, NvMSelectBlockForReadAll=false, NvMSelectBlockForWriteAll=false, NvMWriteRamBlockToNvCallback=NULL_PTR, NvMUseJobendCallback=false, NvMSingleBlockCallback=NULL_PTR, NvMBlockUseCrc=true, NvMCalcRamBlockCrc=false, NvMBlockJobPriority=127, NvMNvBlockLength=20, NvMNvBlockNum=1, NvMNvramBlockIdentifier=67, NvMUseServicePorts=true, NvMBlockUseSetRamBlockStatus=false, NvMRamBlockDataAddress=NULL_PTR, NvMRomBlockDataAddress=CALIB_BLOCK_ID_SW_SELF_PROTECTION_THRS_RomBlockData
        NvMTargetBlockReference
          NvMFeeRef: NvMNameOfFeeBlock=Fee_CALIB_BLOCK_ID_SW_SELF_PROTECTION_THRS
      CALIB_BLOCK_ID_MOTOR_RESIST_PARAM: NvMBlockCrcType=NVM_CRC16, NvMBlockManagementType=NVM_BLOCK_NATIVE, NvMInitBlockCallback=NULL_PTR, NvMResistantToChangedSw=true, NvMSelectBlockForReadAll=false, NvMSelectBlockForWriteAll=false, NvMWriteRamBlockToNvCallback=NULL_PTR, NvMUseJobendCallback=false, NvMSingleBlockCallback=NULL_PTR, NvMBlockUseCrc=true, NvMCalcRamBlockCrc=false, NvMBlockJobPriority=127, NvMNvBlockLength=21, NvMNvBlockNum=1, NvMNvramBlockIdentifier=68, NvMUseServicePorts=true, NvMBlockUseSetRamBlockStatus=false, NvMRamBlockDataAddress=NULL_PTR, NvMRomBlockDataAddress=CALIB_BLOCK_ID_MOTOR_RESIST_PARAM_RomBlockData
        NvMTargetBlockReference
          NvMFeeRef: NvMNameOfFeeBlock=Fee_CALIB_BLOCK_ID_MOTOR_RESIST_PARAM
      CALIB_BLOCK_ID_BOOST_ACTIVATION: NvMBlockCrcType=NVM_CRC16, NvMBlockManagementType=NVM_BLOCK_NATIVE, NvMInitBlockCallback=NULL_PTR, NvMResistantToChangedSw=true, NvMSelectBlockForReadAll=false, NvMSelectBlockForWriteAll=false, NvMWriteRamBlockToNvCallback=NULL_PTR, NvMUseJobendCallback=false, NvMSingleBlockCallback=NULL_PTR, NvMBlockUseCrc=true, NvMCalcRamBlockCrc=false, NvMBlockJobPriority=127, NvMNvBlockLength=1, NvMNvBlockNum=1, NvMNvramBlockIdentifier=69, NvMUseServicePorts=true, NvMBlockUseSetRamBlockStatus=false, NvMRamBlockDataAddress=NULL_PTR, NvMRomBlockDataAddress=CALIB_BLOCK_ID_BOOST_ACTIVATION_RomBlockData
        NvMTargetBlockReference
          NvMFeeRef: NvMNameOfFeeBlock=Fee_CALIB_BLOCK_ID_BOOST_ACTIVATION
      NVP_BLOCK_ID_MEASUREMENT_FRAME_12_CONFIG: NvMBlockCrcType=NVM_CRC32, NvMBlockManagementType=NVM_BLOCK_NATIVE, NvMInitBlockCallback=NULL_PTR, NvMResistantToChangedSw=true, NvMSelectBlockForReadAll=true, NvMSelectBlockForWriteAll=false, NvMWriteRamBlockToNvCallback=NULL_PTR, NvMUseJobendCallback=false, NvMSingleBlockCallback=NULL_PTR, NvMBlockUseCrc=true, NvMCalcRamBlockCrc=false, NvMBlockJobPriority=127, NvMNvBlockLength=5, NvMNvBlockNum=1, NvMNvramBlockIdentifier=41, NvMUseServicePorts=true, NvMBlockUseSetRamBlockStatus=true, NvMRamBlockDataAddress=NVP_BLOCK_ID_MEASUREMENT_FRAME_12_CONFIG_RamBlockData, NvMRomBlockDataAddress=NVP_BLOCK_ID_MEASUREMENT_FRAME_12_CONFIG_DefaultData
        NvMTargetBlockReference
          NvMFeeRef: NvMNameOfFeeBlock=Fee_NVP_BLOCK_ID_MEASUREMENT_FRAME_12_CONFIG
      NVP_BLOCK_ID_MEASUREMENT_FRAME_CONFIG: NvMBlockCrcType=NVM_CRC32, NvMBlockManagementType=NVM_BLOCK_NATIVE, NvMInitBlockCallback=NULL_PTR, NvMResistantToChangedSw=true, NvMSelectBlockForReadAll=true, NvMSelectBlockForWriteAll=false, NvMWriteRamBlockToNvCallback=NULL_PTR, NvMUseJobendCallback=false, NvMSingleBlockCallback=NULL_PTR, NvMBlockUseCrc=true, NvMCalcRamBlockCrc=false, NvMBlockJobPriority=127, NvMNvBlockLength=4, NvMNvBlockNum=1, NvMNvramBlockIdentifier=42, NvMUseServicePorts=true, NvMBlockUseSetRamBlockStatus=true, NvMRamBlockDataAddress=NVP_BLOCK_ID_MEASUREMENT_FRAME_CONFIG_RamBlockData, NvMRomBlockDataAddress=NVP_BLOCK_ID_MEASUREMENT_FRAME_CONFIG_DefaultData
        NvMTargetBlockReference
          NvMFeeRef: NvMNameOfFeeBlock=Fee_NVP_BLOCK_ID_MEASUREMENT_FRAME_CONFIG
      NVP_BLOCK_ID_WARM_RESET: NvMBlockCrcType=NVM_CRC16, NvMBlockManagementType=NVM_BLOCK_NATIVE, NvMInitBlockCallback=NULL_PTR, NvMResistantToChangedSw=true, NvMSelectBlockForReadAll=true, NvMSelectBlockForWriteAll=true, NvMWriteRamBlockToNvCallback=NULL_PTR, NvMUseJobendCallback=false, NvMSingleBlockCallback=NULL_PTR, NvMBlockUseCrc=true, NvMCalcRamBlockCrc=false, NvMBlockJobPriority=127, NvMNvBlockLength=8, NvMNvBlockNum=1, NvMNvramBlockIdentifier=70, NvMUseServicePorts=true, NvMBlockUseSetRamBlockStatus=true, NvMRamBlockDataAddress=NVP_BLOCK_ID_WARM_RESET_RamBlockData, NvMRomBlockDataAddress=NVP_BLOCK_ID_WARM_RESET_DefaultData
        NvMTargetBlockReference
          NvMFeeRef: NvMNameOfFeeBlock=Fee_NVP_BLOCK_ID_WARM_RESET
      NVP_BLOCK_ID_HWA_REPETITION: NvMBlockCrcType=NVM_CRC16, NvMBlockManagementType=NVM_BLOCK_NATIVE, NvMInitBlockCallback=NULL_PTR, NvMResistantToChangedSw=true, NvMSelectBlockForReadAll=true, NvMSelectBlockForWriteAll=false, NvMWriteRamBlockToNvCallback=NULL_PTR, NvMUseJobendCallback=false, NvMSingleBlockCallback=NULL_PTR, NvMBlockUseCrc=true, NvMCalcRamBlockCrc=false, NvMBlockJobPriority=127, NvMNvBlockLength=2, NvMNvBlockNum=1, NvMNvramBlockIdentifier=75, NvMUseServicePorts=true, NvMBlockUseSetRamBlockStatus=false, NvMRamBlockDataAddress=NVP_BLOCK_ID_HWA_REPETITION_RamBlockData, NvMRomBlockDataAddress=NVP_BLOCK_ID_HWA_REPETITION_DefaultData
        NvMTargetBlockReference
          NvMFeeRef: NvMNameOfFeeBlock=Fee_NVP_BLOCK_ID_HWA_REPETITION
      NVP_BLOCK_TEMP_SENSOR_TABLE: NvMBlockCrcType=NVM_CRC16, NvMBlockManagementType=NVM_BLOCK_NATIVE, NvMInitBlockCallback=NULL_PTR, NvMResistantToChangedSw=true, NvMSelectBlockForReadAll=true, NvMSelectBlockForWriteAll=false, NvMWriteRamBlockToNvCallback=NULL_PTR, NvMUseJobendCallback=false, NvMSingleBlockCallback=NULL_PTR, NvMBlockUseCrc=true, NvMCalcRamBlockCrc=false, NvMBlockJobPriority=127, NvMNvBlockLength=42, NvMNvBlockNum=1, NvMNvramBlockIdentifier=76, NvMUseServicePorts=true, NvMBlockUseSetRamBlockStatus=false, NvMRamBlockDataAddress=NVP_BLOCK_TEMP_SENSOR_TABLE_RamBlockData, NvMRomBlockDataAddress=NVP_BLOCK_TEMP_SENSOR_TABLE_DefaultData
        NvMTargetBlockReference
          NvMFeeRef: NvMNameOfFeeBlock=Fee_NVP_BLOCK_TEMP_SENSOR_TABLE
      NVP_BLOCK_ID_VELOCITY_PID_PARAM: NvMBlockCrcType=NVM_CRC16, NvMBlockManagementType=NVM_BLOCK_NATIVE, NvMInitBlockCallback=NULL_PTR, NvMResistantToChangedSw=true, NvMSelectBlockForReadAll=true, NvMSelectBlockForWriteAll=false, NvMWriteRamBlockToNvCallback=NULL_PTR, NvMUseJobendCallback=false, NvMSingleBlockCallback=NULL_PTR, NvMBlockUseCrc=true, NvMCalcRamBlockCrc=false, NvMBlockJobPriority=127, NvMNvBlockLength=30, NvMNvBlockNum=1, NvMNvramBlockIdentifier=80, NvMUseServicePorts=true, NvMBlockUseSetRamBlockStatus=false, NvMRamBlockDataAddress=NVP_BLOCK_ID_VELOCITY_PID_PARAM_RamBlockData, NvMRomBlockDataAddress=NVP_BLOCK_ID_VELOCITY_PID_PARAM_DefaultData
        NvMTargetBlockReference
          NvMFeeRef: NvMNameOfFeeBlock=FEE_NVP_BLOCK_ID_VELOCITY_PID_PARAM
      NVP_BLOCK_ID_AEC_STATUS: NvMBlockCrcType=NVM_CRC16, NvMBlockManagementType=NVM_BLOCK_NATIVE, NvMInitBlockCallback=NULL_PTR, NvMResistantToChangedSw=true, NvMSelectBlockForReadAll=true, NvMSelectBlockForWriteAll=true, NvMWriteRamBlockToNvCallback=NULL_PTR, NvMUseJobendCallback=false, NvMSingleBlockCallback=NULL_PTR, NvMBlockUseCrc=true, NvMCalcRamBlockCrc=false, NvMBlockJobPriority=127, NvMNvBlockLength=64, NvMNvBlockNum=1, NvMNvramBlockIdentifier=81, NvMUseServicePorts=true, NvMBlockUseSetRamBlockStatus=true, NvMRamBlockDataAddress=NVP_BLOCK_ID_AEC_STATUS_RamBlockData, NvMRomBlockDataAddress=NVP_BLOCK_ID_AEC_STATUS_DefaultData
        NvMTargetBlockReference
          NvMFeeRef: NvMNameOfFeeBlock=Fee_NVP_BLOCK_ID_AEC_STATUS
      NVP_BLOCK_ID_ATM_ENABLE_PARAM: NvMBlockCrcType=NVM_CRC16, NvMBlockManagementType=NVM_BLOCK_NATIVE, NvMInitBlockCallback=NULL_PTR, NvMResistantToChangedSw=true, NvMSelectBlockForReadAll=true, NvMSelectBlockForWriteAll=false, NvMWriteRamBlockToNvCallback=NULL_PTR, NvMUseJobendCallback=false, NvMSingleBlockCallback=NULL_PTR, NvMBlockUseCrc=true, NvMCalcRamBlockCrc=false, NvMBlockJobPriority=127, NvMNvBlockLength=53, NvMNvBlockNum=1, NvMNvramBlockIdentifier=82, NvMUseServicePorts=true, NvMBlockUseSetRamBlockStatus=false, NvMRamBlockDataAddress=NVP_BLOCK_ID_ATM_ENABLE_PARAM_RamBlockData, NvMRomBlockDataAddress=NVP_BLOCK_ID_ATM_ENABLE_PARAM_DefaultData
        NvMTargetBlockReference
          NvMFeeRef: NvMNameOfFeeBlock=Fee_NVP_BLOCK_ID_ATM_ENABLE_PARAM
      NvMBlock_Dem_Primary_0: NvMBlockCrcType=NVM_CRC16, NvMBlockManagementType=NVM_BLOCK_NATIVE, NvMInitBlockCallback=NULL_PTR, NvMResistantToChangedSw=false, NvMSelectBlockForReadAll=true, NvMSelectBlockForWriteAll=true, NvMWriteRamBlockToNvCallback=NULL_PTR, NvMUseJobendCallback=true, NvMSingleBlockCallback=Dem_NvM_JobFinished, NvMBlockUseCrc=true, NvMCalcRamBlockCrc=false, NvMBlockJobPriority=0, NvMNvBlockLength=36, NvMNvBlockNum=1, NvMNvramBlockIdentifier=83, NvMUseServicePorts=false, NvMBlockUseSetRamBlockStatus=true, NvMRamBlockDataAddress=Dem_Cfg_PrimaryEntry_0, NvMInitBlockCallbackExtended=Dem_NvM_InitStatusData
        NvMTargetBlockReference
          NvMFeeRef: NvMNameOfFeeBlock=Fee_Dem_Primary_0
      NvMBlock_Dem_Admin_Data: NvMBlockCrcType=NVM_CRC16, NvMBlockManagementType=NVM_BLOCK_NATIVE, NvMInitBlockCallback=NULL_PTR, NvMResistantToChangedSw=false, NvMSelectBlockForReadAll=true, NvMSelectBlockForWriteAll=true, NvMWriteRamBlockToNvCallback=NULL_PTR, NvMUseJobendCallback=true, NvMSingleBlockCallback=Dem_NvM_JobFinished, NvMBlockUseCrc=true, NvMCalcRamBlockCrc=false, NvMBlockJobPriority=0, NvMNvBlockLength=12, NvMNvBlockNum=1, NvMNvramBlockIdentifier=94, NvMUseServicePorts=false, NvMBlockUseSetRamBlockStatus=true, NvMRamBlockDataAddress=Dem_Cfg_AdminData, NvMInitBlockCallbackExtended=Dem_NvM_InitAdminData
        NvMTargetBlockReference
          NvMFeeRef: NvMNameOfFeeBlock=Fee_Dem_Admin_Data
      NvMBlock_Dem_Primary_1: NvMBlockCrcType=NVM_CRC16, NvMBlockManagementType=NVM_BLOCK_NATIVE, NvMInitBlockCallback=NULL_PTR, NvMResistantToChangedSw=false, NvMSelectBlockForReadAll=true, NvMSelectBlockForWriteAll=true, NvMWriteRamBlockToNvCallback=NULL_PTR, NvMUseJobendCallback=true, NvMSingleBlockCallback=Dem_NvM_JobFinished, NvMBlockUseCrc=true, NvMCalcRamBlockCrc=false, NvMBlockJobPriority=0, NvMNvBlockLength=36, NvMNvBlockNum=1, NvMNvramBlockIdentifier=84, NvMUseServicePorts=false, NvMBlockUseSetRamBlockStatus=true, NvMRamBlockDataAddress=Dem_Cfg_PrimaryEntry_1, NvMInitBlockCallbackExtended=Dem_NvM_InitStatusData
        NvMTargetBlockReference
          NvMFeeRef: NvMNameOfFeeBlock=Fee_Dem_Primary_1
      NvMBlock_Dem_Primary_2: NvMBlockCrcType=NVM_CRC16, NvMBlockManagementType=NVM_BLOCK_NATIVE, NvMInitBlockCallback=NULL_PTR, NvMResistantToChangedSw=false, NvMSelectBlockForReadAll=true, NvMSelectBlockForWriteAll=true, NvMWriteRamBlockToNvCallback=NULL_PTR, NvMUseJobendCallback=true, NvMSingleBlockCallback=Dem_NvM_JobFinished, NvMBlockUseCrc=true, NvMCalcRamBlockCrc=false, NvMBlockJobPriority=0, NvMNvBlockLength=36, NvMNvBlockNum=1, NvMNvramBlockIdentifier=85, NvMUseServicePorts=false, NvMBlockUseSetRamBlockStatus=true, NvMRamBlockDataAddress=Dem_Cfg_PrimaryEntry_2, NvMInitBlockCallbackExtended=Dem_NvM_InitStatusData
        NvMTargetBlockReference
          NvMFeeRef: NvMNameOfFeeBlock=Fee_Dem_Primary_2
      NvMBlock_Dem_Primary_3: NvMBlockCrcType=NVM_CRC16, NvMBlockManagementType=NVM_BLOCK_NATIVE, NvMInitBlockCallback=NULL_PTR, NvMResistantToChangedSw=false, NvMSelectBlockForReadAll=true, NvMSelectBlockForWriteAll=true, NvMWriteRamBlockToNvCallback=NULL_PTR, NvMUseJobendCallback=true, NvMSingleBlockCallback=Dem_NvM_JobFinished, NvMBlockUseCrc=true, NvMCalcRamBlockCrc=false, NvMBlockJobPriority=0, NvMNvBlockLength=36, NvMNvBlockNum=1, NvMNvramBlockIdentifier=86, NvMUseServicePorts=false, NvMBlockUseSetRamBlockStatus=true, NvMRamBlockDataAddress=Dem_Cfg_PrimaryEntry_3, NvMInitBlockCallbackExtended=Dem_NvM_InitStatusData
        NvMTargetBlockReference
          NvMFeeRef: NvMNameOfFeeBlock=Fee_Dem_Primary_3
      NvMBlock_Dem_Primary_4: NvMBlockCrcType=NVM_CRC16, NvMBlockManagementType=NVM_BLOCK_NATIVE, NvMInitBlockCallback=NULL_PTR, NvMResistantToChangedSw=false, NvMSelectBlockForReadAll=true, NvMSelectBlockForWriteAll=true, NvMWriteRamBlockToNvCallback=NULL_PTR, NvMUseJobendCallback=true, NvMSingleBlockCallback=Dem_NvM_JobFinished, NvMBlockUseCrc=true, NvMCalcRamBlockCrc=false, NvMBlockJobPriority=0, NvMNvBlockLength=36, NvMNvBlockNum=1, NvMNvramBlockIdentifier=87, NvMUseServicePorts=false, NvMBlockUseSetRamBlockStatus=true, NvMRamBlockDataAddress=Dem_Cfg_PrimaryEntry_4, NvMInitBlockCallbackExtended=Dem_NvM_InitStatusData
        NvMTargetBlockReference
          NvMFeeRef: NvMNameOfFeeBlock=Fee_Dem_Primary_4
      NvMBlock_Dem_Primary_5: NvMBlockCrcType=NVM_CRC16, NvMBlockManagementType=NVM_BLOCK_NATIVE, NvMInitBlockCallback=NULL_PTR, NvMResistantToChangedSw=false, NvMSelectBlockForReadAll=true, NvMSelectBlockForWriteAll=true, NvMWriteRamBlockToNvCallback=NULL_PTR, NvMUseJobendCallback=true, NvMSingleBlockCallback=Dem_NvM_JobFinished, NvMBlockUseCrc=true, NvMCalcRamBlockCrc=false, NvMBlockJobPriority=0, NvMNvBlockLength=36, NvMNvBlockNum=1, NvMNvramBlockIdentifier=88, NvMUseServicePorts=false, NvMBlockUseSetRamBlockStatus=true, NvMRamBlockDataAddress=Dem_Cfg_PrimaryEntry_5, NvMInitBlockCallbackExtended=Dem_NvM_InitStatusData
        NvMTargetBlockReference
          NvMFeeRef: NvMNameOfFeeBlock=Fee_Dem_Primary_5
      NvMBlock_Dem_Primary_6: NvMBlockCrcType=NVM_CRC16, NvMBlockManagementType=NVM_BLOCK_NATIVE, NvMInitBlockCallback=NULL_PTR, NvMResistantToChangedSw=false, NvMSelectBlockForReadAll=true, NvMSelectBlockForWriteAll=true, NvMWriteRamBlockToNvCallback=NULL_PTR, NvMUseJobendCallback=true, NvMSingleBlockCallback=Dem_NvM_JobFinished, NvMBlockUseCrc=true, NvMCalcRamBlockCrc=false, NvMBlockJobPriority=0, NvMNvBlockLength=36, NvMNvBlockNum=1, NvMNvramBlockIdentifier=89, NvMUseServicePorts=false, NvMBlockUseSetRamBlockStatus=true, NvMRamBlockDataAddress=Dem_Cfg_PrimaryEntry_6, NvMInitBlockCallbackExtended=Dem_NvM_InitStatusData
        NvMTargetBlockReference
          NvMFeeRef: NvMNameOfFeeBlock=Fee_Dem_Primary_6
      NvMBlock_Dem_Primary_7: NvMBlockCrcType=NVM_CRC16, NvMBlockManagementType=NVM_BLOCK_NATIVE, NvMInitBlockCallback=NULL_PTR, NvMResistantToChangedSw=false, NvMSelectBlockForReadAll=true, NvMSelectBlockForWriteAll=true, NvMWriteRamBlockToNvCallback=NULL_PTR, NvMUseJobendCallback=true, NvMSingleBlockCallback=Dem_NvM_JobFinished, NvMBlockUseCrc=true, NvMCalcRamBlockCrc=false, NvMBlockJobPriority=0, NvMNvBlockLength=36, NvMNvBlockNum=1, NvMNvramBlockIdentifier=90, NvMUseServicePorts=false, NvMBlockUseSetRamBlockStatus=true, NvMRamBlockDataAddress=Dem_Cfg_PrimaryEntry_7, NvMInitBlockCallbackExtended=Dem_NvM_InitStatusData
        NvMTargetBlockReference
          NvMFeeRef: NvMNameOfFeeBlock=Fee_Dem_Primary_7
      NvMBlock_Dem_Primary_8: NvMBlockCrcType=NVM_CRC16, NvMBlockManagementType=NVM_BLOCK_NATIVE, NvMInitBlockCallback=NULL_PTR, NvMResistantToChangedSw=false, NvMSelectBlockForReadAll=true, NvMSelectBlockForWriteAll=true, NvMWriteRamBlockToNvCallback=NULL_PTR, NvMUseJobendCallback=true, NvMSingleBlockCallback=Dem_NvM_JobFinished, NvMBlockUseCrc=true, NvMCalcRamBlockCrc=false, NvMBlockJobPriority=0, NvMNvBlockLength=36, NvMNvBlockNum=1, NvMNvramBlockIdentifier=91, NvMUseServicePorts=false, NvMBlockUseSetRamBlockStatus=true, NvMRamBlockDataAddress=Dem_Cfg_PrimaryEntry_8, NvMInitBlockCallbackExtended=Dem_NvM_InitStatusData
        NvMTargetBlockReference
          NvMFeeRef: NvMNameOfFeeBlock=Fee_Dem_Primary_8
      NvMBlock_Dem_Primary_9: NvMBlockCrcType=NVM_CRC16, NvMBlockManagementType=NVM_BLOCK_NATIVE, NvMInitBlockCallback=NULL_PTR, NvMResistantToChangedSw=false, NvMSelectBlockForReadAll=true, NvMSelectBlockForWriteAll=true, NvMWriteRamBlockToNvCallback=NULL_PTR, NvMUseJobendCallback=true, NvMSingleBlockCallback=Dem_NvM_JobFinished, NvMBlockUseCrc=true, NvMCalcRamBlockCrc=false, NvMBlockJobPriority=0, NvMNvBlockLength=36, NvMNvBlockNum=1, NvMNvramBlockIdentifier=92, NvMUseServicePorts=false, NvMBlockUseSetRamBlockStatus=true, NvMRamBlockDataAddress=Dem_Cfg_PrimaryEntry_9, NvMInitBlockCallbackExtended=Dem_NvM_InitStatusData
        NvMTargetBlockReference
          NvMFeeRef: NvMNameOfFeeBlock=Fee_Dem_Primary_9
      NvMBlock_Dem_Status: NvMBlockCrcType=NVM_CRC16, NvMBlockManagementType=NVM_BLOCK_NATIVE, NvMInitBlockCallback=NULL_PTR, NvMResistantToChangedSw=false, NvMSelectBlockForReadAll=true, NvMSelectBlockForWriteAll=true, NvMWriteRamBlockToNvCallback=NULL_PTR, NvMUseJobendCallback=true, NvMSingleBlockCallback=Dem_NvM_JobFinished, NvMBlockUseCrc=true, NvMCalcRamBlockCrc=false, NvMBlockJobPriority=0, NvMNvBlockLength=94, NvMNvBlockNum=1, NvMNvramBlockIdentifier=93, NvMUseServicePorts=false, NvMBlockUseSetRamBlockStatus=true, NvMRamBlockDataAddress=Dem_Cfg_StatusData, NvMInitBlockCallbackExtended=Dem_NvM_InitStatusData
        NvMTargetBlockReference
          NvMFeeRef: NvMNameOfFeeBlock=Fee_Dem_Status
      NvMBlockDescriptor_SecAccessDelayFlag: NvMBlockCrcType=NVM_CRC16, NvMBlockManagementType=NVM_BLOCK_NATIVE, NvMInitBlockCallback=NULL_PTR, NvMResistantToChangedSw=false, NvMSelectBlockForReadAll=false, NvMSelectBlockForWriteAll=false, NvMWriteRamBlockToNvCallback=NULL_PTR, NvMUseJobendCallback=false, NvMSingleBlockCallback=NULL_PTR, NvMBlockUseCrc=false, NvMCalcRamBlockCrc=false, NvMBlockJobPriority=127, NvMNvBlockLength=1, NvMNvBlockNum=1, NvMNvramBlockIdentifier=95, NvMUseServicePorts=false, NvMBlockUseSetRamBlockStatus=false
        NvMTargetBlockReference
          NvMFeeRef: NvMNameOfFeeBlock=FeeBlockDescriptor_SecAccessDelayFlag
      NvMBlockDescriptor_VerificationKey: NvMBlockCrcType=NVM_CRC16, NvMBlockManagementType=NVM_BLOCK_NATIVE, NvMInitBlockCallback=NULL_PTR, NvMResistantToChangedSw=false, NvMSelectBlockForReadAll=false, NvMSelectBlockForWriteAll=false, NvMWriteRamBlockToNvCallback=NULL_PTR, NvMUseJobendCallback=false, NvMSingleBlockCallback=NULL_PTR, NvMBlockUseCrc=false, NvMCalcRamBlockCrc=false, NvMBlockJobPriority=127, NvMNvBlockLength=33, NvMNvBlockNum=1, NvMNvramBlockIdentifier=96, NvMUseServicePorts=false, NvMBlockUseSetRamBlockStatus=false
        NvMTargetBlockReference
          NvMFeeRef: NvMNameOfFeeBlock=FeeBlockDescriptor_VerificationKey
      Ssa_KeyM_NvM_KeyM_TrustModelChainOfTrustState: NvMBlockJobPriority=127, NvMBlockManagementType=NVM_BLOCK_NATIVE, NvMBlockUseCrc=false, NvMNvBlockLength=1, NvMNvBlockNum=1, NvMNvramBlockIdentifier=97, NvMResistantToChangedSw=true, NvMUseServicePorts=true, NvMUseJobendCallback=false, NvMBlockUseSetRamBlockStatus=true, NvMSelectBlockForReadAll=true, NvMRamBlockDataAddress=Rte_Ssa_KeyM_KeyMTrustModelChainOfTrustState, NvMRomBlockDataAddress=Rte_Ssa_KeyM_NvM_KeyM_TrustModelChainOfTrustState_DefaultValue, NvMSelectBlockForWriteAll=false  # UC:Derived from NvBlockNeeds
        NvMTargetBlockReference
          NvMFeeRef: NvMNameOfFeeBlock=FeeSsa_KeyM_NvM_KeyM_TrustModelChainOfTrustState
      NVP_BLOCK_ID_PRE_SAFE_RECORDER_1: NvMBlockCrcType=NVM_CRC16, NvMBlockManagementType=NVM_BLOCK_NATIVE, NvMInitBlockCallback=NULL_PTR, NvMResistantToChangedSw=true, NvMSelectBlockForReadAll=true, NvMSelectBlockForWriteAll=true, NvMWriteRamBlockToNvCallback=NULL_PTR, NvMUseJobendCallback=false, NvMSingleBlockCallback=NULL_PTR, NvMBlockUseCrc=true, NvMCalcRamBlockCrc=false, NvMBlockJobPriority=127, NvMNvBlockLength=22, NvMNvBlockNum=1, NvMNvramBlockIdentifier=71, NvMUseServicePorts=true, NvMBlockUseSetRamBlockStatus=false, NvMRamBlockDataAddress=NVP_BLOCK_ID_PRE_SAFE_RECORDER_1_RamBlockData, NvMRomBlockDataAddress=NVP_BLOCK_ID_PRE_SAFE_RECORDER_1_DefaultData
        NvMTargetBlockReference
          NvMFeeRef: NvMNameOfFeeBlock=Fee_NVP_BLOCK_ID_PRE_SAFE_RECORDER_1
      NVP_BLOCK_ID_PRE_SAFE_RECORDER_2: NvMBlockCrcType=NVM_CRC16, NvMBlockManagementType=NVM_BLOCK_NATIVE, NvMInitBlockCallback=NULL_PTR, NvMResistantToChangedSw=true, NvMSelectBlockForReadAll=true, NvMSelectBlockForWriteAll=true, NvMWriteRamBlockToNvCallback=NULL_PTR, NvMUseJobendCallback=false, NvMSingleBlockCallback=NULL_PTR, NvMBlockUseCrc=true, NvMCalcRamBlockCrc=false, NvMBlockJobPriority=127, NvMNvBlockLength=22, NvMNvBlockNum=1, NvMNvramBlockIdentifier=74, NvMUseServicePorts=true, NvMBlockUseSetRamBlockStatus=false, NvMRamBlockDataAddress=NVP_BLOCK_ID_PRE_SAFE_RECORDER_2_RamBlockData, NvMRomBlockDataAddress=NVP_BLOCK_ID_PRE_SAFE_RECORDER_2_DefaultData
        NvMTargetBlockReference
          NvMFeeRef: NvMNameOfFeeBlock=Fee_NVP_BLOCK_ID_PRE_SAFE_RECORDER_2
      Rtm_CpuLoadPersistencyData: NvMBlockJobPriority=127, NvMBlockManagementType=NVM_BLOCK_NATIVE, NvMBlockUseCrc=false, NvMNvBlockLength=48, NvMNvBlockNum=1, NvMNvramBlockIdentifier=98, NvMResistantToChangedSw=true, NvMUseServicePorts=false, NvMUseJobendCallback=false, NvMBlockUseSetRamBlockStatus=true, NvMSelectBlockForReadAll=true, NvMSelectBlockForWriteAll=true, NvMBlockLengthCheck=true, NvMBlockLengthCheckType=true, NvMRamBlockDataAddress=Rtm_CpuLoadPersistencyData
        NvMTargetBlockReference
          NvMFeeRef: NvMNameOfFeeBlock=Fee_Rtm_CpuLoadPersistencyData
      Rtm_MaxTaskStackUsage: NvMBlockJobPriority=127, NvMBlockManagementType=NVM_BLOCK_NATIVE, NvMBlockUseCrc=false, NvMNvBlockLength=44, NvMNvBlockNum=1, NvMNvramBlockIdentifier=99, NvMResistantToChangedSw=true, NvMUseServicePorts=false, NvMUseJobendCallback=false, NvMBlockUseSetRamBlockStatus=true, NvMSelectBlockForReadAll=true, NvMSelectBlockForWriteAll=true, NvMBlockLengthCheck=true, NvMBlockLengthCheckType=true, NvMRamBlockDataAddress=Rtm_MaxTaskStackUsage
        NvMTargetBlockReference
          NvMFeeRef: NvMNameOfFeeBlock=Fee_Rtm_MaxTaskStackUsage
      NVP_BLOCK_ID_PRE_SAFE_RECORDER_ID: NvMBlockCrcType=NVM_CRC16, NvMBlockManagementType=NVM_BLOCK_NATIVE, NvMInitBlockCallback=NULL_PTR, NvMResistantToChangedSw=true, NvMSelectBlockForReadAll=true, NvMSelectBlockForWriteAll=true, NvMWriteRamBlockToNvCallback=NULL_PTR, NvMUseJobendCallback=false, NvMSingleBlockCallback=NULL_PTR, NvMBlockUseCrc=true, NvMCalcRamBlockCrc=false, NvMBlockJobPriority=127, NvMNvBlockLength=1, NvMNvBlockNum=1, NvMNvramBlockIdentifier=72, NvMUseServicePorts=true, NvMBlockUseSetRamBlockStatus=false, NvMRamBlockDataAddress=NVP_BLOCK_ID_PRE_SAFE_RECORDER_ID_RamBlockData, NvMRomBlockDataAddress=NVP_BLOCK_ID_PRE_SAFE_RECORDER_ID_DefaultData
        NvMTargetBlockReference
          NvMFeeRef: NvMNameOfFeeBlock=Fee_NVP_BLOCK_ID_PRE_SAFE_RECORDER_ID
      NVP_BLOCK_ID_SYSTEM_CONTEXT_0: NvMBlockCrcType=NVM_CRC16, NvMBlockManagementType=NVM_BLOCK_NATIVE, NvMInitBlockCallback=NULL_PTR, NvMResistantToChangedSw=true, NvMSelectBlockForReadAll=true, NvMSelectBlockForWriteAll=true, NvMWriteRamBlockToNvCallback=NULL_PTR, NvMUseJobendCallback=false, NvMSingleBlockCallback=NULL_PTR, NvMBlockUseCrc=true, NvMCalcRamBlockCrc=false, NvMBlockJobPriority=127, NvMNvBlockLength=12, NvMNvBlockNum=1, NvMNvramBlockIdentifier=77, NvMUseServicePorts=true, NvMBlockUseSetRamBlockStatus=false, NvMRamBlockDataAddress=NVP_BLOCK_ID_SYSTEM_CONTEXT_0_RamBlockData, NvMRomBlockDataAddress=
        NvMTargetBlockReference
          NvMFeeRef: NvMNameOfFeeBlock=NVP_BLOCK_ID_SYSTEM_CONTEXT_0
      NVP_BLOCK_ID_SYSTEM_CONTEXT_1: NvMBlockCrcType=NVM_CRC16, NvMBlockManagementType=NVM_BLOCK_NATIVE, NvMInitBlockCallback=NULL_PTR, NvMResistantToChangedSw=true, NvMSelectBlockForReadAll=true, NvMSelectBlockForWriteAll=true, NvMWriteRamBlockToNvCallback=NULL_PTR, NvMUseJobendCallback=false, NvMSingleBlockCallback=NULL_PTR, NvMBlockUseCrc=true, NvMCalcRamBlockCrc=false, NvMBlockJobPriority=127, NvMNvBlockLength=12, NvMNvBlockNum=1, NvMNvramBlockIdentifier=78, NvMUseServicePorts=true, NvMBlockUseSetRamBlockStatus=false, NvMRamBlockDataAddress=NVP_BLOCK_ID_SYSTEM_CONTEXT_1_RamBlockData, NvMRomBlockDataAddress=
        NvMTargetBlockReference
          NvMFeeRef: NvMNameOfFeeBlock=NVP_BLOCK_ID_SYSTEM_CONTEXT_1
      NVP_BLOCK_ID_SYSTEM_CONTEXT_2: NvMBlockCrcType=NVM_CRC16, NvMBlockManagementType=NVM_BLOCK_NATIVE, NvMInitBlockCallback=NULL_PTR, NvMResistantToChangedSw=true, NvMSelectBlockForReadAll=true, NvMSelectBlockForWriteAll=true, NvMWriteRamBlockToNvCallback=NULL_PTR, NvMUseJobendCallback=false, NvMSingleBlockCallback=NULL_PTR, NvMBlockUseCrc=true, NvMCalcRamBlockCrc=false, NvMBlockJobPriority=127, NvMNvBlockLength=12, NvMNvBlockNum=1, NvMNvramBlockIdentifier=79, NvMUseServicePorts=true, NvMBlockUseSetRamBlockStatus=false, NvMRamBlockDataAddress=NVP_BLOCK_ID_SYSTEM_CONTEXT_2_RamBlockData, NvMRomBlockDataAddress=
        NvMTargetBlockReference
          NvMFeeRef: NvMNameOfFeeBlock=NVP_BLOCK_ID_SYSTEM_CONTEXT_2
      NVP_BLOCK_ID_CYCLE_DELAYS_MB: NvMBlockCrcType=NVM_CRC16, NvMBlockManagementType=NVM_BLOCK_NATIVE, NvMInitBlockCallback=NULL_PTR, NvMResistantToChangedSw=true, NvMSelectBlockForReadAll=true, NvMSelectBlockForWriteAll=false, NvMWriteRamBlockToNvCallback=NULL_PTR, NvMUseJobendCallback=false, NvMSingleBlockCallback=NULL_PTR, NvMBlockUseCrc=true, NvMCalcRamBlockCrc=false, NvMBlockJobPriority=127, NvMNvBlockLength=9, NvMNvBlockNum=1, NvMNvramBlockIdentifier=44, NvMUseServicePorts=true, NvMBlockUseSetRamBlockStatus=true, NvMRamBlockDataAddress=NVP_BLOCK_ID_CYCLE_DELAYS_MB_RamBlockData, NvMRomBlockDataAddress=NVP_BLOCK_ID_CYCLE_DELAYS_MB_DefaultData
        NvMTargetBlockReference
          NvMFeeRef: NvMNameOfFeeBlock=Fee_NVP_BLOCK_ID_CYCLE_DELAYS_MB
      NVP_BLOCK_ID_HAPTIC_CONFIG_MB: NvMBlockCrcType=NVM_CRC16, NvMBlockManagementType=NVM_BLOCK_NATIVE, NvMInitBlockCallback=NULL_PTR, NvMResistantToChangedSw=true, NvMSelectBlockForReadAll=true, NvMSelectBlockForWriteAll=false, NvMWriteRamBlockToNvCallback=NULL_PTR, NvMUseJobendCallback=false, NvMSingleBlockCallback=NULL_PTR, NvMBlockUseCrc=true, NvMCalcRamBlockCrc=false, NvMBlockJobPriority=127, NvMNvBlockLength=9, NvMNvBlockNum=1, NvMNvramBlockIdentifier=45, NvMUseServicePorts=true, NvMBlockUseSetRamBlockStatus=true, NvMRamBlockDataAddress=NVP_BLOCK_ID_HAPTIC_CONFIG_MB_RamBlockData, NvMRomBlockDataAddress=NVP_BLOCK_ID_HAPTIC_CONFIG_MB_DefaultData
        NvMTargetBlockReference
          NvMFeeRef: NvMNameOfFeeBlock=Fee_NVP_BLOCK_ID_HAPTIC_CONFIG_MB
      NVP_BLOCK_ID_EOL_MAPPING_MB: NvMBlockCrcType=NVM_CRC16, NvMBlockManagementType=NVM_BLOCK_NATIVE, NvMInitBlockCallback=NULL_PTR, NvMResistantToChangedSw=true, NvMSelectBlockForReadAll=true, NvMSelectBlockForWriteAll=false, NvMWriteRamBlockToNvCallback=NULL_PTR, NvMUseJobendCallback=false, NvMSingleBlockCallback=NULL_PTR, NvMBlockUseCrc=true, NvMCalcRamBlockCrc=false, NvMBlockJobPriority=127, NvMNvBlockLength=12, NvMNvBlockNum=1, NvMNvramBlockIdentifier=46, NvMUseServicePorts=true, NvMBlockUseSetRamBlockStatus=true, NvMRamBlockDataAddress=NVP_BLOCK_ID_EOL_MAPPING_MB_RamBlockData, NvMRomBlockDataAddress=NVP_BLOCK_ID_EOL_MAPPING_MB_DefaultData
        NvMTargetBlockReference
          NvMFeeRef: NvMNameOfFeeBlock=Fee_NVP_BLOCK_ID_EOL_MAPPING_MB
      NVP_BLOCK_ID_HW_VERSION: NvMBlockCrcType=NVM_CRC16, NvMBlockManagementType=NVM_BLOCK_NATIVE, NvMInitBlockCallback=NULL_PTR, NvMResistantToChangedSw=false, NvMSelectBlockForReadAll=true, NvMSelectBlockForWriteAll=true, NvMWriteRamBlockToNvCallback=NULL_PTR, NvMUseJobendCallback=false, NvMSingleBlockCallback=NULL_PTR, NvMBlockUseCrc=true, NvMCalcRamBlockCrc=false, NvMBlockJobPriority=127, NvMNvBlockLength=3, NvMNvBlockNum=1, NvMNvramBlockIdentifier=37, NvMUseServicePorts=true, NvMBlockUseSetRamBlockStatus=true, NvMRamBlockDataAddress=NVP_BLOCK_ID_HW_VERSION_RamBlockData, NvMRomBlockDataAddress=NVP_BLOCK_ID_HW_VERSION_DefaultData
        NvMTargetBlockReference
          NvMFeeRef: NvMNameOfFeeBlock=Fee_NVP_BLOCK_ID_HW_VERSION
      NVP_BLOCK_ID_CAN_INPUT_SIGNALS: NvMBlockCrcType=NVM_CRC16, NvMBlockManagementType=NVM_BLOCK_NATIVE, NvMInitBlockCallback=NULL_PTR, NvMResistantToChangedSw=true, NvMSelectBlockForReadAll=true, NvMSelectBlockForWriteAll=true, NvMWriteRamBlockToNvCallback=NULL_PTR, NvMUseJobendCallback=false, NvMSingleBlockCallback=NULL_PTR, NvMBlockUseCrc=true, NvMCalcRamBlockCrc=false, NvMBlockJobPriority=127, NvMNvBlockLength=3, NvMNvBlockNum=1, NvMNvramBlockIdentifier=73, NvMUseServicePorts=true, NvMBlockUseSetRamBlockStatus=false, NvMRamBlockDataAddress=NVP_BLOCK_ID_CAN_INPUT_SIGNALS_RamBlockData, NvMRomBlockDataAddress=NVP_BLOCK_ID_CAN_INPUT_SIGNALS_DefaultData
        NvMTargetBlockReference
          NvMFeeRef: NvMNameOfFeeBlock=Fee_NVP_BLOCK_ID_CAN_INPUT_SIGNALS
      NVP_BLOCK_ID_PCBA_PPN: NvMBlockJobPriority=127, NvMBlockManagementType=NVM_BLOCK_NATIVE, NvMBlockUseCrc=true, NvMNvBlockLength=10, NvMNvBlockNum=1, NvMNvramBlockIdentifier=100, NvMResistantToChangedSw=true, NvMUseServicePorts=true, NvMUseJobendCallback=false, NvMBlockUseSetRamBlockStatus=true, NvMBlockCrcType=NVM_CRC16, NvMRamBlockDataAddress=NVP_BLOCK_ID_PCBA_PPN_RamBlockData, NvMRomBlockDataAddress=NVP_BLOCK_ID_PCBA_PPN_DefaultData, NvMSelectBlockForReadAll=true, NvMSelectBlockForWriteAll=false, NvMSingleBlockCallback=NULL_PTR, NvMWriteRamBlockToNvCallback=NULL_PTR
        NvMTargetBlockReference
          NvMFeeRef: NvMNameOfFeeBlock=Fee_NVP_BLOCK_ID_PCBA_PPN
      NVP_BLOCK_ID_CSR_SUPPLIER_SIGNATURE: NvMBlockJobPriority=127, NvMBlockManagementType=NVM_BLOCK_NATIVE, NvMBlockUseCrc=true, NvMNvBlockLength=258, NvMNvBlockNum=1, NvMNvramBlockIdentifier=101, NvMResistantToChangedSw=true, NvMUseServicePorts=true, NvMUseJobendCallback=false, NvMBlockUseSetRamBlockStatus=false, NvMBlockCrcType=NVM_CRC16, NvMCalcRamBlockCrc=false, NvMSelectBlockForReadAll=true, NvMSelectBlockForWriteAll=false, NvMRamBlockDataAddress=NVP_BLOCK_ID_CSR_SUPPLIER_SIGNATURE_RamBlockData, NvMRomBlockDataAddress=NVP_BLOCK_ID_CSR_SUPPLIER_SIGNATURE_DefaultData
        NvMTargetBlockReference
          NvMFeeRef: NvMNameOfFeeBlock=Fee_NVP_BLOCK_ID_CSR_SUPPLIER_SIGNATURE
      NVP_BLOCK_ID_HW_PARTNUMBER: NvMBlockJobPriority=127, NvMBlockManagementType=NVM_BLOCK_NATIVE, NvMBlockUseCrc=false, NvMNvBlockLength=20, NvMNvBlockNum=1, NvMNvramBlockIdentifier=102, NvMResistantToChangedSw=true, NvMUseServicePorts=true, NvMUseJobendCallback=false, NvMBlockUseSetRamBlockStatus=false, NvMSelectBlockForReadAll=true, NvMRamBlockDataAddress=NVP_BLOCK_ID_HW_PARTNUMBER_RamBlockData, NvMRomBlockDataAddress=NVP_BLOCK_ID_HW_PARTNUMBER_DefaultData
        NvMTargetBlockReference
          NvMFeeRef: NvMNameOfFeeBlock=NVP_BLOCK_ID_HW_PARTNUMBER
