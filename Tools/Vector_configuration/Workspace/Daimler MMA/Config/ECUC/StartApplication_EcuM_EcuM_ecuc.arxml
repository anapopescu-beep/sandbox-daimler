AUTOSAR XML (schema 00049)
package /ActiveEcuC
  module config EcuM: implementation-config-variant=VARIANT-POST-BUILD-SELECTABLE, module-description=EcuM_Impl
    EcuMConfiguration
      EcuMFlexConfiguration: EcuMFlexModuleConfigurationRef=CanConfigSet, EcuMNormalMcuModeRef=McuModeSettingConf_0
        ECUM_CAUSE_UNKNOWN (EcuMShutdownCause): EcuMShutdownCauseId=0
        ECUM_RESET_IO (EcuMResetMode): EcuMResetModeId=2
        ECUM_RESET_MCU (EcuMResetMode): EcuMResetModeId=0
        ECUM_CAUSE_DCM (EcuMShutdownCause): EcuMShutdownCauseId=3
        ECUM_RESET_WAKEUP (EcuMResetMode): EcuMResetModeId=3
        ECUM_CAUSE_ECU_STATE (EcuMShutdownCause): EcuMShutdownCauseId=1
        ECUM_RESET_WDG (EcuMResetMode): EcuMResetModeId=1
        ECUM_CAUSE_WDGM (EcuMShutdownCause): EcuMShutdownCauseId=2
      EcuMCommonConfiguration: EcuMConfigConsistencyHash=18271937665328594505, EcuMDefaultAppMode=OSDEFAULTAPPMODE, EcuMOSResource=OsResource_EcuM
        ECUM_WKSOURCE_POWER (EcuMWakeupSource): EcuMWakeupSourceId=0, EcuMValidationTimeout=0, EcuMCheckWakeupTimeout=0, EcuMWakeupSourcePolling=false
        EcuMDriverInitListOne
          4 x EcuMDriverInitItem:
            PduR_PreInit: EcuMModuleID=PduR, EcuMModuleHeader=PduR.h, EcuMModuleService=PduR_PreInit
            BswM_PreInit: EcuMModuleID=BswM, EcuMModuleHeader=BswM.h, EcuMModuleService=BswM_PreInit
            Mcu_Init: EcuMModuleID=Mcu, EcuMModuleHeader=Mcu.h, EcuMModuleService=Mcu_Init, EcuMAdditionalInitCode=
            E2EXf_Init: EcuMModuleID=E2EXf, EcuMModuleHeader=E2EXf.h, EcuMModuleService=E2EXf_Init
        3 x EcuMWakeupSource, all with EcuMValidationTimeout=0, EcuMCheckWakeupTimeout=0, EcuMWakeupSourcePolling=false:
          ECUM_WKSOURCE_INTERNAL_WDG: EcuMWakeupSourceId=3
          ECUM_WKSOURCE_INTERNAL_RESET: EcuMWakeupSourceId=2
          ECUM_WKSOURCE_RESET: EcuMWakeupSourceId=1
        EcuMDefaultShutdownTarget: EcuMDefaultState=EcuMStateOff
        EcuMDriverRestartList
        ECUM_WKSOURCE_EXTERNAL_WDG (EcuMWakeupSource): EcuMWakeupSourceId=4, EcuMValidationTimeout=0, EcuMCheckWakeupTimeout=0, EcuMWakeupSourcePolling=false
        EcuMDriverInitListZero
          23 x EcuMDriverInitItem:
            Crypto_30_vHsm_InitMemory: index=34, EcuMModuleID=Crypto, EcuMModuleService=Crypto_30_vHsm_InitMemory, EcuMModuleHeader=Crypto_30_vHsm.h
            Crypto_30_LibCv_InitMemory: index=34, EcuMModuleID=Crypto, EcuMModuleService=Crypto_30_LibCv_InitMemory, EcuMModuleHeader=Crypto_30_LibCv.h
            CryIf_InitMemory: index=9, EcuMModuleID=CryIf, EcuMModuleService=CryIf_InitMemory, EcuMModuleHeader=CryIf.h
            Csm_InitMemory: index=11, EcuMModuleID=Csm, EcuMModuleService=Csm_InitMemory, EcuMModuleHeader=Csm.h
            IpduM_InitMemory: index=15, EcuMModuleID=IpduM, EcuMModuleService=IpduM_InitMemory, EcuMModuleHeader=IpduM.h
            SecOC_InitMemory: index=38, EcuMModuleID=SecOC, EcuMModuleService=SecOC_InitMemory, EcuMModuleHeader=SecOC.h
            PduR_InitMemory: index=0, EcuMModuleID=PduR, EcuMModuleService=PduR_InitMemory, EcuMModuleHeader=PduR.h
            ComM_InitMemory: index=1, EcuMModuleID=ComM, EcuMModuleService=ComM_InitMemory, EcuMModuleHeader=ComM.h
            Det_InitMemory: index=2, EcuMModuleID=Det, EcuMModuleService=Det_InitMemory, EcuMModuleHeader=Det.h
            Rte_InitMemory: index=3, EcuMModuleID=Rte, EcuMModuleService=Rte_InitMemory, EcuMModuleHeader=Rte_Main.h
            BswM_InitMemory: index=4, EcuMModuleID=BswM, EcuMModuleService=BswM_InitMemory, EcuMModuleHeader=BswM.h
            Det_Init: index=5, EcuMModuleID=Det, EcuMModuleService=Det_Init, EcuMModuleHeader=Det.h
            CanIf_InitMemory: index=6, EcuMModuleID=CanIf, EcuMModuleService=CanIf_InitMemory, EcuMModuleHeader=CanIf.h
            CanTp_InitMemory: index=7, EcuMModuleID=CanTp, EcuMModuleService=CanTp_InitMemory, EcuMModuleHeader=CanTp.h
            Dcm_InitMemory: index=8, EcuMModuleID=Dcm, EcuMModuleService=Dcm_InitMemory, EcuMModuleHeader=Dcm.h
            Dem_InitMemory: index=9, EcuMModuleID=Dem, EcuMModuleService=Dem_InitMemory, EcuMModuleHeader=Dem.h
            Com_InitMemory: index=10, EcuMModuleID=Com, EcuMModuleService=Com_InitMemory, EcuMModuleHeader=Com.h
            CanSM_InitMemory: index=11, EcuMModuleID=CanSM, EcuMModuleService=CanSM_InitMemory, EcuMModuleHeader=CanSM_EcuM.h
            Can_InitMemory: index=12, EcuMModuleID=Can, EcuMModuleService=Can_InitMemory, EcuMModuleHeader=Can.h
            Dem_PreInit: index=13, EcuMModuleID=Dem, EcuMModuleService=Dem_PreInit, EcuMModuleHeader=Dem.h
            CanNm_InitMemory: index=14, EcuMModuleID=CanNm, EcuMModuleService=CanNm_InitMemory, EcuMModuleHeader=CanNm.h
            Nm_InitMemory: index=15, EcuMModuleID=Nm, EcuMModuleService=Nm_InitMemory, EcuMModuleHeader=Nm.h
            E2EXf_InitMemory: EcuMModuleID=E2EXf, EcuMModuleHeader=E2EXf.h, EcuMModuleService=E2EXf_InitMemory
        RBTM_FL_BODY3_8uqv9blm85ehm0msat385m76v_03d5f5f6 (EcuMWakeupSource):
          EcuMWakeupSourceId = 5
          EcuMWakeupSourcePolling = false
          EcuMComMChannelRef = RBTM_FL_BODY3_8uqv9blm85ehm0msat385m76v_03d5f5f6
          variation-point = post-build-variant-condition{matching-criterion=SideAllocation, value=0}
        RBTM_FR_BODY3_4xwwtd59665s787n6ctawh7k8_23a94727 (EcuMWakeupSource):
          EcuMWakeupSourceId = 5
          EcuMWakeupSourcePolling = false
          EcuMComMChannelRef = RBTM_FR_BODY3_4xwwtd59665s787n6ctawh7k8_23a94727
          variation-point = post-build-variant-condition{matching-criterion=SideAllocation, value=1}
    EcuMGeneral:
      EcuMDevErrorDetect = false
      EcuMIncludeDem = true
      EcuMIncludeDet = true
      EcuMMainFunctionPeriod = 0.005
      EcuMVersionInfoApi = false
      EcuMDeferredBswMNotification = false
      EcuMSlaveCoreHandling = true
      EcuMEnableFixBehavior = false
      EcuMNonChannelWakeupInRun = false
      EcuMSchMStartInitialization = true
      EcuMSafeBswChecks = false
      EcuMGeneration: EcuMOutOfBoundsWriteSanitizer=false, EcuMOutOfBoundsReadSanitizer=false, EcuMInterfacesForDeactivatedData=false
    EcuMFlexGeneral: EcuMAlarmClockPresent=false, EcuMResetLoopDetection=true, EcuMEnableDefBehaviour=false, EcuMModeHandling=true
