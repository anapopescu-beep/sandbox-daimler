AUTOSAR XML (schema 00049)
package /ActiveEcuC
  module config Adc: implementation-config-variant=VARIANT-POST-BUILD, module-description=Adc_Impl
    CommonPublishedInformation:
      ArMajorVersion = 4
      ArMinorVersion = 4
      ArPatchVersion = 0
      SwMajorVersion = 20
      SwMinorVersion = 0
      SwPatchVersion = 2
      ModuleId = 123
      VendorId = 17
      Release = _TRICORE_TC332
    AdcPublishedInformation: AdcChannelValueSigned=false, AdcGroupFirstChannelFixed=false, AdcMaxChannelResolution=12
    AdcGeneral:
      AdcDeInitApi = true
      AdcDevErrorDetect = true
      AdcSafetyEnable = false
      AdcRunTimeErrorDetect = true
      AdcMultiCoreErrorDetect = false
      AdcInitCheckApi = true
      AdcEnableLimitCheck = false
      AdcEnableQueuing = false
      AdcEnableStartStopGroupApi = true
      AdcGrpNotifCapability = false
      AdcHwTriggerApi = false
      AdcReadGroupApi = false
      AdcVersionInfoApi = false
      AdcStartupCalibApi = true
      AdcTriggerOneConversionEnable = true
      AdcSyncConvEnable = false
      AdcPriorityImplementation = ADC_PRIORITY_NONE
      AdcResultAlignment = ADC_ALIGN_RIGHT
      AdcMaxChConvTimeCount = 0
      AdcSleepMode = ADC_SLEEP_MODE_ACCEPT
      AdcSupplyVoltage = ADC_VOLTAGE_CONTROLLED_BY_SUPPLY
      AdcRuntimeApiMode = ADC_MCAL_SUPERVISOR
      AdcInitDeInitApiMode = ADC_MCAL_SUPERVISOR
      AdcEmuxEnable = false
      AdcEmuxGroupInterface0 = HWUNIT_ADC0
      AdcEmuxGroupInterface1 = HWUNIT_ADC1
      AdcResultHandlingImplementation = ADC_DMA_MODE_RESULT_HANDLING
    AdcConfigSet: AdcSyncClockDisable=false, AdcSystemClock=McuClockReferencePointConfig
      AdcGlobalInputClass:
        AdcChSampleTime = 0
        AdcChPreChargeClkCycles = ADC_INPUT_PRECHARGE_CYCLES_0
        AdcChConvMode = ADC_NOISE_REDUCTION_STEPS_0
        AdcChSESPSEnable = false
        AdcEmuxChSampleTime = 0
        AdcEmuxChPreChargeClkCycles = ADC_INPUT_PRECHARGE_CYCLES_0
        AdcEmuxChConvMode = ADC_NOISE_REDUCTION_STEPS_0
        AdcEmuxChSESPSEnable = false
      AdcGlobalInputClass_1 (AdcGlobalInputClass):
        AdcChSampleTime = 0
        AdcChPreChargeClkCycles = ADC_INPUT_PRECHARGE_CYCLES_0
        AdcChConvMode = ADC_NOISE_REDUCTION_STEPS_0
        AdcChSESPSEnable = false
        AdcEmuxChSampleTime = 0
        AdcEmuxChPreChargeClkCycles = ADC_INPUT_PRECHARGE_CYCLES_0
        AdcEmuxChConvMode = ADC_NOISE_REDUCTION_STEPS_0
        AdcEmuxChSESPSEnable = false
      3 x AdcHwUnit, all with AdcIdlePrechargeEnable=false, AdcInputBufferEnable=false, AdcPrechargeReference=ADC_VDD_VSM_USED, AdcReferencePrechargePhases=ADC_PRECHARGE_PHASE_1, AdcCalibrationSampleTime=ADC_CAL_TIME_2_TIMES_TADCI, AdcPostCalibrationDisable=false, AdcAnalogClockSyncDelay=0, AdcSampleSyncEnable=false, AdcMSBDoubleClkEnable=false, AdcRequestSource0ConvMode=ADC_WAIT_FOR_START_MODE, AdcRequestSource1ConvMode=ADC_WAIT_FOR_START_MODE, AdcRequestSource2ConvMode=ADC_WAIT_FOR_START_MODE, AdcSyncConvMode=ADC_STAND_ALONE, AdcPrescale=4, AdcClockSource=ADC_SYSTEM_CLK:
        AdcHwUnit_ADC0: AdcHwUnitId=HWUNIT_ADC0
          AdcHwUnitInputClass:
            AdcChSampleTime = 0
            AdcChPreChargeClkCycles = ADC_INPUT_PRECHARGE_CYCLES_0
            AdcChConvMode = ADC_NOISE_REDUCTION_STEPS_7
            AdcChSESPSEnable = false
            AdcEmuxChSampleTime = 0
            AdcEmuxChPreChargeClkCycles = ADC_INPUT_PRECHARGE_CYCLES_0
            AdcEmuxChConvMode = ADC_NOISE_REDUCTION_STEPS_0
            AdcEmuxChSESPSEnable = false
          AdcHwUnitInputClass_1 (AdcHwUnitInputClass):
            AdcChSampleTime = 0
            AdcChPreChargeClkCycles = ADC_INPUT_PRECHARGE_CYCLES_0
            AdcChConvMode = ADC_NOISE_REDUCTION_STEPS_0
            AdcChSESPSEnable = false
            AdcEmuxChSampleTime = 0
            AdcEmuxChPreChargeClkCycles = ADC_INPUT_PRECHARGE_CYCLES_0
            AdcEmuxChConvMode = ADC_NOISE_REDUCTION_STEPS_0
            AdcEmuxChSESPSEnable = false
          AdcChannel_HES_A_V (AdcChannel):
            AdcChannelId = 0
            AdcAnChannelNum = G0CH4
            AdcInputClassSelection = ADC_HWUNIT_CLASS_0
            AdcSyncConvChannelEnable = false
            AdcBWDEnable = false
            AdcBWDPrechargeLevel = ADC_BWD_PRECH_VAGND
            AdcPullDownDiagnosticEnable = false
            AdcMultiplexerDiagnosticEnable = false
            AdcMultiplexerDiagnosticLevel = ADC_MD_PULL_DOWN
            AdcConverterDiagnosticEnable = false
            AdcConverterDiagnosticsLevel = ADC_CD_PULL_DEVICE_VDDM
            AdcChannelResolution = 10
          AdcGroup_0 (AdcGroup):
            AdcGroupAccessMode = ADC_ACCESS_MODE_SINGLE
            AdcGroupConversionMode = ADC_CONV_MODE_CONTINUOUS
            AdcGroupId = 0
            AdcGroupTriggSrc = ADC_TRIGG_SRC_SW
            AdcStreamingBufferMode = ADC_STREAM_BUFFER_CIRCULAR
            AdcStreamingNumSamples = 1
            AdcHwExtTrigSelect = ADC_TRIG_NONE
            AdcHwExtGateSelect = ADC_GATE_NONE
            AdcHwGateSignal = ADC_GATE_LVL_HIGH
            AdcChannel0Alias = 0
            AdcChannel1Alias = 1
            AdcEmuxChGroup = false
            AdcEmuxStartSelection = 0
            AdcResRegDefinition = 0
            AdcResRegDefinition = 1
            AdcGroupReplacement = ADC_GROUP_REPL_ABORT_RESTART
            AdcGroupDefinition = AdcChannel_HES_A_V
            AdcGroupDefinition = HB_I_P_tens
          HB_I_P_tens (AdcChannel):
            AdcChannelId = 1
            AdcAnChannelNum = G0CH5
            AdcInputClassSelection = ADC_HWUNIT_CLASS_0
            AdcSyncConvChannelEnable = false
            AdcBWDEnable = false
            AdcBWDPrechargeLevel = ADC_BWD_PRECH_VAGND
            AdcPullDownDiagnosticEnable = false
            AdcMultiplexerDiagnosticEnable = false
            AdcMultiplexerDiagnosticLevel = ADC_MD_PULL_DOWN
            AdcConverterDiagnosticEnable = false
            AdcConverterDiagnosticsLevel = ADC_CD_PULL_DEVICE_VDDM
            AdcChannelResolution = 10
        AdcHwUnit_ADC1: AdcHwUnitId=HWUNIT_ADC1
          AdcGroup_1 (AdcGroup):
            AdcGroupAccessMode = ADC_ACCESS_MODE_SINGLE
            AdcGroupConversionMode = ADC_CONV_MODE_CONTINUOUS
            AdcGroupTriggSrc = ADC_TRIGG_SRC_SW
            AdcStreamingBufferMode = ADC_STREAM_BUFFER_CIRCULAR
            AdcStreamingNumSamples = 1
            AdcHwExtTrigSelect = ADC_TRIG_NONE
            AdcHwExtGateSelect = ADC_GATE_NONE
            AdcHwGateSignal = ADC_GATE_LVL_HIGH
            AdcChannel0Alias = 0
            AdcChannel1Alias = 1
            AdcEmuxChGroup = false
            AdcEmuxStartSelection = 0
            AdcResRegDefinition = {0..6}
            AdcGroupId = 32
            AdcGroupReplacement = ADC_GROUP_REPL_ABORT_RESTART
            AdcGroupDefinition = AdcChannel_TEMP_SENSOR_Vlevel
            AdcGroupDefinition = AdcChannel_KL30_SW_Vlevel
            AdcGroupDefinition = AdcChannel_MOTOR_P_Vlevel
            AdcGroupDefinition = AdcChannel_KL30_Vlevel
            AdcGroupDefinition = AdcChannel_KL30BG_Vlevel
            AdcGroupDefinition = AdcChannel_HES_B_V
            AdcGroupDefinition = AdcChannel_HB_N_I_rel
          7 x AdcChannel, all with AdcInputClassSelection=ADC_HWUNIT_CLASS_0, AdcSyncConvChannelEnable=false, AdcBWDEnable=false, AdcBWDPrechargeLevel=ADC_BWD_PRECH_VAGND, AdcPullDownDiagnosticEnable=false, AdcMultiplexerDiagnosticEnable=false, AdcMultiplexerDiagnosticLevel=ADC_MD_PULL_DOWN, AdcConverterDiagnosticEnable=false, AdcConverterDiagnosticsLevel=ADC_CD_PULL_DEVICE_VDDM, AdcChannelResolution=10:
            AdcChannel_TEMP_SENSOR_Vlevel: AdcChannelId=0, AdcAnChannelNum=G1CH0
            AdcChannel_KL30_SW_Vlevel: AdcChannelId=1, AdcAnChannelNum=G1CH1
            AdcChannel_MOTOR_P_Vlevel: AdcChannelId=2, AdcAnChannelNum=G1CH3
            AdcChannel_KL30_Vlevel: AdcChannelId=3, AdcAnChannelNum=G1CH4
            AdcChannel_KL30BG_Vlevel: AdcChannelId=4, AdcAnChannelNum=G1CH5
            AdcChannel_HES_B_V: AdcChannelId=5, AdcAnChannelNum=G1CH6
            AdcChannel_HB_N_I_rel: AdcChannelId=6, AdcAnChannelNum=G1CH7
          AdcHwUnitInputClass:
            AdcChSampleTime = 0
            AdcChPreChargeClkCycles = ADC_INPUT_PRECHARGE_CYCLES_0
            AdcChConvMode = ADC_NOISE_REDUCTION_STEPS_7
            AdcChSESPSEnable = false
            AdcEmuxChSampleTime = 0
            AdcEmuxChPreChargeClkCycles = ADC_INPUT_PRECHARGE_CYCLES_0
            AdcEmuxChConvMode = ADC_NOISE_REDUCTION_STEPS_0
            AdcEmuxChSESPSEnable = false
          AdcHwUnitInputClass_1 (AdcHwUnitInputClass):
            AdcChSampleTime = 0
            AdcChPreChargeClkCycles = ADC_INPUT_PRECHARGE_CYCLES_0
            AdcChConvMode = ADC_NOISE_REDUCTION_STEPS_0
            AdcChSESPSEnable = false
            AdcEmuxChSampleTime = 0
            AdcEmuxChPreChargeClkCycles = ADC_INPUT_PRECHARGE_CYCLES_0
            AdcEmuxChConvMode = ADC_NOISE_REDUCTION_STEPS_0
            AdcEmuxChSESPSEnable = false
        AdcHwUnit_ADC8: AdcHwUnitId=HWUNIT_ADC8
          AdcGroup_2 (AdcGroup):
            AdcGroupAccessMode = ADC_ACCESS_MODE_SINGLE
            AdcGroupConversionMode = ADC_CONV_MODE_CONTINUOUS
            AdcGroupId = 256
            AdcGroupTriggSrc = ADC_TRIGG_SRC_SW
            AdcStreamingBufferMode = ADC_STREAM_BUFFER_CIRCULAR
            AdcStreamingNumSamples = 1
            AdcHwExtTrigSelect = ADC_TRIG_NONE
            AdcHwExtGateSelect = ADC_GATE_NONE
            AdcHwGateSignal = ADC_GATE_LVL_HIGH
            AdcChannel0Alias = 0
            AdcChannel1Alias = 1
            AdcEmuxChGroup = false
            AdcResRegDefinition = 0
            AdcEmuxStartSelection = 0
            AdcGroupReplacement = ADC_GROUP_REPL_ABORT_RESTART
            AdcGroupDefinition = AdcChannel_MOTOR_N_Vlevel
          AdcChannel_MOTOR_N_Vlevel (AdcChannel):
            AdcChannelId = 0
            AdcAnChannelNum = G8CH2
            AdcInputClassSelection = ADC_HWUNIT_CLASS_0
            AdcSyncConvChannelEnable = false
            AdcBWDEnable = false
            AdcBWDPrechargeLevel = ADC_BWD_PRECH_VAGND
            AdcPullDownDiagnosticEnable = false
            AdcMultiplexerDiagnosticEnable = false
            AdcMultiplexerDiagnosticLevel = ADC_MD_PULL_DOWN
            AdcConverterDiagnosticEnable = false
            AdcConverterDiagnosticsLevel = ADC_CD_PULL_DEVICE_VDDM
            AdcChannelResolution = 10
          AdcHwUnitInputClass:
            AdcChSampleTime = 0
            AdcChPreChargeClkCycles = ADC_INPUT_PRECHARGE_CYCLES_0
            AdcChConvMode = ADC_NOISE_REDUCTION_STEPS_7
            AdcChSESPSEnable = false
            AdcEmuxChSampleTime = 0
            AdcEmuxChPreChargeClkCycles = ADC_INPUT_PRECHARGE_CYCLES_0
            AdcEmuxChConvMode = ADC_NOISE_REDUCTION_STEPS_0
            AdcEmuxChSESPSEnable = false
          AdcHwUnitInputClass_1 (AdcHwUnitInputClass):
            AdcChSampleTime = 0
            AdcChPreChargeClkCycles = ADC_INPUT_PRECHARGE_CYCLES_0
            AdcChConvMode = ADC_NOISE_REDUCTION_STEPS_0
            AdcChSESPSEnable = false
            AdcEmuxChSampleTime = 0
            AdcEmuxChPreChargeClkCycles = ADC_INPUT_PRECHARGE_CYCLES_0
            AdcEmuxChConvMode = ADC_NOISE_REDUCTION_STEPS_0
            AdcEmuxChSESPSEnable = false
