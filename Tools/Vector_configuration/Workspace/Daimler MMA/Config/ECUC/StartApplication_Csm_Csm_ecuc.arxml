AUTOSAR XML (schema 00049)
package /ActiveEcuC
  module config Csm: implementation-config-variant=VARIANT-PRE-COMPILE, module-description=Csm_Impl
    3 x CsmPrimitives:
      SigVerifyEd25519_Async
        CsmSignatureVerify
          SigVerifyEd25519_Async (CsmSignatureVerifyConfig):
            CsmSignatureVerifyAlgorithmFamily = CRYPTO_ALGOFAM_ED25519
            CsmSignatureVerifyAlgorithmMode = CRYPTO_ALGOMODE_NOT_SET
            CsmSignatureVerifyProcessing = CSM_ASYNCHRONOUS
            CsmSignatureVerifyCompareLength = 64
            CsmSignatureVerifyAlgorithmSecondaryFamily = CRYPTO_ALGOFAM_NOT_SET
            CsmSignatureVerifyDataMaxLength = 8192
            CsmSignatureVerifyAlgorithmFamiliy = CRYPTO_ALGOFAM_ED25519
            CsmSignatureVerifyKeyLength = 32
            CsmSignatureVerifySwcInterfaceVersion = CSM_ASR_VERSION_4_04
      SigVerifyEd25519ph_SyncAsync
        CsmSignatureVerify
          SigVerifyEd25519ph_SyncAsync (CsmSignatureVerifyConfig):
            CsmSignatureVerifyAlgorithmFamily = CRYPTO_ALGOFAM_ED25519
            CsmSignatureVerifyAlgorithmMode = CRYPTO_ALGOMODE_NOT_SET
            CsmSignatureVerifyProcessing = CSM_SYNCHRONOUS
            CsmSignatureVerifyCompareLength = 64
            CsmSignatureVerifyAlgorithmSecondaryFamily = CRYPTO_ALGOFAM_SHA2_512
            CsmSignatureVerifyDataMaxLength = 8192
            CsmSignatureVerifyAlgorithmFamiliy = CRYPTO_ALGOFAM_ED25519
            CsmSignatureVerifyKeyLength = 32
            CsmSignatureVerifySwcInterfaceVersion = CSM_ASR_VERSION_4_04
      SigVerifyEd25519_SSA
        CsmSignatureVerify
          SigVerifyEd25519_SSA (CsmSignatureVerifyConfig):
            CsmSignatureVerifyAlgorithmMode = CRYPTO_ALGOMODE_NOT_SET
            CsmSignatureVerifyAlgorithmFamiliy = CRYPTO_ALGOFAM_ED25519
            CsmSignatureVerifyAlgorithmSecondaryFamily = CRYPTO_ALGOFAM_NOT_SET
            CsmSignatureVerifyAlgorithmFamily = CRYPTO_ALGOFAM_ED25519
            CsmSignatureVerifyCompareLength = 64
            CsmSignatureVerifyProcessing = CSM_SYNCHRONOUS
            CsmSignatureVerifyDataMaxLength = 8192
            CsmSignatureVerifyKeyLength = 32
            CsmSignatureVerifySwcInterfaceVersion = CSM_ASR_VERSION_4_04
    CsmGeneral:
      CsmAsymPrivateKeyMaxLength = 32
      CsmAsymPublicKeyMaxLength = 32
      CsmDevErrorDetect = false
      CsmMainFunctionPeriod = 0.01
      CsmSymKeyMaxLength = 16
      CsmUseDeprecated = false
      CsmVersionInfoApi = false
      CsmCallbackStartNotification = false
      CsmCancelationDuringProcessing = false
      CsmSafeBswChecks = true
      CsmCustomIncludeFiles = Crypto_30_vHsm_Custom.h
      CsmCustomIncludeFiles = Crypto_30_LibCv_Custom.h
      CsmJobTypeLayout:
        CsmJobTypeLayoutAsr430Compatibility = true
        CsmJobTypeLayoutVarMembers = false
        CsmJobTypeLayoutInput64 = false
        CsmJobTypeLayoutOutput64Ptr = false
        CsmJobTypeLayoutRedirectionInfoRef = true
    CsmJobs
      42 x CsmJob:
        Ssa_SigVerify_Coding: CsmJobUsePort=true, CsmProcessingMode=CRYPTO_PROCESSING_SYNC, CsmJobId=36, CsmJobPriority=1, CsmJobInterfaceUsePort=CRYPTO_USE_PORT, CsmJobPrimitiveCallbackUpdateNotification=false, CsmJobPrimitiveRef=Csm/SigVerifyEd25519ph_SyncAsync, CsmJobQueueRef=CsmQueue, CsmJobKeyRef=Ssa_SignatureRamKey
        Ssa_Hash_Sha2_512: CsmJobUsePort=true, CsmProcessingMode=CRYPTO_PROCESSING_SYNC, CsmJobId=26, CsmJobPriority=1, CsmJobInterfaceUsePort=CRYPTO_USE_PORT, CsmJobPrimitiveCallbackUpdateNotification=false, CsmJobPrimitiveRef=Csm/Sha2_512, CsmJobQueueRef=CsmQueue_Ssa_Hash, CsmJobKeyRef=CsmKey_Ssa_Hash
        Ssa_MacVerify_RealTime: CsmJobUsePort=true, CsmProcessingMode=CRYPTO_PROCESSING_SYNC, CsmJobId=30, CsmJobPriority=1, CsmJobInterfaceUsePort=CRYPTO_USE_PORT, CsmJobPrimitiveCallbackUpdateNotification=false, CsmJobPrimitiveRef=Csm/MacVerifyAesCmac, CsmJobQueueRef=CsmQueue_BcTp, CsmJobKeyRef=Ssa_RealTime
        Ssa_MacVerify_TickCount: CsmJobUsePort=true, CsmProcessingMode=CRYPTO_PROCESSING_SYNC, CsmJobId=31, CsmJobPriority=1, CsmJobInterfaceUsePort=CRYPTO_USE_PORT, CsmJobPrimitiveCallbackUpdateNotification=false, CsmJobPrimitiveRef=Csm/MacVerifyAesCmac, CsmJobQueueRef=CsmQueue_BcTp, CsmJobKeyRef=Ssa_TickCount
        Ssa_MacVerify_Authentication: CsmJobUsePort=true, CsmProcessingMode=CRYPTO_PROCESSING_SYNC, CsmJobId=29, CsmJobPriority=1, CsmJobInterfaceUsePort=CRYPTO_USE_PORT, CsmJobPrimitiveCallbackUpdateNotification=false, CsmJobPrimitiveRef=Csm/MacVerifyAesCmac, CsmJobQueueRef=CsmQueue_BcTp, CsmJobKeyRef=Ssa_Authentication
        Ssa_MacVerify_VIN: CsmJobUsePort=true, CsmProcessingMode=CRYPTO_PROCESSING_SYNC, CsmJobId=32, CsmJobPriority=1, CsmJobInterfaceUsePort=CRYPTO_USE_PORT, CsmJobPrimitiveCallbackUpdateNotification=false, CsmJobPrimitiveRef=Csm/MacVerifyAesCmac, CsmJobQueueRef=CsmQueue_BcTp, CsmJobKeyRef=Ssa_VIN
        Ssa_Decrypt_Aes128: CsmJobUsePort=true, CsmProcessingMode=CRYPTO_PROCESSING_SYNC, CsmJobId=25, CsmJobPriority=1, CsmJobInterfaceUsePort=CRYPTO_USE_PORT, CsmJobPrimitiveCallbackUpdateNotification=false, CsmJobPrimitiveRef=Csm/AES128Decrypt, CsmJobQueueRef=CsmQueue, CsmJobKeyRef=Ssa_AesRamKey
        Ssa_MacGen_TickCount: CsmJobUsePort=true, CsmProcessingMode=CRYPTO_PROCESSING_SYNC, CsmJobId=28, CsmJobPriority=1, CsmJobInterfaceUsePort=CRYPTO_USE_PORT, CsmJobPrimitiveCallbackUpdateNotification=false, CsmJobPrimitiveRef=Csm/MacGenAesCmac, CsmJobQueueRef=CsmQueue_BcTp, CsmJobKeyRef=Ssa_TickCount
        Ssa_MacGen_RealTime: CsmJobUsePort=true, CsmProcessingMode=CRYPTO_PROCESSING_SYNC, CsmJobId=27, CsmJobPriority=1, CsmJobInterfaceUsePort=CRYPTO_USE_PORT, CsmJobPrimitiveCallbackUpdateNotification=false, CsmJobPrimitiveRef=Csm/MacGenAesCmac, CsmJobQueueRef=CsmQueue_BcTp, CsmJobKeyRef=Ssa_RealTime
        KeyM_SigVerify_TrustModelBackend: CsmJobId=2, CsmJobPriority=1, CsmJobUsePort=false, CsmProcessingMode=CRYPTO_PROCESSING_ASYNC, CsmJobInterfaceUsePort=CRYPTO_USE_FNC, CsmJobPrimitiveCallbackUpdateNotification=false, CsmJobKeyRef=KeyM_SigVerifyKey_TrustModelBackend, CsmJobPrimitiveRef=Csm/SigVerifyEd25519_Async, CsmJobQueueRef=CsmQueue_KeyM, CsmJobPrimitiveCallbackRef=CsmCallback_SigVerify_TrustModelBackend
        KeyM_SigVerify_TrustModelEcu: CsmJobId=4, CsmJobPriority=1, CsmJobUsePort=false, CsmProcessingMode=CRYPTO_PROCESSING_ASYNC, CsmJobInterfaceUsePort=CRYPTO_USE_FNC, CsmJobPrimitiveCallbackUpdateNotification=false, CsmJobKeyRef=CsmKey_Ssa_TrustModelEcuPublic_LiveKey, CsmJobPrimitiveRef=Csm/SigVerifyEd25519_Async, CsmJobQueueRef=CsmQueue_KeyM, CsmJobPrimitiveCallbackRef=CsmCallback_SigVerify_TrustModelEcu
        KeyM_SigVerify_TrustModelIntermediate: CsmJobId=7, CsmJobPriority=1, CsmJobUsePort=false, CsmProcessingMode=CRYPTO_PROCESSING_ASYNC, CsmJobInterfaceUsePort=CRYPTO_USE_FNC, CsmJobPrimitiveCallbackUpdateNotification=false, CsmJobKeyRef=KeyM_SigVerifyKey_TrustModelIntermediate, CsmJobPrimitiveRef=Csm/SigVerifyEd25519_Async, CsmJobQueueRef=CsmQueue_KeyM, CsmJobPrimitiveCallbackRef=CsmCallback_SigVerify_TrustModelIntermediate
        KeyM_SigVerify_TrustModelRoot: CsmJobId=9, CsmJobPriority=1, CsmJobUsePort=false, CsmProcessingMode=CRYPTO_PROCESSING_ASYNC, CsmJobInterfaceUsePort=CRYPTO_USE_FNC, CsmJobPrimitiveCallbackUpdateNotification=false, CsmJobKeyRef=KeyM_SigVerifyKey_TrustModelRoot, CsmJobPrimitiveRef=Csm/SigVerifyEd25519_Async, CsmJobQueueRef=CsmQueue_KeyM, CsmJobPrimitiveCallbackRef=CsmCallback_SigVerify_TrustModelRoot
        SSA_SecOC_Int_MacVerify_Ign_Stat: CsmJobUsePort=false, CsmJobPrimitiveCallbackUpdateNotification=false, CsmProcessingMode=CRYPTO_PROCESSING_SYNC, CsmJobId=20, CsmJobPriority=1, CsmJobInterfaceUsePort=CRYPTO_USE_FNC, CsmJobKeyRef=CsmKeys/SSA_SecOC_Int_MacVerify_Ign_Stat, CsmJobPrimitiveRef=Csm/MacVerifyAesCmac, CsmJobQueueRef=SSA_SecOC_Int_CsmQueue
        SSA_SecOC_Int_MacVerify_PN14_Master_Stat1: CsmJobUsePort=false, CsmJobPrimitiveCallbackUpdateNotification=false, CsmProcessingMode=CRYPTO_PROCESSING_SYNC, CsmJobId=21, CsmJobPriority=1, CsmJobInterfaceUsePort=CRYPTO_USE_FNC, CsmJobKeyRef=CsmKeys/SSA_SecOC_Int_MacVerify_PN14_Master_Stat1, CsmJobPrimitiveRef=Csm/MacVerifyAesCmac, CsmJobQueueRef=SSA_SecOC_Int_CsmQueue
        SSA_SecOC_Int_MacVerify_PT4_PTCoor4: CsmJobUsePort=false, CsmJobPrimitiveCallbackUpdateNotification=false, CsmProcessingMode=CRYPTO_PROCESSING_SYNC, CsmJobId=22, CsmJobPriority=1, CsmJobInterfaceUsePort=CRYPTO_USE_FNC, CsmJobKeyRef=CsmKeys/SSA_SecOC_Int_MacVerify_PT4_PTCoor4, CsmJobPrimitiveRef=Csm/MacVerifyAesCmac, CsmJobQueueRef=SSA_SecOC_Int_CsmQueue
        SSA_SecOC_Int_MacVerify_VehSpd_8: CsmJobUsePort=false, CsmJobPrimitiveCallbackUpdateNotification=false, CsmProcessingMode=CRYPTO_PROCESSING_SYNC, CsmJobId=23, CsmJobPriority=1, CsmJobInterfaceUsePort=CRYPTO_USE_FNC, CsmJobKeyRef=CsmKeys/SSA_SecOC_Int_MacVerify_VehSpd_8, CsmJobPrimitiveRef=Csm/MacVerifyAesCmac, CsmJobQueueRef=SSA_SecOC_Int_CsmQueue
        SSA_SecOC_Int_MacVerify_DI_OdoSpeedometer: CsmJobUsePort=false, CsmJobPrimitiveCallbackUpdateNotification=false, CsmProcessingMode=CRYPTO_PROCESSING_SYNC, CsmJobId=19, CsmJobPriority=1, CsmJobInterfaceUsePort=CRYPTO_USE_FNC, CsmJobKeyRef=CsmKeys/SSA_SecOC_Int_MacVerify_DI_OdoSpeedometer, CsmJobPrimitiveRef=Csm/MacVerifyAesCmac, CsmJobQueueRef=SSA_SecOC_Int_CsmQueue
        SSA_SecOC_Int_MacVerify_COM_C0X_Pdu20_secured_3ef6961f_Rx: CsmJobUsePort=false, CsmJobPrimitiveCallbackUpdateNotification=false, CsmProcessingMode=CRYPTO_PROCESSING_SYNC, CsmJobId=17, CsmJobPriority=1, CsmJobInterfaceUsePort=CRYPTO_USE_FNC, CsmJobKeyRef=CsmKeys/SSA_SecOC_Int_MacVerify_COM_C0X_Pdu20_secured_3ef6961f_Rx, CsmJobPrimitiveRef=Csm/MacVerifyAesCmac, CsmJobQueueRef=SSA_SecOC_Int_CsmQueue
        SSA_SecOC_Int_MacVerify_COM_C0X_Pdu21_secured_298d825c_Rx: CsmJobUsePort=false, CsmJobPrimitiveCallbackUpdateNotification=false, CsmProcessingMode=CRYPTO_PROCESSING_SYNC, CsmJobId=18, CsmJobPriority=1, CsmJobInterfaceUsePort=CRYPTO_USE_FNC, CsmJobKeyRef=CsmKeys/SSA_SecOC_Int_MacVerify_COM_C0X_Pdu21_secured_298d825c_Rx, CsmJobPrimitiveRef=Csm/MacVerifyAesCmac, CsmJobQueueRef=SSA_SecOC_Int_CsmQueue
        SSA_SecOC_Int_MacGen_COM_C04_Pdu20_secured_393d7a18_Tx: CsmJobUsePort=false, CsmJobPrimitiveCallbackUpdateNotification=false, CsmProcessingMode=CRYPTO_PROCESSING_SYNC, CsmJobId=15, CsmJobPriority=1, CsmJobInterfaceUsePort=CRYPTO_USE_FNC, CsmJobKeyRef=CsmKeys/SSA_SecOC_Int_MacGen_COM_C04_Pdu20_secured_393d7a18_Tx, CsmJobPrimitiveRef=Csm/MacGenAesCmac, CsmJobQueueRef=SSA_SecOC_Int_CsmQueue
        SSA_SecOC_Int_MacGen_COM_C04_Pdu03_secured_044596e0_Tx: CsmJobUsePort=false, CsmJobPrimitiveCallbackUpdateNotification=false, CsmProcessingMode=CRYPTO_PROCESSING_SYNC, CsmJobId=14, CsmJobPriority=1, CsmJobInterfaceUsePort=CRYPTO_USE_FNC, CsmJobKeyRef=CsmKeys/SSA_SecOC_Int_MacGen_COM_C04_Pdu03_secured_044596e0_Tx, CsmJobPrimitiveRef=Csm/MacGenAesCmac, CsmJobQueueRef=SSA_SecOC_Int_CsmQueue
        SSA_SecOC_Int_MacGen_COM_C04_Pdu21_secured_2e466e5b_Tx: CsmJobUsePort=false, CsmJobPrimitiveCallbackUpdateNotification=false, CsmProcessingMode=CRYPTO_PROCESSING_SYNC, CsmJobId=16, CsmJobPriority=1, CsmJobInterfaceUsePort=CRYPTO_USE_FNC, CsmJobKeyRef=CsmKeys/SSA_SecOC_Int_MacGen_COM_C04_Pdu21_secured_2e466e5b_Tx, CsmJobPrimitiveRef=Csm/MacGenAesCmac, CsmJobQueueRef=SSA_SecOC_Int_CsmQueue
        Ssa_SigVerify_RamKey: CsmJobUsePort=true, CsmJobPrimitiveCallbackUpdateNotification=false, CsmProcessingMode=CRYPTO_PROCESSING_SYNC, CsmJobId=38, CsmJobPriority=1, CsmJobInterfaceUsePort=CRYPTO_USE_PORT, CsmJobPrimitiveRef=Csm/SigVerifyEd25519ph_SyncAsync, CsmJobQueueRef=CsmQueue, CsmJobKeyRef=Ssa_SignatureRamKey
        KeyM_SigVerify_TrustModelBackendPeer: CsmJobId=3, CsmJobPriority=1, CsmJobUsePort=false, CsmProcessingMode=CRYPTO_PROCESSING_ASYNC, CsmJobInterfaceUsePort=CRYPTO_USE_FNC, CsmJobPrimitiveCallbackUpdateNotification=false, CsmJobKeyRef=KeyM_SigVerifyKey_TrustModelBackendPeer, CsmJobPrimitiveRef=Csm/SigVerifyEd25519_Async, CsmJobQueueRef=CsmQueue_KeyM, CsmJobPrimitiveCallbackRef=CsmCallback_SigVerify_TrustModelBackendPeer
        KeyM_SigVerify_TrustModelEcuPeer: CsmJobId=6, CsmJobPriority=1, CsmJobUsePort=false, CsmProcessingMode=CRYPTO_PROCESSING_ASYNC, CsmJobInterfaceUsePort=CRYPTO_USE_FNC, CsmJobPrimitiveCallbackUpdateNotification=false, CsmJobKeyRef=KeyM_SigVerifyKey_TrustModelEcuPeer, CsmJobPrimitiveRef=Csm/SigVerifyEd25519_Async, CsmJobQueueRef=CsmQueue_KeyM, CsmJobPrimitiveCallbackRef=CsmCallback_SigVerify_TrustModelEcuPeer
        KeyM_SigVerify_TrustModelIntermediatePeer: CsmJobId=8, CsmJobPriority=1, CsmJobUsePort=false, CsmProcessingMode=CRYPTO_PROCESSING_ASYNC, CsmJobInterfaceUsePort=CRYPTO_USE_FNC, CsmJobPrimitiveCallbackUpdateNotification=false, CsmJobKeyRef=KeyM_SigVerifyKey_TrustModelIntermediatePeer, CsmJobPrimitiveRef=Csm/SigVerifyEd25519_Async, CsmJobQueueRef=CsmQueue_KeyM, CsmJobPrimitiveCallbackRef=CsmCallback_SigVerify_TrustModelIntermediatePeer
        Ssa_SigVerify_SecurityAccess: CsmJobPriority=12, CsmJobId=40, CsmJobUsePort=true, CsmProcessingMode=CRYPTO_PROCESSING_SYNC, CsmJobInterfaceUsePort=CRYPTO_USE_PORT, CsmJobPrimitiveCallbackUpdateNotification=false, CsmJobPrimitiveRef=Csm/SigVerifyEd25519ph_SyncAsync, CsmJobQueueRef=CsmQueue, CsmJobKeyRef=Ssa_SecurityAccessPublicKey
        KeyM_MacGenerate_PduKeyMac: CsmJobUsePort=true, CsmJobPrimitiveCallbackUpdateNotification=false, CsmProcessingMode=CRYPTO_PROCESSING_SYNC, CsmJobId=0, CsmJobPriority=0, CsmJobInterfaceUsePort=CRYPTO_USE_PORT, CsmJobKeyRef=Ssa_PduKeysMac, CsmJobPrimitiveRef=Csm/MacGenAesCmac, CsmJobQueueRef=CsmQueue
        SSA_SigVerify_KeyM_TrustModel: CsmJobUsePort=true, CsmJobPrimitiveCallbackUpdateNotification=false, CsmProcessingMode=CRYPTO_PROCESSING_SYNC, CsmJobId=24, CsmJobPriority=1, CsmJobInterfaceUsePort=CRYPTO_USE_PORT, CsmJobKeyRef=KeyM_SigVerifyKey_TrustModelEcuPeer, CsmJobPrimitiveRef=Csm/SigVerifyEd25519_SSA, CsmJobQueueRef=CsmQueue_KeyM
        Ssa_SigGenerate_KeyM_TrustModel_with_changeableKey: CsmJobUsePort=true, CsmJobPrimitiveCallbackUpdateNotification=false, CsmProcessingMode=CRYPTO_PROCESSING_SYNC, CsmJobId=35, CsmJobPriority=1, CsmJobInterfaceUsePort=CRYPTO_USE_PORT, CsmJobPrimitiveRef=Csm/SigGenEd25519, CsmJobQueueRef=CsmQueue, CsmJobKeyRef=CsmKey_Ssa_TrustModel_Ecu_CsrPrivateKey
        Ssa_SigVerify_replacementAuthority: CsmJobUsePort=true, CsmJobPrimitiveCallbackUpdateNotification=false, CsmProcessingMode=CRYPTO_PROCESSING_SYNC, CsmJobId=41, CsmJobPriority=1, CsmJobInterfaceUsePort=CRYPTO_USE_PORT, CsmJobKeyRef=CsmKey_Ssa_SignatureRamKey_replacementAuthority, CsmJobPrimitiveRef=Csm/SigVerifyEd25519_SSA, CsmJobQueueRef=CsmQueue
        KeyM_SigVerify_TrustModelEcuCsr_with_changeableKeys: CsmJobId=5, CsmJobPriority=1, CsmJobUsePort=false, CsmProcessingMode=CRYPTO_PROCESSING_ASYNC, CsmJobInterfaceUsePort=CRYPTO_USE_FNC, CsmJobKeyRef=CsmKey_Ssa_TrustModel_Ecu_CsrPublicKey, CsmJobPrimitiveRef=Csm/SigVerifyEd25519_Async, CsmJobQueueRef=CsmQueue_KeyM, CsmJobPrimitiveCallbackRef=CsmCallback_SigVerify_AsrKeyM_Callback
        Ssa_SigGenerate_KeyM_TrustModel_with_LiveKey: CsmJobId=34, CsmJobPriority=1, CsmJobUsePort=true, CsmProcessingMode=CRYPTO_PROCESSING_SYNC, CsmJobInterfaceUsePort=CRYPTO_USE_PORT, CsmJobKeyRef=CsmKey_Ssa_TrustModelPrivateEcu_LiveKey, CsmJobPrimitiveRef=Csm/SigGenEd25519, CsmJobQueueRef=CsmQueue
        KeyM_SigGenerate_TrustModelEcuCsr_with_changeableKeys: CsmJobId=1, CsmJobPriority=1, CsmJobUsePort=false, CsmProcessingMode=CRYPTO_PROCESSING_SYNC, CsmJobInterfaceUsePort=CRYPTO_USE_FNC, CsmJobKeyRef=CsmKey_Ssa_TrustModel_Ecu_CsrPrivateKey, CsmJobPrimitiveRef=Csm/SigGenEd25519_Sync, CsmJobQueueRef=CsmQueue_KeyM
        Ssa_Random_TRNG: CsmJobId=33, CsmJobPriority=0, CsmJobUsePort=true, CsmProcessingMode=CRYPTO_PROCESSING_SYNC, CsmJobInterfaceUsePort=CRYPTO_USE_PORT, CsmJobKeyRef=CsmKey_TRNG, CsmJobPrimitiveRef=Csm/Random_TRNG, CsmJobQueueRef=CsmQueue_Hwa
        SECPDU_Impact2_ST3_0071e663: CsmJobId=13, CsmJobPriority=0, CsmJobUsePort=false, CsmProcessingMode=CRYPTO_PROCESSING_SYNC, CsmJobInterfaceUsePort=CRYPTO_USE_FNC, CsmJobKeyRef=CSK_27103CRYPTO_ALGOFAM_AES128_0b48e843, CsmJobPrimitiveRef=CMAC_AES_128_88396350, CsmJobQueueRef=SSA_SecOC_Int_CsmQueue
        SECPDU_Bckl_Sw_Fx_Stat_ST3_010732c3: CsmJobId=10, CsmJobPriority=0, CsmJobUsePort=false, CsmProcessingMode=CRYPTO_PROCESSING_SYNC, CsmJobInterfaceUsePort=CRYPTO_USE_FNC, CsmJobKeyRef=CSK_15576CRYPTO_ALGOFAM_AES128_3d4fd2d7, CsmJobPrimitiveRef=CMAC_AES_128_88396350, CsmJobQueueRef=SSA_SecOC_Int_CsmQueue
        SECPDU_ELC_Lvr_Stat_ST3_4a443aad: CsmJobId=11, CsmJobPriority=0, CsmJobUsePort=false, CsmProcessingMode=CRYPTO_PROCESSING_SYNC, CsmJobInterfaceUsePort=CRYPTO_USE_FNC, CsmJobKeyRef=CSK_37177CRYPTO_ALGOFAM_AES128_c64d457a, CsmJobPrimitiveRef=CMAC_AES_128_88396350, CsmJobQueueRef=SSA_SecOC_Int_CsmQueue
        SECPDU_Ign_Stat_ST3_8f01dfcb: CsmJobId=12, CsmJobPriority=0, CsmJobUsePort=false, CsmProcessingMode=CRYPTO_PROCESSING_SYNC, CsmJobInterfaceUsePort=CRYPTO_USE_FNC, CsmJobKeyRef=CSK_28212CRYPTO_ALGOFAM_AES128_3d56a060, CsmJobPrimitiveRef=CMAC_AES_128_88396350, CsmJobQueueRef=SSA_SecOC_Int_CsmQueue
        Ssa_SigVerify_RamKey_HWA: CsmJobId=39, CsmJobPriority=0, CsmJobUsePort=false, CsmProcessingMode=CRYPTO_PROCESSING_SYNC, CsmJobInterfaceUsePort=CRYPTO_USE_FNC, CsmJobKeyRef=Ssa_SignatureRamKey, CsmJobPrimitiveRef=Csm/SigVerifyEd25519ph_SyncAsync_HWA, CsmJobQueueRef=CsmQueue_Hwa
        Ssa_SigVerify_Coding_HWA: CsmJobUsePort=true, CsmProcessingMode=CRYPTO_PROCESSING_SYNC, CsmJobId=37, CsmJobPriority=1, CsmJobInterfaceUsePort=CRYPTO_USE_PORT, CsmJobPrimitiveCallbackUpdateNotification=false, CsmJobPrimitiveRef=Csm/SigVerifyEd25519ph_SyncAsync_HWA, CsmJobQueueRef=CsmQueue_Hwa, CsmJobKeyRef=Ssa_SignatureRamKey
    3 x CsmPrimitives:
      MacVerifyAesCmac
        CsmMacVerify
          MacVerifyAesCmac (CsmMacVerifyConfig):
            CsmMacVerifyCompareLength = 64
            CsmMacVerifyAlgorithmMode = CRYPTO_ALGOMODE_CMAC
            CsmMacVerifyAlgorithmSecondaryFamily = CRYPTO_ALGOFAM_NOT_SET
            CsmMacVerifyAlgorithmFamily = CRYPTO_ALGOFAM_AES
            CsmMacVerifyAlgorithmFamiliy = CRYPTO_ALGOFAM_AES
            CsmMacVerifyProcessing = CSM_SYNCHRONOUS
            CsmMacVerifyDataMaxLength = 27
            CsmMacVerifyAlgorithmKeyLength = 16
            CsmMacVerifySwcInterfaceVersion = CSM_ASR_VERSION_4_04
      Sha2_512
        CsmHash
          Sha2_512 (CsmHashConfig):
            CsmHashAlgorithmFamiliy = CRYPTO_ALGOFAM_SHA2_512
            CsmHashResultLength = 64
            CsmHashAlgorithmFamily = CRYPTO_ALGOFAM_SHA2_512
            CsmHashAlgorithmMode = CRYPTO_ALGOMODE_NOT_SET
            CsmHashAlgorithmSecondaryFamily = CRYPTO_ALGOFAM_NOT_SET
            CsmHashProcessing = CSM_SYNCHRONOUS
            CsmHashDataMaxLength = 8192
            CsmHashSwcInterfaceVersion = CSM_ASR_VERSION_4_04
      MacGenAesCmac
        CsmMacGenerate
          MacGenAesCmac (CsmMacGenerateConfig):
            CsmMacGenerateAlgorithmKeyLength = 16
            CsmMacGenerateAlgorithmMode = CRYPTO_ALGOMODE_CMAC
            CsmMacGenerateResultLength = 16
            CsmMacGenerateAlgorithmFamily = CRYPTO_ALGOFAM_AES
            CsmMacGenerateAlgorithmSecondaryFamily = CRYPTO_ALGOFAM_NOT_SET
            CsmMacGenerateAlgorithmFamiliy = CRYPTO_ALGOFAM_AES
            CsmMacGenerateProcessing = CSM_SYNCHRONOUS
            CsmMacGenerateDataMaxLength = 27
            CsmMacGenerateSwcInterfaceVersion = CSM_ASR_VERSION_4_04
    CsmQueues
      7 x CsmQueue, all with CsmQueueSize=1, CsmTriggerAsynchJobsInCallback=false:
        CsmQueue_KeyM: CsmJobSharing=true, CsmChannelRef=CryIfChannel_KeyM
        SSA_SecOC_Int_CsmQueue: CsmJobSharing=true, CsmChannelRef=SSA_SecOC_Int_CryIfChannel
        CsmQueue: CsmJobSharing=false, CsmChannelRef=CryIfChannel
        CsmQueue_TRNG: CsmJobSharing=true, CsmChannelRef=CryIfChannel_TRNG
        CsmQueue_BcTp: CsmJobSharing=true, CsmChannelRef=CryIfChannel_BcTp
        CsmQueue_Ssa_Hash: CsmJobSharing=true, CsmChannelRef=CryIfChannel_Ssa_Hash
        CsmQueue_Hwa: CsmJobSharing=true, CsmChannelRef=CryIfChannel_Hwa
    CsmKeys
      50 x CsmKey:
        Ssa_TickCount: CsmKeyUsePort=true, CsmKeyId=48, CsmKeySwcInterfaceVersion=CSM_ASR_VERSION_4_04, CsmKeyRef=Ssa_TickCount
        Ssa_Authentication: CsmKeyUsePort=true, CsmKeyId=38, CsmKeySwcInterfaceVersion=CSM_ASR_VERSION_4_04, CsmKeyRef=Ssa_Authentication
        Ssa_VIN: CsmKeyUsePort=true, CsmKeyId=49, CsmKeySwcInterfaceVersion=CSM_ASR_VERSION_4_04, CsmKeyRef=Ssa_VIN
        Ssa_RealTime: CsmKeyUsePort=true, CsmKeyId=42, CsmKeySwcInterfaceVersion=CSM_ASR_VERSION_4_04, CsmKeyRef=Ssa_RealTime
        Ssa_SharedSecretKeyExchange: CsmKeyUsePort=true, CsmKeyId=46, CsmKeySwcInterfaceVersion=CSM_ASR_VERSION_4_04, CsmKeyRef=Ssa_SharedSecretExchangeKey
        Ssa_BackendCert: CsmKeyUsePort=true, CsmKeyId=39, CsmKeySwcInterfaceVersion=CSM_ASR_VERSION_4_04, CsmKeyRef=Saa_BackendCert
        Ssa_RootCert: CsmKeyUsePort=true, CsmKeyId=43, CsmKeySwcInterfaceVersion=CSM_ASR_VERSION_4_04, CsmKeyRef=Saa_RootCert
        Ssa_RandomSeed: CsmKeyUsePort=true, CsmKeyId=41, CsmKeySwcInterfaceVersion=CSM_ASR_VERSION_4_04, CsmKeyRef=Ssa_RandomSeed
        Ssa_AesRamKey: CsmKeyUsePort=true, CsmKeyId=37, CsmKeySwcInterfaceVersion=CSM_ASR_VERSION_4_04, CsmKeyRef=Ssa_AesRamKey
        KeyM_SigVerifyKey_TrustModelBackend: CsmKeyId=20, CsmKeyUsePort=false, CsmKeySwcInterfaceVersion=CSM_ASR_VERSION_4_04, CsmKeyRef=KeyM_SigVerifyKey_TrustModelBackend
        KeyM_SigVerifyKey_TrustModelIntermediate: CsmKeyId=23, CsmKeyUsePort=false, CsmKeySwcInterfaceVersion=CSM_ASR_VERSION_4_04, CsmKeyRef=KeyM_SigVerifyKey_TrustModelIntermediate
        KeyM_SigVerifyKey_TrustModelRoot: CsmKeyId=25, CsmKeyUsePort=false, CsmKeySwcInterfaceVersion=CSM_ASR_VERSION_4_04, CsmKeyRef=KeyM_SigVerifyKey_TrustModelRoot
        SSA_SecOC_Int_MacVerify_Ign_Stat: CsmKeyId=33, CsmKeyUsePort=false, CsmKeySwcInterfaceVersion=CSM_ASR_VERSION_4_04, CsmKeyRef=SSA_SecOC_Int_MacVerify_Ign_Stat
        SSA_SecOC_Int_MacVerify_PN14_Master_Stat1: CsmKeyId=34, CsmKeyUsePort=false, CsmKeySwcInterfaceVersion=CSM_ASR_VERSION_4_04, CsmKeyRef=SSA_SecOC_Int_MacVerify_PN14_Master_Stat1
        SSA_SecOC_Int_MacVerify_PT4_PTCoor4: CsmKeyId=35, CsmKeyUsePort=false, CsmKeySwcInterfaceVersion=CSM_ASR_VERSION_4_04, CsmKeyRef=SSA_SecOC_Int_MacVerify_PT4_PTCoor4
        SSA_SecOC_Int_MacVerify_VehSpd_8: CsmKeyId=36, CsmKeyUsePort=false, CsmKeySwcInterfaceVersion=CSM_ASR_VERSION_4_04, CsmKeyRef=SSA_SecOC_Int_MacVerify_VehSpd_8
        SSA_SecOC_Int_MacVerify_DI_OdoSpeedometer: CsmKeyId=32, CsmKeyUsePort=false, CsmKeySwcInterfaceVersion=CSM_ASR_VERSION_4_04, CsmKeyRef=SSA_SecOC_Int_MacVerify_DI_OdoSpeedometer
        SSA_SecOC_Int_MacVerify_COM_C0X_Pdu20_secured_3ef6961f_Rx: CsmKeyId=30, CsmKeyUsePort=false, CsmKeySwcInterfaceVersion=CSM_ASR_VERSION_4_04, CsmKeyRef=SSA_SecOC_Int_MacVerify_COM_C0X_Pdu20_secured_3ef6961f_Rx
        SSA_SecOC_Int_MacVerify_COM_C0X_Pdu21_secured_298d825c_Rx: CsmKeyId=31, CsmKeyUsePort=false, CsmKeySwcInterfaceVersion=CSM_ASR_VERSION_4_04, CsmKeyRef=SSA_SecOC_Int_MacVerify_COM_C0X_Pdu21_secured_298d825c_Rx
        SSA_SecOC_Int_MacGen_COM_C04_Pdu20_secured_393d7a18_Tx: CsmKeyId=28, CsmKeyUsePort=false, CsmKeySwcInterfaceVersion=CSM_ASR_VERSION_4_04, CsmKeyRef=SSA_SecOC_Int_MacGen_COM_C04_Pdu20_secured_393d7a18_Tx
        SSA_SecOC_Int_MacGen_COM_C04_Pdu03_secured_044596e0_Tx: CsmKeyId=27, CsmKeyUsePort=false, CsmKeySwcInterfaceVersion=CSM_ASR_VERSION_4_04, CsmKeyRef=SSA_SecOC_Int_MacGen_COM_C04_Pdu03_secured_044596e0_Tx
        SSA_SecOC_Int_MacGen_COM_C04_Pdu21_secured_2e466e5b_Tx: CsmKeyId=29, CsmKeyUsePort=false, CsmKeySwcInterfaceVersion=CSM_ASR_VERSION_4_04, CsmKeyRef=SSA_SecOC_Int_MacGen_COM_C04_Pdu21_secured_2e466e5b_Tx
        CsmKey_TRNG: CsmKeyId=17, CsmKeyUsePort=false, CsmKeySwcInterfaceVersion=CSM_ASR_VERSION_4_04, CsmKeyRef=CryIfKey_TRNG
        Ssa_SharedSecretHash: CsmKeyUsePort=true, CsmKeyId=45, CsmKeySwcInterfaceVersion=CSM_ASR_VERSION_4_04, CsmKeyRef=Ssa_SharedSecretHash
        Ssa_SignatureRamKey: CsmKeyUsePort=true, CsmKeyId=47, CsmKeySwcInterfaceVersion=CSM_ASR_VERSION_4_04, CsmKeyRef=Ssa_SignatureRamKey
        KeyM_SigVerifyKey_TrustModelBackendPeer: CsmKeyId=21, CsmKeyUsePort=false, CsmKeySwcInterfaceVersion=CSM_ASR_VERSION_4_04, CsmKeyRef=KeyM_SigVerifyKey_TrustModelBackendPeer
        KeyM_SigVerifyKey_TrustModelEcuPeer: CsmKeyId=22, CsmKeyUsePort=true, CsmKeySwcInterfaceVersion=CSM_ASR_VERSION_4_04, CsmKeyRef=KeyM_SigVerifyKey_TrustModelEcuPeer
        KeyM_SigVerifyKey_TrustModelIntermediatePeer: CsmKeyId=24, CsmKeyUsePort=false, CsmKeySwcInterfaceVersion=CSM_ASR_VERSION_4_04, CsmKeyRef=KeyM_SigVerifyKey_TrustModelIntermediatePeer
        Ssa_PduKeysMac: CsmKeyId=40, CsmKeyUsePort=false, CsmKeySwcInterfaceVersion=CSM_ASR_VERSION_4_04, CsmKeyRef=Ssa_PduKeysMac
        Ssa_SecurityAccessPublicKey: CsmKeyId=44, CsmKeyUsePort=true, CsmKeySwcInterfaceVersion=CSM_ASR_VERSION_4_04, CsmKeyRef=Ssa_SecurityAccessPublicKey
        CsmKey_Ssa_SignatureRamKey_replacementAuthority: CsmKeyId=5, CsmKeyUsePort=true, CsmKeyRef=CryIfKey_CryIfKey_Ssa_SignatureRamKey_replacementAuthority
        CsmKey_Ssa_TrustModelPrivateEcuUnique_StagingKey: CsmKeyId=11, CsmKeyUsePort=true, CsmKeyRef=Ssa_TrustModelEcuPrivateUniqueKey
        CsmKey_Ssa_TrustModelEcuPublic_LiveKey: CsmKeyId=9, CsmKeyUsePort=true, CsmKeyRef=KeyM_SigVerifyKey_TrustModelEcu
        CsmKey_Ssa_TrustModelEcuPublicCsr_StagingKey: CsmKeyId=8, CsmKeyUsePort=true, CsmKeyRef=KeyM_SigVerifyKey_TrustModelEcuCsr
        CsmKey_Ssa_TrustModelPrivateEcu_LiveKey: CsmKeyId=13, CsmKeyUsePort=true, CsmKeyRef=Ssa_TrustModelEcuPrivateKey
        CsmKey_Ssa_TrustModelEcuCert_inHSM: CsmKeyId=7, CsmKeyUsePort=false, CsmKeyRef=CryIfKey_CryIfKey_Ssa_TrustModelEcuCert_inHSM
        CsmKey_Ssa_TrustModel_Ecu_CsrPrivateKey: CsmKeyId=15, CsmKeyUsePort=true, CsmKeyRef=CryIfKey_CryIfKey_Ssa_TrustModel_Ecu_CsrPrivateKey
        CsmKey_Ssa_TrustModelRootCert_inHSM: CsmKeyId=14, CsmKeyUsePort=false, CsmKeyRef=CryIfKey_CryIfKey_Ssa_TrustModelRootCert_inHSM
        CsmKey_Ssa_TrustModel_Ecu_CsrPublicKey: CsmKeyId=16, CsmKeyUsePort=true, CsmKeyRef=CryIfKey_CryIfKey_Ssa_TrustModel_Ecu_CsrPublicKey
        CsmKey_Ssa_TrustModelIntermediateCert_inHSM: CsmKeyId=10, CsmKeyUsePort=false, CsmKeyRef=CryIfKey_CryIfKey_Ssa_TrustModelIntermediateCert_inHSM
        CsmKey_Ssa_TrustModelBackendCert_inHSM: CsmKeyId=6, CsmKeyUsePort=false, CsmKeyRef=CryIfKey_CryIfKey_Ssa_TrustModelBackendCert_inHSM
        CsmKey_Ssa_Hash: CsmKeyId=4, CsmKeyUsePort=false, CsmKeyRef=CryIfKey_Ssa_Hash
        CsmKey_Ssa_TrustModelPrivateEcuUnique_StagingKey_01: CsmKeyId=12, CsmKeyUsePort=false, CsmKeyRef=Ssa_TrustModelEcuPrivateUniqueKey
        CsmKey_vHsm_Info: CsmKeyId=18, CsmKeyUsePort=false, CsmKeyRef=CryIfKey_vHsm_Info
        CSK_15576CRYPTO_ALGOFAM_AES128_3d4fd2d7: CsmKeyId=0, CsmKeyUsePort=false, CsmKeyRef=CryIfKey_CSK_15576CRYPTO_ALGOFAM_AES128_3d4fd2d7
        CSK_27103CRYPTO_ALGOFAM_AES128_0b48e843: CsmKeyId=1, CsmKeyUsePort=false, CsmKeyRef=CryIfKey_CSK_27103CRYPTO_ALGOFAM_AES128_0b48e843
        CSK_37177CRYPTO_ALGOFAM_AES128_c64d457a: CsmKeyId=3, CsmKeyUsePort=false, CsmKeyRef=CryIfKey_CSK_37177CRYPTO_ALGOFAM_AES128_c64d457a
        CSK_28212CRYPTO_ALGOFAM_AES128_3d56a060: CsmKeyId=2, CsmKeyUsePort=false, CsmKeyRef=CryIfKey_CSK_28212CRYPTO_ALGOFAM_AES128_3d56a060
        Key_Custom_HSM_Version: CsmKeyId=26, CsmKeyUsePort=false, CsmKeyRef=vHSM_Version
        CsmKey_vHsm_Info_01: CsmKeyId=19, CsmKeyUsePort=false, CsmKeyRef=CryIfKey_CryIfKey_vHsm_Info
    CsmCallbacks
      9 x CsmCallback, all with CsmCallbackFunc=KeyM_CallbackNotificationSignature:
        CsmCallback_SigVerify_TrustModelBackend: CsmCallbackId=1
        CsmCallback_SigVerify_TrustModelEcu: CsmCallbackId=3
        CsmCallback_SigVerify_TrustModelIntermediate: CsmCallbackId=6
        CsmCallback_SigVerify_TrustModelRoot: CsmCallbackId=8
        CsmCallback_SigVerify_TrustModelBackendPeer: CsmCallbackId=2
        CsmCallback_SigVerify_TrustModelEcuCsr: CsmCallbackId=4
        CsmCallback_SigVerify_TrustModelEcuPeer: CsmCallbackId=5
        CsmCallback_SigVerify_TrustModelIntermediatePeer: CsmCallbackId=7
        CsmCallback_SigVerify_AsrKeyM_Callback: CsmCallbackId=0
    5 x CsmPrimitives:
      AES128Decrypt
        CsmDecrypt
          AES128Decrypt (CsmDecryptConfig):
            CsmDecryptAlgorithmFamily = CRYPTO_ALGOFAM_AES
            CsmDecryptAlgorithmMode = CRYPTO_ALGOMODE_CBC
            CsmDecryptAlgorithmKeyLength = 16
            CsmDecryptAlgorithmFamiliy = CRYPTO_ALGOFAM_AES
            CsmDecryptAlgorithmSecondaryFamily = CRYPTO_ALGOFAM_NOT_SET
            CsmDecryptProcessing = CSM_SYNCHRONOUS
            CsmDecryptResultMaxLength = 80
            CsmDecryptDataMaxLength = 80
            CsmDecryptSwcInterfaceVersion = CSM_ASR_VERSION_4_04
      Random_TRNG
        CsmRandom (CsmRandomGenerate)
          Random_TRNG (CsmRandomGenerateConfig):
            CsmRandomGenerateAlgorithmSecondaryFamily = CRYPTO_ALGOFAM_NOT_SET
            CsmRandomGenerateResultLength = 32
            CsmRandomGenerateAlgorithmFamiliy = CRYPTO_ALGOFAM_RNG
            CsmRandomGenerateAlgorithmMode = CRYPTO_ALGOMODE_NOT_SET
            CsmRandomGenerateAlgorithmFamily = CRYPTO_ALGOFAM_RNG
            CsmRandomGenerateProcessing = CSM_SYNCHRONOUS
      AES128Encrypt
        CsmEncrypt
          AES128Encrypt (CsmEncryptConfig):
            CsmEncryptAlgorithmFamiliy = CRYPTO_ALGOFAM_AES
            CsmEncryptAlgorithmMode = CRYPTO_ALGOMODE_CBC
            CsmEncryptAlgorithmFamily = CRYPTO_ALGOFAM_AES
            CsmEncryptAlgorithmKeyLength = 16
            CsmEncryptAlgorithmSecondaryFamily = CRYPTO_ALGOFAM_NOT_SET
            CsmEncryptProcessing = CSM_SYNCHRONOUS
            CsmEncryptSwcInterfaceVersion = CSM_ASR_VERSION_4_04
      SigGenEd25519
        CsmSignatureGenerate
          SigGenEd25519 (CsmSignatureGenerateConfig):
            CsmSignatureGenerateAlgorithmMode = CRYPTO_ALGOMODE_NOT_SET
            CsmSignatureGenerateKeyLength = 32
            CsmSignatureGenerateResultLength = 64
            CsmSignatureGenerateAlgorithmFamily = CRYPTO_ALGOFAM_ED25519
            CsmSignatureGenerateAlgorithmSecondaryFamily = CRYPTO_ALGOFAM_NOT_SET
            CsmSignatureGenerateAlgorithmFamiliy = CRYPTO_ALGOFAM_ED25519
            CsmSignatureGenerateProcessing = CSM_SYNCHRONOUS
            CsmSignatureGenerateDataMaxLength = 129
            CsmSignatureGenerateSwcInterfaceVersion = CSM_ASR_VERSION_4_04
      SigGenEd25519_Sync
        CsmSignatureGenerate
          SigGenEd25519_Sync (CsmSignatureGenerateConfig):
            CsmSignatureGenerateAlgorithmFamily = CRYPTO_ALGOFAM_ED25519
            CsmSignatureGenerateAlgorithmMode = CRYPTO_ALGOMODE_NOT_SET
            CsmSignatureGenerateProcessing = CSM_SYNCHRONOUS
            CsmSignatureGenerateKeyLength = 32
            CsmSignatureGenerateAlgorithmSecondaryFamily = CRYPTO_ALGOFAM_NOT_SET
            CsmSignatureGenerateDataMaxLength = 8192
            CsmSignatureGenerateAlgorithmFamiliy = CRYPTO_ALGOFAM_ED25519
            CsmSignatureGenerateResultLength = 64
            CsmSignatureGenerateSwcInterfaceVersion = CSM_ASR_VERSION_4_04
    CsmInOutRedirections
      CsmInOutRedirection
    CMAC_AES_128_88396350 (CsmPrimitives)
      CsmMacVerify
        CsmMacVerifyConfig:
          CsmMacVerifyAlgorithmFamily = CRYPTO_ALGOFAM_AES
          CsmMacVerifyAlgorithmKeyLength = 128
          CsmMacVerifyAlgorithmMode = CRYPTO_ALGOMODE_CMAC
          CsmMacVerifyAlgorithmSecondaryFamily = CRYPTO_ALGOFAM_NOT_SET
          CsmMacVerifyAlgorithmFamiliy = CRYPTO_ALGOFAM_AES
          CsmMacVerifyCompareLength = 64
          CsmMacVerifyProcessing = CSM_SYNCHRONOUS
    SigVerifyEd25519ph_SyncAsync_HWA (CsmPrimitives)
      CsmSignatureVerify
        SigVerifyEd25519ph_SyncAsync_HWA (CsmSignatureVerifyConfig):
          CsmSignatureVerifyAlgorithmFamiliy = CRYPTO_ALGOFAM_ED25519
          CsmSignatureVerifyAlgorithmFamily = CRYPTO_ALGOFAM_ED25519
          CsmSignatureVerifyAlgorithmMode = CRYPTO_ALGOMODE_CUSTOM
          CsmSignatureVerifyAlgorithmSecondaryFamily = CRYPTO_ALGOFAM_SHA2_512
          CsmSignatureVerifyCompareLength = 64
          CsmSignatureVerifyProcessing = CSM_SYNCHRONOUS
          CsmSignatureVerifyKeyLength = 32
          CsmSignatureVerifyDataMaxLength = 8192
          CsmSignatureVerifySwcInterfaceVersion = CSM_ASR_VERSION_4_04
          CsmSignatureVerifyAlgorithmModeCustomRef = Crypto_30_vHsm_Hwa_Ed25519Ph
