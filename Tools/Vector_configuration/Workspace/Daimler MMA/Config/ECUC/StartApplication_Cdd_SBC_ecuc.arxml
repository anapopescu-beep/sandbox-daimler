AUTOSAR XML (schema 00049)
package /ActiveEcuC
  module config SBC: definition=Cdd, implementation-config-variant=VARIANT-PRE-COMPILE
