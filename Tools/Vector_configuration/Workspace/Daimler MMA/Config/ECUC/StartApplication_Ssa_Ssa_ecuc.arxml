AUTOSAR XML (schema 00049)
package /ActiveEcuC
  module config Ssa: implementation-config-variant=VARIANT-PRE-COMPILE, module-description=Ssa_Impl
    SsaSpecialDataIds
      4 x SsaSpecialDataId, all with SsaMacVerificationFailureLogging=true:
        Ssa_TickcountBroadcast: SsaDataId=65535, SsaCsmKeyRef=Ssa_TickCount
        Ssa_AuthenticationBroadcast: SsaDataId=65532, SsaCsmKeyRef=Ssa_Authentication
        Ssa_VINBroadcast: SsaDataId=65533, SsaCsmKeyRef=Ssa_VIN
        Ssa_RealtimeBroadcast: SsaDataId=65534, SsaCsmKeyRef=Ssa_RealTime
    SsaGeneral:
      SsaEcuType = SSA_ECU_TYPE_NORMAL
      SsaEnableDebugAuthentication = false
      SsaEnableDebugRights = false
      SsaEnableDebugNonce = false
      SsaIgnoreSecureBroadcastVerificationResult = false
      SsaEnableDebugAuthenticationStatus = false
      SsaIgnoreCodingVerificationResult = false
      SsaEnableAsyncCsmJobProcessing = false
      SsaEnableAsyncCsmKeyManagementPrimitives = false
      SsaKeepBufferVariablesStatic = false
      SsaGenerateKeyPairCustomCallout = false
      SsaDiagServiceTrustModelGenerateKeyPair = true
      SsaDiagServiceInjectSeed = false
      SsaDecoupleExternalProcessingService29 = true
      SsaSafeBswChecks = false
    SsaCoding:
      SsaCodingTimeout = 20000
      SsaCodingVINReceiveTimeout = 5000
      SsaCodingDataBufferSize = 1081
      SsaSignatureVerifyJob = Ssa_SigVerify_Coding_HWA
      SsaCodingDID = Configure_SAR_Trigger_Events
      SsaCodingDID = Activate_SAR_Data_Storage
      SsaCodingNvMBlock = Cp_MBBL_SsaAppl_CodingNvBlockNeed_CodingData
      SsaCodingDID = DID_Calibration_Identifications_CAL_ID_Read
      SsaCodingDID = DID_Vehicle_Equipment_Read
      SsaCodingNvMBlock = Ct_MBBL_SsaAppl_CodingNvmCoding_CurrentVehicleEquipment
      SsaCodingDID = DID_Tensioning_Cycle_BSR_Read
      SsaCodingNvMBlock = Ct_MBBL_SsaAppl_CodingNvmCoding_TensioningCycleBSR
      SsaCodingDID = DID_Release_Cycles_BSR_and_PreSafe_Read
      SsaCodingDID = DID_PreSafe_Cycles_Level_1_8_Read
      SsaCodingNvMBlock = Ct_MBBL_SsaAppl_CodingNvmCoding_ReleaseCyclesBsrAndPreSafe
      SsaCodingNvMBlock = Ct_MBBL_SsaAppl_CodingNvmCoding_PreSafeCyclesLevel
      SsaCodingDID = DID_ZZZ_Vehicle_Equipment_Development_Read
      SsaCodingNvMBlock = Ct_MBBL_SsaAppl_CodingNvmCoding_ZZZVehicleEquipmentDevelopment
      SsaCodingNvMBlock = Ct_MBBL_SsaAppl_CodingNvmCoding_CalibrationID
      SsaCodingDID = DID_Calibration_Identifications_CAL_ID_Write
    SsaFvM:
      SsaFvMUnlimitedTurningBackOfTickCount = false
      SsaFvMPercentageTurningBackLocalTickCount = 40
      SsaFvMPercentageLocalTickCountSlowdown = 2
      SsaFvMRtcCorrectionTolerance = 0
      SsaFvMRtcResolution = 1000
      SsaFvMSecuredTickCountCycleTime = 100
      SsaFvMSecuredTickCountStartupCycleTime = 100
      SsaFvMSecuredTickCountStartupCycleDuration = 1000
      SsaFvMDebounceTimeDetectionUnautheticatedTickCountMessages = 3000
      SsaFvMDebounceTimeDetectionMissingTickCountMessages = 3000
      SsaFvMDebounceTimeDetectionRejectedTickCountMessages = 3000
      SsaFvMLocalTickCountSynchronizationTimeout = 3000
    SsaSecLog:
      SsaSecLogCircularBufferSizeFailedCertificateVerificationEvent = 20
      SsaSecLogCircularBufferSizeSuccessfulCertificateVerificationEvent = 10
      SsaSecLogCircularBufferSizeSuccessfulAuthenticationAndEnhanceRightsEvent = 15
      SsaSecLogCircularBufferSizeAuthorizationBySecurityAccessEvent = 7
      SsaSecLogCircularBufferSizeSuccessfulDiagnosticServiceExecutionEvent = 15
      SsaSecLogCircularBufferSizeRightsManagementEvent = 20
      SsaSecLogCircularBufferSizeSignatureVerificationEvent = 10
      SsaSecLogCircularBufferSizeChangeOfTickCountOrDateAndTimeEvent = 20
      SsaSecLogCircularBufferSizeSecocMisconfigurationEvent = 10
      SsaSecLogCircularBufferSizeFailedPduMacVerificationEvent = 15
      SsaSecLogCircularBufferSizeSecureBootOrAuthenticatedBootEvent = 10
      SsaSecLogCircularBufferSizeChangeOfVinEvent = 3
      SsaSecLogCircularBufferSizeEcuIndividualAclReplacementEvent = 5
      SsaSecLogDebounceTime = 3000
      SsaSecLogFailedMacVerificationCounterThresholdDtc = 100
      SsaSecLogLoggingActiveTimeout = 180
      SsaSecLogFailedMacVerificationCounterThreshold1 = 250
      SsaSecLogFailedMacVerificationCounterThreshold2 = 1000
      SsaSecLogFailedMacVerificationCounterThreshold3 = 50000
      SsaSecLogUsePimAccessMacrosAsCompileTimeConstants = true
    SsaRightsM:
      SsaRightsMEnhancedAccessRightsTableSize = 300
      SsaRightsMEcuIndividualAclPtrName = Ssa_RightsM_EcuIndividualAcl
      SsaRightsMPostProductionStatusActivationMileageThreshold = 100000
      SsaRightsMMaxDidListLength = 30
      SsaRightsMCsmHashJobRef = Ssa_Hash_Sha2_512
      SsaRightsMCsmSignatureVerifyJobRef = Ssa_SigVerify_RamKey_HWA
      4 x SsaSecurityAccessLevel, all with SsaCsmSignatureVerifyJobRef=Ssa_SigVerify_SecurityAccess:
        SsaSecurityAccessLevel_SAR_Remove: SsaDcmDspSecurityRowRef=SAR_Remove
        SsaSecurityAccessLevel_5F: SsaDcmDspSecurityRowRef=Level_5F
        SsaSecurityAccessLevel_SAR_Read: SsaDcmDspSecurityRowRef=SAR_Read
        SsaSecurityAccessLevel_3: SsaDcmDspSecurityRowRef=Level_3
    SsaKeyM:
      SsaKeyMNumberKeysGeneratedInMain = 65535
      SsaKeyMUniqueEcuId = RBTMFL174
      SsaKeyMUniqueEcuId = RBTMFR174
      SsaKeyMNumberRetriesKeyGeneration = 0
      SsaKeyMNumberWaitCyclesBeforeKeyGeneration = 0
      SsaCsmKeyExchangeKeyRef = Ssa_SharedSecretKeyExchange
      SsaCsmPduKeysMacKeyRef = Ssa_PduKeysMac
      SsaKeyMTrustModelEcuCertRef = Ssa_TrustModelEcuCert
      SsaKeyMTrustModelEcuPeerCertRef = Ssa_TrustModelEcuPeerCert
      SsaKeyMTrustModelEcuCsrRef = Ssa_TrustModelEcuCsr
      SsaKeyMTrustModelEcuCsrCertElemUniqueEcuIdRef = ext_uniqueECUID_007
      SsaKeyMTrustModelEcuCsrCertElemSpecialEcuRef = ext_specialEcu_007
      SsaKeyMTrustModelEcuCsrCertElemCommonNameRef = subject_008
      SsaCsmTrustModelEcuLivePrivateKeyRef = CsmKey_Ssa_TrustModelPrivateEcu_LiveKey
      SsaCsmTrustModelEcuStagingPrivateKeyRef = CsmKey_Ssa_TrustModelPrivateEcuUnique_StagingKey
      SsaCsmTrustModelEcuStagingPublicKeyRef = CsmKey_Ssa_TrustModelEcuPublicCsr_StagingKey
      SsaCsmDiagChainBackendCertKeyRef = Ssa_BackendCert
      SsaCsmDiagChainRootCertKeyRef = Ssa_RootCert
      SsaKeyMCsmHashJobRef = Ssa_Hash_Sha2_512
      SsaKeyMCsmSignatureVerifyJobRef = Ssa_SigVerify_RamKey_HWA
      SsaKeyMCsmSignatureVerifyReplacmentAuthorityJobRef = Ssa_SigVerify_replacementAuthority
      SsaKeyMCsmTrustModelBackendSignatureVerifyJobRef = KeyM_SigVerify_TrustModelBackend
      SsaKeyMCsmTrustModelTempSignatureVerifyJobRef = SSA_SigVerify_KeyM_TrustModel
      SsaCsmTrustModelEcuCsrPrivateKeyRef = CsmKey_Ssa_TrustModel_Ecu_CsrPrivateKey
      SsaCsmTrustModelEcuCsrPublicKeyRef = CsmKey_Ssa_TrustModel_Ecu_CsrPublicKey
      SsaKeyMCsmTrustModelEcuCsrSignatureGenerateJobRef = KeyM_SigGenerate_TrustModelEcuCsr_with_changeableKeys
      SsaKeyMCsmTrustModelEcuLiveSignatureGenerateJobRef = Ssa_SigGenerate_KeyM_TrustModel_with_LiveKey
    SsaProcCtrl: SsaProcCtrlEnableBufferHandling=true
    SsaCertP: SsaCertPCsmSignatureVerifyJobRef=Ssa_SigVerify_RamKey_HWA
