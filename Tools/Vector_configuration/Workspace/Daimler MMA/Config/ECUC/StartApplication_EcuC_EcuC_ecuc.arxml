AUTOSAR XML (schema 00049)
package /ActiveEcuC
  module config EcuC: implementation-config-variant=VARIANT-POST-BUILD-SELECTABLE, module-description=EcuC_Impl
    EcucPduCollection: PduIdTypeEnum=UINT8, PduLengthTypeEnum=UINT16
      159 x Pdu, all with J1939Requestable=false:
        SDU_DIAG_GLOBAL_ExtEth_RQ_BODY3_ST3_38ac71dd_Rx: DynamicLength=true, PduLength=7
        SDU_DIAG_RBTM_FL_03_IntEth_RS_BODY3_ST3_ed6362f9_Tx: DynamicLength=true, PduLength=4095, variation-point=post-build-variant-condition{matching-criterion=SideAllocation, value=0}
        CLkS_Dr_State_ST3_513e9c19_Rx: DynamicLength=false, PduLength=8
        Develop8_Rs_RBTM_FL_ST3_9a3b4dd1_Tx: DynamicLength=false, PduLength=8, variation-point=post-build-variant-condition{matching-criterion=SideAllocation, value=0}
        Impact2_ST3_secured_de133629_Rx: DynamicLength=false, PduLength=8, SysTPduToFrameMappingRef=Impact2_ST3
        ECU_Stat_RBTM_FL_ST3_42655720_Tx: DynamicLength=false, PduLength=8, SysTPduToFrameMappingRef=ECU_Stat_RBTM_FL_ST3, variation-point=post-build-variant-condition{matching-criterion=SideAllocation, value=0}
        VSS_TP_SharedSecret_ST3_6d7ca724_Rx: DynamicLength=false, PduLength=8, SysTPduToFrameMappingRef=VSS_TP_SharedSecret_ST3
        ELC_Lvr_Stat_ST3_d97bab99_Rx: DynamicLength=false, PduLength=4
        PT4_PTCoor_DrvPosn_Gear_ST3_6b508375_Rx: DynamicLength=false, PduLength=8
        Develop8_Rs_RBTM_FL_ST3_711f265e_Tx: DynamicLength=false, PduLength=8, SysTPduToFrameMappingRef=Develop8_Rs_RBTM_FL_ST3, variation-point=post-build-variant-condition{matching-criterion=SideAllocation, value=0}
        NTG_Master_Navi_ST3_dea580a6_Rx: DynamicLength=false, PduLength=2
        NM_RBTM_FL_ST3_0cdf2d0f_Tx: PduLength=7, variation-point=post-build-variant-condition{matching-criterion=SideAllocation, value=0}
        RBTM_FR_Stat_ST3_8dd11b6c_Rx: DynamicLength=false, PduLength=8, SysTPduToFrameMappingRef=RBTM_FR_Stat_ST3, variation-point=post-build-variant-condition{matching-criterion=SideAllocation, value=0}
        VSS_TP_VIN_ST3_8e87972a_Rx: DynamicLength=false, PduLength=8
        EVC_CfgList_01_08_Pr5_ST3_be03dd9d_Rx: DynamicLength=false, PduLength=8, SysTPduToFrameMappingRef=EVC_CfgList_01_08_Pr5_ST3
        PT4_PTCoor4_ST3_bf069154_Rx: DynamicLength=false, PduLength=4
        PN14_Master_Stat1_ST3_69644078_Rx: DynamicLength=false, PduLength=8, SysTPduToFrameMappingRef=PN14_Master_Stat1_ST3
        SDU_DIAG_RBTM_FL_03_IntEth_RS_BODY3_ST3_e1d59ed3_Tx: DynamicLength=true, PduLength=4095, variation-point=post-build-variant-condition{matching-criterion=SideAllocation, value=0}
        DPC_Md_Rq_ESP_d1_ST3_5573a8b2_Rx: DynamicLength=false, PduLength=1, SysTPduToFrameMappingRef=DPC_Md_Rq_ESP_d1_ST3
        VSS_TP_Auth_ST3_7c9f23ce_Rx: DynamicLength=false, PduLength=8
        ADAS_POSITION_ST3_0b61d436_Rx: DynamicLength=false, PduLength=8
        RBTM_FR_Stat_ST3_e44387fa_Rx: DynamicLength=false, PduLength=8, variation-point=post-build-variant-condition{matching-criterion=SideAllocation, value=0}
        ROE_RBTM_FL_ST3_75ad963a_Tx: DynamicLength=false, PduLength=8, SysTPduToFrameMappingRef=ROE_RBTM_FL_ST3, variation-point=post-build-variant-condition{matching-criterion=SideAllocation, value=0}
        PT4_PTCoor9_d1_BC_F_ST3_f2a4ec1b_Rx: DynamicLength=false, PduLength=1, SysTPduToFrameMappingRef=PT4_PTCoor9_d1_BC_F_ST3
        ROE_RBTM_FL_ST3_a66ccb5f_Tx: DynamicLength=false, PduLength=8, variation-point=post-build-variant-condition{matching-criterion=SideAllocation, value=0}
        BeltAdj_FR_Stat_ST3_2b5906f9_Rx: DynamicLength=false, PduLength=1, SysTPduToFrameMappingRef=BeltAdj_FR_Stat_ST3, variation-point=post-build-variant-condition{matching-criterion=SideAllocation, value=0}
        DIAG_RQ_GLOBAL_ExtCAN_ST3_320b5155_Rx: DynamicLength=false, PduLength=8, SysTPduToFrameMappingRef=DIAG_RQ_GLOBAL_ExtCAN_ST3
        PresfAct_Adj_ST3_61c58c91_Rx: DynamicLength=false, PduLength=8
        SDU_DIAG_RBTM_FL_03_ExtEth_RQ_BODY3_ST3_75192bc2_Rx: DynamicLength=true, PduLength=4095, variation-point=post-build-variant-condition{matching-criterion=SideAllocation, value=0}
        ELC_Lvr_Stat_ST3_secured_29d2456c_Rx: DynamicLength=false, PduLength=8, SysTPduToFrameMappingRef=ELC_Lvr_Stat_ST3
        Impact2_ST3_secured_2ba32448_Rx: DynamicLength=false, PduLength=8
        DPC_Md_Rq_ESP_d1_ST3_e30f951d_Rx: DynamicLength=false, PduLength=1
        Develop8_Rq_RBTM_FL_ST3_0a7cffe6_Rx: DynamicLength=false, PduLength=8, SysTPduToFrameMappingRef=Develop8_Rq_RBTM_FL_ST3, variation-point=post-build-variant-condition{matching-criterion=SideAllocation, value=0}
        CLkS_Dr_State_ST3_74337ed5_Rx: DynamicLength=false, PduLength=8, SysTPduToFrameMappingRef=CLkS_Dr_State_ST3
        NTG_Master_Navi_ST3_1032e485_Rx: DynamicLength=false, PduLength=2, SysTPduToFrameMappingRef=NTG_Master_Navi_ST3
        DIAG_Stat_ST3_3a031d4a_Rx: DynamicLength=false, PduLength=4
        NM_RBTM_FL_ST3_b7c99fb7_Tx: DynamicLength=false, PduLength=8, SysTPduToFrameMappingRef=NM_RBTM_FL_ST3, variation-point=post-build-variant-condition{matching-criterion=SideAllocation, value=0}
        SDU_DIAG_GLOBAL_ExtCAN_RQ_BODY3_ST3_18e7f235_Rx: DynamicLength=true, PduLength=7
        SDU_DIAG_RBTM_FL_03_ExtCAN_RQ_BODY3_ST3_6d2a29a5_Rx: DynamicLength=true, PduLength=4095, variation-point=post-build-variant-condition{matching-criterion=SideAllocation, value=0}
        SDU_DIAG_RBTM_FL_03_ExtCAN_RS_BODY3_ST3_b462d7d3_Tx: DynamicLength=true, PduLength=4095, variation-point=post-build-variant-condition{matching-criterion=SideAllocation, value=0}
        PresfAct_Adj_ST3_81976f17_Rx: DynamicLength=false, PduLength=8, SysTPduToFrameMappingRef=PresfAct_Adj_ST3
        SDU_DIAG_GLOBAL_ExtEth_RQ_BODY3_ST3_81f0b7e5_Rx: DynamicLength=true, PduLength=7
        DI_OdoSpeedometer_ST3_6fef7507_Rx: DynamicLength=false, PduLength=8
        Meas8_RBTM_FL_ST3_b4f3e350_Tx: DynamicLength=false, PduLength=8, SysTPduToFrameMappingRef=Meas8_RBTM_FL_ST3, variation-point=post-build-variant-condition{matching-criterion=SideAllocation, value=0}
        VSS_TP_RealTmOffset_ST3_62955a84_Rx: DynamicLength=false, PduLength=8
        VSS_TP_RealTmOffset_ST3_d6d134b3_Rx: DynamicLength=false, PduLength=8, SysTPduToFrameMappingRef=VSS_TP_RealTmOffset_ST3
        BeltAdj_FL_Stat_ST3_d2ce0dbb_Tx: DynamicLength=false, PduLength=1, variation-point=post-build-variant-condition{matching-criterion=SideAllocation, value=0}
        RBTM_FL_Stat_ST3_d76d14af_Tx: DynamicLength=false, PduLength=8, SysTPduToFrameMappingRef=RBTM_FL_Stat_ST3, variation-point=post-build-variant-condition{matching-criterion=SideAllocation, value=0}
        SDU_DIAG_RBTM_FL_03_ExtEth_RS_BODY3_ST3_b783cf68_Tx: DynamicLength=true, PduLength=4095, variation-point=post-build-variant-condition{matching-criterion=SideAllocation, value=0}
        SDU_DIAG_RBTM_FL_03_IntEth_RQ_BODY3_ST3_b50fdb38_Rx: DynamicLength=true, PduLength=4095, variation-point=post-build-variant-condition{matching-criterion=SideAllocation, value=0}
        SDU_DIAG_RBTM_FL_03_ExtEth_RQ_BODY3_ST3_4810f84e_Rx: DynamicLength=true, PduLength=4095, variation-point=post-build-variant-condition{matching-criterion=SideAllocation, value=0}
        DIAG_Stat_ST3_d3ec8369_Rx: DynamicLength=false, PduLength=4, SysTPduToFrameMappingRef=DIAG_Stat_ST3
        Impact3_ST3_d832457c_Rx: DynamicLength=false, PduLength=4
        VSS_TP_SecTickCount_Lvl2_ST3_c0c3ca3b_Rx: DynamicLength=false, PduLength=8, SysTPduToFrameMappingRef=VSS_TP_SecTickCount_Lvl2_ST3
        SDU_DIAG_RBTM_FL_03_ExtEth_RS_BODY3_ST3_2d759203_Tx: DynamicLength=true, PduLength=4095, variation-point=post-build-variant-condition{matching-criterion=SideAllocation, value=0}
        ADAS_POSITION_ST3_1ca04d74_Rx: DynamicLength=false, PduLength=8, SysTPduToFrameMappingRef=ADAS_POSITION_ST3
        ADAS_PREDICTION_ST3_549e2a63_Rx: DynamicLength=false, PduLength=8
        SDU_DIAG_GLOBAL_IntEth_RQ_BODY3_ST3_41e6471f_Rx: DynamicLength=true, PduLength=7
        PT4_PTCoor_DrvPosn_Gear_ST3_f70358bf_Rx: DynamicLength=false, PduLength=8, SysTPduToFrameMappingRef=PT4_PTCoor_DrvPosn_Gear_ST3
        ADAS_PREDICTION_ST3_7_512c5347_Rx: DynamicLength=false, PduLength=8
        ADAS_PROFILE_SHORT_ST3_2225c4a7_Rx: DynamicLength=false, PduLength=8
        DIAG_RBTM_FL_03_ExtCAN_RS_ST3_ba6d58fb_Tx: DynamicLength=false, PduLength=8, SysTPduToFrameMappingRef=DIAG_RBTM_FL_03_ExtCAN_RS_ST3, variation-point=post-build-variant-condition{matching-criterion=SideAllocation, value=0}
        Impact2_ST3_e5526ccc_Rx: DynamicLength=false, PduLength=4
        BeltHdOvr_FL_State_ST3_0b4fb3a9_Rx: DynamicLength=false, PduLength=4, SysTPduToFrameMappingRef=BeltHdOvr_FL_State_ST3, variation-point=post-build-variant-condition{matching-criterion=SideAllocation, value=0}
        ADAS_PROFILE_SHORT_ST3_894b8265_Rx: DynamicLength=false, PduLength=8, SysTPduToFrameMappingRef=ADAS_PROFILE_SHORT_ST3
        SDU_DIAG_RBTM_FL_03_ExtCAN_RS_BODY3_ST3_92b91e83_Tx: DynamicLength=true, PduLength=4095, variation-point=post-build-variant-condition{matching-criterion=SideAllocation, value=0}
        VSS_TP_Auth_ST3_29a0d419_Rx: DynamicLength=false, PduLength=8, SysTPduToFrameMappingRef=VSS_TP_Auth_ST3
        DI_OdoSpeedometer_ST3_0665a232_Rx: DynamicLength=false, PduLength=8, SysTPduToFrameMappingRef=DI_OdoSpeedometer_ST3
        ELC_Lvr_Stat_ST3_secured_7bad7996_Rx: DynamicLength=false, PduLength=8
        Develop8_Rq_RBTM_FL_ST3_fa67f89a_Rx: DynamicLength=false, PduLength=8, variation-point=post-build-variant-condition{matching-criterion=SideAllocation, value=0}
        SDU_DIAG_GLOBAL_ExtCAN_RQ_BODY3_ST3_1d96a036_Rx: DynamicLength=true, PduLength=7
        SDU_DIAG_GLOBAL_IntEth_RQ_BODY3_ST3_6efa2066_Rx: DynamicLength=true, PduLength=7
        BeltAdj_UI_Set_Rq_ST3_7be22993_Rx: DynamicLength=false, PduLength=1, SysTPduToFrameMappingRef=BeltAdj_UI_Set_Rq_ST3
        BeltAdj_FL_Stat_ST3_71e5093a_Tx: DynamicLength=false, PduLength=1, SysTPduToFrameMappingRef=BeltAdj_FL_Stat_ST3, variation-point=post-build-variant-condition{matching-criterion=SideAllocation, value=0}
        EVC_CfgList_01_08_Pr5_ST3_32c5e6fb_Rx: DynamicLength=false, PduLength=8
        Bckl_Sw_Fx_Stat_ST3_9c2de10c_Rx: DynamicLength=false, PduLength=4
        Ign_Stat_ST3_1e3dc39f_Rx: DynamicLength=false, PduLength=4
        ADAS_PROFILE_SHORT_ST3_31_05b1585f_Rx: DynamicLength=false, PduLength=8
        ECU_Stat_RBTM_FL_ST3_f703b6eb_Tx: DynamicLength=false, PduLength=8, variation-point=post-build-variant-condition{matching-criterion=SideAllocation, value=0}
        ADAS_PREDICTION_ST3_6_262b63d1_Rx: DynamicLength=false, PduLength=8
        ADAS_PROFILE_SHORT_ST3_1_506b5dfc_Rx: DynamicLength=false, PduLength=8
        RBTM_FL_BODY3NMNODE_34236992_Rx: PduLength=8, SysTPduToFrameMappingRef=NM_Dummy_ST3, variation-point=post-build-variant-condition{matching-criterion=SideAllocation, value=0}
        VSS_TP_SharedSecret_ST3_605b0fee_Rx: DynamicLength=false, PduLength=8
        SDU_DIAG_RBTM_FL_03_ExtCAN_RQ_BODY3_ST3_ec0e6e12_Rx: DynamicLength=true, PduLength=4095, variation-point=post-build-variant-condition{matching-criterion=SideAllocation, value=0}
        Meas8_RBTM_FL_ST3_a92f14da_Tx: DynamicLength=false, PduLength=8, variation-point=post-build-variant-condition{matching-criterion=SideAllocation, value=0}
        BeltAdj_FR_Stat_ST3_eba9bce0_Rx: DynamicLength=false, PduLength=1, variation-point=post-build-variant-condition{matching-criterion=SideAllocation, value=0}
        VSS_TP_SecTickCount_Lvl2_ST3_4917056b_Rx: DynamicLength=false, PduLength=8
        Ign_Stat_ST3_secured_fb0d4f19_Rx: DynamicLength=false, PduLength=8, SysTPduToFrameMappingRef=Ign_Stat_ST3
        PN14_Master_Stat1_ST3_eba3e383_Rx: DynamicLength=false, PduLength=8
        ADAS_PREDICTION_ST3_1de136c9_Rx: DynamicLength=false, PduLength=8, SysTPduToFrameMappingRef=ADAS_PREDICTION_ST3
        PT4_PTCoor9_d1_BC_F_ST3_da786b84_Rx: DynamicLength=false, PduLength=1
        BeltHdOvr_FL_State_ST3_342163b7_Rx: DynamicLength=false, PduLength=4, variation-point=post-build-variant-condition{matching-criterion=SideAllocation, value=0}
        DIAG_RBTM_FL_03_ExtCAN_RQ_ST3_3f957a34_Rx: DynamicLength=false, PduLength=8, SysTPduToFrameMappingRef=DIAG_RBTM_FL_03_ExtCAN_RQ_ST3, variation-point=post-build-variant-condition{matching-criterion=SideAllocation, value=0}
        SDU_DIAG_RBTM_FL_03_IntEth_RQ_BODY3_ST3_1e46a9f5_Rx: DynamicLength=true, PduLength=4095, variation-point=post-build-variant-condition{matching-criterion=SideAllocation, value=0}
        BeltAdj_UI_Set_Rq_ST3_1223a83d_Rx: DynamicLength=false, PduLength=1
        PT4_PTCoor4_ST3_868ca7d3_Rx: DynamicLength=false, PduLength=4, SysTPduToFrameMappingRef=PT4_PTCoor4_ST3
        Impact3_ST3_993f4b56_Rx: DynamicLength=false, PduLength=4, SysTPduToFrameMappingRef=Impact3_ST3
        PduPnc_EIRA_CAN_Rx: PduLength=7
        RBTM_FL_Stat_ST3_dd2436a1_Tx: DynamicLength=false, PduLength=8, variation-point=post-build-variant-condition{matching-criterion=SideAllocation, value=0}
        VSS_TP_VIN_ST3_f7ab6516_Rx: DynamicLength=false, PduLength=8, SysTPduToFrameMappingRef=VSS_TP_VIN_ST3
        Bckl_Sw_Fx_Stat_ST3_secured_b672d5e7_Rx: DynamicLength=false, PduLength=8
        Ign_Stat_ST3_secured_87afaf29_Rx: DynamicLength=false, PduLength=8
        DIAG_RBTM_FL_03_ExtEth_RQ_ST3_8e910fe6_Rx: DynamicLength=false, PduLength=8, SysTPduToFrameMappingRef=DIAG_RBTM_FL_03_ExtEth_RQ_ST3, variation-point=post-build-variant-condition{matching-criterion=SideAllocation, value=0}
        DIAG_RBTM_FL_03_ExtEth_RS_ST3_0b692d29_Tx: DynamicLength=false, PduLength=8, SysTPduToFrameMappingRef=DIAG_RBTM_FL_03_ExtEth_RS_ST3, variation-point=post-build-variant-condition{matching-criterion=SideAllocation, value=0}
        DIAG_RBTM_FL_03_IntEth_RQ_ST3_c3ea483d_Rx: DynamicLength=false, PduLength=8, SysTPduToFrameMappingRef=DIAG_RBTM_FL_03_IntEth_RQ_ST3, variation-point=post-build-variant-condition{matching-criterion=SideAllocation, value=0}
        DIAG_RBTM_FL_03_IntEth_RS_ST3_46126af2_Tx: DynamicLength=false, PduLength=8, SysTPduToFrameMappingRef=DIAG_RBTM_FL_03_IntEth_RS_ST3, variation-point=post-build-variant-condition{matching-criterion=SideAllocation, value=0}
        DIAG_RQ_GLOBAL_ExtEth_ST3_3402b191_Rx: DynamicLength=false, PduLength=8, SysTPduToFrameMappingRef=DIAG_RQ_GLOBAL_ExtEth_ST3
        DIAG_RQ_GLOBAL_IntEth_ST3_f8cf566a_Rx: DynamicLength=false, PduLength=8, SysTPduToFrameMappingRef=DIAG_RQ_GLOBAL_IntEth_ST3
        Bckl_Sw_Fx_Stat_ST3_secured_62272d37_Rx: DynamicLength=false, PduLength=8, SysTPduToFrameMappingRef=Bckl_Sw_Fx_Stat_ST3
        GTS_Main_CAN_ST3_dd88dcd5_Rx: DynamicLength=true, PduLength=8, SysTPduToFrameMappingRef=GTS_Main_CAN_ST3
        RBTM_FL_Tens_ST3_553ec607_Tx: DynamicLength=false, PduLength=8, variation-point=post-build-variant-condition{matching-criterion=SideAllocation, value=0}
        SBeltTens_SP_Lvl_ST3_73b20851_Rx: DynamicLength=false, PduLength=8, SysTPduToFrameMappingRef=SBeltTens_SP_Lvl_ST3
        SBeltTens_SP_Lvl_ST3_46421e11_Rx: DynamicLength=false, PduLength=8
        RBTM_FL_Tens_ST3_49d8a970_Tx: DynamicLength=false, PduLength=8, SysTPduToFrameMappingRef=RBTM_FL_Tens_ST3, variation-point=post-build-variant-condition{matching-criterion=SideAllocation, value=0}
        DIAG_RBTM_FR_03_ExtEth_RQ_ST3_935b3bbf_Rx: DynamicLength=false, PduLength=8, SysTPduToFrameMappingRef=DIAG_RBTM_FR_03_ExtEth_RQ_ST3, variation-point=post-build-variant-condition{matching-criterion=SideAllocation, value=1}
        DIAG_RBTM_FR_03_ExtCAN_RQ_ST3_225f4e6d_Rx: DynamicLength=false, PduLength=8, SysTPduToFrameMappingRef=DIAG_RBTM_FR_03_ExtCAN_RQ_ST3, variation-point=post-build-variant-condition{matching-criterion=SideAllocation, value=1}
        SDU_DIAG_RBTM_FR_03_ExtCAN_RS_BODY3_ST3_e09767bb_Tx: DynamicLength=true, PduLength=4095, variation-point=post-build-variant-condition{matching-criterion=SideAllocation, value=1}
        NM_RBTM_FR_ST3_6c247ca6_Tx: DynamicLength=false, PduLength=8, SysTPduToFrameMappingRef=NM_RBTM_FR_ST3, variation-point=post-build-variant-condition{matching-criterion=SideAllocation, value=1}
        BeltAdj_FR_Stat_ST3_eba9bce0_Tx: DynamicLength=false, PduLength=1, variation-point=post-build-variant-condition{matching-criterion=SideAllocation, value=1}
        DIAG_RBTM_FR_03_ExtCAN_RS_ST3_a7a76ca2_Tx: DynamicLength=false, PduLength=8, SysTPduToFrameMappingRef=DIAG_RBTM_FR_03_ExtCAN_RS_ST3, variation-point=post-build-variant-condition{matching-criterion=SideAllocation, value=1}
        DIAG_RBTM_FR_03_ExtEth_RS_ST3_16a31970_Tx: DynamicLength=false, PduLength=8, SysTPduToFrameMappingRef=DIAG_RBTM_FR_03_ExtEth_RS_ST3, variation-point=post-build-variant-condition{matching-criterion=SideAllocation, value=1}
        ROE_RBTM_FR_ST3_79bce2bc_Tx: DynamicLength=false, PduLength=8, variation-point=post-build-variant-condition{matching-criterion=SideAllocation, value=1}
        SDU_DIAG_RBTM_FR_03_IntEth_RS_BODY3_ST3_93fbe7eb_Tx: DynamicLength=true, PduLength=4095, variation-point=post-build-variant-condition{matching-criterion=SideAllocation, value=1}
        SDU_DIAG_RBTM_FR_03_ExtEth_RQ_BODY3_ST3_3a3e8176_Rx: DynamicLength=true, PduLength=4095, variation-point=post-build-variant-condition{matching-criterion=SideAllocation, value=1}
        SDU_DIAG_RBTM_FR_03_ExtCAN_RS_BODY3_ST3_a939c600_Tx: DynamicLength=true, PduLength=4095, variation-point=post-build-variant-condition{matching-criterion=SideAllocation, value=1}
        SDU_DIAG_RBTM_FR_03_ExtCAN_RQ_BODY3_ST3_1f04509d_Rx: DynamicLength=true, PduLength=4095, variation-point=post-build-variant-condition{matching-criterion=SideAllocation, value=1}
        SDU_DIAG_RBTM_FR_03_ExtEth_RQ_BODY3_ST3_68423a11_Rx: DynamicLength=true, PduLength=4095, variation-point=post-build-variant-condition{matching-criterion=SideAllocation, value=1}
        SDU_DIAG_RBTM_FR_03_IntEth_RQ_BODY3_ST3_a854caeb_Rx: DynamicLength=true, PduLength=4095, variation-point=post-build-variant-condition{matching-criterion=SideAllocation, value=1}
        ROE_RBTM_FR_ST3_ae40752b_Tx: DynamicLength=false, PduLength=8, SysTPduToFrameMappingRef=ROE_RBTM_FR_ST3, variation-point=post-build-variant-condition{matching-criterion=SideAllocation, value=1}
        DIAG_RBTM_FR_03_IntEth_RS_ST3_5bd85eab_Tx: DynamicLength=false, PduLength=8, SysTPduToFrameMappingRef=DIAG_RBTM_FR_03_IntEth_RS_ST3, variation-point=post-build-variant-condition{matching-criterion=SideAllocation, value=1}
        RBTM_FR_Stat_ST3_8dd11b6c_Tx: DynamicLength=false, PduLength=8, SysTPduToFrameMappingRef=RBTM_FR_Stat_ST3, variation-point=post-build-variant-condition{matching-criterion=SideAllocation, value=1}
        DIAG_RBTM_FR_03_IntEth_RQ_ST3_de207c64_Rx: DynamicLength=false, PduLength=8, SysTPduToFrameMappingRef=DIAG_RBTM_FR_03_IntEth_RQ_ST3, variation-point=post-build-variant-condition{matching-criterion=SideAllocation, value=1}
        SDU_DIAG_RBTM_FR_03_IntEth_RS_BODY3_ST3_f038732a_Tx: DynamicLength=true, PduLength=4095, variation-point=post-build-variant-condition{matching-criterion=SideAllocation, value=1}
        Develop8_Rq_RBTM_FR_ST3_d1911cf7_Rx: DynamicLength=false, PduLength=8, SysTPduToFrameMappingRef=Develop8_Rq_RBTM_FR_ST3, variation-point=post-build-variant-condition{matching-criterion=SideAllocation, value=1}
        Develop8_Rq_RBTM_FR_ST3_25b7d179_Rx: DynamicLength=false, PduLength=8, variation-point=post-build-variant-condition{matching-criterion=SideAllocation, value=1}
        XCP8_Rq_RBTM_FR_ST3_93e199bd_Rx: DynamicLength=true, PduLength=8, SysTPduToFrameMappingRef=XCP8_Rq_RBTM_FR_ST3, variation-point=post-build-variant-condition{matching-criterion=SideAllocation, value=1}
        Develop8_Rs_RBTM_FR_ST3_45eb6432_Tx: DynamicLength=false, PduLength=8, variation-point=post-build-variant-condition{matching-criterion=SideAllocation, value=1}
        SDU_DIAG_RBTM_FR_03_IntEth_RQ_BODY3_ST3_6c68d0cd_Rx: DynamicLength=true, PduLength=4095, variation-point=post-build-variant-condition{matching-criterion=SideAllocation, value=1}
        BeltHdOvr_FR_State_ST3_09789cac_Rx: DynamicLength=false, PduLength=4, SysTPduToFrameMappingRef=BeltHdOvr_FR_State_ST3, variation-point=post-build-variant-condition{matching-criterion=SideAllocation, value=1}
        RBTM_FR_Stat_ST3_e44387fa_Tx: DynamicLength=false, PduLength=8, variation-point=post-build-variant-condition{matching-criterion=SideAllocation, value=1}
        SDU_DIAG_RBTM_FR_03_ExtEth_RS_BODY3_ST3_c5adb650_Tx: DynamicLength=true, PduLength=4095, variation-point=post-build-variant-condition{matching-criterion=SideAllocation, value=1}
        SDU_DIAG_RBTM_FR_03_ExtCAN_RQ_BODY3_ST3_f1557fc1_Rx: DynamicLength=true, PduLength=4095, variation-point=post-build-variant-condition{matching-criterion=SideAllocation, value=1}
        BeltAdj_FL_Stat_ST3_71e5093a_Rx: DynamicLength=false, PduLength=1, SysTPduToFrameMappingRef=BeltAdj_FL_Stat_ST3, variation-point=post-build-variant-condition{matching-criterion=SideAllocation, value=1}
        NM_RBTM_FR_ST3_d30f04ec_Tx: PduLength=7, variation-point=post-build-variant-condition{matching-criterion=SideAllocation, value=1}
        BeltAdj_FR_Stat_ST3_2b5906f9_Tx: DynamicLength=false, PduLength=1, SysTPduToFrameMappingRef=BeltAdj_FR_Stat_ST3, variation-point=post-build-variant-condition{matching-criterion=SideAllocation, value=1}
        Meas8_RBTM_FR_ST3_6f1e0041_Tx: DynamicLength=false, PduLength=8, SysTPduToFrameMappingRef=Meas8_RBTM_FR_ST3, variation-point=post-build-variant-condition{matching-criterion=SideAllocation, value=1}
        Meas8_RBTM_FR_ST3_76ff3d39_Tx: DynamicLength=false, PduLength=8, variation-point=post-build-variant-condition{matching-criterion=SideAllocation, value=1}
        BeltAdj_FL_Stat_ST3_d2ce0dbb_Rx: DynamicLength=false, PduLength=1, variation-point=post-build-variant-condition{matching-criterion=SideAllocation, value=1}
        ECU_Stat_RBTM_FR_ST3_9988b431_Tx: DynamicLength=false, PduLength=8, SysTPduToFrameMappingRef=ECU_Stat_RBTM_FR_ST3, variation-point=post-build-variant-condition{matching-criterion=SideAllocation, value=1}
        RBTM_FL_Stat_ST3_dd2436a1_Rx: DynamicLength=false, PduLength=8, variation-point=post-build-variant-condition{matching-criterion=SideAllocation, value=1}
        RBTM_FL_Stat_ST3_d76d14af_Rx: DynamicLength=false, PduLength=8, SysTPduToFrameMappingRef=RBTM_FL_Stat_ST3, variation-point=post-build-variant-condition{matching-criterion=SideAllocation, value=1}
        SDU_DIAG_RBTM_FR_03_ExtEth_RS_BODY3_ST3_302e83d0_Tx: DynamicLength=true, PduLength=4095, variation-point=post-build-variant-condition{matching-criterion=SideAllocation, value=1}
        ECU_Stat_RBTM_FR_ST3_28d39f08_Tx: DynamicLength=false, PduLength=8, variation-point=post-build-variant-condition{matching-criterion=SideAllocation, value=1}
        BeltHdOvr_FR_State_ST3_c8a18c7a_Rx: DynamicLength=false, PduLength=4, variation-point=post-build-variant-condition{matching-criterion=SideAllocation, value=1}
        RBTM_FR_BODY3NMNODE_e285a2b9_Rx: PduLength=8, SysTPduToFrameMappingRef=NM_Dummy_ST3, variation-point=post-build-variant-condition{matching-criterion=SideAllocation, value=1}
        XCP8_Rs_RBTM_FR_ST3_e8824005_Tx: DynamicLength=true, PduLength=8, SysTPduToFrameMappingRef=XCP8_Rs_RBTM_FR_ST3, variation-point=post-build-variant-condition{matching-criterion=SideAllocation, value=1}
        Develop8_Rs_RBTM_FR_ST3_aaf2c54f_Tx: DynamicLength=false, PduLength=8, SysTPduToFrameMappingRef=Develop8_Rs_RBTM_FR_ST3, variation-point=post-build-variant-condition{matching-criterion=SideAllocation, value=1}
        RBTM_FR_Tens_ST3_1364a6b3_Tx: DynamicLength=false, PduLength=8, SysTPduToFrameMappingRef=RBTM_FR_Tens_ST3, variation-point=post-build-variant-condition{matching-criterion=SideAllocation, value=1}
        RBTM_FR_Tens_ST3_6c59775c_Tx: DynamicLength=false, PduLength=8, variation-point=post-build-variant-condition{matching-criterion=SideAllocation, value=1}
    EcucGeneral:
      CPUType = CPU32Bit
      SizeOfInt = Size32Bit
      ByteOrder = LITTLE_ENDIAN
      BitOrder = LSB_to_MSB
      AtomicBitAccessInBitfield = false
      AtomicVariableAccess = Atomic32BitAccess
      SizeOfEnum = Size32Bit
      SizeOfROMPointer = Size32Bit
      SizeOfRAMPointer = Size32Bit
      BitFieldDataType = INT
      StructAlignment = Auto
      ArrayAlignment = Align8Bit
      StructInArrayAlignment = Auto
      DummyFunction = false
      DummyStatement = false
      DummyStatementKind = None
      ConditionalGenerating = true
      EcucBswImplementationCodeType = EcuCSourceCode
      EcuCUseStdReturnTypeForRte = false
      PostbuildLoadable: AlignmentFillPattern=0, PBROMStartAddress=0, PBRAMStartAddress=0, PBROMEndAddress=0, PBRAMEndAddress=0
      BswInitialization
        87 x InitFunction:
          BswM_Init: Header=BswM.h, InitPhase=NO_INIT, ConfigType=BswM_ConfigType, ConfigPtrName=BswM_Config_Left_Ptr if post-build-variant-condition{matching-criterion=SideAllocation, value=0}, ConfigPtrClass=BSWM_INIT_DATA, ConfigPtrName=BswM_Config_Right_Ptr if post-build-variant-condition{matching-criterion=SideAllocation, value=1}, ModuleRef=BswM  # /ActiveEcuC/BswM PLAIN_TEXT Init function description of BswM in PostBuildPredefinedVariantView (Left) .
          BswM_PreInit: Header=BswM.h, InitPhase=INIT_ONE, ConfigType=BswM_ConfigType, ConfigPtrName=BswM_Config_Left_Ptr if post-build-variant-condition{matching-criterion=SideAllocation, value=0}, ConfigPtrClass=BSWM_INIT_DATA, ConfigPtrName=BswM_Config_Right_Ptr if post-build-variant-condition{matching-criterion=SideAllocation, value=1}, ModuleRef=BswM  # /ActiveEcuC/BswM PLAIN_TEXT PreInit function description of BswM in PostBuildPredefinedVariantView (Left) .
          BswM_InitMemory: Header=BswM.h, InitPhase=INIT_MEMORY, ModuleRef=BswM  # /ActiveEcuC/BswM PLAIN_TEXT InitMemory function description of BswM in UnfilteredViewInInvariantProject (UnfilteredInvariantProjectModelView) .
          CanIf_Init: Header=CanIf.h, InitPhase=INIT_TWO_IF, ConfigType=CanIf_ConfigType, ConfigPtrName=CanIf_Config_Left_Ptr if post-build-variant-condition{matching-criterion=SideAllocation, value=0}, ConfigPtrClass=CANIF_INIT_DATA, ConfigPtrName=CanIf_Config_Right_Ptr if post-build-variant-condition{matching-criterion=SideAllocation, value=1}, ModuleRef=CanIf  # /ActiveEcuC/CanIf PLAIN_TEXT Init function description of CanIf in PostBuildPredefinedVariantView (Left) .
          CanIf_InitMemory: Header=CanIf.h, InitPhase=INIT_MEMORY, ModuleRef=CanIf  # /ActiveEcuC/CanIf PLAIN_TEXT InitMemory function description of CanIf in UnfilteredViewInInvariantProject (UnfilteredInvariantProjectModelView) .
          CanNm_Init: Header=CanNm.h, InitPhase=INIT_TWO_NM, ConfigType=CanNm_ConfigType, ConfigPtrName=CanNm_Config_Left_Ptr if post-build-variant-condition{matching-criterion=SideAllocation, value=0}, ConfigPtrClass=CANNM_INIT_DATA, ConfigPtrName=CanNm_Config_Right_Ptr if post-build-variant-condition{matching-criterion=SideAllocation, value=1}, ModuleRef=CanNm  # /ActiveEcuC/CanNm PLAIN_TEXT Init function description of CanNm in PostBuildPredefinedVariantView (Left) .
          CanNm_InitMemory: Header=CanNm.h, InitPhase=INIT_MEMORY, ModuleRef=CanNm  # /ActiveEcuC/CanNm PLAIN_TEXT InitMemory function description of CanNm in UnfilteredViewInInvariantProject (UnfilteredInvariantProjectModelView) .
          CanSM_Init: Header=CanSM_EcuM.h, InitPhase=INIT_TWO_SM, ConfigType=CanSM_ConfigType, ConfigPtrName=CanSM_Config_Left_Ptr if post-build-variant-condition{matching-criterion=SideAllocation, value=0}, ConfigPtrClass=CANSM_INIT_DATA, ConfigPtrName=CanSM_Config_Right_Ptr if post-build-variant-condition{matching-criterion=SideAllocation, value=1}, ModuleRef=CanSM  # /ActiveEcuC/CanSM PLAIN_TEXT Init function description of CanSM in PostBuildPredefinedVariantView (Left) .
          CanSM_InitMemory: Header=CanSM_EcuM.h, InitPhase=INIT_MEMORY, ModuleRef=CanSM  # /ActiveEcuC/CanSM PLAIN_TEXT InitMemory function description of CanSM in UnfilteredViewInInvariantProject (UnfilteredInvariantProjectModelView) .
          CanTp_InitMemory: Header=CanTp.h, InitPhase=INIT_MEMORY, ModuleRef=CanTp  # /ActiveEcuC/CanTp PLAIN_TEXT InitMemory function description of CanTp in UnfilteredViewInInvariantProject (UnfilteredInvariantProjectModelView) .
          CanTp_Init: Header=CanTp.h, InitPhase=INIT_TWO_TP, ConfigType=CanTp_ConfigType, ConfigPtrName=CanTp_Config_Left_Ptr if post-build-variant-condition{matching-criterion=SideAllocation, value=0}, ConfigPtrClass=CANTP_INIT_DATA, ConfigPtrName=CanTp_Config_Right_Ptr if post-build-variant-condition{matching-criterion=SideAllocation, value=1}, ModuleRef=CanTp  # /ActiveEcuC/CanTp PLAIN_TEXT Init function description of CanTp in PostBuildPredefinedVariantView (Left) .
          Can_InitMemory: Header=Can.h, InitPhase=INIT_MEMORY, ModuleRef=Can  # /ActiveEcuC/Can PLAIN_TEXT InitMemory function description of Can in UnfilteredViewInInvariantProject (UnfilteredInvariantProjectModelView) .
          Can_Init: Header=Can.h, InitPhase=INIT_TWO_DRV, ConfigType=Can_ConfigType, ConfigPtrName=Can_Config_Left_Ptr if post-build-variant-condition{matching-criterion=SideAllocation, value=0}, ConfigPtrClass=CAN_INIT_DATA, ConfigPtrName=Can_Config_Right_Ptr if post-build-variant-condition{matching-criterion=SideAllocation, value=1}, ModuleRef=Can  # /ActiveEcuC/Can PLAIN_TEXT Init function description of Can in PostBuildPredefinedVariantView (Left) .
          ComM_InitMemory: Header=ComM.h, InitPhase=INIT_MEMORY, ModuleRef=ComM  # /ActiveEcuC/ComM PLAIN_TEXT Initializes variables of Communication Manager
          ComM_Init: Header=ComM.h, InitPhase=INIT_TWO_POST_NVMREADALL, ConfigType=ComM_ConfigType, ConfigPtrName=ComM_Config_Left_Ptr if post-build-variant-condition{matching-criterion=SideAllocation, value=0}, ConfigPtrClass=COMM_INIT_DATA, ConfigPtrName=ComM_Config_Right_Ptr if post-build-variant-condition{matching-criterion=SideAllocation, value=1}, ModuleRef=ComM  # /ActiveEcuC/ComM PLAIN_TEXT Init function description of ComM in PostBuildPredefinedVariantView (Left) .
          ComXf_Init: Header=ComXf.h, InitPhase=NO_INIT, ModuleRef=ComXf  # /ActiveEcuC/ComXf PLAIN_TEXT Automatically generated by EcuCBswInitFctConfigurationService.
          Com_Init: Header=Com.h, InitPhase=INIT_TWO_COM, ConfigType=Com_ConfigType, ConfigPtrName=Com_Config_Left_Ptr if post-build-variant-condition{matching-criterion=SideAllocation, value=0}, ConfigPtrClass=COM_INIT_DATA, ConfigPtrName=Com_Config_Right_Ptr if post-build-variant-condition{matching-criterion=SideAllocation, value=1}, ModuleRef=Com  # /ActiveEcuC/Com PLAIN_TEXT Init function description of Com in PostBuildPredefinedVariantView (Left) .
          Com_InitMemory: Header=Com.h, InitPhase=INIT_MEMORY, ModuleRef=Com  # /ActiveEcuC/Com PLAIN_TEXT InitMemory function description of Com in UnfilteredViewInInvariantProject (UnfilteredInvariantProjectModelView) .
          Dcm_Init: Header=Dcm.h, InitPhase=INIT_TWO_POST_NVMREADALL, ConfigType=Dcm_ConfigType, ConfigPtrName=&Dcm_CfgConfig_Left if post-build-variant-condition{matching-criterion=SideAllocation, value=0}, ConfigPtrClass=DCM_CONST, ConfigPtrName=&Dcm_CfgConfig_Right if post-build-variant-condition{matching-criterion=SideAllocation, value=1}, ModuleRef=Dcm  # /ActiveEcuC/Dcm PLAIN_TEXT Dcm_Init function description
          Dcm_InitMemory: Header=Dcm.h, InitPhase=INIT_MEMORY, ModuleRef=Dcm  # /ActiveEcuC/Dcm PLAIN_TEXT Dcm_InitMemory function description
          Det_Init: Header=Det.h, InitPhase=INIT_ZERO, ConfigType=Det_ConfigType, ConfigPtrName=Det_Config_Ptr, ConfigPtrClass=DET_INIT_DATA, ModuleRef=Det  # /ActiveEcuC/Det PLAIN_TEXT Init function description of Det in UnfilteredViewInInvariantProject (UnfilteredInvariantProjectModelView) .
          Det_InitMemory: Header=Det.h, InitPhase=INIT_MEMORY, ModuleRef=Det  # /ActiveEcuC/Det PLAIN_TEXT InitMemory function description of Det in UnfilteredViewInInvariantProject (UnfilteredInvariantProjectModelView) .
          E2EXf_InitMemory: Header=E2EXf.h, InitPhase=INIT_MEMORY, ModuleRef=E2EXf  # /ActiveEcuC/E2EXf PLAIN_TEXT Automatically generated by EcuCBswInitFctConfigurationService.
          E2EXf_Init: Header=E2EXf.h, InitPhase=INIT_ONE, ConfigType=E2EXf_ConfigType, ConfigPtrName=NULL_PTR, ConfigPtrClass=E2EXF_PBCFG, ModuleRef=E2EXf  # /ActiveEcuC/E2EXf PLAIN_TEXT Automatically generated by EcuCBswInitFctConfigurationService.
          EcuM_Init: Header=EcuM.h, InitPhase=NO_INIT, ConfigType=EcuM_PbConfigType, ConfigPtrName=EcuM_Config_Left_Ptr if post-build-variant-condition{matching-criterion=SideAllocation, value=0}, ConfigPtrClass=ECUM_INIT_DATA, ConfigPtrName=EcuM_Config_Right_Ptr if post-build-variant-condition{matching-criterion=SideAllocation, value=1}, ModuleRef=EcuM  # /ActiveEcuC/EcuM PLAIN_TEXT Init function description of EcuM in PostBuildPredefinedVariantView (Left) .
          IpduM_Init: Header=IpduM.h, InitPhase=INIT_TWO_COM, ConfigType=IpduM_ConfigType, ConfigPtrName=IpduM_Config_Ptr, ConfigPtrClass=IPDUM_INIT_DATA, ModuleRef=IpduM  # /ActiveEcuC/IpduM PLAIN_TEXT Init function description of IpduM in UnfilteredViewInInvariantProject (UnfilteredInvariantProjectModelView) .
          IpduM_InitMemory: Header=IpduM.h, InitPhase=INIT_MEMORY, ModuleRef=IpduM  # /ActiveEcuC/IpduM PLAIN_TEXT InitMemory function description of IpduM in UnfilteredViewInInvariantProject (UnfilteredInvariantProjectModelView) .
          Nm_InitMemory: Header=Nm.h, InitPhase=INIT_MEMORY, ModuleRef=Nm  # /ActiveEcuC/Nm PLAIN_TEXT Pre-Initialization of the Network Management and its internal state machine
          Nm_Init: Header=Nm.h, InitPhase=INIT_TWO_NM, ConfigType=Nm_ConfigType, ConfigPtrName=Nm_Config_Left_Ptr if post-build-variant-condition{matching-criterion=SideAllocation, value=0}, ConfigPtrClass=NM_INIT_DATA, ConfigPtrName=Nm_Config_Right_Ptr if post-build-variant-condition{matching-criterion=SideAllocation, value=1}, ModuleRef=Nm  # /ActiveEcuC/Nm PLAIN_TEXT Init function description of Nm in PostBuildPredefinedVariantView (Left) .
          PduR_Init: Header=PduR.h, InitPhase=INIT_TWO_COM, ConfigType=PduR_PBConfigType, ConfigPtrName=PduR_Config_Left_Ptr if post-build-variant-condition{matching-criterion=SideAllocation, value=0}, ConfigPtrClass=PDUR_INIT_DATA, ConfigPtrName=PduR_Config_Right_Ptr if post-build-variant-condition{matching-criterion=SideAllocation, value=1}, ModuleRef=PduR  # /ActiveEcuC/PduR PLAIN_TEXT Init function description of PduR in PostBuildPredefinedVariantView (Left) .
          PduR_PreInit: Header=PduR.h, InitPhase=INIT_ONE, ConfigType=PduR_PBConfigType, ConfigPtrName=PduR_Config_Left_Ptr if post-build-variant-condition{matching-criterion=SideAllocation, value=0}, ConfigPtrClass=PDUR_INIT_DATA, ConfigPtrName=PduR_Config_Right_Ptr if post-build-variant-condition{matching-criterion=SideAllocation, value=1}, ModuleRef=PduR  # /ActiveEcuC/PduR PLAIN_TEXT PreInit function description of PduR in PostBuildPredefinedVariantView (Left) .
          PduR_InitMemory: Header=PduR.h, InitPhase=INIT_MEMORY, ModuleRef=PduR  # /ActiveEcuC/PduR PLAIN_TEXT InitMemory function description of PduR in UnfilteredViewInInvariantProject (UnfilteredInvariantProjectModelView) .
          SchM_Init: Header=Rte_Main.h, InitPhase=NO_INIT, ConfigType=SchM_ConfigType, ConfigPtrName=&Rte_Config_Left if post-build-variant-condition{matching-criterion=SideAllocation, value=0}, ConfigPtrClass=RTE_CONST, ConfigPtrName=&Rte_Config_Right if post-build-variant-condition{matching-criterion=SideAllocation, value=1}, ModuleRef=Rte  # /ActiveEcuC/Rte PLAIN_TEXT Automatically generated by EcuCBswInitFctConfigurationService.
          Rte_Start: Header=Rte_Main.h, InitPhase=INIT_THREE, ModuleRef=Rte  # /ActiveEcuC/Rte PLAIN_TEXT Automatically generated by EcuCBswInitFctConfigurationService.
          Rte_InitMemory: Header=Rte_Main.h, InitPhase=INIT_MEMORY, ModuleRef=Rte  # /ActiveEcuC/Rte PLAIN_TEXT Automatically generated by EcuCBswInitFctConfigurationService.
          Rte_StartTiming: Header=Rte_Main.h, InitPhase=NO_INIT, ModuleRef=Rte  # /ActiveEcuC/Rte PLAIN_TEXT Automatically generated by EcuCBswInitFctConfigurationService.
          Dem_InitMemory: Header=Dem.h, InitPhase=INIT_MEMORY, ModuleRef=Dem  # /ActiveEcuC/Dem PLAIN_TEXT InitMemory function description of Dem in UnfilteredViewInInvariantProject (UnfilteredInvariantProjectModelView) .
          Dem_Init: Header=Dem.h, InitPhase=INIT_TWO_POST_NVMREADALL, ConfigType=Dem_ConfigType, ConfigPtrName=Dem_Config_Ptr, ConfigPtrClass=DEM_INIT_DATA, ModuleRef=Dem  # /ActiveEcuC/Dem PLAIN_TEXT Init function description of Dem in UnfilteredViewInInvariantProject (UnfilteredInvariantProjectModelView) .
          Dem_PreInit: Header=Dem.h, InitPhase=INIT_ZERO, ConfigType=Dem_ConfigType, ConfigPtrName=Dem_Config_Ptr, ConfigPtrClass=DEM_INIT_DATA, ModuleRef=Dem  # /ActiveEcuC/Dem PLAIN_TEXT PreInit function description of Dem in UnfilteredViewInInvariantProject (UnfilteredInvariantProjectModelView) .
          Brs_Init: Header=, InitPhase=NO_INIT, ModuleRef=vBRS  # /ActiveEcuC/vBRS PLAIN_TEXT Automatically generated by EcuCBswInitFctConfigurationService.
          vBaseEnv_Init: Header=, InitPhase=NO_INIT, ModuleRef=vBaseEnv  # /ActiveEcuC/vBaseEnv PLAIN_TEXT Created vBaseEnv_Init by Extended Init XML Service
          vLinkGen_Init: Header=vLinkGen_Lcfg.h, InitPhase=NO_INIT, ModuleRef=vLinkGen  # /ActiveEcuC/vLinkGen PLAIN_TEXT Dummy initialization of the vLinkGen
          McalLib_Init: Header=McalLib.h, InitPhase=NO_INIT, ModuleRef=McalLib  # /McalLib/McalLib PLAIN_TEXT Created McalLib_Init by Extended Init XML Service
          Mcu_Init: Header=Mcu.h, InitPhase=INIT_ONE_EARLY, ConfigType=Mcu_ConfigType, ConfigPtrName=&Mcu_Config, ConfigPtrClass=AUTOMATIC, AdditionalInitCode=Mcu_InitClock(0);while (MCU_PLL_LOCKED != Mcu_GetPllStatus());Mcu_DistributePllClock();, ModuleRef=Mcu  # /Mcu/Mcu PLAIN_TEXT Created Mcu_Init by Extended Init XML Service
          Port_Init: Header=Port.h, InitPhase=INIT_ONE_EARLY, ConfigType=Port_ConfigType, ConfigPtrName=&Port_Config, ConfigPtrClass=AUTOMATIC, ModuleRef=Port  # /Port/Port PLAIN_TEXT Created Port_Init by Extended Init XML Service
          Dio_Init: Header=Dio.h, InitPhase=NO_INIT, ModuleRef=Dio  # /Dio/Dio PLAIN_TEXT Created Dio_Init by Extended Init XML Service
          Irq_Init: Header=Irq.h, InitPhase=NO_INIT, ModuleRef=Irq  # /Irq/Irq PLAIN_TEXT Created Irq_Init by Extended Init XML Service
          Dma_Init: Header=Dma.h, InitPhase=INIT_ONE, ConfigType=Dma_ConfigType, ConfigPtrName=&Dma_Config, ConfigPtrClass=AUTOMATIC, ModuleRef=Dma  # /Dma/Dma PLAIN_TEXT Created Dma_Init by Extended Init XML Service
          Spi_Init: Header=Spi.h, InitPhase=INIT_ONE, ConfigType=Spi_ConfigType, ConfigPtrName=&Spi_Config, ConfigPtrClass=AUTOMATIC, ModuleRef=Spi  # /Spi/Spi PLAIN_TEXT Created Spi_Init by Extended Init XML Service
          Icu_17_TimerIp_Init: Header=Icu_17_TimerIp.h, InitPhase=INIT_ONE_LATE, ConfigType=Icu_17_TimerIp_ConfigType, ConfigPtrName=&Icu_17_TimerIp_Config, ConfigPtrClass=AUTOMATIC, ModuleRef=Icu  # /Icu/Icu PLAIN_TEXT Created Icu_17_TimerIp_Init by Extended Init XML Service
          Wdg_17_Scu_Init: Header=Wdg_17_Scu.h, InitPhase=INIT_ONE, ConfigType=Wdg_17_Scu_ConfigType, ConfigPtrName=&Wdg_17_Scu_Config_0, ConfigPtrClass=AUTOMATIC, ModuleRef=Wdg  # /Wdg/Wdg PLAIN_TEXT Created Wdg_17_Scu_Init by Extended Init XML Service
          WdgM_Init: Header=WdgM.h, InitPhase=INIT_TWO_IF, ConfigType=WdgM_ConfigType, ConfigPtrName=&WdgMConfig_Mode0_core0, ConfigPtrClass=WDGM_APPL_CONST, ModuleRef=WdgM  # /ActiveEcuC/WdgM PLAIN_TEXT Initialization of WdgM Module
          Fls_17_Dmu_Init: Header=Fls_17_Dmu.h, InitPhase=INIT_ONE, ConfigType=Fls_17_Dmu_ConfigType, ConfigPtrName=&Fls_17_Dmu_Config, ConfigPtrClass=AUTOMATIC, ModuleRef=Fls  # /Fls/Fls PLAIN_TEXT Created Fls_17_Dmu_Init by Extended Init XML Service
          Fee_Init: Header=Fee.h, InitPhase=INIT_ONE_LATE, ConfigType=Fee_ConfigType, ConfigPtrName=&Fee_Config, ConfigPtrClass=AUTOMATIC, ModuleRef=Fee  # /ActiveEcuC/Fee PLAIN_TEXT Created Fee_Init by Extended Init XML Service
          NvM_Init: Header=NvM.h, InitPhase=INIT_TWO_SYS, ModuleRef=NvM  # /ActiveEcuC/NvM PLAIN_TEXT Initialization of the NVRAM Manager, to make it ready for NvM_ReadAll being requested
          SecOC_Init: Header=SecOC.h, InitPhase=INIT_TWO_COM, ConfigType=SecOC_ConfigType, ConfigPtrName=SecOC_Config_Ptr, ConfigPtrClass=SECOC_INIT_DATA, ModuleRef=SecOC  # /ActiveEcuC/SecOC PLAIN_TEXT Init function description of SecOC in UnfilteredViewInInvariantProject (UnfilteredInvariantProjectModelView) .
          SecOC_InitMemory: Header=SecOC.h, InitPhase=INIT_MEMORY, ModuleRef=SecOC  # /ActiveEcuC/SecOC PLAIN_TEXT InitMemory function description of SecOC in UnfilteredViewInInvariantProject (UnfilteredInvariantProjectModelView) .
          CryIf_Init: Header=CryIf.h, InitPhase=INIT_TWO_IF, ModuleRef=CryIf  # /ActiveEcuC/CryIf PLAIN_TEXT Initializes the Crypto Interface
          CryIf_InitMemory: Header=CryIf.h, InitPhase=INIT_MEMORY, ModuleRef=CryIf  # /ActiveEcuC/CryIf PLAIN_TEXT Initializes variables of the Crypto Interface
          Crypto_30_vHsm_Init: Header=Crypto_30_vHsm.h, InitPhase=INIT_TWO_DRV, ModuleRef=Crypto_30_vHsm  # /ActiveEcuC/Crypto_30_vHsm PLAIN_TEXT Initializes the Crypto Driver
          Crypto_30_vHsm_InitMemory: Header=Crypto_30_vHsm.h, InitPhase=INIT_MEMORY, ModuleRef=Crypto_30_vHsm  # /ActiveEcuC/Crypto_30_vHsm PLAIN_TEXT Initializes variables of the Crypto Interface
          Crypto_30_LibCv_Init: Header=Crypto_30_LibCv.h, InitPhase=INIT_TWO_DRV, ModuleRef=Crypto  # /ActiveEcuC/Crypto PLAIN_TEXT Initializes the Crypto Driver
          Crypto_30_LibCv_InitMemory: Header=Crypto_30_LibCv.h, InitPhase=INIT_MEMORY, ModuleRef=Crypto  # /ActiveEcuC/Crypto PLAIN_TEXT Initializes variables of the Crypto Driver
          KeyM_InitMemory: Header=KeyM.h, InitPhase=INIT_MEMORY, ModuleRef=KeyM  # /ActiveEcuC/KeyM PLAIN_TEXT Initializes variables of the MICROSAR KeyM
          KeyM_Init: Header=KeyM.h, InitPhase=INIT_TWO_SYS, ConfigType=KeyM_ConfigType, ConfigPtrName=NULL_PTR, ConfigPtrClass=KEYM_INIT_DATA, ModuleRef=KeyM  # /ActiveEcuC/KeyM PLAIN_TEXT Initializes the MICROSAR KeyM
          Csm_InitMemory: Header=Csm.h, InitPhase=INIT_MEMORY, ModuleRef=Csm  # /ActiveEcuC/Csm PLAIN_TEXT Initializes variables of the Crypto Service Manager
          Csm_Init: Header=Csm.h, InitPhase=INIT_TWO_SYS, ModuleRef=Csm  # /ActiveEcuC/Csm PLAIN_TEXT Initializes the Crypto Service Manager
          SchM_Start: Header=Rte_Main.h, InitPhase=NO_INIT, ModuleRef=Rte  # /ActiveEcuC/Rte PLAIN_TEXT Automatically generated by EcuCBswInitFctConfigurationService.
          SchM_StartTiming: Header=Rte_Main.h, InitPhase=NO_INIT, ModuleRef=Rte  # /ActiveEcuC/Rte PLAIN_TEXT Automatically generated by EcuCBswInitFctConfigurationService.
          Adc_Init: Header=Adc.h, InitPhase=INIT_ONE_LATE, ConfigType=Adc_ConfigType, ConfigPtrName=&Adc_Config, ConfigPtrClass=AUTOMATIC, ModuleRef=Adc  # /ActiveEcuC/Adc PLAIN_TEXT Created Adc_Init by Extended Init XML Service
          Gpt_Init: Header=Gpt.h, InitPhase=INIT_ONE, ConfigType=Gpt_ConfigType, ConfigPtrName=&Gpt_Config, ConfigPtrClass=AUTOMATIC, ModuleRef=Gpt  # /ActiveEcuC/Gpt PLAIN_TEXT Created Gpt_Init by Extended Init XML Service
          Pwm_17_GtmCcu6_Init: Header=Pwm_17_GtmCcu6.h, InitPhase=INIT_ONE, ConfigType=Pwm_17_GtmCcu6_ConfigType, ConfigPtrName=&Pwm_17_GtmCcu6_Config, ConfigPtrClass=AUTOMATIC, ModuleRef=Pwm  # /ActiveEcuC/Pwm PLAIN_TEXT Created Pwm_17_GtmCcu6_Init by Extended Init XML Service
          Nm_PreInit: Header=Nm.h, InitPhase=INIT_ONE, ConfigType=Nm_ConfigType, ConfigPtrName=Nm_Config_Left_Ptr if post-build-variant-condition{matching-criterion=SideAllocation, value=0}, ConfigPtrClass=NM_INIT_DATA, ConfigPtrName=Nm_Config_Right_Ptr if post-build-variant-condition{matching-criterion=SideAllocation, value=1}, ModuleRef=Nm  # /ActiveEcuC/Nm PLAIN_TEXT PreInit function description of Nm in PostBuildPredefinedVariantView (Left) .
          Nm_PostInit: Header=Nm.h, InitPhase=INIT_THREE, ModuleRef=Nm  # /ActiveEcuC/Nm PLAIN_TEXT Post-Initialization of the Network Management and its internal state machine
          ComM_PostInit: Header=ComM.h, InitPhase=INIT_THREE, ModuleRef=ComM  # /ActiveEcuC/ComM PLAIN_TEXT Post-Initialization of the ComM and its internal state machine
          ComM_PreInit: Header=ComM.h, ConfigType=ComM_ConfigType, ConfigPtrClass=COMM_INIT_DATA, ConfigPtrName=ComM_Config_Left_Ptr if post-build-variant-condition{matching-criterion=SideAllocation, value=0}, InitPhase=INIT_ONE, ConfigPtrName=ComM_Config_Right_Ptr if post-build-variant-condition{matching-criterion=SideAllocation, value=1}, ModuleRef=ComM  # /ActiveEcuC/ComM PLAIN_TEXT PreInit function description of ComM in PostBuildPredefinedVariantView (Left) .
          StbM_Init: Header=StbM.h, InitPhase=INIT_TWO_SYS, ConfigType=StbM_ConfigType, ConfigPtrName=StbM_Config_Ptr, ConfigPtrClass=STBM_INIT_DATA, ModuleRef=StbM  # /ActiveEcuC/StbM PLAIN_TEXT Init function description of StbM in PostBuildPredefinedVariantView (Left) .
          StbM_InitMemory: Header=StbM.h, InitPhase=INIT_MEMORY, ModuleRef=StbM  # /ActiveEcuC/StbM PLAIN_TEXT InitMemory function description of StbM in PostBuildPredefinedVariantView (Left) .
          CanTSyn_Init: Header=CanTSyn.h, InitPhase=INIT_TWO_SYS, ConfigType=CanTSyn_ConfigType, ConfigPtrName=CanTSyn_Config_Ptr, ConfigPtrClass=CANTSYN_INIT_DATA, ModuleRef=CanTSyn  # /ActiveEcuC/CanTSyn PLAIN_TEXT Init function description of CanTSyn in PostBuildPredefinedVariantView (Left) .
          CanTSyn_InitMemory: Header=CanTSyn.h, InitPhase=INIT_MEMORY, ModuleRef=CanTSyn  # /ActiveEcuC/CanTSyn PLAIN_TEXT InitMemory function description of CanTSyn in PostBuildPredefinedVariantView (Left) .
          Smu_Init: Header=Smu.h, InitPhase=INIT_ONE, ConfigType=Smu_ConfigType, ConfigPtrName=&Smu_Config, ConfigPtrClass=AUTOMATIC, ModuleRef=Smu  # /ActiveEcuC/Smu PLAIN_TEXT Created Smu_Init by Extended Init XML Service
          ResourceM_Init: Header=ResourceM.h, InitPhase=NO_INIT, ModuleRef=ResourceM  # /ResourceM/ResourceM PLAIN_TEXT Created ResourceM_Init by Extended Init XML Service
          StbM_PreInit: Header=StbM.h, InitPhase=INIT_ONE, ConfigType=StbM_ConfigType, ConfigPtrClass=STBM_INIT_DATA, ConfigPtrName=StbM_Config_Ptr, ModuleRef=StbM  # /ActiveEcuC/StbM PLAIN_TEXT PreInit function description of StbM in PostBuildPredefinedVariantView (Left) .
          StbM_PostInit: Header=StbM.h, InitPhase=INIT_THREE, ModuleRef=StbM  # /ActiveEcuC/StbM PLAIN_TEXT PostInit function description of StbM in PostBuildPredefinedVariantView (Left) .
          Rtm_Init: Header=Rtm.h, InitPhase=INIT_TWO_POST_NVMREADALL, ModuleRef=Rtm  # /ActiveEcuC/Rtm PLAIN_TEXT Module Initialization function of module Rtm.
          Rtm_InitMemory: Header=Rtm.h, InitPhase=INIT_MEMORY, ModuleRef=Rtm  # /ActiveEcuC/Rtm PLAIN_TEXT Memory Initialization function of module Rtm.
          CanTSyn_PreInit: Header=CanTSyn.h, InitPhase=INIT_ONE, ConfigType=CanTSyn_ConfigType, ConfigPtrClass=CANTSYN_INIT_DATA, ConfigPtrName=CanTSyn_Config_Ptr, ModuleRef=CanTSyn  # /ActiveEcuC/CanTSyn PLAIN_TEXT PreInit function description of CanTSyn in PostBuildPredefinedVariantView (Left) .
    EcucHardware
      EcucCoreDefinition: EcucCoreId=0
    EcucPartitionCollection
      EcucPartition_OsApplication_Trusted_Core0 (EcucPartition):
        EcucPartitionBswModuleExecution = true
        PartitionCanBeRestarted = false
        ASIL = QM
        EcucPartitionSoftwareComponentInstanceRef = StbM_OsApplication_Trusted_Core0
