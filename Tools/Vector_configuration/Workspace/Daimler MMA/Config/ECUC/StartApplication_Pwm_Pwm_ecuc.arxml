AUTOSAR XML (schema 00049)
package /ActiveEcuC
  module config Pwm: implementation-config-variant=VARIANT-POST-BUILD, module-description=Pwm_Impl
    PwmChannelConfigSet
      HB_P_PwmChannel (PwmChannel):
        PwmChannelId = 0
        PwmAssignedHwUnit = CCU6
        PwmDutycycleDefault = 0
        PwmIdleState = PWM_LOW
        PwmPeriodDefault = 2000
        PwmPolarity = PWM_HIGH
        PwmShiftValue = 0
        PwmCoherentUpdate = false
        PwmChannelClass = PWM_FIXED_PERIOD
        PwmMcuClockReferencePoint = McuClockReferencePoint_GTM
        PwmReferenceChannel = HB_P_PwmChannel
        CCU6CC6Configuration:
          CCU6TimerUsed = T12
          Cc6xChannel = Cc62
          CCU6TimerClockSelect = CCU6_CONFIGURABLE_CLOCK_1
          CCU6TimerPrescalarEnabled = false
          CCU6KernelUsed = McuCcu6ModuleAllocationConf_0
      HB_N_PwmChannel (PwmChannel):
        PwmChannelId = 1
        PwmAssignedHwUnit = GTM
        PwmDutycycleDefault = 0
        PwmIdleState = PWM_LOW
        PwmPeriodDefault = 2000
        PwmPolarity = PWM_HIGH
        PwmShiftValue = 0
        PwmCoherentUpdate = false
        PwmChannelClass = PWM_FIXED_PERIOD
        PwmMcuClockReferencePoint = McuClockReferencePoint_GTM
        PwmReferenceChannel = HB_P_PwmChannel
        GtmTimerOutputModuleConfiguration: GtmTimerClockSelect=GTM_FIXED_CLOCK_0, GtmTimerUsed=McuGtmTomChannelAllocationConf_8
    PwmConfigurationOfOptApiServices: PwmDeInitApi=true, PwmGetOutputState=false, PwmSetDutyCycle=true, PwmSetOutputToIdle=true, PwmSetPeriodAndDuty=true, PwmVersionInfoApi=false
    PwmGeneral:
      PwmDevErrorDetect = false
      PwmMultiCoreErrorDetect = false
      PwmDutycycleUpdatedEndperiod = false
      PwmIndex = 0
      PwmNotificationSupported = false
      PwmPeriodUpdatedEndperiod = false
      PwmChannelCoherentSelection = false
      PwmHandleShiftByOffset = false
      PwmDutyShiftInTicks = false
      PwmEnable0Or100DutyNotification = false
      PwmPowerStateAsynchTransitionMode = false
      PwmSafetyEnable = true
      PwmInitCheckApi = true
    CommonPublishedInformation:
      ArMajorVersion = 4
      ArMinorVersion = 4
      ArPatchVersion = 0
      SwMajorVersion = 20
      SwMinorVersion = 0
      SwPatchVersion = 2
      ModuleId = 121
      VendorId = 17
      VendorApiInfix = GtmCcu6
      Release = _TRICORE_TC332
