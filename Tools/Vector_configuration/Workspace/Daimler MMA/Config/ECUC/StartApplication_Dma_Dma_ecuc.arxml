AUTOSAR XML (schema 00049)
package /Dma
  module config Dma: implementation-config-variant=VARIANT-POST-BUILD, module-description=Dma_Impl
    CommonPublishedInformation:
      ArMajorVersion = 4
      ArMinorVersion = 4
      ArPatchVersion = 0
      ModuleId = 255
      Release = _TRICORE_TC332
      SwMajorVersion = 20
      SwMinorVersion = 0
      SwPatchVersion = 1
      VendorId = 17
    DmaGeneral:
      DmaBufferSwitchApi = false
      DmaChDeInitApi = false
      DmaDataPendingApi = false
      DmaDeInitApi = false
      DmaDevErrorDetect = true
      DmaGetVersionInfoApi = false
      DmaInitCheckApi = true
      DmaInitDeInitApiMode = DMA_MCAL_SUPERVISORMODE
      DmaMaxTransactionSetPerChannel = 1
      DmaMultiCoreErrorDetect = false
      DmaRuntimeApiMode = DMA_MCAL_SUPERVISORMODE
      DmaSafetyEnable = true
      DmaSuspendApi = false
      DmaTriggerApi = true
    DmaMoveEngineConfig: DmaMEDestinationErrorInterrupt=true, DmaMELinkedListErrorInterrupt=true, DmaMESourceErrorInterrupt=true
    DmaPatternConfig: DmaPattern0=0, DmaPattern1=0
    4 x DmaResourcePartition, all with DmaPermittedBusMaster=4294967295, DmaResourcePartitionBusMode=DMA_RP_SUPERVISOR_MODE:
      DmaResourcePartition_{0..3}
    3 x DmaChannelConfig, all with DmaChannelAssignedPartition=0, DmaChannelNotification=NULL_PTR, DmaChannelNumTransactionSet=1, DmaChannelUser=Other, DmaErrorNotification=NULL_PTR, DmaTcsInterruptTransactionLoss=false:
      DmaChannelConfig_0: DmaChannelId=0
        DmaChannelTransactionSet_0 (DmaChannelTransactionSet):
          DmaCLLNextIndex = 0
          DmaNextTcsIndex = 1
          DmaPatternMode = Pattern_Detection_Disabled
          DmaTcsAppendTimeStamp = false
          DmaTcsAutoStartEnable = false
          DmaTcsCircularBufferDestinationEnable = true
          DmaTcsCircularBufferDestinationLength = DMA_CIRCULAR_BUFFER_LENGTH_4BYTE
          DmaTcsCircularBufferSourceEnable = true
          DmaTcsCircularBufferSourceLength = DMA_CIRCULAR_BUFFER_LENGTH_8BYTE
          DmaTcsDaisyChaining = false
          DmaTcsDataTransferInterrupt = false
          DmaTcsDestinationAddressModificationFactor = DMA_FACTOR_1
          DmaTcsDestinationAddressMovement = DMA_INCREASING
          DmaTcsDoubleBuffer = NULL_PTR
          DmaTcsHardwareTrigger = DMA_HARDWARE_TRIGGER_CONTINUOUS_MODE
          DmaTcsIndex = 0
          DmaTcsInterruptDataTransfer = DMA_INTERRUPT_PER_TRANSACTION
          DmaTcsInterruptDataTransferThreshold = 0
          DmaTcsInterruptDestinationAddressWrap = false
          DmaTcsInterruptSourceAddressWrap = false
          DmaTcsMoveLength = DMA_WIDTH_16BITS
          DmaTcsReferenceAddressCrc = 0
          DmaTcsReferenceDataCrc = 0
          DmaTcsShadowRegisterConfiguration = DMA_SHADOWING_DISABLED
          DmaTcsSourceAddress = &EVADC_G0_RES0
          DmaTcsSourceAddressModificationFactor = DMA_FACTOR_2
          DmaTcsSourceAddressMovement = DMA_INCREASING
          DmaTcsSwapDataCRCByteOrder = false
          DmaTcsTransactionLength = 2
          DmaTcsTransferLength = DMA_MOVES_1
          DmaTcsTriggerFrequency = DMA_TRANSACTION_PER_TRIGGER
          DmaUserHeaderFileWithExternDeclarations = AdcIf.h
          DmaTcsDestinationAddress = &BufferList0[ADC0_ELEM-1]
      DmaChannelConfig_1: DmaChannelId=1
        DmaChannelTransactionSet_0 (DmaChannelTransactionSet):
          DmaCLLNextIndex = 0
          DmaNextTcsIndex = 1
          DmaPatternMode = Pattern_Detection_Disabled
          DmaTcsAppendTimeStamp = false
          DmaTcsAutoStartEnable = false
          DmaTcsCircularBufferDestinationEnable = true
          DmaTcsCircularBufferDestinationLength = DMA_CIRCULAR_BUFFER_LENGTH_16BYTE
          DmaTcsCircularBufferSourceEnable = true
          DmaTcsCircularBufferSourceLength = DMA_CIRCULAR_BUFFER_LENGTH_32BYTE
          DmaTcsDaisyChaining = false
          DmaTcsDataTransferInterrupt = false
          DmaTcsDestinationAddressModificationFactor = DMA_FACTOR_1
          DmaTcsDestinationAddressMovement = DMA_INCREASING
          DmaTcsDoubleBuffer = NULL_PTR
          DmaTcsHardwareTrigger = DMA_HARDWARE_TRIGGER_CONTINUOUS_MODE
          DmaTcsIndex = 0
          DmaTcsInterruptDataTransfer = DMA_INTERRUPT_PER_TRANSACTION
          DmaTcsInterruptDataTransferThreshold = 0
          DmaTcsInterruptDestinationAddressWrap = false
          DmaTcsInterruptSourceAddressWrap = false
          DmaTcsMoveLength = DMA_WIDTH_16BITS
          DmaTcsReferenceAddressCrc = 0
          DmaTcsReferenceDataCrc = 0
          DmaTcsShadowRegisterConfiguration = DMA_SHADOWING_DISABLED
          DmaTcsSourceAddress = &EVADC_G1_RES0
          DmaTcsSourceAddressModificationFactor = DMA_FACTOR_2
          DmaTcsSourceAddressMovement = DMA_INCREASING
          DmaTcsSwapDataCRCByteOrder = false
          DmaTcsTransactionLength = 8
          DmaTcsTransferLength = DMA_MOVES_1
          DmaTcsTriggerFrequency = DMA_TRANSACTION_PER_TRIGGER
          DmaUserHeaderFileWithExternDeclarations = AdcIf.h
          DmaTcsDestinationAddress = &BufferList1[ADC1_ELEM-1]
      DmaChannelConfig_2: DmaChannelId=2
        DmaChannelTransactionSet_0 (DmaChannelTransactionSet):
          DmaCLLNextIndex = 0
          DmaNextTcsIndex = 1
          DmaPatternMode = Pattern_Detection_Disabled
          DmaTcsAppendTimeStamp = false
          DmaTcsAutoStartEnable = false
          DmaTcsCircularBufferDestinationEnable = true
          DmaTcsCircularBufferDestinationLength = DMA_CIRCULAR_BUFFER_LENGTH_1BYTE
          DmaTcsCircularBufferSourceEnable = true
          DmaTcsCircularBufferSourceLength = DMA_CIRCULAR_BUFFER_LENGTH_1BYTE
          DmaTcsDaisyChaining = false
          DmaTcsDataTransferInterrupt = false
          DmaTcsDestinationAddressModificationFactor = DMA_FACTOR_1
          DmaTcsDestinationAddressMovement = DMA_INCREASING
          DmaTcsDoubleBuffer = NULL_PTR
          DmaTcsHardwareTrigger = DMA_HARDWARE_TRIGGER_CONTINUOUS_MODE
          DmaTcsIndex = 0
          DmaTcsInterruptDataTransfer = DMA_INTERRUPT_PER_TRANSACTION
          DmaTcsInterruptDataTransferThreshold = 0
          DmaTcsInterruptDestinationAddressWrap = false
          DmaTcsInterruptSourceAddressWrap = false
          DmaTcsMoveLength = DMA_WIDTH_16BITS
          DmaTcsReferenceAddressCrc = 0
          DmaTcsReferenceDataCrc = 0
          DmaTcsShadowRegisterConfiguration = DMA_SHADOWING_DISABLED
          DmaTcsSourceAddress = &EVADC_G8_RES0
          DmaTcsSourceAddressModificationFactor = DMA_FACTOR_1
          DmaTcsSourceAddressMovement = DMA_INCREASING
          DmaTcsSwapDataCRCByteOrder = false
          DmaTcsTransactionLength = 1
          DmaTcsTransferLength = DMA_MOVES_1
          DmaTcsTriggerFrequency = DMA_TRANSFER_PER_TRIGGER
          DmaUserHeaderFileWithExternDeclarations = AdcIf.h
          DmaTcsDestinationAddress = &BufferList2[ADC2_ELEM-1]
