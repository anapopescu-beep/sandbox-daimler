AUTOSAR XML (schema 00049)
package /ActiveEcuC
  module config Can: implementation-config-variant=VARIANT-POST-BUILD-SELECTABLE, module-description=Can_Impl
    CanGeneral:
      CanIndex = 0
      CanChangeBaudrateApi = false
      CanDevErrorDetection = false
      CanHardwareCancellation = false
      CanIdenticalIdCancellation = false
      CanMainFunctionBusoffPeriod = 0.01
      CanMainFunctionModePeriod = 0.01
      CanMainFunctionWakeupPeriod = 0.01
      CanMultiplexedTransmission = false
      CanSetBaudrateApi = false
      CanTimeoutDuration = 0.01
      CanVersionInfoApi = false
      CanGenericPrecopy = true
      CanHardwareLoopCheck = true
      CanSecureTempBuffer = false
      CanRxFullCANSupport = false
      CanTxFullCANSupport = false
      CanRxBasicCANSupport = true
      CanUseNestedCANInterrupts = false
      CanHardwareCancelByAppl = false
      CanIndividualProcessing = false
      CanGenericConfirmation = false
      CanGenericConfirmationAPI2 = false
      CanRxQueue = false
      CanSupportMixedID = true
      CanRxQueueSize = 10
      CanMultipleBasicCANObjects = true
      CanMultipleBasicCANTxObjects = false
      CanHardwareHandleType = UINT8
      CanOptimizeOneController = false
      CanInterruptCategory = CATEGORY2
      CanGetStatus = false
      CanInterruptLock = DRIVER
      CanWakeupSupport = false
      CanRamCheck = None
      CanOverrunNotification = None
      CanReinitStart = false
      CanGenericPreTransmit = true
      CanFdSupport = NONE
      CanRuntimeMeasurementSupport = true
      CanMaxRxDataLen = 8
      CanMaxTxDataLen = 8
      CanUsePeripheralAccessApi = false
      CanMirrorModeSupport = false
      CanUseOsInterruptControl = true
      CanSafeBswChecks = true
      CanSilentModeSupport = false
      CanHwTxFifoSupport = false
      CanMcanRevision = M_CAN_REV_315
      CanCheckWakeupCanRetType = false
      CanFdHardwareBufferOptimization = true
      CanEccInit = true
      CanUseVirtualAddressing = false
      CanEnableSecurityEventReporting = false
      CanCounterRef = SystemTimer
      CanMainFunctionRWPeriods
    CanConfigSet
      RBTM_FL_BODY3_8uqv9blm85ehm0msat385m76v_d50cf0d9_Rx (CanHardwareObject):
        CanHandleType = BASIC
        CanIdType = STANDARD
        CanIdValue = 0
        CanObjectType = RECEIVE
        CanObjectId = 1
        CanHwProcessing = false
        CanObjectHwSize = 6
        CanObjectHwHandle = 0
        CanMaxDataLen = 8
        CanFdPaddingValue = 0
        CanObjectMultiplexedTransmission = false
        CanObjectHwFifo = false
        CanControllerRef = RBTM_FL_BODY3_180ddaa4
        CanFilterMaskRef = RBTM_FL_BODY3_180ddaa4/CanFilterMask
        variation-point = post-build-variant-condition{matching-criterion=SideAllocation, value=0}
      RBTM_FL_BODY3_180ddaa4 (CanController):  # BODY3
        CanControllerActivation = true
        CanBusoffProcessing = INTERRUPT
        CanControllerBaseAddress = 4028663040
        CanControllerId = 0
        CanRxProcessing = INTERRUPT
        CanTxProcessing = INTERRUPT
        CanWakeupProcessing = INTERRUPT
        CanWakeupSupport = false
        CanWakeupSourceId = 0
        CanBasisAddressEnum = M_CAN1
        CanTxBufferElementSize = ES_8
        CanRxBufferElementSize = ES_8
        CanRxFifo0ElementSize = ES_8
        CanRxFifo1ElementSize = ES_8
        CanMaxNrOfRxFifo0Elements = 64
        CanMaxNrOfRxFifo1Elements = 64
        CanMaxNrOfRxBuffers = 64
        CanMaxNrOfTxBuffers = 32
        CanIsTTCAN = false
        CanIOPort = b_000
        CanInterruptPriority = 0
        CanControllerDefaultBaudrate = RBTM_FL_BODY3_180ddaa4/CanControllerBaudrateConfig
        CanControllerSystemRef = RBTM_FL_BODY3
        CanCpuClockRef = McuClockReferencePoint_MCAN
        variation-point = post-build-variant-condition{matching-criterion=SideAllocation, value=0}
        CanControllerBaudrateConfig:
          CanControllerBaudRate = 250
          CanControllerBaudRateConfigID = 0
          CanControllerPropSeg = 11
          CanControllerSeg1 = 4
          CanControllerSeg2 = 4
          CanControllerSyncJumpWidth = 4
          CanBaudrateClock = 80000
          CanBaudratePrescaler = 16
        CanFilterMask: CanFilterMaskValue=0, CanFilterCodeValue=0, IsLocked=false
        CanFilterMask_001 (CanFilterMask): CanFilterMaskValue=2147483648, CanFilterCodeValue=0, IsLocked=false
      4 x CanHardwareObject, all with CanHandleType=BASIC, CanIdValue=0, CanHwProcessing=false, CanMaxDataLen=8, CanFdPaddingValue=0, CanObjectMultiplexedTransmission=false, CanObjectHwFifo=false:
        RBTM_FL_BODY3_8uqv9blm85ehm0msat385m76v_e046a621_Rx: CanIdType=EXTENDED, CanObjectType=RECEIVE, CanObjectId=2, CanObjectHwSize=6, CanObjectHwHandle=1, CanControllerRef=RBTM_FL_BODY3_180ddaa4, CanFilterMaskRef=RBTM_FL_BODY3_180ddaa4/CanFilterMask_001, variation-point=post-build-variant-condition{matching-criterion=SideAllocation, value=0}
        RBTM_FL_BODY3_8uqv9blm85ehm0msat385m76v_03d5f5f6_Tx: CanObjectType=TRANSMIT, CanIdType=MIXED, CanObjectId=0, CanObjectHwSize=1, CanObjectHwHandle=0, CanControllerRef=RBTM_FL_BODY3_180ddaa4, variation-point=post-build-variant-condition{matching-criterion=SideAllocation, value=0}
        RBTM_FR_BODY3_4xwwtd59665s787n6ctawh7k8_5b8d9de8_Rx: CanIdType=EXTENDED, CanObjectType=RECEIVE, CanObjectId=1, CanObjectHwSize=6, CanObjectHwHandle=0, CanControllerRef=RBTM_FR_BODY3_2fec3d37, CanFilterMaskRef=RBTM_FR_BODY3_2fec3d37/CanFilterMask, variation-point=post-build-variant-condition{matching-criterion=SideAllocation, value=1}
        RBTM_FR_BODY3_4xwwtd59665s787n6ctawh7k8_6ec7cb10_Rx: CanIdType=STANDARD, CanObjectType=RECEIVE, CanObjectId=2, CanObjectHwSize=6, CanObjectHwHandle=1, CanControllerRef=RBTM_FR_BODY3_2fec3d37, CanFilterMaskRef=RBTM_FR_BODY3_2fec3d37/CanFilterMask_001, variation-point=post-build-variant-condition{matching-criterion=SideAllocation, value=1}
      RBTM_FR_BODY3_2fec3d37 (CanController):  # BODY3
        CanControllerActivation = true
        CanBusoffProcessing = INTERRUPT
        CanControllerBaseAddress = 4028663040
        CanControllerId = 0
        CanRxProcessing = INTERRUPT
        CanTxProcessing = INTERRUPT
        CanWakeupProcessing = INTERRUPT
        CanWakeupSupport = false
        CanWakeupSourceId = 0
        CanBasisAddressEnum = M_CAN1
        CanTxBufferElementSize = ES_8
        CanRxBufferElementSize = ES_8
        CanRxFifo0ElementSize = ES_8
        CanRxFifo1ElementSize = ES_8
        CanMaxNrOfRxFifo0Elements = 64
        CanMaxNrOfRxFifo1Elements = 64
        CanMaxNrOfRxBuffers = 64
        CanMaxNrOfTxBuffers = 32
        CanIsTTCAN = false
        CanInterruptPriority = 0
        CanIOPort = b_000
        CanControllerDefaultBaudrate = RBTM_FR_BODY3_2fec3d37/CanControllerBaudrateConfig
        CanControllerSystemRef = RBTM_FR_BODY3
        CanCpuClockRef = McuClockReferencePoint_MCAN
        variation-point = post-build-variant-condition{matching-criterion=SideAllocation, value=1}
        CanControllerBaudrateConfig:
          CanControllerBaudRate = 250
          CanControllerBaudRateConfigID = 0
          CanControllerPropSeg = 11
          CanControllerSeg1 = 4
          CanControllerSeg2 = 4
          CanControllerSyncJumpWidth = 4
          CanBaudrateClock = 80000
          CanBaudratePrescaler = 16
        CanFilterMask: CanFilterMaskValue=2147483648, CanFilterCodeValue=0, IsLocked=false
        CanFilterMask_001 (CanFilterMask): CanFilterMaskValue=0, CanFilterCodeValue=0, IsLocked=false
      RBTM_FR_BODY3_4xwwtd59665s787n6ctawh7k8_23a94727_Tx (CanHardwareObject):
        CanHandleType = BASIC
        CanIdValue = 0
        CanObjectType = TRANSMIT
        CanIdType = MIXED
        CanObjectId = 0
        CanHwProcessing = false
        CanObjectHwSize = 1
        CanObjectHwHandle = 0
        CanMaxDataLen = 8
        CanFdPaddingValue = 0
        CanObjectMultiplexedTransmission = false
        CanObjectHwFifo = false
        CanControllerRef = RBTM_FR_BODY3_2fec3d37
        variation-point = post-build-variant-condition{matching-criterion=SideAllocation, value=1}
