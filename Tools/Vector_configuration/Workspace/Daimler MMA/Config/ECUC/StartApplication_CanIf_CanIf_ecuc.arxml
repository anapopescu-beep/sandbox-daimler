AUTOSAR XML (schema 00049)
package /ActiveEcuC
  module config CanIf: implementation-config-variant=VARIANT-POST-BUILD-SELECTABLE, module-description=CanIf_Impl
    CanIfCtrlDrvCfg_7d254554 (CanIfCtrlDrvCfg): CanIfCtrlDrvTxCancellation=false, CanIfCtrlDrvInitHohConfigRef=CanIfInitHohCfg, CanIfCtrlDrvNameRef=CanGeneral
      RBTM_FL_BODY3_180ddaa4 (CanIfCtrlCfg):
        CanIfCtrlId = 0
        CanIfCtrlWakeupSupport = false
        CanIfCtrlJ1939DynAddrSupport = DISABLED
        CanIfCtrlCanCtrlRef = RBTM_FL_BODY3_180ddaa4
        variation-point = post-build-variant-condition{matching-criterion=SideAllocation, value=0}
      RBTM_FR_BODY3_2fec3d37 (CanIfCtrlCfg):
        CanIfCtrlId = 0
        CanIfCtrlWakeupSupport = false
        CanIfCtrlJ1939DynAddrSupport = DISABLED
        CanIfCtrlCanCtrlRef = RBTM_FR_BODY3_2fec3d37
        variation-point = post-build-variant-condition{matching-criterion=SideAllocation, value=1}
    CanIfDispatchCfg:
      CanIfDispatchUserCtrlBusOffName = CanSM_ControllerBusOff
      CanIfDispatchUserCtrlBusOffUL = CAN_SM
      CanIfDispatchUserCtrlModeIndicationName = CanSM_ControllerModeIndication
      CanIfDispatchUserCtrlModeIndicationUL = CAN_SM
      CanIfDispatchUserValidateWakeupEventUL = ECUM
      CanIfDispatchUserCheckTrcvWakeFlagIndicationUL = CAN_SM
      CanIfDispatchUserClearTrcvWufFlagIndicationUL = CAN_SM
      CanIfDispatchUserConfirmPnAvailabilityUL = CAN_SM
      CanIfDispatchUserTrcvModeIndicationUL = CAN_SM
      CanIfDispatchUserValidateWakeupEventName = EcuM_ValidateWakeupEvent
    CanIfInitCfg
      5 x CanIfRxPduCfg, all with CanIfRxPduDlc=8, CanIfRxPduReadData=false, CanIfRxPduReadNotifyStatus=false, CanIfRxPduDlcCheck=false:
        DIAG_RBTM_FL_03_ExtCAN_RQ_ST3_688ae269_Rx: CanIfRxPduCanId=417440905, CanIfRxPduCanIdType=EXTENDED_CAN, CanIfRxPduUserRxIndicationName=CanTp_RxIndication, CanIfRxPduUserRxIndicationType=PDUID_PDUINFOPTR, CanIfRxPduUserRxIndicationUL=CAN_TP, CanIfRxPduId=32, CanIfRxPduHrhIdRef=RBTM_FL_BODY3_8uqv9blm85ehm0msat385m76v_e046a621_Rx, CanIfRxPduRef=DIAG_RBTM_FL_03_ExtCAN_RQ_ST3_3f957a34_Rx, variation-point=post-build-variant-condition{matching-criterion=SideAllocation, value=0}
        VSS_TP_Auth_ST3_1d67253f_Rx: CanIfRxPduCanId=749, CanIfRxPduCanIdType=STANDARD_CAN, CanIfRxPduUserRxIndicationName=PduR_CanIfRxIndication, CanIfRxPduUserRxIndicationUL=PDUR, CanIfRxPduId=25, CanIfRxPduHrhIdRef=RBTM_FL_BODY3_8uqv9blm85ehm0msat385m76v_d50cf0d9_Rx if post-build-variant-condition{matching-criterion=SideAllocation, value=0}, CanIfRxPduRef=VSS_TP_Auth_ST3_29a0d419_Rx, CanIfRxPduHrhIdRef=RBTM_FR_BODY3_4xwwtd59665s787n6ctawh7k8_6ec7cb10_Rx if post-build-variant-condition{matching-criterion=SideAllocation, value=1}
        RBTM_FL_BODY3NMNODE_032841d9_Rx: CanIfRxPduCanIdType=EXTENDED_CAN, CanIfRxPduUserRxIndicationName=CanNm_RxIndication, CanIfRxPduUserRxIndicationUL=CAN_NM, CanIfRxPduId=36, CanIfRxPduHrhIdRef=RBTM_FL_BODY3_8uqv9blm85ehm0msat385m76v_e046a621_Rx, CanIfRxPduRef=RBTM_FL_BODY3NMNODE_34236992_Rx, variation-point=post-build-variant-condition{matching-criterion=SideAllocation, value=0}
          BODY3_a3c1981a (CanIfRxPduCanIdRange): CanIfRxPduCanIdRangeLowerCanId=339869696, CanIfRxPduCanIdRangeUpperCanId=339873791
        CLkS_Dr_State_ST3_27f55e1e_Rx: CanIfRxPduCanId=1426, CanIfRxPduCanIdType=STANDARD_CAN, CanIfRxPduUserRxIndicationName=PduR_CanIfRxIndication, CanIfRxPduUserRxIndicationUL=PDUR, CanIfRxPduId=5, CanIfRxPduHrhIdRef=RBTM_FL_BODY3_8uqv9blm85ehm0msat385m76v_d50cf0d9_Rx if post-build-variant-condition{matching-criterion=SideAllocation, value=0}, CanIfRxPduRef=CLkS_Dr_State_ST3_74337ed5_Rx, CanIfRxPduHrhIdRef=RBTM_FR_BODY3_4xwwtd59665s787n6ctawh7k8_6ec7cb10_Rx if post-build-variant-condition{matching-criterion=SideAllocation, value=1}
        ADAS_PREDICTION_ST3_7c36fc01_Rx: CanIfRxPduCanId=1766, CanIfRxPduCanIdType=STANDARD_CAN, CanIfRxPduUserRxIndicationName=PduR_CanIfRxIndication, CanIfRxPduUserRxIndicationUL=PDUR, CanIfRxPduId=1, CanIfRxPduHrhIdRef=RBTM_FL_BODY3_8uqv9blm85ehm0msat385m76v_d50cf0d9_Rx if post-build-variant-condition{matching-criterion=SideAllocation, value=0}, CanIfRxPduRef=ADAS_PREDICTION_ST3_1de136c9_Rx, CanIfRxPduHrhIdRef=RBTM_FR_BODY3_4xwwtd59665s787n6ctawh7k8_6ec7cb10_Rx if post-build-variant-condition{matching-criterion=SideAllocation, value=1}
      Develop8_Rs_RBTM_FL_ST3_474b54d0_Tx (CanIfTxPduCfg):
        CanIfTxPduCanId = 417440832
        CanIfTxPduCanIdType = EXTENDED_CAN
        CanIfTxPduDlc = 8
        CanIfTxPduUserTxConfirmationName = PduR_CanIfTxConfirmation
        CanIfTxPduUserTxConfirmationUL = PDUR
        CanIfTxPduId = 4
        CanIfTxPduReadNotifyStatus = false
        CanIfTxPduType = STATIC
        CanIfTxPduTruncation = false
        CanIfTxPduBufferRef = BODY3_bccb160f
        CanIfTxPduRef = Develop8_Rs_RBTM_FL_ST3_711f265e_Tx
        variation-point = post-build-variant-condition{matching-criterion=SideAllocation, value=0}
      BeltAdj_FR_Stat_ST3_070be586_Rx (CanIfRxPduCfg):
        CanIfRxPduCanId = 1697
        CanIfRxPduCanIdType = STANDARD_CAN
        CanIfRxPduDlc = 1
        CanIfRxPduUserRxIndicationName = PduR_CanIfRxIndication
        CanIfRxPduUserRxIndicationUL = PDUR
        CanIfRxPduId = 30
        CanIfRxPduReadData = false
        CanIfRxPduReadNotifyStatus = false
        CanIfRxPduDlcCheck = false
        CanIfRxPduHrhIdRef = RBTM_FL_BODY3_8uqv9blm85ehm0msat385m76v_d50cf0d9_Rx
        CanIfRxPduRef = BeltAdj_FR_Stat_ST3_2b5906f9_Rx
        variation-point = post-build-variant-condition{matching-criterion=SideAllocation, value=0}
      RBTM_FL_Stat_ST3_558a33d8_Tx (CanIfTxPduCfg):
        CanIfTxPduCanId = 1688
        CanIfTxPduCanIdType = STANDARD_CAN
        CanIfTxPduDlc = 8
        CanIfTxPduUserTxConfirmationName = PduR_CanIfTxConfirmation
        CanIfTxPduUserTxConfirmationUL = PDUR
        CanIfTxPduId = 8
        CanIfTxPduReadNotifyStatus = false
        CanIfTxPduType = STATIC
        CanIfTxPduTruncation = false
        CanIfTxPduBufferRef = BODY3_bccb160f
        CanIfTxPduRef = RBTM_FL_Stat_ST3_d76d14af_Tx
        variation-point = post-build-variant-condition{matching-criterion=SideAllocation, value=0}
      NTG_Master_Navi_ST3_1e826461_Rx (CanIfRxPduCfg):
        CanIfRxPduCanId = 1732
        CanIfRxPduCanIdType = STANDARD_CAN
        CanIfRxPduDlc = 2
        CanIfRxPduUserRxIndicationName = PduR_CanIfRxIndication
        CanIfRxPduUserRxIndicationUL = PDUR
        CanIfRxPduId = 18
        CanIfRxPduReadData = false
        CanIfRxPduReadNotifyStatus = false
        CanIfRxPduDlcCheck = false
        CanIfRxPduHrhIdRef = RBTM_FL_BODY3_8uqv9blm85ehm0msat385m76v_d50cf0d9_Rx if post-build-variant-condition{matching-criterion=SideAllocation, value=0}
        CanIfRxPduRef = NTG_Master_Navi_ST3_1032e485_Rx
        CanIfRxPduHrhIdRef = RBTM_FR_BODY3_4xwwtd59665s787n6ctawh7k8_6ec7cb10_Rx if post-build-variant-condition{matching-criterion=SideAllocation, value=1}
      CanIfInitHohCfg: CanIfInitRefCfgSet=CanConfigSet
        RBTM_FL_BODY3_8uqv9blm85ehm0msat385m76v_e046a621_Rx (CanIfHrhCfg):
          CanIfHrhSoftwareFilter = true
          CanIfHrhCanCtrlIdRef = RBTM_FL_BODY3_180ddaa4
          CanIfHrhIdSymRef = RBTM_FL_BODY3_8uqv9blm85ehm0msat385m76v_e046a621_Rx
          variation-point = post-build-variant-condition{matching-criterion=SideAllocation, value=0}
        RBTM_FL_BODY3_8uqv9blm85ehm0msat385m76v_d50cf0d9_Rx (CanIfHrhCfg):
          CanIfHrhSoftwareFilter = true
          CanIfHrhCanCtrlIdRef = RBTM_FL_BODY3_180ddaa4
          CanIfHrhIdSymRef = RBTM_FL_BODY3_8uqv9blm85ehm0msat385m76v_d50cf0d9_Rx
          variation-point = post-build-variant-condition{matching-criterion=SideAllocation, value=0}
        RBTM_FL_BODY3_8uqv9blm85ehm0msat385m76v_03d5f5f6_Tx (CanIfHthCfg):
          CanIfHthCanCtrlIdRef = RBTM_FL_BODY3_180ddaa4
          CanIfHthIdSymRef = RBTM_FL_BODY3_8uqv9blm85ehm0msat385m76v_03d5f5f6_Tx
          variation-point = post-build-variant-condition{matching-criterion=SideAllocation, value=0}
        RBTM_FR_BODY3_4xwwtd59665s787n6ctawh7k8_6ec7cb10_Rx (CanIfHrhCfg):
          CanIfHrhSoftwareFilter = true
          CanIfHrhCanCtrlIdRef = RBTM_FR_BODY3_2fec3d37
          CanIfHrhIdSymRef = RBTM_FR_BODY3_4xwwtd59665s787n6ctawh7k8_6ec7cb10_Rx
          variation-point = post-build-variant-condition{matching-criterion=SideAllocation, value=1}
        RBTM_FR_BODY3_4xwwtd59665s787n6ctawh7k8_23a94727_Tx (CanIfHthCfg):
          CanIfHthCanCtrlIdRef = RBTM_FR_BODY3_2fec3d37
          CanIfHthIdSymRef = RBTM_FR_BODY3_4xwwtd59665s787n6ctawh7k8_23a94727_Tx
          variation-point = post-build-variant-condition{matching-criterion=SideAllocation, value=1}
        RBTM_FR_BODY3_4xwwtd59665s787n6ctawh7k8_5b8d9de8_Rx (CanIfHrhCfg):
          CanIfHrhSoftwareFilter = true
          CanIfHrhCanCtrlIdRef = RBTM_FR_BODY3_2fec3d37
          CanIfHrhIdSymRef = RBTM_FR_BODY3_4xwwtd59665s787n6ctawh7k8_5b8d9de8_Rx
          variation-point = post-build-variant-condition{matching-criterion=SideAllocation, value=1}
      BeltAdj_FL_Stat_ST3_df27ce55_Tx (CanIfTxPduCfg):
        CanIfTxPduCanId = 1696
        CanIfTxPduCanIdType = STANDARD_CAN
        CanIfTxPduDlc = 1
        CanIfTxPduUserTxConfirmationName = PduR_CanIfTxConfirmation
        CanIfTxPduUserTxConfirmationUL = PDUR
        CanIfTxPduId = 0
        CanIfTxPduReadNotifyStatus = false
        CanIfTxPduType = STATIC
        CanIfTxPduTruncation = false
        CanIfTxPduBufferRef = BODY3_bccb160f
        CanIfTxPduRef = BeltAdj_FL_Stat_ST3_71e5093a_Tx
        variation-point = post-build-variant-condition{matching-criterion=SideAllocation, value=0}
      DI_OdoSpeedometer_ST3_11e98e6f_Rx (CanIfRxPduCfg):
        CanIfRxPduCanId = 1381
        CanIfRxPduCanIdType = STANDARD_CAN
        CanIfRxPduDlc = 8
        CanIfRxPduUserRxIndicationName = PduR_CanIfRxIndication
        CanIfRxPduUserRxIndicationUL = PDUR
        CanIfRxPduId = 10
        CanIfRxPduReadData = false
        CanIfRxPduReadNotifyStatus = false
        CanIfRxPduDlcCheck = false
        CanIfRxPduHrhIdRef = RBTM_FL_BODY3_8uqv9blm85ehm0msat385m76v_d50cf0d9_Rx if post-build-variant-condition{matching-criterion=SideAllocation, value=0}
        CanIfRxPduRef = DI_OdoSpeedometer_ST3_0665a232_Rx
        CanIfRxPduHrhIdRef = RBTM_FR_BODY3_4xwwtd59665s787n6ctawh7k8_6ec7cb10_Rx if post-build-variant-condition{matching-criterion=SideAllocation, value=1}
      Meas8_RBTM_FL_ST3_a87f4b23_Tx (CanIfTxPduCfg):
        CanIfTxPduCanId = 417440912
        CanIfTxPduCanIdType = EXTENDED_CAN
        CanIfTxPduDlc = 8
        CanIfTxPduUserTxConfirmationName = PduR_CanIfTxConfirmation
        CanIfTxPduUserTxConfirmationUL = PDUR
        CanIfTxPduId = 6
        CanIfTxPduReadNotifyStatus = false
        CanIfTxPduType = STATIC
        CanIfTxPduTruncation = false
        CanIfTxPduBufferRef = BODY3_bccb160f
        CanIfTxPduRef = Meas8_RBTM_FL_ST3_b4f3e350_Tx
        variation-point = post-build-variant-condition{matching-criterion=SideAllocation, value=0}
      5 x CanIfRxPduCfg, all with CanIfRxPduCanIdType=STANDARD_CAN, CanIfRxPduUserRxIndicationName=PduR_CanIfRxIndication, CanIfRxPduUserRxIndicationUL=PDUR, CanIfRxPduReadData=false, CanIfRxPduReadNotifyStatus=false, CanIfRxPduDlcCheck=false, CanIfRxPduHrhIdRef=RBTM_FL_BODY3_8uqv9blm85ehm0msat385m76v_d50cf0d9_Rx if post-build-variant-condition{matching-criterion=SideAllocation, value=0}, CanIfRxPduHrhIdRef=RBTM_FR_BODY3_4xwwtd59665s787n6ctawh7k8_6ec7cb10_Rx if post-build-variant-condition{matching-criterion=SideAllocation, value=1}:
        BeltAdj_UI_Set_Rq_ST3_0cef232d_Rx: CanIfRxPduCanId=1698, CanIfRxPduDlc=1, CanIfRxPduId=4, CanIfRxPduRef=BeltAdj_UI_Set_Rq_ST3_7be22993_Rx
        DIAG_Stat_ST3_7f697120_Rx: CanIfRxPduCanId=1744, CanIfRxPduDlc=4, CanIfRxPduId=9, CanIfRxPduRef=DIAG_Stat_ST3_d3ec8369_Rx
        EVC_CfgList_01_08_Pr5_ST3_2e9e0d1a_Rx: CanIfRxPduCanId=1760, CanIfRxPduDlc=8, CanIfRxPduId=13, CanIfRxPduRef=EVC_CfgList_01_08_Pr5_ST3_be03dd9d_Rx
        VSS_TP_SharedSecret_ST3_70962814_Rx: CanIfRxPduCanId=751, CanIfRxPduDlc=8, CanIfRxPduId=28, CanIfRxPduRef=VSS_TP_SharedSecret_ST3_6d7ca724_Rx
        PT4_PTCoor_DrvPosn_Gear_ST3_aabed571_Rx: CanIfRxPduCanId=1410, CanIfRxPduDlc=8, CanIfRxPduId=22, CanIfRxPduRef=PT4_PTCoor_DrvPosn_Gear_ST3_f70358bf_Rx
      NM_RBTM_FL_ST3_8b5cec70_Tx (CanIfTxPduCfg):
        CanIfTxPduCanId = 339870116
        CanIfTxPduCanIdType = EXTENDED_CAN
        CanIfTxPduDlc = 8
        CanIfTxPduUserTxConfirmationName = CanNm_TxConfirmation
        CanIfTxPduUserTxConfirmationUL = CAN_NM
        CanIfTxPduId = 7
        CanIfTxPduReadNotifyStatus = false
        CanIfTxPduType = STATIC
        CanIfTxPduTruncation = false
        CanIfTxPduBufferRef = BODY3_bccb160f
        CanIfTxPduRef = NM_RBTM_FL_ST3_b7c99fb7_Tx
        variation-point = post-build-variant-condition{matching-criterion=SideAllocation, value=0}
      VSS_TP_SecTickCount_Lvl2_ST3_2123eaf8_Rx (CanIfRxPduCfg):
        CanIfRxPduCanId = 746
        CanIfRxPduCanIdType = STANDARD_CAN
        CanIfRxPduDlc = 8
        CanIfRxPduUserRxIndicationName = PduR_CanIfRxIndication
        CanIfRxPduUserRxIndicationUL = PDUR
        CanIfRxPduId = 27
        CanIfRxPduReadData = false
        CanIfRxPduReadNotifyStatus = false
        CanIfRxPduDlcCheck = false
        CanIfRxPduHrhIdRef = RBTM_FL_BODY3_8uqv9blm85ehm0msat385m76v_d50cf0d9_Rx if post-build-variant-condition{matching-criterion=SideAllocation, value=0}
        CanIfRxPduRef = VSS_TP_SecTickCount_Lvl2_ST3_c0c3ca3b_Rx
        CanIfRxPduHrhIdRef = RBTM_FR_BODY3_4xwwtd59665s787n6ctawh7k8_6ec7cb10_Rx if post-build-variant-condition{matching-criterion=SideAllocation, value=1}
      RBTM_FR_Stat_ST3_b20121fa_Rx (CanIfRxPduCfg):
        CanIfRxPduCanId = 1689
        CanIfRxPduCanIdType = STANDARD_CAN
        CanIfRxPduDlc = 8
        CanIfRxPduUserRxIndicationName = PduR_CanIfRxIndication
        CanIfRxPduUserRxIndicationUL = PDUR
        CanIfRxPduId = 37
        CanIfRxPduReadData = false
        CanIfRxPduReadNotifyStatus = false
        CanIfRxPduDlcCheck = false
        CanIfRxPduHrhIdRef = RBTM_FL_BODY3_8uqv9blm85ehm0msat385m76v_d50cf0d9_Rx
        CanIfRxPduRef = RBTM_FR_Stat_ST3_8dd11b6c_Rx
        variation-point = post-build-variant-condition{matching-criterion=SideAllocation, value=0}
      ECU_Stat_RBTM_FL_ST3_b7e6aa56_Tx (CanIfTxPduCfg):
        CanIfTxPduCanId = 373424548
        CanIfTxPduCanIdType = EXTENDED_CAN
        CanIfTxPduDlc = 8
        CanIfTxPduUserTxConfirmationName = PduR_CanIfTxConfirmation
        CanIfTxPduUserTxConfirmationUL = PDUR
        CanIfTxPduId = 5
        CanIfTxPduReadNotifyStatus = false
        CanIfTxPduType = STATIC
        CanIfTxPduTruncation = false
        CanIfTxPduBufferRef = BODY3_bccb160f
        CanIfTxPduRef = ECU_Stat_RBTM_FL_ST3_42655720_Tx
        variation-point = post-build-variant-condition{matching-criterion=SideAllocation, value=0}
      ADAS_POSITION_ST3_bc4541a2_Rx (CanIfRxPduCfg):
        CanIfRxPduCanId = 1686
        CanIfRxPduCanIdType = STANDARD_CAN
        CanIfRxPduDlc = 8
        CanIfRxPduUserRxIndicationName = PduR_CanIfRxIndication
        CanIfRxPduUserRxIndicationUL = PDUR
        CanIfRxPduId = 0
        CanIfRxPduReadData = false
        CanIfRxPduReadNotifyStatus = false
        CanIfRxPduDlcCheck = false
        CanIfRxPduHrhIdRef = RBTM_FL_BODY3_8uqv9blm85ehm0msat385m76v_d50cf0d9_Rx if post-build-variant-condition{matching-criterion=SideAllocation, value=0}
        CanIfRxPduRef = ADAS_POSITION_ST3_1ca04d74_Rx
        CanIfRxPduHrhIdRef = RBTM_FR_BODY3_4xwwtd59665s787n6ctawh7k8_6ec7cb10_Rx if post-build-variant-condition{matching-criterion=SideAllocation, value=1}
      ADAS_PROFILE_SHORT_ST3_7ff16020_Rx (CanIfRxPduCfg):
        CanIfRxPduCanId = 1341
        CanIfRxPduCanIdType = STANDARD_CAN
        CanIfRxPduDlc = 8
        CanIfRxPduUserRxIndicationName = PduR_CanIfRxIndication
        CanIfRxPduUserRxIndicationUL = PDUR
        CanIfRxPduId = 2
        CanIfRxPduReadData = false
        CanIfRxPduReadNotifyStatus = false
        CanIfRxPduDlcCheck = false
        CanIfRxPduHrhIdRef = RBTM_FL_BODY3_8uqv9blm85ehm0msat385m76v_d50cf0d9_Rx if post-build-variant-condition{matching-criterion=SideAllocation, value=0}
        CanIfRxPduRef = ADAS_PROFILE_SHORT_ST3_894b8265_Rx
        CanIfRxPduHrhIdRef = RBTM_FR_BODY3_4xwwtd59665s787n6ctawh7k8_6ec7cb10_Rx if post-build-variant-condition{matching-criterion=SideAllocation, value=1}
      DIAG_RBTM_FL_03_ExtCAN_RS_ST3_70f788c0_Tx (CanIfTxPduCfg):
        CanIfTxPduCanId = 417440897
        CanIfTxPduCanIdType = EXTENDED_CAN
        CanIfTxPduDlc = 8
        CanIfTxPduUserTxConfirmationName = CanTp_TxConfirmation
        CanIfTxPduUserTxConfirmationUL = CAN_TP
        CanIfTxPduId = 1
        CanIfTxPduReadNotifyStatus = false
        CanIfTxPduType = STATIC
        CanIfTxPduTruncation = false
        CanIfTxPduBufferRef = BODY3_bccb160f
        CanIfTxPduRef = DIAG_RBTM_FL_03_ExtCAN_RS_ST3_ba6d58fb_Tx
        variation-point = post-build-variant-condition{matching-criterion=SideAllocation, value=0}
      7 x CanIfRxPduCfg, all with CanIfRxPduUserRxIndicationName=PduR_CanIfRxIndication, CanIfRxPduUserRxIndicationUL=PDUR, CanIfRxPduReadData=false, CanIfRxPduReadNotifyStatus=false, CanIfRxPduDlcCheck=false:
        BeltHdOvr_FL_State_ST3_b4846ceb_Rx: CanIfRxPduCanId=1532, CanIfRxPduCanIdType=STANDARD_CAN, CanIfRxPduDlc=4, CanIfRxPduId=31, CanIfRxPduHrhIdRef=RBTM_FL_BODY3_8uqv9blm85ehm0msat385m76v_d50cf0d9_Rx, CanIfRxPduRef=BeltHdOvr_FL_State_ST3_0b4fb3a9_Rx, variation-point=post-build-variant-condition{matching-criterion=SideAllocation, value=0}
        DPC_Md_Rq_ESP_d1_ST3_92dc8d11_Rx: CanIfRxPduCanId=1731, CanIfRxPduCanIdType=STANDARD_CAN, CanIfRxPduDlc=1, CanIfRxPduId=11, CanIfRxPduHrhIdRef=RBTM_FL_BODY3_8uqv9blm85ehm0msat385m76v_d50cf0d9_Rx if post-build-variant-condition{matching-criterion=SideAllocation, value=0}, CanIfRxPduRef=DPC_Md_Rq_ESP_d1_ST3_5573a8b2_Rx, CanIfRxPduHrhIdRef=RBTM_FR_BODY3_4xwwtd59665s787n6ctawh7k8_6ec7cb10_Rx if post-build-variant-condition{matching-criterion=SideAllocation, value=1}
        Develop8_Rq_RBTM_FL_ST3_fe216789_Rx: CanIfRxPduCanId=417440833, CanIfRxPduCanIdType=EXTENDED_CAN, CanIfRxPduDlc=8, CanIfRxPduId=35, CanIfRxPduHrhIdRef=RBTM_FL_BODY3_8uqv9blm85ehm0msat385m76v_e046a621_Rx, CanIfRxPduRef=Develop8_Rq_RBTM_FL_ST3_0a7cffe6_Rx, variation-point=post-build-variant-condition{matching-criterion=SideAllocation, value=0}
        PN14_Master_Stat1_ST3_56fd286b_Rx: CanIfRxPduCanId=1124, CanIfRxPduCanIdType=STANDARD_CAN, CanIfRxPduDlc=8, CanIfRxPduId=19, CanIfRxPduHrhIdRef=RBTM_FL_BODY3_8uqv9blm85ehm0msat385m76v_d50cf0d9_Rx if post-build-variant-condition{matching-criterion=SideAllocation, value=0}, CanIfRxPduRef=PN14_Master_Stat1_ST3_69644078_Rx, CanIfRxPduHrhIdRef=RBTM_FR_BODY3_4xwwtd59665s787n6ctawh7k8_6ec7cb10_Rx if post-build-variant-condition{matching-criterion=SideAllocation, value=1}
        VSS_TP_RealTmOffset_ST3_012f1a71_Rx: CanIfRxPduCanId=741, CanIfRxPduCanIdType=STANDARD_CAN, CanIfRxPduDlc=8, CanIfRxPduId=26, CanIfRxPduHrhIdRef=RBTM_FL_BODY3_8uqv9blm85ehm0msat385m76v_d50cf0d9_Rx if post-build-variant-condition{matching-criterion=SideAllocation, value=0}, CanIfRxPduRef=VSS_TP_RealTmOffset_ST3_d6d134b3_Rx, CanIfRxPduHrhIdRef=RBTM_FR_BODY3_4xwwtd59665s787n6ctawh7k8_6ec7cb10_Rx if post-build-variant-condition{matching-criterion=SideAllocation, value=1}
        Impact3_ST3_c1d5b894_Rx: CanIfRxPduCanId=1125, CanIfRxPduCanIdType=STANDARD_CAN, CanIfRxPduDlc=4, CanIfRxPduId=17, CanIfRxPduHrhIdRef=RBTM_FL_BODY3_8uqv9blm85ehm0msat385m76v_d50cf0d9_Rx if post-build-variant-condition{matching-criterion=SideAllocation, value=0}, CanIfRxPduRef=Impact3_ST3_993f4b56_Rx, CanIfRxPduHrhIdRef=RBTM_FR_BODY3_4xwwtd59665s787n6ctawh7k8_6ec7cb10_Rx if post-build-variant-condition{matching-criterion=SideAllocation, value=1}
        PT4_PTCoor4_ST3_59056fb4_Rx: CanIfRxPduCanId=863, CanIfRxPduCanIdType=STANDARD_CAN, CanIfRxPduDlc=4, CanIfRxPduId=20, CanIfRxPduHrhIdRef=RBTM_FL_BODY3_8uqv9blm85ehm0msat385m76v_d50cf0d9_Rx if post-build-variant-condition{matching-criterion=SideAllocation, value=0}, CanIfRxPduRef=PT4_PTCoor4_ST3_868ca7d3_Rx, CanIfRxPduHrhIdRef=RBTM_FR_BODY3_4xwwtd59665s787n6ctawh7k8_6ec7cb10_Rx if post-build-variant-condition{matching-criterion=SideAllocation, value=1}
      ROE_RBTM_FL_ST3_e9956dfc_Tx (CanIfTxPduCfg):
        CanIfTxPduCanId = 417440768
        CanIfTxPduCanIdType = EXTENDED_CAN
        CanIfTxPduDlc = 8
        CanIfTxPduUserTxConfirmationName = PduR_CanIfTxConfirmation
        CanIfTxPduUserTxConfirmationUL = PDUR
        CanIfTxPduId = 10
        CanIfTxPduReadNotifyStatus = false
        CanIfTxPduType = STATIC
        CanIfTxPduTruncation = false
        CanIfTxPduBufferRef = BODY3_bccb160f
        CanIfTxPduRef = ROE_RBTM_FL_ST3_75ad963a_Tx
        variation-point = post-build-variant-condition{matching-criterion=SideAllocation, value=0}
      3 x CanIfRxPduCfg, all with CanIfRxPduReadData=false, CanIfRxPduReadNotifyStatus=false, CanIfRxPduDlcCheck=false:
        PT4_PTCoor9_d1_BC_F_ST3_4460ebae_Rx: CanIfRxPduCanId=772, CanIfRxPduCanIdType=STANDARD_CAN, CanIfRxPduDlc=1, CanIfRxPduUserRxIndicationName=PduR_CanIfRxIndication, CanIfRxPduUserRxIndicationUL=PDUR, CanIfRxPduId=21, CanIfRxPduHrhIdRef=RBTM_FL_BODY3_8uqv9blm85ehm0msat385m76v_d50cf0d9_Rx if post-build-variant-condition{matching-criterion=SideAllocation, value=0}, CanIfRxPduRef=PT4_PTCoor9_d1_BC_F_ST3_f2a4ec1b_Rx, CanIfRxPduHrhIdRef=RBTM_FR_BODY3_4xwwtd59665s787n6ctawh7k8_6ec7cb10_Rx if post-build-variant-condition{matching-criterion=SideAllocation, value=1}
        PresfAct_Adj_ST3_87d3ccaf_Rx: CanIfRxPduCanId=1685, CanIfRxPduCanIdType=STANDARD_CAN, CanIfRxPduDlc=8, CanIfRxPduUserRxIndicationName=PduR_CanIfRxIndication, CanIfRxPduUserRxIndicationUL=PDUR, CanIfRxPduId=23, CanIfRxPduHrhIdRef=RBTM_FL_BODY3_8uqv9blm85ehm0msat385m76v_d50cf0d9_Rx if post-build-variant-condition{matching-criterion=SideAllocation, value=0}, CanIfRxPduRef=PresfAct_Adj_ST3_81976f17_Rx, CanIfRxPduHrhIdRef=RBTM_FR_BODY3_4xwwtd59665s787n6ctawh7k8_6ec7cb10_Rx if post-build-variant-condition{matching-criterion=SideAllocation, value=1}
        DIAG_RQ_GLOBAL_ExtCAN_ST3_c34d4a41_Rx: CanIfRxPduCanId=418314633, CanIfRxPduCanIdType=EXTENDED_CAN, CanIfRxPduDlc=8, CanIfRxPduUserRxIndicationName=CanTp_RxIndication, CanIfRxPduUserRxIndicationType=PDUID_PDUINFOPTR, CanIfRxPduUserRxIndicationUL=CAN_TP, CanIfRxPduId=6, CanIfRxPduHrhIdRef=RBTM_FL_BODY3_8uqv9blm85ehm0msat385m76v_e046a621_Rx if post-build-variant-condition{matching-criterion=SideAllocation, value=0}, CanIfRxPduRef=DIAG_RQ_GLOBAL_ExtCAN_ST3_320b5155_Rx, CanIfRxPduHrhIdRef=RBTM_FR_BODY3_4xwwtd59665s787n6ctawh7k8_5b8d9de8_Rx if post-build-variant-condition{matching-criterion=SideAllocation, value=1}
      BODY3_bccb160f (CanIfBufferCfg):
        CanIfBufferSize = 11
        CanIfTxBufferHandlingType = PRIO_BY_CANID
        CanIfTxBufferMappedTxPdus = 11
        CanIfTxBufferMaxPduLength = 8
        CanIfBufferHthRef = RBTM_FL_BODY3_8uqv9blm85ehm0msat385m76v_03d5f5f6_Tx if post-build-variant-condition{matching-criterion=SideAllocation, value=0}
        CanIfBufferHthRef = RBTM_FR_BODY3_4xwwtd59665s787n6ctawh7k8_23a94727_Tx if post-build-variant-condition{matching-criterion=SideAllocation, value=1}
      3 x CanIfRxPduCfg, all with CanIfRxPduDlc=8, CanIfRxPduReadData=false, CanIfRxPduReadNotifyStatus=false, CanIfRxPduDlcCheck=false:
        VSS_TP_VIN_ST3_b3b4e778_Rx: CanIfRxPduCanId=747, CanIfRxPduCanIdType=STANDARD_CAN, CanIfRxPduUserRxIndicationName=PduR_CanIfRxIndication, CanIfRxPduUserRxIndicationUL=PDUR, CanIfRxPduId=29, CanIfRxPduHrhIdRef=RBTM_FL_BODY3_8uqv9blm85ehm0msat385m76v_d50cf0d9_Rx if post-build-variant-condition{matching-criterion=SideAllocation, value=0}, CanIfRxPduRef=VSS_TP_VIN_ST3_f7ab6516_Rx, CanIfRxPduHrhIdRef=RBTM_FR_BODY3_4xwwtd59665s787n6ctawh7k8_6ec7cb10_Rx if post-build-variant-condition{matching-criterion=SideAllocation, value=1}
        Ign_Stat_ST3_secured_07d79dc2_Rx: CanIfRxPduCanId=127, CanIfRxPduCanIdType=STANDARD_CAN, CanIfRxPduUserRxIndicationName=PduR_CanIfRxIndication, CanIfRxPduUserRxIndicationUL=PDUR, CanIfRxPduId=15, CanIfRxPduHrhIdRef=RBTM_FL_BODY3_8uqv9blm85ehm0msat385m76v_d50cf0d9_Rx if post-build-variant-condition{matching-criterion=SideAllocation, value=0}, CanIfRxPduRef=Ign_Stat_ST3_secured_fb0d4f19_Rx, CanIfRxPduHrhIdRef=RBTM_FR_BODY3_4xwwtd59665s787n6ctawh7k8_6ec7cb10_Rx if post-build-variant-condition{matching-criterion=SideAllocation, value=1}
        DIAG_RBTM_FL_03_ExtEth_RQ_ST3_89267c36_Rx: CanIfRxPduCanId=417440904, CanIfRxPduCanIdType=EXTENDED_CAN, CanIfRxPduUserRxIndicationName=CanTp_RxIndication, CanIfRxPduUserRxIndicationType=PDUID_PDUINFOPTR, CanIfRxPduUserRxIndicationUL=CAN_TP, CanIfRxPduId=33, CanIfRxPduHrhIdRef=RBTM_FL_BODY3_8uqv9blm85ehm0msat385m76v_e046a621_Rx, CanIfRxPduRef=DIAG_RBTM_FL_03_ExtEth_RQ_ST3_8e910fe6_Rx, variation-point=post-build-variant-condition{matching-criterion=SideAllocation, value=0}
      DIAG_RBTM_FL_03_ExtEth_RS_ST3_5af4aefa_Tx (CanIfTxPduCfg):
        CanIfTxPduCanId = 417440896
        CanIfTxPduCanIdType = EXTENDED_CAN
        CanIfTxPduDlc = 8
        CanIfTxPduUserTxConfirmationName = CanTp_TxConfirmation
        CanIfTxPduUserTxConfirmationUL = CAN_TP
        CanIfTxPduId = 2
        CanIfTxPduReadNotifyStatus = false
        CanIfTxPduType = STATIC
        CanIfTxPduTruncation = false
        CanIfTxPduPnFilterPdu = false
        CanIfTxPduBufferRef = BODY3_bccb160f
        CanIfTxPduRef = DIAG_RBTM_FL_03_ExtEth_RS_ST3_0b692d29_Tx
        variation-point = post-build-variant-condition{matching-criterion=SideAllocation, value=0}
      DIAG_RBTM_FL_03_IntEth_RQ_ST3_91813a5c_Rx (CanIfRxPduCfg):
        CanIfRxPduCanId = 417440909
        CanIfRxPduCanIdType = EXTENDED_CAN
        CanIfRxPduDlc = 8
        CanIfRxPduUserRxIndicationName = CanTp_RxIndication
        CanIfRxPduUserRxIndicationType = PDUID_PDUINFOPTR
        CanIfRxPduUserRxIndicationUL = CAN_TP
        CanIfRxPduId = 34
        CanIfRxPduReadData = false
        CanIfRxPduReadNotifyStatus = false
        CanIfRxPduDlcCheck = false
        CanIfRxPduHrhIdRef = RBTM_FL_BODY3_8uqv9blm85ehm0msat385m76v_e046a621_Rx
        CanIfRxPduRef = DIAG_RBTM_FL_03_IntEth_RQ_ST3_c3ea483d_Rx
        variation-point = post-build-variant-condition{matching-criterion=SideAllocation, value=0}
      DIAG_RBTM_FL_03_IntEth_RS_ST3_de5e5f30_Tx (CanIfTxPduCfg):
        CanIfTxPduCanId = 417440901
        CanIfTxPduCanIdType = EXTENDED_CAN
        CanIfTxPduDlc = 8
        CanIfTxPduUserTxConfirmationName = CanTp_TxConfirmation
        CanIfTxPduUserTxConfirmationUL = CAN_TP
        CanIfTxPduId = 3
        CanIfTxPduReadNotifyStatus = false
        CanIfTxPduType = STATIC
        CanIfTxPduTruncation = false
        CanIfTxPduPnFilterPdu = false
        CanIfTxPduBufferRef = BODY3_bccb160f
        CanIfTxPduRef = DIAG_RBTM_FL_03_IntEth_RS_ST3_46126af2_Tx
        variation-point = post-build-variant-condition{matching-criterion=SideAllocation, value=0}
      7 x CanIfRxPduCfg, all with CanIfRxPduReadData=false, CanIfRxPduReadNotifyStatus=false, CanIfRxPduDlcCheck=false:
        DIAG_RQ_GLOBAL_ExtEth_ST3_c52e42e8_Rx: CanIfRxPduCanId=418314376, CanIfRxPduCanIdType=EXTENDED_CAN, CanIfRxPduDlc=8, CanIfRxPduUserRxIndicationName=CanTp_RxIndication, CanIfRxPduUserRxIndicationType=PDUID_PDUINFOPTR, CanIfRxPduUserRxIndicationUL=CAN_TP, CanIfRxPduId=7, CanIfRxPduHrhIdRef=RBTM_FL_BODY3_8uqv9blm85ehm0msat385m76v_e046a621_Rx if post-build-variant-condition{matching-criterion=SideAllocation, value=0}, CanIfRxPduRef=DIAG_RQ_GLOBAL_ExtEth_ST3_3402b191_Rx, CanIfRxPduHrhIdRef=RBTM_FR_BODY3_4xwwtd59665s787n6ctawh7k8_5b8d9de8_Rx if post-build-variant-condition{matching-criterion=SideAllocation, value=1}
        DIAG_RQ_GLOBAL_IntEth_ST3_dc07327b_Rx: CanIfRxPduCanId=418319757, CanIfRxPduCanIdType=EXTENDED_CAN, CanIfRxPduDlc=8, CanIfRxPduUserRxIndicationName=CanTp_RxIndication, CanIfRxPduUserRxIndicationType=PDUID_PDUINFOPTR, CanIfRxPduUserRxIndicationUL=CAN_TP, CanIfRxPduId=8, CanIfRxPduHrhIdRef=RBTM_FL_BODY3_8uqv9blm85ehm0msat385m76v_e046a621_Rx if post-build-variant-condition{matching-criterion=SideAllocation, value=0}, CanIfRxPduRef=DIAG_RQ_GLOBAL_IntEth_ST3_f8cf566a_Rx, CanIfRxPduHrhIdRef=RBTM_FR_BODY3_4xwwtd59665s787n6ctawh7k8_5b8d9de8_Rx if post-build-variant-condition{matching-criterion=SideAllocation, value=1}
        Bckl_Sw_Fx_Stat_ST3_secured_b4b7136c_Rx: CanIfRxPduCanId=1699, CanIfRxPduCanIdType=STANDARD_CAN, CanIfRxPduDlc=8, CanIfRxPduUserRxIndicationName=PduR_CanIfRxIndication, CanIfRxPduUserRxIndicationUL=PDUR, CanIfRxPduId=3, CanIfRxPduHrhIdRef=RBTM_FL_BODY3_8uqv9blm85ehm0msat385m76v_d50cf0d9_Rx if post-build-variant-condition{matching-criterion=SideAllocation, value=0}, CanIfRxPduRef=Bckl_Sw_Fx_Stat_ST3_secured_62272d37_Rx, CanIfRxPduHrhIdRef=RBTM_FR_BODY3_4xwwtd59665s787n6ctawh7k8_6ec7cb10_Rx if post-build-variant-condition{matching-criterion=SideAllocation, value=1}
        ELC_Lvr_Stat_ST3_secured_612a2882_Rx: CanIfRxPduCanId=1733, CanIfRxPduCanIdType=STANDARD_CAN, CanIfRxPduDlc=8, CanIfRxPduUserRxIndicationName=PduR_CanIfRxIndication, CanIfRxPduUserRxIndicationUL=PDUR, CanIfRxPduId=12, CanIfRxPduHrhIdRef=RBTM_FL_BODY3_8uqv9blm85ehm0msat385m76v_d50cf0d9_Rx if post-build-variant-condition{matching-criterion=SideAllocation, value=0}, CanIfRxPduRef=ELC_Lvr_Stat_ST3_secured_29d2456c_Rx, CanIfRxPduHrhIdRef=RBTM_FR_BODY3_4xwwtd59665s787n6ctawh7k8_6ec7cb10_Rx if post-build-variant-condition{matching-criterion=SideAllocation, value=1}
        Impact2_ST3_e5526ccc_Rx: CanIfRxPduCanIdType=STANDARD_CAN, CanIfRxPduDlc=4, CanIfRxPduId=16, CanIfRxPduUserRxIndicationName=PduR_CanIfRxIndication, CanIfRxPduUserRxIndicationUL=PDUR, CanIfRxPduCanId=1123, CanIfRxPduRef=Impact2_ST3_e5526ccc_Rx, CanIfRxPduHrhIdRef=RBTM_FL_BODY3_8uqv9blm85ehm0msat385m76v_d50cf0d9_Rx if post-build-variant-condition{matching-criterion=SideAllocation, value=0}, CanIfRxPduHrhIdRef=RBTM_FR_BODY3_4xwwtd59665s787n6ctawh7k8_6ec7cb10_Rx if post-build-variant-condition{matching-criterion=SideAllocation, value=1}
        GTS_Main_CAN_ST3_007ffebc_Rx: CanIfRxPduCanId=121, CanIfRxPduCanIdType=STANDARD_CAN, CanIfRxPduDlc=8, CanIfRxPduUserRxIndicationName=CanTSyn_RxIndication, CanIfRxPduUserRxIndicationUL=CAN_TSYN, CanIfRxPduId=14, CanIfRxPduHrhIdRef=RBTM_FL_BODY3_8uqv9blm85ehm0msat385m76v_d50cf0d9_Rx if post-build-variant-condition{matching-criterion=SideAllocation, value=0}, CanIfRxPduRef=GTS_Main_CAN_ST3_dd88dcd5_Rx, CanIfRxPduHrhIdRef=RBTM_FR_BODY3_4xwwtd59665s787n6ctawh7k8_6ec7cb10_Rx if post-build-variant-condition{matching-criterion=SideAllocation, value=1}
        SBeltTens_SP_Lvl_ST3_7cf5644e_Rx: CanIfRxPduCanId=782, CanIfRxPduCanIdType=STANDARD_CAN, CanIfRxPduDlc=8, CanIfRxPduUserRxIndicationName=PduR_CanIfRxIndication, CanIfRxPduUserRxIndicationUL=PDUR, CanIfRxPduId=24, CanIfRxPduHrhIdRef=RBTM_FL_BODY3_8uqv9blm85ehm0msat385m76v_d50cf0d9_Rx if post-build-variant-condition{matching-criterion=SideAllocation, value=0}, CanIfRxPduRef=SBeltTens_SP_Lvl_ST3_73b20851_Rx, CanIfRxPduHrhIdRef=RBTM_FR_BODY3_4xwwtd59665s787n6ctawh7k8_6ec7cb10_Rx if post-build-variant-condition{matching-criterion=SideAllocation, value=1}
      3 x CanIfTxPduCfg, all with CanIfTxPduDlc=8, CanIfTxPduReadNotifyStatus=false, CanIfTxPduType=STATIC, CanIfTxPduTruncation=false, CanIfTxPduBufferRef=BODY3_bccb160f:
        RBTM_FL_Tens_ST3_1446be6f_Tx: CanIfTxPduCanId=783, CanIfTxPduCanIdType=STANDARD_CAN, CanIfTxPduUserTxConfirmationName=PduR_CanIfTxConfirmation, CanIfTxPduUserTxConfirmationUL=PDUR, CanIfTxPduId=9, CanIfTxPduRef=RBTM_FL_Tens_ST3_49d8a970_Tx, variation-point=post-build-variant-condition{matching-criterion=SideAllocation, value=0}
        DIAG_RBTM_FR_03_ExtEth_RS_ST3_25545cfe_Tx: CanIfTxPduCanId=417441152, CanIfTxPduCanIdType=EXTENDED_CAN, CanIfTxPduUserTxConfirmationName=CanTp_TxConfirmation, CanIfTxPduUserTxConfirmationUL=CAN_TP, CanIfTxPduId=2, CanIfTxPduRef=DIAG_RBTM_FR_03_ExtEth_RS_ST3_16a31970_Tx, variation-point=post-build-variant-condition{matching-criterion=SideAllocation, value=1}
        Develop8_Rs_RBTM_FR_ST3_1a924f62_Tx: CanIfTxPduCanId=417441088, CanIfTxPduCanIdType=EXTENDED_CAN, CanIfTxPduUserTxConfirmationName=PduR_CanIfTxConfirmation, CanIfTxPduUserTxConfirmationUL=PDUR, CanIfTxPduId=4, CanIfTxPduRef=Develop8_Rs_RBTM_FR_ST3_aaf2c54f_Tx, variation-point=post-build-variant-condition{matching-criterion=SideAllocation, value=1}
      RBTM_FL_Stat_ST3_558a33d8_Rx (CanIfRxPduCfg):
        CanIfRxPduCanId = 1688
        CanIfRxPduCanIdType = STANDARD_CAN
        CanIfRxPduDlc = 8
        CanIfRxPduUserRxIndicationName = PduR_CanIfRxIndication
        CanIfRxPduUserRxIndicationUL = PDUR
        CanIfRxPduId = 36
        CanIfRxPduReadData = false
        CanIfRxPduReadNotifyStatus = false
        CanIfRxPduDlcCheck = false
        CanIfRxPduHrhIdRef = RBTM_FR_BODY3_4xwwtd59665s787n6ctawh7k8_6ec7cb10_Rx
        CanIfRxPduRef = RBTM_FL_Stat_ST3_d76d14af_Rx
        variation-point = post-build-variant-condition{matching-criterion=SideAllocation, value=1}
      4 x CanIfTxPduCfg, all with CanIfTxPduReadNotifyStatus=false, CanIfTxPduType=STATIC, CanIfTxPduTruncation=false, CanIfTxPduBufferRef=BODY3_bccb160f, variation-point=post-build-variant-condition{matching-criterion=SideAllocation, value=1}:
        NM_RBTM_FR_ST3_d6dddcba_Tx: CanIfTxPduCanId=339870117, CanIfTxPduCanIdType=EXTENDED_CAN, CanIfTxPduDlc=8, CanIfTxPduUserTxConfirmationName=CanNm_TxConfirmation, CanIfTxPduUserTxConfirmationUL=CAN_NM, CanIfTxPduId=7, CanIfTxPduRef=NM_RBTM_FR_ST3_6c247ca6_Tx
        ECU_Stat_RBTM_FR_ST3_430ba797_Tx: CanIfTxPduCanId=373424549, CanIfTxPduCanIdType=EXTENDED_CAN, CanIfTxPduDlc=8, CanIfTxPduUserTxConfirmationName=PduR_CanIfTxConfirmation, CanIfTxPduUserTxConfirmationUL=PDUR, CanIfTxPduId=5, CanIfTxPduRef=ECU_Stat_RBTM_FR_ST3_9988b431_Tx
        DIAG_RBTM_FR_03_IntEth_RS_ST3_6c8422ac_Tx: CanIfTxPduCanId=417441157, CanIfTxPduCanIdType=EXTENDED_CAN, CanIfTxPduDlc=8, CanIfTxPduUserTxConfirmationName=CanTp_TxConfirmation, CanIfTxPduUserTxConfirmationUL=CAN_TP, CanIfTxPduId=3, CanIfTxPduRef=DIAG_RBTM_FR_03_IntEth_RS_ST3_5bd85eab_Tx
        BeltAdj_FR_Stat_ST3_070be586_Tx: CanIfTxPduCanId=1697, CanIfTxPduCanIdType=STANDARD_CAN, CanIfTxPduDlc=1, CanIfTxPduUserTxConfirmationName=PduR_CanIfTxConfirmation, CanIfTxPduUserTxConfirmationUL=PDUR, CanIfTxPduId=0, CanIfTxPduRef=BeltAdj_FR_Stat_ST3_2b5906f9_Tx
      3 x CanIfRxPduCfg, all with CanIfRxPduReadData=false, CanIfRxPduReadNotifyStatus=false, CanIfRxPduDlcCheck=false, variation-point=post-build-variant-condition{matching-criterion=SideAllocation, value=1}:
        BeltAdj_FL_Stat_ST3_df27ce55_Rx: CanIfRxPduCanId=1696, CanIfRxPduCanIdType=STANDARD_CAN, CanIfRxPduDlc=1, CanIfRxPduUserRxIndicationName=PduR_CanIfRxIndication, CanIfRxPduUserRxIndicationUL=PDUR, CanIfRxPduId=30, CanIfRxPduHrhIdRef=RBTM_FR_BODY3_4xwwtd59665s787n6ctawh7k8_6ec7cb10_Rx, CanIfRxPduRef=BeltAdj_FL_Stat_ST3_71e5093a_Rx
        DIAG_RBTM_FR_03_IntEth_RQ_ST3_fad47561_Rx: CanIfRxPduCanId=417441165, CanIfRxPduCanIdType=EXTENDED_CAN, CanIfRxPduDlc=8, CanIfRxPduUserRxIndicationName=CanTp_RxIndication, CanIfRxPduUserRxIndicationType=PDUID_PDUINFOPTR, CanIfRxPduUserRxIndicationUL=CAN_TP, CanIfRxPduId=34, CanIfRxPduHrhIdRef=RBTM_FR_BODY3_4xwwtd59665s787n6ctawh7k8_5b8d9de8_Rx, CanIfRxPduRef=DIAG_RBTM_FR_03_IntEth_RQ_ST3_de207c64_Rx
        DIAG_RBTM_FR_03_ExtEth_RQ_ST3_0a9e12f4_Rx: CanIfRxPduCanId=417441160, CanIfRxPduCanIdType=EXTENDED_CAN, CanIfRxPduDlc=8, CanIfRxPduUserRxIndicationName=CanTp_RxIndication, CanIfRxPduUserRxIndicationType=PDUID_PDUINFOPTR, CanIfRxPduUserRxIndicationUL=CAN_TP, CanIfRxPduId=33, CanIfRxPduHrhIdRef=RBTM_FR_BODY3_4xwwtd59665s787n6ctawh7k8_5b8d9de8_Rx, CanIfRxPduRef=DIAG_RBTM_FR_03_ExtEth_RQ_ST3_935b3bbf_Rx
      ROE_RBTM_FR_ST3_d7dfdf54_Tx (CanIfTxPduCfg):
        CanIfTxPduCanId = 417441024
        CanIfTxPduCanIdType = EXTENDED_CAN
        CanIfTxPduDlc = 8
        CanIfTxPduUserTxConfirmationName = PduR_CanIfTxConfirmation
        CanIfTxPduUserTxConfirmationUL = PDUR
        CanIfTxPduId = 10
        CanIfTxPduReadNotifyStatus = false
        CanIfTxPduType = STATIC
        CanIfTxPduTruncation = false
        CanIfTxPduBufferRef = BODY3_bccb160f
        CanIfTxPduRef = ROE_RBTM_FR_ST3_ae40752b_Tx
        variation-point = post-build-variant-condition{matching-criterion=SideAllocation, value=1}
      BeltHdOvr_FR_State_ST3_61b04b2f_Rx (CanIfRxPduCfg):
        CanIfRxPduCanId = 1533
        CanIfRxPduCanIdType = STANDARD_CAN
        CanIfRxPduDlc = 4
        CanIfRxPduUserRxIndicationName = PduR_CanIfRxIndication
        CanIfRxPduUserRxIndicationUL = PDUR
        CanIfRxPduId = 31
        CanIfRxPduReadData = false
        CanIfRxPduReadNotifyStatus = false
        CanIfRxPduDlcCheck = false
        CanIfRxPduHrhIdRef = RBTM_FR_BODY3_4xwwtd59665s787n6ctawh7k8_6ec7cb10_Rx
        CanIfRxPduRef = BeltHdOvr_FR_State_ST3_09789cac_Rx
        variation-point = post-build-variant-condition{matching-criterion=SideAllocation, value=1}
      RBTM_FR_Stat_ST3_b20121fa_Tx (CanIfTxPduCfg):
        CanIfTxPduCanId = 1689
        CanIfTxPduCanIdType = STANDARD_CAN
        CanIfTxPduDlc = 8
        CanIfTxPduUserTxConfirmationName = PduR_CanIfTxConfirmation
        CanIfTxPduUserTxConfirmationUL = PDUR
        CanIfTxPduId = 8
        CanIfTxPduReadNotifyStatus = false
        CanIfTxPduType = STATIC
        CanIfTxPduTruncation = false
        CanIfTxPduBufferRef = BODY3_bccb160f
        CanIfTxPduRef = RBTM_FR_Stat_ST3_8dd11b6c_Tx
        variation-point = post-build-variant-condition{matching-criterion=SideAllocation, value=1}
      3 x CanIfRxPduCfg, all with CanIfRxPduCanIdType=EXTENDED_CAN, CanIfRxPduDlc=8, CanIfRxPduReadData=false, CanIfRxPduReadNotifyStatus=false, CanIfRxPduDlcCheck=false, CanIfRxPduHrhIdRef=RBTM_FR_BODY3_4xwwtd59665s787n6ctawh7k8_5b8d9de8_Rx, variation-point=post-build-variant-condition{matching-criterion=SideAllocation, value=1}:
        DIAG_RBTM_FR_03_ExtCAN_RQ_ST3_72fbd255_Rx: CanIfRxPduCanId=417441161, CanIfRxPduUserRxIndicationName=CanTp_RxIndication, CanIfRxPduUserRxIndicationType=PDUID_PDUINFOPTR, CanIfRxPduUserRxIndicationUL=CAN_TP, CanIfRxPduId=32, CanIfRxPduRef=DIAG_RBTM_FR_03_ExtCAN_RQ_ST3_225f4e6d_Rx
        Develop8_Rq_RBTM_FR_ST3_197eb912_Rx: CanIfRxPduCanId=417441089, CanIfRxPduUserRxIndicationName=PduR_CanIfRxIndication, CanIfRxPduUserRxIndicationUL=PDUR, CanIfRxPduId=35, CanIfRxPduRef=Develop8_Rq_RBTM_FR_ST3_d1911cf7_Rx
        RBTM_FR_BODY3NMNODE_65b97d54_Rx: CanIfRxPduUserRxIndicationName=CanNm_RxIndication, CanIfRxPduUserRxIndicationUL=CAN_NM, CanIfRxPduId=37, CanIfRxPduRef=RBTM_FR_BODY3NMNODE_e285a2b9_Rx
          BODY3_ed203270 (CanIfRxPduCanIdRange): CanIfRxPduCanIdRangeLowerCanId=339869696, CanIfRxPduCanIdRangeUpperCanId=339873791
      3 x CanIfTxPduCfg, all with CanIfTxPduDlc=8, CanIfTxPduReadNotifyStatus=false, CanIfTxPduType=STATIC, CanIfTxPduTruncation=false, CanIfTxPduBufferRef=BODY3_bccb160f, variation-point=post-build-variant-condition{matching-criterion=SideAllocation, value=1}:
        Meas8_RBTM_FR_ST3_492d97af_Tx: CanIfTxPduCanId=417441168, CanIfTxPduCanIdType=EXTENDED_CAN, CanIfTxPduUserTxConfirmationName=PduR_CanIfTxConfirmation, CanIfTxPduUserTxConfirmationUL=PDUR, CanIfTxPduId=6, CanIfTxPduRef=Meas8_RBTM_FR_ST3_6f1e0041_Tx
        DIAG_RBTM_FR_03_ExtCAN_RS_ST3_d977ea77_Tx: CanIfTxPduCanId=417441153, CanIfTxPduCanIdType=EXTENDED_CAN, CanIfTxPduUserTxConfirmationName=CanTp_TxConfirmation, CanIfTxPduUserTxConfirmationUL=CAN_TP, CanIfTxPduId=1, CanIfTxPduRef=DIAG_RBTM_FR_03_ExtCAN_RS_ST3_a7a76ca2_Tx
        RBTM_FR_Tens_ST3_019feca0_Tx: CanIfTxPduCanId=784, CanIfTxPduCanIdType=STANDARD_CAN, CanIfTxPduUserTxConfirmationName=PduR_CanIfTxConfirmation, CanIfTxPduUserTxConfirmationUL=PDUR, CanIfTxPduId=9, CanIfTxPduRef=RBTM_FR_Tens_ST3_1364a6b3_Tx
    CanIfPrivateCfg:
      CanIfPrivateSoftwareFilterType = LINEAR
      CanIfPrivateDlcCheck = false
      CanIfSupportTTCAN = false
      CanIfTransceiverMapping = false
      CanIfTransceiverHandling = false
      CanIfSupportExtendedIds = true
      CanIfSupportNmOsek = false
      CanIfTxBufferType = BIT_QUEUE
      CanIfWakeupSupport = true
      CanIfStaticFdTxBufferSupport = false
      CanIfRxSearchConsiderMsgType = false
      CanIfTxBufferFifoSupport = false
      CanIfSetPduReceptionModeSupport = false
      CanIfCheckWakeupCanRetType = false
      CanIfDataChecksumRxSupport = false
      CanIfDataChecksumTxSupport = false
    CanIfPublicCfg:
      CanIfPublicPnSupport = true
      CanIfPublicCancelTransmitSupport = true
      CanIfPublicDevErrorDetect = false
      CanIfPublicHandleTypeEnum = UINT8
      CanIfPublicMultipleDrvSupport = false
      CanIfPublicNumberOfCanHwUnits = 1
      CanIfPublicReadRxPduDataApi = false
      CanIfPublicReadRxPduNotifyStatusApi = false
      CanIfPublicReadTxPduNotifyStatusApi = false
      CanIfPublicSetDynamicTxIdApi = false
      CanIfPublicTxBuffering = true
      CanIfPublicTxConfirmPollingSupport = false
      CanIfPublicVersionInfoApi = false
      CanIfPublicWakeupCheckValidSupport = true
      CanIfPnWakeupTxPduFilterSupport = false
      CanIfPnTrcvHandlingSupport = false
      CanIfJ1939DynAddrSupport = DISABLED
      CanIfSafeBswChecks = true
      CanIfBusMirroringSupport = false
      CanIfEnableSecurityEventReporting = false
      CanIfSupportCanDrvAsr440 = false
      CanIfSupportMultipartition = false
      CanIfPublicWakeupCheckValidByNM = false
      CanIfSetBaudrateApi = false
      CanIfMetaDataSupport = false
