AUTOSAR XML (schema 00049)
package /ActiveEcuC
  module config SecOC: implementation-config-variant=VARIANT-PRE-COMPILE, module-description=SecOC_Impl
    SecOCGeneral:
      SecOCDevErrorDetect = false
      SecOCEnableForcedPassOverride = false
      SecOcIgnoreVerificationResult = false
      SecOCMainFunctionPeriodRx = 0.005
      SecOCMainFunctionPeriodTx = 0.005
      SecOCMaxAlignScalarType = 
      SecOCQueryFreshnessValue = RTE
      SecOCVersionInfoApi = false
      SecOCMaxMessageLinkerSizeOfRxPdus = 0
      SecOCSafeBswChecks = true
      SecOCPropagateOnlyFinalVerificationStatus = false
      SecOCEnableDevelopmentMode = false
      SecOCUseGetRxFreshness = true
      SecOCUseGetRxFreshnessAuthData = false
      SecOCUseGetTxFreshness = false
      SecOCUseGetTxFreshnessTruncData = false
      SecOCUseSPduTxConfirmation = false
      SecOCEnableCustomAuthenticationAPI = false
      SecOCCanFdPadding = false
      SecOCRetryFailedTransmitRequest = true
      SecOCUseMSBAlignedTruncatedFreshnessValueInFvM = false
      SecOCEnableAsyncCSMJobTimeout = false
    Ign_Stat_ST3_secured_87afaf29_Rx (SecOCRxPduProcessing):
      SecOCAuthInfoTxLength = 24
      SecOCAuthenticationVerifyAttempts = 0
      SecOCDataId = 28212
      SecOCFreshnessValueId = 1
      SecOCFreshnessValueLength = 40
      SecOCFreshnessValueTxLength = 8
      SecOCAuthenticationBuildAttempts = 1
      SecOCReceptionOverflowStrategy = REJECT
      SecOCUseAuthDataFreshness = false
      SecOCVerificationStatusPropagationMode = FAILURE_ONLY
      SecOCVerificationStatusWithSecuredPduPropagationMode = NONE
      SecOCImmediateProcessingOfCsmCallback = false
      SecOCPduProcessing = DEFERRED
      SecOCClientServerVerificationStatusPropagationMode = FAILURE_ONLY
      SecOCRxAuthServiceConfigRef = SSA_SecOC_Int_MacVerify_Ign_Stat
      Ign_Stat_ST3_1e3dc39f_Rx (SecOCRxAuthenticPduLayer): SecOCPduType=SECOC_IFPDU, SecOCRxAuthenticLayerPduRef=Ign_Stat_ST3_1e3dc39f_Rx
      SecOCRxSecuredPduLayer
        Ign_Stat_ST3_secured_87afaf29_Rx (SecOCRxSecuredPdu): SecOCSecuredRxPduVerification=true, SecOCRxSecuredLayerPduId=2, SecOCRxSecuredLayerPduRef=Ign_Stat_ST3_secured_87afaf29_Rx
    SecOCGeneration:
      SecOCOutOfBoundsWriteProtectionStrategy = NONE
      SecOCOutOfBoundsWriteSanitizer = false
      SecOCOutOfBoundsReadSanitizer = false
      SecOCShortSymbols = false
      SecOCInterfacesForDeactivatedData = false
      SecOCReferringKeysInComments = false
    Bckl_Sw_Fx_Stat_ST3_secured_b672d5e7_Rx (SecOCRxPduProcessing):
      SecOCAuthInfoTxLength = 24
      SecOCAuthenticationVerifyAttempts = 0
      SecOCDataId = 15576
      SecOCFreshnessValueId = 1
      SecOCFreshnessValueLength = 40
      SecOCFreshnessValueTxLength = 8
      SecOCAuthenticationBuildAttempts = 1
      SecOCReceptionOverflowStrategy = REJECT
      SecOCUseAuthDataFreshness = false
      SecOCVerificationStatusPropagationMode = FAILURE_ONLY
      SecOCVerificationStatusWithSecuredPduPropagationMode = NONE
      SecOCImmediateProcessingOfCsmCallback = false
      SecOCPduProcessing = DEFERRED
      SecOCClientServerVerificationStatusPropagationMode = FAILURE_ONLY
      SecOCRxAuthServiceConfigRef = SSA_SecOC_Int_MacVerify_COM_C0X_Pdu20_secured_3ef6961f_Rx
      Bckl_Sw_Fx_Stat_ST3_9c2de10c_Rx (SecOCRxAuthenticPduLayer): SecOCPduType=SECOC_IFPDU, SecOCRxAuthenticLayerPduRef=Bckl_Sw_Fx_Stat_ST3_9c2de10c_Rx
      SecOCRxSecuredPduLayer
        Bckl_Sw_Fx_Stat_ST3_secured_b672d5e7_Rx (SecOCRxSecuredPdu): SecOCSecuredRxPduVerification=true, SecOCRxSecuredLayerPduId=0, SecOCRxSecuredLayerPduRef=Bckl_Sw_Fx_Stat_ST3_secured_b672d5e7_Rx
    ELC_Lvr_Stat_ST3_secured_7bad7996_Rx (SecOCRxPduProcessing):
      SecOCAuthInfoTxLength = 24
      SecOCAuthenticationVerifyAttempts = 0
      SecOCDataId = 37177
      SecOCFreshnessValueId = 1
      SecOCFreshnessValueLength = 40
      SecOCFreshnessValueTxLength = 8
      SecOCAuthenticationBuildAttempts = 1
      SecOCReceptionOverflowStrategy = REJECT
      SecOCUseAuthDataFreshness = false
      SecOCVerificationStatusPropagationMode = FAILURE_ONLY
      SecOCVerificationStatusWithSecuredPduPropagationMode = NONE
      SecOCImmediateProcessingOfCsmCallback = false
      SecOCPduProcessing = DEFERRED
      SecOCClientServerVerificationStatusPropagationMode = FAILURE_ONLY
      SecOCRxAuthServiceConfigRef = SSA_SecOC_Int_MacVerify_COM_C0X_Pdu21_secured_298d825c_Rx
      ELC_Lvr_Stat_ST3_d97bab99_Rx (SecOCRxAuthenticPduLayer): SecOCPduType=SECOC_IFPDU, SecOCRxAuthenticLayerPduRef=ELC_Lvr_Stat_ST3_d97bab99_Rx
      SecOCRxSecuredPduLayer
        ELC_Lvr_Stat_ST3_secured_7bad7996_Rx (SecOCRxSecuredPdu): SecOCSecuredRxPduVerification=true, SecOCRxSecuredLayerPduId=1, SecOCRxSecuredLayerPduRef=ELC_Lvr_Stat_ST3_secured_7bad7996_Rx
