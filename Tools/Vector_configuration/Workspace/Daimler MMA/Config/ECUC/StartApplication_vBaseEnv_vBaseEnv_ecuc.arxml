AUTOSAR XML (schema 00049)
package /ActiveEcuC
  module config vBaseEnv: implementation-config-variant=VARIANT-PRE-COMPILE, module-description=vBaseEnv_Impl
    vBaseEnvGeneral: vBaseEnvTestedDerivativeRef=TC322L
      vBaseEnvInterruptHandling
        vBaseEnvCan
          9 x vBaseEnvChannel:
            SRC_CAN0INT0: vBaseEnvIndex=0, vBaseEnvIsrInterruptPriority=10, vBaseEnvIsrInterruptSource=1456
            SRC_CAN0INT1: vBaseEnvIndex=0, vBaseEnvIsrInterruptPriority=11, vBaseEnvIsrInterruptSource=1460
            SRC_CAN0INT2: vBaseEnvIndex=0, vBaseEnvIsrInterruptPriority=12, vBaseEnvIsrInterruptSource=1464
            SRC_CAN1INT0: vBaseEnvIndex=1, vBaseEnvIsrInterruptPriority=13, vBaseEnvIsrInterruptSource=1520
            SRC_CAN1INT1: vBaseEnvIndex=1, vBaseEnvIsrInterruptPriority=14, vBaseEnvIsrInterruptSource=1524
            SRC_CAN1INT2: vBaseEnvIndex=1, vBaseEnvIsrInterruptPriority=15, vBaseEnvIsrInterruptSource=1528
            SRC_CAN2INT0: vBaseEnvIndex=2, vBaseEnvIsrInterruptPriority=16, vBaseEnvIsrInterruptSource=1584
            SRC_CAN2INT1: vBaseEnvIndex=2, vBaseEnvIsrInterruptPriority=17, vBaseEnvIsrInterruptSource=1588
            SRC_CAN2INT2: vBaseEnvIndex=2, vBaseEnvIsrInterruptPriority=18, vBaseEnvIsrInterruptSource=1592
      16 x vBaseEnvMemLayoutHwRegion:
        DSPR0
        PSPR0
        DSPR1
        PSPR1
        DSPR2
        PSPR2
        PFlash0_Cached
        PFlash0_NonCached
        LMU0_Cached
        LMU0_NonCached
        LMU1_Cached
        LMU1_NonCached
        BMHD{0..3}
      5 x vBaseEnvDerivativeInformation, all with vBaseEnvCpuCoreAmount=1, vBaseEnvCpuMaxFrequency=300000000, vBaseEnvTestedDerivative=TC33x, vBaseEnvTestedDerivativeDescription=Infineon Aurix 2G TC33x Family, vBaseEnvAvailableChannels_Ethernet=0, vBaseEnvAvailableChannels_Flexray=2, vBaseEnvCpuCore=TC162, vBaseEnvAvailableChannels_Hyperbus=0, vBaseEnvAvailableChannels_I2c=0, vBaseEnvAvailableChannels_Spi=0:
        TC337L: vBaseEnvAvailableChannels_Can=8, vBaseEnvAvailableChannels_Lin=12
          vBaseEnvAdditionalParameters: vBaseEnvWatchdogGroup=B, vBaseEnvPllGroup=B, vBaseEnvPortGroup=B, vBaseEnvResetGroup=B, vBaseEnvDerivativeGroup=TC3xx
          16 x vBaseEnvMemLayoutHwRegion:
            DSPR0: vBaseEnvHwRegionStartAddress=1879048192, vBaseEnvHwRegionSize=196608, vBaseEnvHwRegionType=RAM
            PSPR0: vBaseEnvHwRegionStartAddress=1880096768, vBaseEnvHwRegionSize=8192, vBaseEnvHwRegionType=RAM
            PFlash0_Cached: vBaseEnvHwRegionStartAddress=2147483648, vBaseEnvHwRegionSize=2097152, vBaseEnvHwRegionType=ROM
            PFlash0_NonCached: vBaseEnvHwRegionStartAddress=2684354560, vBaseEnvHwRegionSize=2097152, vBaseEnvHwRegionType=ROM
            LMU0_Cached: vBaseEnvHwRegionStartAddress=2415919104, vBaseEnvHwRegionSize=8192, vBaseEnvHwRegionType=RAM
            LMU0_NonCached: vBaseEnvHwRegionStartAddress=2952790016, vBaseEnvHwRegionSize=8192, vBaseEnvHwRegionType=RAM
            BMHD0: vBaseEnvHwRegionStartAddress=2940207104, vBaseEnvHwRegionSize=512, vBaseEnvHwRegionType=ROM
            BMHD1: vBaseEnvHwRegionStartAddress=2940207616, vBaseEnvHwRegionSize=512, vBaseEnvHwRegionType=ROM
            BMHD2: vBaseEnvHwRegionStartAddress=2940208128, vBaseEnvHwRegionSize=512, vBaseEnvHwRegionType=ROM
            BMHD3: vBaseEnvHwRegionStartAddress=2940208640, vBaseEnvHwRegionSize=512, vBaseEnvHwRegionType=ROM
            OLDA_Cached: vBaseEnvHwRegionStartAddress=2413821952, vBaseEnvHwRegionSize=524288, vBaseEnvHwRegionType=RAM
            OLDA_NonCached: vBaseEnvHwRegionStartAddress=2950692864, vBaseEnvHwRegionSize=524288, vBaseEnvHwRegionType=RAM
            DLMU0_Cached: vBaseEnvHwRegionStartAddress=2415919104, vBaseEnvHwRegionSize=8192, vBaseEnvHwRegionType=RAM
            DLMU0_NonCached: vBaseEnvHwRegionStartAddress=2952790016, vBaseEnvHwRegionSize=8192, vBaseEnvHwRegionType=RAM
            DFlash0: vBaseEnvHwRegionStartAddress=2936012800, vBaseEnvHwRegionSize=1048576, vBaseEnvHwRegionType=ROM
            DFlash1: vBaseEnvHwRegionStartAddress=2948595712, vBaseEnvHwRegionSize=131072, vBaseEnvHwRegionType=ROM
        TC332L: vBaseEnvAvailableChannels_Can=6, vBaseEnvAvailableChannels_Lin=5
          vBaseEnvAdditionalParameters: vBaseEnvWatchdogGroup=B, vBaseEnvPllGroup=B, vBaseEnvPortGroup=B, vBaseEnvResetGroup=B, vBaseEnvDerivativeGroup=TC3xx
          16 x vBaseEnvMemLayoutHwRegion:
            DSPR0: vBaseEnvHwRegionStartAddress=1879048192, vBaseEnvHwRegionSize=196608, vBaseEnvHwRegionType=RAM
            PSPR0: vBaseEnvHwRegionStartAddress=1880096768, vBaseEnvHwRegionSize=8192, vBaseEnvHwRegionType=RAM
            PFlash0_Cached: vBaseEnvHwRegionStartAddress=2147483648, vBaseEnvHwRegionSize=2097152, vBaseEnvHwRegionType=ROM
            PFlash0_NonCached: vBaseEnvHwRegionStartAddress=2684354560, vBaseEnvHwRegionSize=2097152, vBaseEnvHwRegionType=ROM
            LMU0_Cached: vBaseEnvHwRegionStartAddress=2415919104, vBaseEnvHwRegionSize=8192, vBaseEnvHwRegionType=RAM
            LMU0_NonCached: vBaseEnvHwRegionStartAddress=2952790016, vBaseEnvHwRegionSize=8192, vBaseEnvHwRegionType=RAM
            BMHD0: vBaseEnvHwRegionStartAddress=2940207104, vBaseEnvHwRegionSize=512, vBaseEnvHwRegionType=ROM
            BMHD1: vBaseEnvHwRegionStartAddress=2940207616, vBaseEnvHwRegionSize=512, vBaseEnvHwRegionType=ROM
            BMHD2: vBaseEnvHwRegionStartAddress=2940208128, vBaseEnvHwRegionSize=512, vBaseEnvHwRegionType=ROM
            BMHD3: vBaseEnvHwRegionStartAddress=2940208640, vBaseEnvHwRegionSize=512, vBaseEnvHwRegionType=ROM
            OLDA_Cached: vBaseEnvHwRegionStartAddress=2413821952, vBaseEnvHwRegionSize=524288, vBaseEnvHwRegionType=RAM
            OLDA_NonCached: vBaseEnvHwRegionStartAddress=2950692864, vBaseEnvHwRegionSize=524288, vBaseEnvHwRegionType=RAM
            DLMU0_Cached: vBaseEnvHwRegionStartAddress=2415919104, vBaseEnvHwRegionSize=8192, vBaseEnvHwRegionType=RAM
            DLMU0_NonCached: vBaseEnvHwRegionStartAddress=2952790016, vBaseEnvHwRegionSize=8192, vBaseEnvHwRegionType=RAM
            DFlash0: vBaseEnvHwRegionStartAddress=2936012800, vBaseEnvHwRegionSize=1048576, vBaseEnvHwRegionType=ROM
            DFlash1: vBaseEnvHwRegionStartAddress=2948595712, vBaseEnvHwRegionSize=131072, vBaseEnvHwRegionType=ROM
        TC333L: vBaseEnvAvailableChannels_Can=8, vBaseEnvAvailableChannels_Lin=5
          vBaseEnvAdditionalParameters: vBaseEnvWatchdogGroup=B, vBaseEnvPllGroup=B, vBaseEnvPortGroup=B, vBaseEnvResetGroup=B, vBaseEnvDerivativeGroup=TC3xx
          16 x vBaseEnvMemLayoutHwRegion:
            DSPR0: vBaseEnvHwRegionStartAddress=1879048192, vBaseEnvHwRegionSize=196608, vBaseEnvHwRegionType=RAM
            PSPR0: vBaseEnvHwRegionStartAddress=1880096768, vBaseEnvHwRegionSize=8192, vBaseEnvHwRegionType=RAM
            PFlash0_Cached: vBaseEnvHwRegionStartAddress=2147483648, vBaseEnvHwRegionSize=2097152, vBaseEnvHwRegionType=ROM
            PFlash0_NonCached: vBaseEnvHwRegionStartAddress=2684354560, vBaseEnvHwRegionSize=2097152, vBaseEnvHwRegionType=ROM
            LMU0_Cached: vBaseEnvHwRegionStartAddress=2415919104, vBaseEnvHwRegionSize=8192, vBaseEnvHwRegionType=RAM
            LMU0_NonCached: vBaseEnvHwRegionStartAddress=2952790016, vBaseEnvHwRegionSize=8192, vBaseEnvHwRegionType=RAM
            BMHD0: vBaseEnvHwRegionStartAddress=2940207104, vBaseEnvHwRegionSize=512, vBaseEnvHwRegionType=ROM
            BMHD1: vBaseEnvHwRegionStartAddress=2940207616, vBaseEnvHwRegionSize=512, vBaseEnvHwRegionType=ROM
            BMHD2: vBaseEnvHwRegionStartAddress=2940208128, vBaseEnvHwRegionSize=512, vBaseEnvHwRegionType=ROM
            BMHD3: vBaseEnvHwRegionStartAddress=2940208640, vBaseEnvHwRegionSize=512, vBaseEnvHwRegionType=ROM
            OLDA_Cached: vBaseEnvHwRegionStartAddress=2413821952, vBaseEnvHwRegionSize=524288, vBaseEnvHwRegionType=RAM
            OLDA_NonCached: vBaseEnvHwRegionStartAddress=2950692864, vBaseEnvHwRegionSize=524288, vBaseEnvHwRegionType=RAM
            DLMU0_Cached: vBaseEnvHwRegionStartAddress=2415919104, vBaseEnvHwRegionSize=8192, vBaseEnvHwRegionType=RAM
            DLMU0_NonCached: vBaseEnvHwRegionStartAddress=2952790016, vBaseEnvHwRegionSize=8192, vBaseEnvHwRegionType=RAM
            DFlash0: vBaseEnvHwRegionStartAddress=2936012800, vBaseEnvHwRegionSize=1048576, vBaseEnvHwRegionType=ROM
            DFlash1: vBaseEnvHwRegionStartAddress=2948595712, vBaseEnvHwRegionSize=131072, vBaseEnvHwRegionType=ROM
        TC334L: vBaseEnvAvailableChannels_Can=8, vBaseEnvAvailableChannels_Lin=12
          vBaseEnvAdditionalParameters: vBaseEnvWatchdogGroup=B, vBaseEnvPllGroup=B, vBaseEnvPortGroup=B, vBaseEnvResetGroup=B, vBaseEnvDerivativeGroup=TC3xx
          16 x vBaseEnvMemLayoutHwRegion:
            DSPR0: vBaseEnvHwRegionStartAddress=1879048192, vBaseEnvHwRegionSize=196608, vBaseEnvHwRegionType=RAM
            PSPR0: vBaseEnvHwRegionStartAddress=1880096768, vBaseEnvHwRegionSize=8192, vBaseEnvHwRegionType=RAM
            PFlash0_Cached: vBaseEnvHwRegionStartAddress=2147483648, vBaseEnvHwRegionSize=2097152, vBaseEnvHwRegionType=ROM
            PFlash0_NonCached: vBaseEnvHwRegionStartAddress=2684354560, vBaseEnvHwRegionSize=2097152, vBaseEnvHwRegionType=ROM
            LMU0_Cached: vBaseEnvHwRegionStartAddress=2415919104, vBaseEnvHwRegionSize=8192, vBaseEnvHwRegionType=RAM
            LMU0_NonCached: vBaseEnvHwRegionStartAddress=2952790016, vBaseEnvHwRegionSize=8192, vBaseEnvHwRegionType=RAM
            BMHD0: vBaseEnvHwRegionStartAddress=2940207104, vBaseEnvHwRegionSize=512, vBaseEnvHwRegionType=ROM
            BMHD1: vBaseEnvHwRegionStartAddress=2940207616, vBaseEnvHwRegionSize=512, vBaseEnvHwRegionType=ROM
            BMHD2: vBaseEnvHwRegionStartAddress=2940208128, vBaseEnvHwRegionSize=512, vBaseEnvHwRegionType=ROM
            BMHD3: vBaseEnvHwRegionStartAddress=2940208640, vBaseEnvHwRegionSize=512, vBaseEnvHwRegionType=ROM
            OLDA_Cached: vBaseEnvHwRegionStartAddress=2413821952, vBaseEnvHwRegionSize=524288, vBaseEnvHwRegionType=RAM
            OLDA_NonCached: vBaseEnvHwRegionStartAddress=2950692864, vBaseEnvHwRegionSize=524288, vBaseEnvHwRegionType=RAM
            DLMU0_Cached: vBaseEnvHwRegionStartAddress=2415919104, vBaseEnvHwRegionSize=8192, vBaseEnvHwRegionType=RAM
            DLMU0_NonCached: vBaseEnvHwRegionStartAddress=2952790016, vBaseEnvHwRegionSize=8192, vBaseEnvHwRegionType=RAM
            DFlash0: vBaseEnvHwRegionStartAddress=2936012800, vBaseEnvHwRegionSize=1048576, vBaseEnvHwRegionType=ROM
            DFlash1: vBaseEnvHwRegionStartAddress=2948595712, vBaseEnvHwRegionSize=131072, vBaseEnvHwRegionType=ROM
        TC336L: vBaseEnvAvailableChannels_Can=8, vBaseEnvAvailableChannels_Lin=12
          vBaseEnvAdditionalParameters: vBaseEnvWatchdogGroup=B, vBaseEnvPllGroup=B, vBaseEnvPortGroup=B, vBaseEnvResetGroup=B, vBaseEnvDerivativeGroup=TC3xx
          16 x vBaseEnvMemLayoutHwRegion:
            DSPR0: vBaseEnvHwRegionStartAddress=1879048192, vBaseEnvHwRegionSize=196608, vBaseEnvHwRegionType=RAM
            PSPR0: vBaseEnvHwRegionStartAddress=1880096768, vBaseEnvHwRegionSize=8192, vBaseEnvHwRegionType=RAM
            PFlash0_Cached: vBaseEnvHwRegionStartAddress=2147483648, vBaseEnvHwRegionSize=2097152, vBaseEnvHwRegionType=ROM
            PFlash0_NonCached: vBaseEnvHwRegionStartAddress=2684354560, vBaseEnvHwRegionSize=2097152, vBaseEnvHwRegionType=ROM
            LMU0_Cached: vBaseEnvHwRegionStartAddress=2415919104, vBaseEnvHwRegionSize=8192, vBaseEnvHwRegionType=RAM
            LMU0_NonCached: vBaseEnvHwRegionStartAddress=2952790016, vBaseEnvHwRegionSize=8192, vBaseEnvHwRegionType=RAM
            BMHD0: vBaseEnvHwRegionStartAddress=2940207104, vBaseEnvHwRegionSize=512, vBaseEnvHwRegionType=ROM
            BMHD1: vBaseEnvHwRegionStartAddress=2940207616, vBaseEnvHwRegionSize=512, vBaseEnvHwRegionType=ROM
            BMHD2: vBaseEnvHwRegionStartAddress=2940208128, vBaseEnvHwRegionSize=512, vBaseEnvHwRegionType=ROM
            BMHD3: vBaseEnvHwRegionStartAddress=2940208640, vBaseEnvHwRegionSize=512, vBaseEnvHwRegionType=ROM
            OLDA_Cached: vBaseEnvHwRegionStartAddress=2413821952, vBaseEnvHwRegionSize=524288, vBaseEnvHwRegionType=RAM
            OLDA_NonCached: vBaseEnvHwRegionStartAddress=2950692864, vBaseEnvHwRegionSize=524288, vBaseEnvHwRegionType=RAM
            DLMU0_Cached: vBaseEnvHwRegionStartAddress=2415919104, vBaseEnvHwRegionSize=8192, vBaseEnvHwRegionType=RAM
            DLMU0_NonCached: vBaseEnvHwRegionStartAddress=2952790016, vBaseEnvHwRegionSize=8192, vBaseEnvHwRegionType=RAM
            DFlash0: vBaseEnvHwRegionStartAddress=2936012800, vBaseEnvHwRegionSize=1048576, vBaseEnvHwRegionType=ROM
            DFlash1: vBaseEnvHwRegionStartAddress=2948595712, vBaseEnvHwRegionSize=131072, vBaseEnvHwRegionType=ROM
      PFlash1_Cached (vBaseEnvMemLayoutHwRegion)
      PFlash1_NonCached (vBaseEnvMemLayoutHwRegion)
      13 x vBaseEnvDerivativeInformation, all with vBaseEnvCpuMaxFrequency=300000000, vBaseEnvAvailableChannels_Flexray=2, vBaseEnvCpuCore=TC162, vBaseEnvAvailableChannels_Hyperbus=0, vBaseEnvAvailableChannels_I2c=0, vBaseEnvAvailableChannels_Spi=0:
        TC357T: vBaseEnvCpuCoreAmount=3, vBaseEnvTestedDerivative=TC35x, vBaseEnvTestedDerivativeDescription=Infineon Aurix 2G TC35x Family, vBaseEnvAvailableChannels_Can=8, vBaseEnvAvailableChannels_Ethernet=1, vBaseEnvAvailableChannels_Lin=4
          vBaseEnvAdditionalParameters: vBaseEnvWatchdogGroup=B, vBaseEnvPllGroup=B, vBaseEnvPortGroup=B, vBaseEnvResetGroup=B, vBaseEnvDerivativeGroup=TC3xx
          32 x vBaseEnvMemLayoutHwRegion:
            DSPR0: vBaseEnvHwRegionStartAddress=1879048192, vBaseEnvHwRegionSize=245760, vBaseEnvHwRegionType=RAM
            PSPR0: vBaseEnvHwRegionStartAddress=1880096768, vBaseEnvHwRegionSize=65536, vBaseEnvHwRegionType=RAM
            DSPR1: vBaseEnvHwRegionStartAddress=1610612736, vBaseEnvHwRegionSize=245760, vBaseEnvHwRegionType=RAM
            PSPR1: vBaseEnvHwRegionStartAddress=1611661312, vBaseEnvHwRegionSize=65536, vBaseEnvHwRegionType=RAM
            DSPR2: vBaseEnvHwRegionStartAddress=1342177280, vBaseEnvHwRegionSize=98304, vBaseEnvHwRegionType=RAM
            PSPR2: vBaseEnvHwRegionStartAddress=1343225856, vBaseEnvHwRegionSize=65536, vBaseEnvHwRegionType=RAM
            PFlash0_Cached: vBaseEnvHwRegionStartAddress=2147483648, vBaseEnvHwRegionSize=2097152, vBaseEnvHwRegionType=ROM
            PFlash0_NonCached: vBaseEnvHwRegionStartAddress=2684354560, vBaseEnvHwRegionSize=2097152, vBaseEnvHwRegionType=ROM
            PFlash1_Cached: vBaseEnvHwRegionStartAddress=2150629376, vBaseEnvHwRegionSize=2097152, vBaseEnvHwRegionType=ROM
            PFlash1_NonCached: vBaseEnvHwRegionStartAddress=2687500288, vBaseEnvHwRegionSize=2097152, vBaseEnvHwRegionType=ROM
            LMU0_Cached: vBaseEnvHwRegionStartAddress=2416181248, vBaseEnvHwRegionSize=262144, vBaseEnvHwRegionType=RAM
            LMU0_NonCached: vBaseEnvHwRegionStartAddress=2953052160, vBaseEnvHwRegionSize=262144, vBaseEnvHwRegionType=RAM
            LMU1_Cached: vBaseEnvHwRegionStartAddress=2416443392, vBaseEnvHwRegionSize=262144, vBaseEnvHwRegionType=RAM
            LMU1_NonCached: vBaseEnvHwRegionStartAddress=2953314304, vBaseEnvHwRegionSize=262144, vBaseEnvHwRegionType=RAM
            BMHD0: vBaseEnvHwRegionStartAddress=2940207104, vBaseEnvHwRegionSize=512, vBaseEnvHwRegionType=ROM
            BMHD1: vBaseEnvHwRegionStartAddress=2940207616, vBaseEnvHwRegionSize=512, vBaseEnvHwRegionType=ROM
            BMHD2: vBaseEnvHwRegionStartAddress=2940208128, vBaseEnvHwRegionSize=512, vBaseEnvHwRegionType=ROM
            BMHD3: vBaseEnvHwRegionStartAddress=2940208640, vBaseEnvHwRegionSize=512, vBaseEnvHwRegionType=ROM
            OLDA_Cached: vBaseEnvHwRegionStartAddress=2413821952, vBaseEnvHwRegionSize=524288, vBaseEnvHwRegionType=RAM
            OLDA_NonCached: vBaseEnvHwRegionStartAddress=2950692864, vBaseEnvHwRegionSize=524288, vBaseEnvHwRegionType=RAM
            DLMU0_Cached: vBaseEnvHwRegionStartAddress=2415919104, vBaseEnvHwRegionSize=65536, vBaseEnvHwRegionType=RAM
            DLMU0_NonCached: vBaseEnvHwRegionStartAddress=2952790016, vBaseEnvHwRegionSize=65536, vBaseEnvHwRegionType=RAM
            DLMU1_Cached: vBaseEnvHwRegionStartAddress=2415984640, vBaseEnvHwRegionSize=65536, vBaseEnvHwRegionType=RAM
            DLMU1_NonCached: vBaseEnvHwRegionStartAddress=2952855552, vBaseEnvHwRegionSize=65536, vBaseEnvHwRegionType=RAM
            DLMU2_Cached: vBaseEnvHwRegionStartAddress=2416050176, vBaseEnvHwRegionSize=65536, vBaseEnvHwRegionType=RAM
            DLMU2_NonCached: vBaseEnvHwRegionStartAddress=2952921088, vBaseEnvHwRegionSize=65536, vBaseEnvHwRegionType=RAM
            EMEM0_Cached: vBaseEnvHwRegionStartAddress=2566914048, vBaseEnvHwRegionSize=1048576, vBaseEnvHwRegionType=RAM
            EMEM0_NonCached: vBaseEnvHwRegionStartAddress=3103784960, vBaseEnvHwRegionSize=1048576, vBaseEnvHwRegionType=RAM
            EMEM1_Cached: vBaseEnvHwRegionStartAddress=2567962624, vBaseEnvHwRegionSize=1048576, vBaseEnvHwRegionType=RAM
            EMEM1_NonCached: vBaseEnvHwRegionStartAddress=3104833536, vBaseEnvHwRegionSize=1048576, vBaseEnvHwRegionType=RAM
            DFlash0: vBaseEnvHwRegionStartAddress=2936012800, vBaseEnvHwRegionSize=131072, vBaseEnvHwRegionType=ROM
            DFlash1: vBaseEnvHwRegionStartAddress=2948595712, vBaseEnvHwRegionSize=131072, vBaseEnvHwRegionType=ROM
        TC356T: vBaseEnvCpuCoreAmount=3, vBaseEnvTestedDerivative=TC35x, vBaseEnvTestedDerivativeDescription=Infineon Aurix 2G TC35x Family, vBaseEnvAvailableChannels_Can=7, vBaseEnvAvailableChannels_Ethernet=1, vBaseEnvAvailableChannels_Lin=4
          vBaseEnvAdditionalParameters: vBaseEnvWatchdogGroup=B, vBaseEnvPllGroup=B, vBaseEnvPortGroup=B, vBaseEnvResetGroup=B, vBaseEnvDerivativeGroup=TC3xx
          32 x vBaseEnvMemLayoutHwRegion:
            DSPR0: vBaseEnvHwRegionStartAddress=1879048192, vBaseEnvHwRegionSize=245760, vBaseEnvHwRegionType=RAM
            PSPR0: vBaseEnvHwRegionStartAddress=1880096768, vBaseEnvHwRegionSize=65536, vBaseEnvHwRegionType=RAM
            DSPR1: vBaseEnvHwRegionStartAddress=1610612736, vBaseEnvHwRegionSize=245760, vBaseEnvHwRegionType=RAM
            PSPR1: vBaseEnvHwRegionStartAddress=1611661312, vBaseEnvHwRegionSize=65536, vBaseEnvHwRegionType=RAM
            DSPR2: vBaseEnvHwRegionStartAddress=1342177280, vBaseEnvHwRegionSize=98304, vBaseEnvHwRegionType=RAM
            PSPR2: vBaseEnvHwRegionStartAddress=1343225856, vBaseEnvHwRegionSize=65536, vBaseEnvHwRegionType=RAM
            PFlash0_Cached: vBaseEnvHwRegionStartAddress=2147483648, vBaseEnvHwRegionSize=2097152, vBaseEnvHwRegionType=ROM
            PFlash0_NonCached: vBaseEnvHwRegionStartAddress=2684354560, vBaseEnvHwRegionSize=2097152, vBaseEnvHwRegionType=ROM
            PFlash1_Cached: vBaseEnvHwRegionStartAddress=2150629376, vBaseEnvHwRegionSize=2097152, vBaseEnvHwRegionType=ROM
            PFlash1_NonCached: vBaseEnvHwRegionStartAddress=2687500288, vBaseEnvHwRegionSize=2097152, vBaseEnvHwRegionType=ROM
            LMU0_Cached: vBaseEnvHwRegionStartAddress=2416181248, vBaseEnvHwRegionSize=262144, vBaseEnvHwRegionType=RAM
            LMU0_NonCached: vBaseEnvHwRegionStartAddress=2953052160, vBaseEnvHwRegionSize=262144, vBaseEnvHwRegionType=RAM
            LMU1_Cached: vBaseEnvHwRegionStartAddress=2416443392, vBaseEnvHwRegionSize=262144, vBaseEnvHwRegionType=RAM
            LMU1_NonCached: vBaseEnvHwRegionStartAddress=2953314304, vBaseEnvHwRegionSize=262144, vBaseEnvHwRegionType=RAM
            BMHD0: vBaseEnvHwRegionStartAddress=2940207104, vBaseEnvHwRegionSize=512, vBaseEnvHwRegionType=ROM
            BMHD1: vBaseEnvHwRegionStartAddress=2940207616, vBaseEnvHwRegionSize=512, vBaseEnvHwRegionType=ROM
            BMHD2: vBaseEnvHwRegionStartAddress=2940208128, vBaseEnvHwRegionSize=512, vBaseEnvHwRegionType=ROM
            BMHD3: vBaseEnvHwRegionStartAddress=2940208640, vBaseEnvHwRegionSize=512, vBaseEnvHwRegionType=ROM
            OLDA_Cached: vBaseEnvHwRegionStartAddress=2413821952, vBaseEnvHwRegionSize=524288, vBaseEnvHwRegionType=RAM
            OLDA_NonCached: vBaseEnvHwRegionStartAddress=2950692864, vBaseEnvHwRegionSize=524288, vBaseEnvHwRegionType=RAM
            DLMU0_Cached: vBaseEnvHwRegionStartAddress=2415919104, vBaseEnvHwRegionSize=65536, vBaseEnvHwRegionType=RAM
            DLMU0_NonCached: vBaseEnvHwRegionStartAddress=2952790016, vBaseEnvHwRegionSize=65536, vBaseEnvHwRegionType=RAM
            DLMU1_Cached: vBaseEnvHwRegionStartAddress=2415984640, vBaseEnvHwRegionSize=65536, vBaseEnvHwRegionType=RAM
            DLMU1_NonCached: vBaseEnvHwRegionStartAddress=2952855552, vBaseEnvHwRegionSize=65536, vBaseEnvHwRegionType=RAM
            DLMU2_Cached: vBaseEnvHwRegionStartAddress=2416050176, vBaseEnvHwRegionSize=65536, vBaseEnvHwRegionType=RAM
            DLMU2_NonCached: vBaseEnvHwRegionStartAddress=2952921088, vBaseEnvHwRegionSize=65536, vBaseEnvHwRegionType=RAM
            EMEM0_Cached: vBaseEnvHwRegionStartAddress=2566914048, vBaseEnvHwRegionSize=1048576, vBaseEnvHwRegionType=RAM
            EMEM0_NonCached: vBaseEnvHwRegionStartAddress=3103784960, vBaseEnvHwRegionSize=1048576, vBaseEnvHwRegionType=RAM
            EMEM1_Cached: vBaseEnvHwRegionStartAddress=2567962624, vBaseEnvHwRegionSize=1048576, vBaseEnvHwRegionType=RAM
            EMEM1_NonCached: vBaseEnvHwRegionStartAddress=3104833536, vBaseEnvHwRegionSize=1048576, vBaseEnvHwRegionType=RAM
            DFlash0: vBaseEnvHwRegionStartAddress=2936012800, vBaseEnvHwRegionSize=131072, vBaseEnvHwRegionType=ROM
            DFlash1: vBaseEnvHwRegionStartAddress=2948595712, vBaseEnvHwRegionSize=131072, vBaseEnvHwRegionType=ROM
        TC367D: vBaseEnvCpuCoreAmount=2, vBaseEnvTestedDerivative=TC36x, vBaseEnvTestedDerivativeDescription=Infineon Aurix 2G TC36x Family, vBaseEnvAvailableChannels_Can=8, vBaseEnvAvailableChannels_Ethernet=1, vBaseEnvAvailableChannels_Lin=12
          vBaseEnvAdditionalParameters: vBaseEnvWatchdogGroup=B, vBaseEnvPllGroup=B, vBaseEnvPortGroup=B, vBaseEnvResetGroup=B, vBaseEnvDerivativeGroup=TC3xx
          24 x vBaseEnvMemLayoutHwRegion:
            DSPR0: vBaseEnvHwRegionStartAddress=1879048192, vBaseEnvHwRegionSize=196608, vBaseEnvHwRegionType=RAM
            PSPR0: vBaseEnvHwRegionStartAddress=1880096768, vBaseEnvHwRegionSize=32768, vBaseEnvHwRegionType=RAM
            DSPR1: vBaseEnvHwRegionStartAddress=1610612736, vBaseEnvHwRegionSize=196608, vBaseEnvHwRegionType=RAM
            PSPR1: vBaseEnvHwRegionStartAddress=1611661312, vBaseEnvHwRegionSize=32768, vBaseEnvHwRegionType=RAM
            PFlash0_Cached: vBaseEnvHwRegionStartAddress=2147483648, vBaseEnvHwRegionSize=2097152, vBaseEnvHwRegionType=ROM
            PFlash0_NonCached: vBaseEnvHwRegionStartAddress=2684354560, vBaseEnvHwRegionSize=2097152, vBaseEnvHwRegionType=ROM
            PFlash1_Cached: vBaseEnvHwRegionStartAddress=2150629376, vBaseEnvHwRegionSize=2097152, vBaseEnvHwRegionType=ROM
            PFlash1_NonCached: vBaseEnvHwRegionStartAddress=2687500288, vBaseEnvHwRegionSize=2097152, vBaseEnvHwRegionType=ROM
            LMU0_Cached: vBaseEnvHwRegionStartAddress=2415919104, vBaseEnvHwRegionSize=65536, vBaseEnvHwRegionType=RAM
            LMU0_NonCached: vBaseEnvHwRegionStartAddress=2952790016, vBaseEnvHwRegionSize=65536, vBaseEnvHwRegionType=RAM
            LMU1_Cached: vBaseEnvHwRegionStartAddress=2415984640, vBaseEnvHwRegionSize=65536, vBaseEnvHwRegionType=RAM
            LMU1_NonCached: vBaseEnvHwRegionStartAddress=2952855552, vBaseEnvHwRegionSize=65536, vBaseEnvHwRegionType=RAM
            BMHD0: vBaseEnvHwRegionStartAddress=2940207104, vBaseEnvHwRegionSize=512, vBaseEnvHwRegionType=ROM
            BMHD1: vBaseEnvHwRegionStartAddress=2940207616, vBaseEnvHwRegionSize=512, vBaseEnvHwRegionType=ROM
            BMHD2: vBaseEnvHwRegionStartAddress=2940208128, vBaseEnvHwRegionSize=512, vBaseEnvHwRegionType=ROM
            BMHD3: vBaseEnvHwRegionStartAddress=2940208640, vBaseEnvHwRegionSize=512, vBaseEnvHwRegionType=ROM
            OLDA_Cached: vBaseEnvHwRegionStartAddress=2413821952, vBaseEnvHwRegionSize=524288, vBaseEnvHwRegionType=RAM
            OLDA_NonCached: vBaseEnvHwRegionStartAddress=2950692864, vBaseEnvHwRegionSize=524288, vBaseEnvHwRegionType=RAM
            DLMU0_Cached: vBaseEnvHwRegionStartAddress=2415919104, vBaseEnvHwRegionSize=65536, vBaseEnvHwRegionType=RAM
            DLMU0_NonCached: vBaseEnvHwRegionStartAddress=2952790016, vBaseEnvHwRegionSize=65536, vBaseEnvHwRegionType=RAM
            DLMU1_Cached: vBaseEnvHwRegionStartAddress=2415984640, vBaseEnvHwRegionSize=65536, vBaseEnvHwRegionType=RAM
            DLMU1_NonCached: vBaseEnvHwRegionStartAddress=2952855552, vBaseEnvHwRegionSize=65536, vBaseEnvHwRegionType=RAM
            DFlash0: vBaseEnvHwRegionStartAddress=2936012800, vBaseEnvHwRegionSize=131072, vBaseEnvHwRegionType=ROM
            DFlash1: vBaseEnvHwRegionStartAddress=2948595712, vBaseEnvHwRegionSize=131072, vBaseEnvHwRegionType=ROM
        TC364D: vBaseEnvCpuCoreAmount=2, vBaseEnvTestedDerivative=TC36x, vBaseEnvTestedDerivativeDescription=Infineon Aurix 2G TC36x Family, vBaseEnvAvailableChannels_Can=8, vBaseEnvAvailableChannels_Ethernet=1, vBaseEnvAvailableChannels_Lin=12
          vBaseEnvAdditionalParameters: vBaseEnvWatchdogGroup=B, vBaseEnvPllGroup=B, vBaseEnvPortGroup=B, vBaseEnvResetGroup=B, vBaseEnvDerivativeGroup=TC3xx
          24 x vBaseEnvMemLayoutHwRegion:
            DSPR0: vBaseEnvHwRegionStartAddress=1879048192, vBaseEnvHwRegionSize=196608, vBaseEnvHwRegionType=RAM
            PSPR0: vBaseEnvHwRegionStartAddress=1880096768, vBaseEnvHwRegionSize=32768, vBaseEnvHwRegionType=RAM
            DSPR1: vBaseEnvHwRegionStartAddress=1610612736, vBaseEnvHwRegionSize=196608, vBaseEnvHwRegionType=RAM
            PSPR1: vBaseEnvHwRegionStartAddress=1611661312, vBaseEnvHwRegionSize=32768, vBaseEnvHwRegionType=RAM
            PFlash0_Cached: vBaseEnvHwRegionStartAddress=2147483648, vBaseEnvHwRegionSize=2097152, vBaseEnvHwRegionType=ROM
            PFlash0_NonCached: vBaseEnvHwRegionStartAddress=2684354560, vBaseEnvHwRegionSize=2097152, vBaseEnvHwRegionType=ROM
            PFlash1_Cached: vBaseEnvHwRegionStartAddress=2150629376, vBaseEnvHwRegionSize=2097152, vBaseEnvHwRegionType=ROM
            PFlash1_NonCached: vBaseEnvHwRegionStartAddress=2687500288, vBaseEnvHwRegionSize=2097152, vBaseEnvHwRegionType=ROM
            LMU0_Cached: vBaseEnvHwRegionStartAddress=2415919104, vBaseEnvHwRegionSize=65536, vBaseEnvHwRegionType=RAM
            LMU0_NonCached: vBaseEnvHwRegionStartAddress=2952790016, vBaseEnvHwRegionSize=65536, vBaseEnvHwRegionType=RAM
            LMU1_Cached: vBaseEnvHwRegionStartAddress=2415984640, vBaseEnvHwRegionSize=65536, vBaseEnvHwRegionType=RAM
            LMU1_NonCached: vBaseEnvHwRegionStartAddress=2952855552, vBaseEnvHwRegionSize=65536, vBaseEnvHwRegionType=RAM
            BMHD0: vBaseEnvHwRegionStartAddress=2940207104, vBaseEnvHwRegionSize=512, vBaseEnvHwRegionType=ROM
            BMHD1: vBaseEnvHwRegionStartAddress=2940207616, vBaseEnvHwRegionSize=512, vBaseEnvHwRegionType=ROM
            BMHD2: vBaseEnvHwRegionStartAddress=2940208128, vBaseEnvHwRegionSize=512, vBaseEnvHwRegionType=ROM
            BMHD3: vBaseEnvHwRegionStartAddress=2940208640, vBaseEnvHwRegionSize=512, vBaseEnvHwRegionType=ROM
            OLDA_Cached: vBaseEnvHwRegionStartAddress=2413821952, vBaseEnvHwRegionSize=524288, vBaseEnvHwRegionType=RAM
            OLDA_NonCached: vBaseEnvHwRegionStartAddress=2950692864, vBaseEnvHwRegionSize=524288, vBaseEnvHwRegionType=RAM
            DLMU0_Cached: vBaseEnvHwRegionStartAddress=2415919104, vBaseEnvHwRegionSize=65536, vBaseEnvHwRegionType=RAM
            DLMU0_NonCached: vBaseEnvHwRegionStartAddress=2952790016, vBaseEnvHwRegionSize=65536, vBaseEnvHwRegionType=RAM
            DLMU1_Cached: vBaseEnvHwRegionStartAddress=2415984640, vBaseEnvHwRegionSize=65536, vBaseEnvHwRegionType=RAM
            DLMU1_NonCached: vBaseEnvHwRegionStartAddress=2952855552, vBaseEnvHwRegionSize=65536, vBaseEnvHwRegionType=RAM
            DFlash0: vBaseEnvHwRegionStartAddress=2936012800, vBaseEnvHwRegionSize=131072, vBaseEnvHwRegionType=ROM
            DFlash1: vBaseEnvHwRegionStartAddress=2948595712, vBaseEnvHwRegionSize=131072, vBaseEnvHwRegionType=ROM
        TC360D: vBaseEnvCpuCoreAmount=2, vBaseEnvTestedDerivative=TC36x, vBaseEnvTestedDerivativeDescription=Infineon Aurix 2G TC36x Family, vBaseEnvAvailableChannels_Can=8, vBaseEnvAvailableChannels_Ethernet=1, vBaseEnvAvailableChannels_Lin=12
          vBaseEnvAdditionalParameters: vBaseEnvWatchdogGroup=B, vBaseEnvPllGroup=B, vBaseEnvPortGroup=B, vBaseEnvResetGroup=B, vBaseEnvDerivativeGroup=TC3xx
          24 x vBaseEnvMemLayoutHwRegion:
            DSPR0: vBaseEnvHwRegionStartAddress=1879048192, vBaseEnvHwRegionSize=196608, vBaseEnvHwRegionType=RAM
            PSPR0: vBaseEnvHwRegionStartAddress=1880096768, vBaseEnvHwRegionSize=32768, vBaseEnvHwRegionType=RAM
            DSPR1: vBaseEnvHwRegionStartAddress=1610612736, vBaseEnvHwRegionSize=196608, vBaseEnvHwRegionType=RAM
            PSPR1: vBaseEnvHwRegionStartAddress=1611661312, vBaseEnvHwRegionSize=32768, vBaseEnvHwRegionType=RAM
            PFlash0_Cached: vBaseEnvHwRegionStartAddress=2147483648, vBaseEnvHwRegionSize=2097152, vBaseEnvHwRegionType=ROM
            PFlash0_NonCached: vBaseEnvHwRegionStartAddress=2684354560, vBaseEnvHwRegionSize=2097152, vBaseEnvHwRegionType=ROM
            PFlash1_Cached: vBaseEnvHwRegionStartAddress=2150629376, vBaseEnvHwRegionSize=2097152, vBaseEnvHwRegionType=ROM
            PFlash1_NonCached: vBaseEnvHwRegionStartAddress=2687500288, vBaseEnvHwRegionSize=2097152, vBaseEnvHwRegionType=ROM
            LMU0_Cached: vBaseEnvHwRegionStartAddress=2415919104, vBaseEnvHwRegionSize=65536, vBaseEnvHwRegionType=RAM
            LMU0_NonCached: vBaseEnvHwRegionStartAddress=2952790016, vBaseEnvHwRegionSize=65536, vBaseEnvHwRegionType=RAM
            LMU1_Cached: vBaseEnvHwRegionStartAddress=2415984640, vBaseEnvHwRegionSize=65536, vBaseEnvHwRegionType=RAM
            LMU1_NonCached: vBaseEnvHwRegionStartAddress=2952855552, vBaseEnvHwRegionSize=65536, vBaseEnvHwRegionType=RAM
            BMHD0: vBaseEnvHwRegionStartAddress=2940207104, vBaseEnvHwRegionSize=512, vBaseEnvHwRegionType=ROM
            BMHD1: vBaseEnvHwRegionStartAddress=2940207616, vBaseEnvHwRegionSize=512, vBaseEnvHwRegionType=ROM
            BMHD2: vBaseEnvHwRegionStartAddress=2940208128, vBaseEnvHwRegionSize=512, vBaseEnvHwRegionType=ROM
            BMHD3: vBaseEnvHwRegionStartAddress=2940208640, vBaseEnvHwRegionSize=512, vBaseEnvHwRegionType=ROM
            OLDA_Cached: vBaseEnvHwRegionStartAddress=2413821952, vBaseEnvHwRegionSize=524288, vBaseEnvHwRegionType=RAM
            OLDA_NonCached: vBaseEnvHwRegionStartAddress=2950692864, vBaseEnvHwRegionSize=524288, vBaseEnvHwRegionType=RAM
            DLMU0_Cached: vBaseEnvHwRegionStartAddress=2415919104, vBaseEnvHwRegionSize=65536, vBaseEnvHwRegionType=RAM
            DLMU0_NonCached: vBaseEnvHwRegionStartAddress=2952790016, vBaseEnvHwRegionSize=65536, vBaseEnvHwRegionType=RAM
            DLMU1_Cached: vBaseEnvHwRegionStartAddress=2415984640, vBaseEnvHwRegionSize=65536, vBaseEnvHwRegionType=RAM
            DLMU1_NonCached: vBaseEnvHwRegionStartAddress=2952855552, vBaseEnvHwRegionSize=65536, vBaseEnvHwRegionType=RAM
            DFlash0: vBaseEnvHwRegionStartAddress=2936012800, vBaseEnvHwRegionSize=131072, vBaseEnvHwRegionType=ROM
            DFlash1: vBaseEnvHwRegionStartAddress=2948595712, vBaseEnvHwRegionSize=131072, vBaseEnvHwRegionType=ROM
        TC365D: vBaseEnvCpuCoreAmount=2, vBaseEnvTestedDerivative=TC36x, vBaseEnvTestedDerivativeDescription=Infineon Aurix 2G TC36x Family, vBaseEnvAvailableChannels_Can=8, vBaseEnvAvailableChannels_Ethernet=1, vBaseEnvAvailableChannels_Lin=12
          vBaseEnvAdditionalParameters: vBaseEnvWatchdogGroup=B, vBaseEnvPllGroup=B, vBaseEnvPortGroup=B, vBaseEnvResetGroup=B, vBaseEnvDerivativeGroup=TC3xx
          24 x vBaseEnvMemLayoutHwRegion:
            DSPR0: vBaseEnvHwRegionStartAddress=1879048192, vBaseEnvHwRegionSize=196608, vBaseEnvHwRegionType=RAM
            PSPR0: vBaseEnvHwRegionStartAddress=1880096768, vBaseEnvHwRegionSize=32768, vBaseEnvHwRegionType=RAM
            DSPR1: vBaseEnvHwRegionStartAddress=1610612736, vBaseEnvHwRegionSize=196608, vBaseEnvHwRegionType=RAM
            PSPR1: vBaseEnvHwRegionStartAddress=1611661312, vBaseEnvHwRegionSize=32768, vBaseEnvHwRegionType=RAM
            PFlash0_Cached: vBaseEnvHwRegionStartAddress=2147483648, vBaseEnvHwRegionSize=2097152, vBaseEnvHwRegionType=ROM
            PFlash0_NonCached: vBaseEnvHwRegionStartAddress=2684354560, vBaseEnvHwRegionSize=2097152, vBaseEnvHwRegionType=ROM
            PFlash1_Cached: vBaseEnvHwRegionStartAddress=2150629376, vBaseEnvHwRegionSize=2097152, vBaseEnvHwRegionType=ROM
            PFlash1_NonCached: vBaseEnvHwRegionStartAddress=2687500288, vBaseEnvHwRegionSize=2097152, vBaseEnvHwRegionType=ROM
            LMU0_Cached: vBaseEnvHwRegionStartAddress=2415919104, vBaseEnvHwRegionSize=65536, vBaseEnvHwRegionType=RAM
            LMU0_NonCached: vBaseEnvHwRegionStartAddress=2952790016, vBaseEnvHwRegionSize=65536, vBaseEnvHwRegionType=RAM
            LMU1_Cached: vBaseEnvHwRegionStartAddress=2415984640, vBaseEnvHwRegionSize=65536, vBaseEnvHwRegionType=RAM
            LMU1_NonCached: vBaseEnvHwRegionStartAddress=2952855552, vBaseEnvHwRegionSize=65536, vBaseEnvHwRegionType=RAM
            BMHD0: vBaseEnvHwRegionStartAddress=2940207104, vBaseEnvHwRegionSize=512, vBaseEnvHwRegionType=ROM
            BMHD1: vBaseEnvHwRegionStartAddress=2940207616, vBaseEnvHwRegionSize=512, vBaseEnvHwRegionType=ROM
            BMHD2: vBaseEnvHwRegionStartAddress=2940208128, vBaseEnvHwRegionSize=512, vBaseEnvHwRegionType=ROM
            BMHD3: vBaseEnvHwRegionStartAddress=2940208640, vBaseEnvHwRegionSize=512, vBaseEnvHwRegionType=ROM
            OLDA_Cached: vBaseEnvHwRegionStartAddress=2413821952, vBaseEnvHwRegionSize=524288, vBaseEnvHwRegionType=RAM
            OLDA_NonCached: vBaseEnvHwRegionStartAddress=2950692864, vBaseEnvHwRegionSize=524288, vBaseEnvHwRegionType=RAM
            DLMU0_Cached: vBaseEnvHwRegionStartAddress=2415919104, vBaseEnvHwRegionSize=65536, vBaseEnvHwRegionType=RAM
            DLMU0_NonCached: vBaseEnvHwRegionStartAddress=2952790016, vBaseEnvHwRegionSize=65536, vBaseEnvHwRegionType=RAM
            DLMU1_Cached: vBaseEnvHwRegionStartAddress=2415984640, vBaseEnvHwRegionSize=65536, vBaseEnvHwRegionType=RAM
            DLMU1_NonCached: vBaseEnvHwRegionStartAddress=2952855552, vBaseEnvHwRegionSize=65536, vBaseEnvHwRegionType=RAM
            DFlash0: vBaseEnvHwRegionStartAddress=2936012800, vBaseEnvHwRegionSize=131072, vBaseEnvHwRegionType=ROM
            DFlash1: vBaseEnvHwRegionStartAddress=2948595712, vBaseEnvHwRegionSize=131072, vBaseEnvHwRegionType=ROM
        TC366D: vBaseEnvCpuCoreAmount=2, vBaseEnvTestedDerivative=TC36x, vBaseEnvTestedDerivativeDescription=Infineon Aurix 2G TC36x Family, vBaseEnvAvailableChannels_Can=8, vBaseEnvAvailableChannels_Ethernet=1, vBaseEnvAvailableChannels_Lin=12
          vBaseEnvAdditionalParameters: vBaseEnvWatchdogGroup=B, vBaseEnvPllGroup=B, vBaseEnvPortGroup=B, vBaseEnvResetGroup=B, vBaseEnvDerivativeGroup=TC3xx
          24 x vBaseEnvMemLayoutHwRegion:
            DSPR0: vBaseEnvHwRegionStartAddress=1879048192, vBaseEnvHwRegionSize=196608, vBaseEnvHwRegionType=RAM
            PSPR0: vBaseEnvHwRegionStartAddress=1880096768, vBaseEnvHwRegionSize=32768, vBaseEnvHwRegionType=RAM
            DSPR1: vBaseEnvHwRegionStartAddress=1610612736, vBaseEnvHwRegionSize=196608, vBaseEnvHwRegionType=RAM
            PSPR1: vBaseEnvHwRegionStartAddress=1611661312, vBaseEnvHwRegionSize=32768, vBaseEnvHwRegionType=RAM
            PFlash0_Cached: vBaseEnvHwRegionStartAddress=2147483648, vBaseEnvHwRegionSize=2097152, vBaseEnvHwRegionType=ROM
            PFlash0_NonCached: vBaseEnvHwRegionStartAddress=2684354560, vBaseEnvHwRegionSize=2097152, vBaseEnvHwRegionType=ROM
            PFlash1_Cached: vBaseEnvHwRegionStartAddress=2150629376, vBaseEnvHwRegionSize=2097152, vBaseEnvHwRegionType=ROM
            PFlash1_NonCached: vBaseEnvHwRegionStartAddress=2687500288, vBaseEnvHwRegionSize=2097152, vBaseEnvHwRegionType=ROM
            LMU0_Cached: vBaseEnvHwRegionStartAddress=2415919104, vBaseEnvHwRegionSize=65536, vBaseEnvHwRegionType=RAM
            LMU0_NonCached: vBaseEnvHwRegionStartAddress=2952790016, vBaseEnvHwRegionSize=65536, vBaseEnvHwRegionType=RAM
            LMU1_Cached: vBaseEnvHwRegionStartAddress=2415984640, vBaseEnvHwRegionSize=65536, vBaseEnvHwRegionType=RAM
            LMU1_NonCached: vBaseEnvHwRegionStartAddress=2952855552, vBaseEnvHwRegionSize=65536, vBaseEnvHwRegionType=RAM
            BMHD0: vBaseEnvHwRegionStartAddress=2940207104, vBaseEnvHwRegionSize=512, vBaseEnvHwRegionType=ROM
            BMHD1: vBaseEnvHwRegionStartAddress=2940207616, vBaseEnvHwRegionSize=512, vBaseEnvHwRegionType=ROM
            BMHD2: vBaseEnvHwRegionStartAddress=2940208128, vBaseEnvHwRegionSize=512, vBaseEnvHwRegionType=ROM
            BMHD3: vBaseEnvHwRegionStartAddress=2940208640, vBaseEnvHwRegionSize=512, vBaseEnvHwRegionType=ROM
            OLDA_Cached: vBaseEnvHwRegionStartAddress=2413821952, vBaseEnvHwRegionSize=524288, vBaseEnvHwRegionType=RAM
            OLDA_NonCached: vBaseEnvHwRegionStartAddress=2950692864, vBaseEnvHwRegionSize=524288, vBaseEnvHwRegionType=RAM
            DLMU0_Cached: vBaseEnvHwRegionStartAddress=2415919104, vBaseEnvHwRegionSize=65536, vBaseEnvHwRegionType=RAM
            DLMU0_NonCached: vBaseEnvHwRegionStartAddress=2952790016, vBaseEnvHwRegionSize=65536, vBaseEnvHwRegionType=RAM
            DLMU1_Cached: vBaseEnvHwRegionStartAddress=2415984640, vBaseEnvHwRegionSize=65536, vBaseEnvHwRegionType=RAM
            DLMU1_NonCached: vBaseEnvHwRegionStartAddress=2952855552, vBaseEnvHwRegionSize=65536, vBaseEnvHwRegionType=RAM
            DFlash0: vBaseEnvHwRegionStartAddress=2936012800, vBaseEnvHwRegionSize=131072, vBaseEnvHwRegionType=ROM
            DFlash1: vBaseEnvHwRegionStartAddress=2948595712, vBaseEnvHwRegionSize=131072, vBaseEnvHwRegionType=ROM
        TC377T: vBaseEnvCpuCoreAmount=3, vBaseEnvTestedDerivative=TC37x, vBaseEnvTestedDerivativeDescription=Infineon Aurix 2G TC37x Family, vBaseEnvAvailableChannels_Can=12, vBaseEnvAvailableChannels_Ethernet=2, vBaseEnvAvailableChannels_Lin=12
          vBaseEnvAdditionalParameters: vBaseEnvWatchdogGroup=B, vBaseEnvPllGroup=B, vBaseEnvPortGroup=B, vBaseEnvResetGroup=B, vBaseEnvDerivativeGroup=TC3xx
          26 x vBaseEnvMemLayoutHwRegion:
            DSPR0: vBaseEnvHwRegionStartAddress=1879048192, vBaseEnvHwRegionSize=245760, vBaseEnvHwRegionType=RAM
            PSPR0: vBaseEnvHwRegionStartAddress=1880096768, vBaseEnvHwRegionSize=65536, vBaseEnvHwRegionType=RAM
            DSPR1: vBaseEnvHwRegionStartAddress=1610612736, vBaseEnvHwRegionSize=245760, vBaseEnvHwRegionType=RAM
            PSPR1: vBaseEnvHwRegionStartAddress=1611661312, vBaseEnvHwRegionSize=65536, vBaseEnvHwRegionType=RAM
            DSPR2: vBaseEnvHwRegionStartAddress=1342177280, vBaseEnvHwRegionSize=98304, vBaseEnvHwRegionType=RAM
            PSPR2: vBaseEnvHwRegionStartAddress=1343225856, vBaseEnvHwRegionSize=65536, vBaseEnvHwRegionType=RAM
            PFlash0_Cached: vBaseEnvHwRegionStartAddress=2147483648, vBaseEnvHwRegionSize=3145728, vBaseEnvHwRegionType=ROM
            PFlash0_NonCached: vBaseEnvHwRegionStartAddress=2684354560, vBaseEnvHwRegionSize=3145728, vBaseEnvHwRegionType=ROM
            PFlash1_Cached: vBaseEnvHwRegionStartAddress=2150629376, vBaseEnvHwRegionSize=3145728, vBaseEnvHwRegionType=ROM
            PFlash1_NonCached: vBaseEnvHwRegionStartAddress=2687500288, vBaseEnvHwRegionSize=3145728, vBaseEnvHwRegionType=ROM
            BMHD0: vBaseEnvHwRegionStartAddress=2940207104, vBaseEnvHwRegionSize=512, vBaseEnvHwRegionType=ROM
            BMHD1: vBaseEnvHwRegionStartAddress=2940207616, vBaseEnvHwRegionSize=512, vBaseEnvHwRegionType=ROM
            BMHD2: vBaseEnvHwRegionStartAddress=2940208128, vBaseEnvHwRegionSize=512, vBaseEnvHwRegionType=ROM
            BMHD3: vBaseEnvHwRegionStartAddress=2940208640, vBaseEnvHwRegionSize=512, vBaseEnvHwRegionType=ROM
            OLDA_Cached: vBaseEnvHwRegionStartAddress=2413821952, vBaseEnvHwRegionSize=524288, vBaseEnvHwRegionType=RAM
            OLDA_NonCached: vBaseEnvHwRegionStartAddress=2950692864, vBaseEnvHwRegionSize=524288, vBaseEnvHwRegionType=RAM
            DLMU0_Cached: vBaseEnvHwRegionStartAddress=2415919104, vBaseEnvHwRegionSize=65536, vBaseEnvHwRegionType=RAM
            DLMU0_NonCached: vBaseEnvHwRegionStartAddress=2952790016, vBaseEnvHwRegionSize=65536, vBaseEnvHwRegionType=RAM
            DLMU1_Cached: vBaseEnvHwRegionStartAddress=2415984640, vBaseEnvHwRegionSize=65536, vBaseEnvHwRegionType=RAM
            DLMU1_NonCached: vBaseEnvHwRegionStartAddress=2952855552, vBaseEnvHwRegionSize=65536, vBaseEnvHwRegionType=RAM
            DLMU2_Cached: vBaseEnvHwRegionStartAddress=2416050176, vBaseEnvHwRegionSize=65536, vBaseEnvHwRegionType=RAM
            DLMU2_NonCached: vBaseEnvHwRegionStartAddress=2952921088, vBaseEnvHwRegionSize=65536, vBaseEnvHwRegionType=RAM
            DAM0_Cached: vBaseEnvHwRegionStartAddress=2420113408, vBaseEnvHwRegionSize=32768, vBaseEnvHwRegionType=RAM
            DAM0_NonCached: vBaseEnvHwRegionStartAddress=2956984320, vBaseEnvHwRegionSize=32768, vBaseEnvHwRegionType=RAM
            DFlash0: vBaseEnvHwRegionStartAddress=2936012800, vBaseEnvHwRegionSize=131072, vBaseEnvHwRegionType=ROM
            DFlash1: vBaseEnvHwRegionStartAddress=2948595712, vBaseEnvHwRegionSize=131072, vBaseEnvHwRegionType=ROM
        TC375T: vBaseEnvCpuCoreAmount=3, vBaseEnvTestedDerivative=TC37x, vBaseEnvTestedDerivativeDescription=Infineon Aurix 2G TC37x Family, vBaseEnvAvailableChannels_Can=12, vBaseEnvAvailableChannels_Ethernet=2, vBaseEnvAvailableChannels_Lin=12
          vBaseEnvAdditionalParameters: vBaseEnvWatchdogGroup=B, vBaseEnvPllGroup=B, vBaseEnvPortGroup=B, vBaseEnvResetGroup=B, vBaseEnvDerivativeGroup=TC3xx
          26 x vBaseEnvMemLayoutHwRegion:
            DSPR0: vBaseEnvHwRegionStartAddress=1879048192, vBaseEnvHwRegionSize=245760, vBaseEnvHwRegionType=RAM
            PSPR0: vBaseEnvHwRegionStartAddress=1880096768, vBaseEnvHwRegionSize=65536, vBaseEnvHwRegionType=RAM
            DSPR1: vBaseEnvHwRegionStartAddress=1610612736, vBaseEnvHwRegionSize=245760, vBaseEnvHwRegionType=RAM
            PSPR1: vBaseEnvHwRegionStartAddress=1611661312, vBaseEnvHwRegionSize=65536, vBaseEnvHwRegionType=RAM
            DSPR2: vBaseEnvHwRegionStartAddress=1342177280, vBaseEnvHwRegionSize=98304, vBaseEnvHwRegionType=RAM
            PSPR2: vBaseEnvHwRegionStartAddress=1343225856, vBaseEnvHwRegionSize=65536, vBaseEnvHwRegionType=RAM
            PFlash0_Cached: vBaseEnvHwRegionStartAddress=2147483648, vBaseEnvHwRegionSize=3145728, vBaseEnvHwRegionType=ROM
            PFlash0_NonCached: vBaseEnvHwRegionStartAddress=2684354560, vBaseEnvHwRegionSize=3145728, vBaseEnvHwRegionType=ROM
            PFlash1_Cached: vBaseEnvHwRegionStartAddress=2150629376, vBaseEnvHwRegionSize=3145728, vBaseEnvHwRegionType=ROM
            PFlash1_NonCached: vBaseEnvHwRegionStartAddress=2687500288, vBaseEnvHwRegionSize=3145728, vBaseEnvHwRegionType=ROM
            BMHD0: vBaseEnvHwRegionStartAddress=2940207104, vBaseEnvHwRegionSize=512, vBaseEnvHwRegionType=ROM
            BMHD1: vBaseEnvHwRegionStartAddress=2940207616, vBaseEnvHwRegionSize=512, vBaseEnvHwRegionType=ROM
            BMHD2: vBaseEnvHwRegionStartAddress=2940208128, vBaseEnvHwRegionSize=512, vBaseEnvHwRegionType=ROM
            BMHD3: vBaseEnvHwRegionStartAddress=2940208640, vBaseEnvHwRegionSize=512, vBaseEnvHwRegionType=ROM
            OLDA_Cached: vBaseEnvHwRegionStartAddress=2413821952, vBaseEnvHwRegionSize=524288, vBaseEnvHwRegionType=RAM
            OLDA_NonCached: vBaseEnvHwRegionStartAddress=2950692864, vBaseEnvHwRegionSize=524288, vBaseEnvHwRegionType=RAM
            DLMU0_Cached: vBaseEnvHwRegionStartAddress=2415919104, vBaseEnvHwRegionSize=65536, vBaseEnvHwRegionType=RAM
            DLMU0_NonCached: vBaseEnvHwRegionStartAddress=2952790016, vBaseEnvHwRegionSize=65536, vBaseEnvHwRegionType=RAM
            DLMU1_Cached: vBaseEnvHwRegionStartAddress=2415984640, vBaseEnvHwRegionSize=65536, vBaseEnvHwRegionType=RAM
            DLMU1_NonCached: vBaseEnvHwRegionStartAddress=2952855552, vBaseEnvHwRegionSize=65536, vBaseEnvHwRegionType=RAM
            DLMU2_Cached: vBaseEnvHwRegionStartAddress=2416050176, vBaseEnvHwRegionSize=65536, vBaseEnvHwRegionType=RAM
            DLMU2_NonCached: vBaseEnvHwRegionStartAddress=2952921088, vBaseEnvHwRegionSize=65536, vBaseEnvHwRegionType=RAM
            DAM0_Cached: vBaseEnvHwRegionStartAddress=2420113408, vBaseEnvHwRegionSize=32768, vBaseEnvHwRegionType=RAM
            DAM0_NonCached: vBaseEnvHwRegionStartAddress=2956984320, vBaseEnvHwRegionSize=32768, vBaseEnvHwRegionType=RAM
            DFlash0: vBaseEnvHwRegionStartAddress=2936012800, vBaseEnvHwRegionSize=131072, vBaseEnvHwRegionType=ROM
            DFlash1: vBaseEnvHwRegionStartAddress=2948595712, vBaseEnvHwRegionSize=131072, vBaseEnvHwRegionType=ROM
        TC370T: vBaseEnvCpuCoreAmount=3, vBaseEnvTestedDerivative=TC37x, vBaseEnvTestedDerivativeDescription=Infineon Aurix 2G TC37x Family, vBaseEnvAvailableChannels_Can=8, vBaseEnvAvailableChannels_Ethernet=1, vBaseEnvAvailableChannels_Lin=12
          vBaseEnvAdditionalParameters: vBaseEnvWatchdogGroup=B, vBaseEnvPllGroup=B, vBaseEnvPortGroup=B, vBaseEnvResetGroup=B, vBaseEnvDerivativeGroup=TC3xx
          26 x vBaseEnvMemLayoutHwRegion:
            DSPR0: vBaseEnvHwRegionStartAddress=1879048192, vBaseEnvHwRegionSize=245760, vBaseEnvHwRegionType=RAM
            PSPR0: vBaseEnvHwRegionStartAddress=1880096768, vBaseEnvHwRegionSize=65536, vBaseEnvHwRegionType=RAM
            DSPR1: vBaseEnvHwRegionStartAddress=1610612736, vBaseEnvHwRegionSize=245760, vBaseEnvHwRegionType=RAM
            PSPR1: vBaseEnvHwRegionStartAddress=1611661312, vBaseEnvHwRegionSize=65536, vBaseEnvHwRegionType=RAM
            DSPR2: vBaseEnvHwRegionStartAddress=1342177280, vBaseEnvHwRegionSize=98304, vBaseEnvHwRegionType=RAM
            PSPR2: vBaseEnvHwRegionStartAddress=1343225856, vBaseEnvHwRegionSize=65536, vBaseEnvHwRegionType=RAM
            PFlash0_Cached: vBaseEnvHwRegionStartAddress=2147483648, vBaseEnvHwRegionSize=3145728, vBaseEnvHwRegionType=ROM
            PFlash0_NonCached: vBaseEnvHwRegionStartAddress=2684354560, vBaseEnvHwRegionSize=3145728, vBaseEnvHwRegionType=ROM
            PFlash1_Cached: vBaseEnvHwRegionStartAddress=2150629376, vBaseEnvHwRegionSize=3145728, vBaseEnvHwRegionType=ROM
            PFlash1_NonCached: vBaseEnvHwRegionStartAddress=2687500288, vBaseEnvHwRegionSize=3145728, vBaseEnvHwRegionType=ROM
            BMHD0: vBaseEnvHwRegionStartAddress=2940207104, vBaseEnvHwRegionSize=512, vBaseEnvHwRegionType=ROM
            BMHD1: vBaseEnvHwRegionStartAddress=2940207616, vBaseEnvHwRegionSize=512, vBaseEnvHwRegionType=ROM
            BMHD2: vBaseEnvHwRegionStartAddress=2940208128, vBaseEnvHwRegionSize=512, vBaseEnvHwRegionType=ROM
            BMHD3: vBaseEnvHwRegionStartAddress=2940208640, vBaseEnvHwRegionSize=512, vBaseEnvHwRegionType=ROM
            OLDA_Cached: vBaseEnvHwRegionStartAddress=2413821952, vBaseEnvHwRegionSize=524288, vBaseEnvHwRegionType=RAM
            OLDA_NonCached: vBaseEnvHwRegionStartAddress=2950692864, vBaseEnvHwRegionSize=524288, vBaseEnvHwRegionType=RAM
            DLMU0_Cached: vBaseEnvHwRegionStartAddress=2415919104, vBaseEnvHwRegionSize=65536, vBaseEnvHwRegionType=RAM
            DLMU0_NonCached: vBaseEnvHwRegionStartAddress=2952790016, vBaseEnvHwRegionSize=65536, vBaseEnvHwRegionType=RAM
            DLMU1_Cached: vBaseEnvHwRegionStartAddress=2415984640, vBaseEnvHwRegionSize=65536, vBaseEnvHwRegionType=RAM
            DLMU1_NonCached: vBaseEnvHwRegionStartAddress=2952855552, vBaseEnvHwRegionSize=65536, vBaseEnvHwRegionType=RAM
            DLMU2_Cached: vBaseEnvHwRegionStartAddress=2416050176, vBaseEnvHwRegionSize=65536, vBaseEnvHwRegionType=RAM
            DLMU2_NonCached: vBaseEnvHwRegionStartAddress=2952921088, vBaseEnvHwRegionSize=65536, vBaseEnvHwRegionType=RAM
            DAM0_Cached: vBaseEnvHwRegionStartAddress=2420113408, vBaseEnvHwRegionSize=32768, vBaseEnvHwRegionType=RAM
            DAM0_NonCached: vBaseEnvHwRegionStartAddress=2956984320, vBaseEnvHwRegionSize=32768, vBaseEnvHwRegionType=RAM
            DFlash0: vBaseEnvHwRegionStartAddress=2936012800, vBaseEnvHwRegionSize=131072, vBaseEnvHwRegionType=ROM
            DFlash1: vBaseEnvHwRegionStartAddress=2948595712, vBaseEnvHwRegionSize=131072, vBaseEnvHwRegionType=ROM
        TC374T: vBaseEnvCpuCoreAmount=3, vBaseEnvTestedDerivative=TC37x, vBaseEnvTestedDerivativeDescription=Infineon Aurix 2G TC37x Family, vBaseEnvAvailableChannels_Can=12, vBaseEnvAvailableChannels_Ethernet=2, vBaseEnvAvailableChannels_Lin=12
          vBaseEnvAdditionalParameters: vBaseEnvWatchdogGroup=B, vBaseEnvPllGroup=B, vBaseEnvPortGroup=B, vBaseEnvResetGroup=B, vBaseEnvDerivativeGroup=TC3xx
          26 x vBaseEnvMemLayoutHwRegion:
            DSPR0: vBaseEnvHwRegionStartAddress=1879048192, vBaseEnvHwRegionSize=245760, vBaseEnvHwRegionType=RAM
            PSPR0: vBaseEnvHwRegionStartAddress=1880096768, vBaseEnvHwRegionSize=65536, vBaseEnvHwRegionType=RAM
            DSPR1: vBaseEnvHwRegionStartAddress=1610612736, vBaseEnvHwRegionSize=245760, vBaseEnvHwRegionType=RAM
            PSPR1: vBaseEnvHwRegionStartAddress=1611661312, vBaseEnvHwRegionSize=65536, vBaseEnvHwRegionType=RAM
            DSPR2: vBaseEnvHwRegionStartAddress=1342177280, vBaseEnvHwRegionSize=98304, vBaseEnvHwRegionType=RAM
            PSPR2: vBaseEnvHwRegionStartAddress=1343225856, vBaseEnvHwRegionSize=65536, vBaseEnvHwRegionType=RAM
            PFlash0_Cached: vBaseEnvHwRegionStartAddress=2147483648, vBaseEnvHwRegionSize=3145728, vBaseEnvHwRegionType=ROM
            PFlash0_NonCached: vBaseEnvHwRegionStartAddress=2684354560, vBaseEnvHwRegionSize=3145728, vBaseEnvHwRegionType=ROM
            PFlash1_Cached: vBaseEnvHwRegionStartAddress=2150629376, vBaseEnvHwRegionSize=3145728, vBaseEnvHwRegionType=ROM
            PFlash1_NonCached: vBaseEnvHwRegionStartAddress=2687500288, vBaseEnvHwRegionSize=3145728, vBaseEnvHwRegionType=ROM
            BMHD0: vBaseEnvHwRegionStartAddress=2940207104, vBaseEnvHwRegionSize=512, vBaseEnvHwRegionType=ROM
            BMHD1: vBaseEnvHwRegionStartAddress=2940207616, vBaseEnvHwRegionSize=512, vBaseEnvHwRegionType=ROM
            BMHD2: vBaseEnvHwRegionStartAddress=2940208128, vBaseEnvHwRegionSize=512, vBaseEnvHwRegionType=ROM
            BMHD3: vBaseEnvHwRegionStartAddress=2940208640, vBaseEnvHwRegionSize=512, vBaseEnvHwRegionType=ROM
            OLDA_Cached: vBaseEnvHwRegionStartAddress=2413821952, vBaseEnvHwRegionSize=524288, vBaseEnvHwRegionType=RAM
            OLDA_NonCached: vBaseEnvHwRegionStartAddress=2950692864, vBaseEnvHwRegionSize=524288, vBaseEnvHwRegionType=RAM
            DLMU0_Cached: vBaseEnvHwRegionStartAddress=2415919104, vBaseEnvHwRegionSize=65536, vBaseEnvHwRegionType=RAM
            DLMU0_NonCached: vBaseEnvHwRegionStartAddress=2952790016, vBaseEnvHwRegionSize=65536, vBaseEnvHwRegionType=RAM
            DLMU1_Cached: vBaseEnvHwRegionStartAddress=2415984640, vBaseEnvHwRegionSize=65536, vBaseEnvHwRegionType=RAM
            DLMU1_NonCached: vBaseEnvHwRegionStartAddress=2952855552, vBaseEnvHwRegionSize=65536, vBaseEnvHwRegionType=RAM
            DLMU2_Cached: vBaseEnvHwRegionStartAddress=2416050176, vBaseEnvHwRegionSize=65536, vBaseEnvHwRegionType=RAM
            DLMU2_NonCached: vBaseEnvHwRegionStartAddress=2952921088, vBaseEnvHwRegionSize=65536, vBaseEnvHwRegionType=RAM
            DAM0_Cached: vBaseEnvHwRegionStartAddress=2420113408, vBaseEnvHwRegionSize=32768, vBaseEnvHwRegionType=RAM
            DAM0_NonCached: vBaseEnvHwRegionStartAddress=2956984320, vBaseEnvHwRegionSize=32768, vBaseEnvHwRegionType=RAM
            DFlash0: vBaseEnvHwRegionStartAddress=2936012800, vBaseEnvHwRegionSize=131072, vBaseEnvHwRegionType=ROM
            DFlash1: vBaseEnvHwRegionStartAddress=2948595712, vBaseEnvHwRegionSize=131072, vBaseEnvHwRegionType=ROM
        TC375D: vBaseEnvCpuCoreAmount=2, vBaseEnvTestedDerivative=TC37x, vBaseEnvTestedDerivativeDescription=Infineon Aurix 2G TC37x Family, vBaseEnvAvailableChannels_Can=8, vBaseEnvAvailableChannels_Ethernet=1, vBaseEnvAvailableChannels_Lin=12
          vBaseEnvAdditionalParameters: vBaseEnvWatchdogGroup=B, vBaseEnvPllGroup=B, vBaseEnvPortGroup=B, vBaseEnvResetGroup=B, vBaseEnvDerivativeGroup=TC3xx
          22 x vBaseEnvMemLayoutHwRegion:
            DSPR0: vBaseEnvHwRegionStartAddress=1879048192, vBaseEnvHwRegionSize=245760, vBaseEnvHwRegionType=RAM
            PSPR0: vBaseEnvHwRegionStartAddress=1880096768, vBaseEnvHwRegionSize=65536, vBaseEnvHwRegionType=RAM
            DSPR1: vBaseEnvHwRegionStartAddress=1610612736, vBaseEnvHwRegionSize=245760, vBaseEnvHwRegionType=RAM
            PSPR1: vBaseEnvHwRegionStartAddress=1611661312, vBaseEnvHwRegionSize=65536, vBaseEnvHwRegionType=RAM
            PFlash0_Cached: vBaseEnvHwRegionStartAddress=2147483648, vBaseEnvHwRegionSize=3145728, vBaseEnvHwRegionType=ROM
            PFlash0_NonCached: vBaseEnvHwRegionStartAddress=2684354560, vBaseEnvHwRegionSize=3145728, vBaseEnvHwRegionType=ROM
            PFlash1_Cached: vBaseEnvHwRegionStartAddress=2150629376, vBaseEnvHwRegionSize=3145728, vBaseEnvHwRegionType=ROM
            PFlash1_NonCached: vBaseEnvHwRegionStartAddress=2687500288, vBaseEnvHwRegionSize=3145728, vBaseEnvHwRegionType=ROM
            BMHD0: vBaseEnvHwRegionStartAddress=2940207104, vBaseEnvHwRegionSize=512, vBaseEnvHwRegionType=ROM
            BMHD1: vBaseEnvHwRegionStartAddress=2940207616, vBaseEnvHwRegionSize=512, vBaseEnvHwRegionType=ROM
            BMHD2: vBaseEnvHwRegionStartAddress=2940208128, vBaseEnvHwRegionSize=512, vBaseEnvHwRegionType=ROM
            BMHD3: vBaseEnvHwRegionStartAddress=2940208640, vBaseEnvHwRegionSize=512, vBaseEnvHwRegionType=ROM
            OLDA_Cached: vBaseEnvHwRegionStartAddress=2413821952, vBaseEnvHwRegionSize=524288, vBaseEnvHwRegionType=RAM
            OLDA_NonCached: vBaseEnvHwRegionStartAddress=2950692864, vBaseEnvHwRegionSize=524288, vBaseEnvHwRegionType=RAM
            DLMU0_Cached: vBaseEnvHwRegionStartAddress=2415919104, vBaseEnvHwRegionSize=65536, vBaseEnvHwRegionType=RAM
            DLMU0_NonCached: vBaseEnvHwRegionStartAddress=2952790016, vBaseEnvHwRegionSize=65536, vBaseEnvHwRegionType=RAM
            DLMU1_Cached: vBaseEnvHwRegionStartAddress=2415984640, vBaseEnvHwRegionSize=65536, vBaseEnvHwRegionType=RAM
            DLMU1_NonCached: vBaseEnvHwRegionStartAddress=2952855552, vBaseEnvHwRegionSize=65536, vBaseEnvHwRegionType=RAM
            DAM0_Cached: vBaseEnvHwRegionStartAddress=2420113408, vBaseEnvHwRegionSize=32768, vBaseEnvHwRegionType=RAM
            DAM0_NonCached: vBaseEnvHwRegionStartAddress=2956984320, vBaseEnvHwRegionSize=32768, vBaseEnvHwRegionType=RAM
            DFlash0: vBaseEnvHwRegionStartAddress=2936012800, vBaseEnvHwRegionSize=131072, vBaseEnvHwRegionType=ROM
            DFlash1: vBaseEnvHwRegionStartAddress=2948595712, vBaseEnvHwRegionSize=131072, vBaseEnvHwRegionType=ROM
        TC377D: vBaseEnvCpuCoreAmount=2, vBaseEnvTestedDerivative=TC37x, vBaseEnvTestedDerivativeDescription=Infineon Aurix 2G TC37x Family, vBaseEnvAvailableChannels_Can=8, vBaseEnvAvailableChannels_Ethernet=1, vBaseEnvAvailableChannels_Lin=12
          vBaseEnvAdditionalParameters: vBaseEnvWatchdogGroup=B, vBaseEnvPllGroup=B, vBaseEnvPortGroup=B, vBaseEnvResetGroup=B, vBaseEnvDerivativeGroup=TC3xx
          22 x vBaseEnvMemLayoutHwRegion:
            DSPR0: vBaseEnvHwRegionStartAddress=1879048192, vBaseEnvHwRegionSize=245760, vBaseEnvHwRegionType=RAM
            PSPR0: vBaseEnvHwRegionStartAddress=1880096768, vBaseEnvHwRegionSize=65536, vBaseEnvHwRegionType=RAM
            DSPR1: vBaseEnvHwRegionStartAddress=1610612736, vBaseEnvHwRegionSize=245760, vBaseEnvHwRegionType=RAM
            PSPR1: vBaseEnvHwRegionStartAddress=1611661312, vBaseEnvHwRegionSize=65536, vBaseEnvHwRegionType=RAM
            PFlash0_Cached: vBaseEnvHwRegionStartAddress=2147483648, vBaseEnvHwRegionSize=3145728, vBaseEnvHwRegionType=ROM
            PFlash0_NonCached: vBaseEnvHwRegionStartAddress=2684354560, vBaseEnvHwRegionSize=3145728, vBaseEnvHwRegionType=ROM
            PFlash1_Cached: vBaseEnvHwRegionStartAddress=2150629376, vBaseEnvHwRegionSize=3145728, vBaseEnvHwRegionType=ROM
            PFlash1_NonCached: vBaseEnvHwRegionStartAddress=2687500288, vBaseEnvHwRegionSize=3145728, vBaseEnvHwRegionType=ROM
            BMHD0: vBaseEnvHwRegionStartAddress=2940207104, vBaseEnvHwRegionSize=512, vBaseEnvHwRegionType=ROM
            BMHD1: vBaseEnvHwRegionStartAddress=2940207616, vBaseEnvHwRegionSize=512, vBaseEnvHwRegionType=ROM
            BMHD2: vBaseEnvHwRegionStartAddress=2940208128, vBaseEnvHwRegionSize=512, vBaseEnvHwRegionType=ROM
            BMHD3: vBaseEnvHwRegionStartAddress=2940208640, vBaseEnvHwRegionSize=512, vBaseEnvHwRegionType=ROM
            OLDA_Cached: vBaseEnvHwRegionStartAddress=2413821952, vBaseEnvHwRegionSize=524288, vBaseEnvHwRegionType=RAM
            OLDA_NonCached: vBaseEnvHwRegionStartAddress=2950692864, vBaseEnvHwRegionSize=524288, vBaseEnvHwRegionType=RAM
            DLMU0_Cached: vBaseEnvHwRegionStartAddress=2415919104, vBaseEnvHwRegionSize=65536, vBaseEnvHwRegionType=RAM
            DLMU0_NonCached: vBaseEnvHwRegionStartAddress=2952790016, vBaseEnvHwRegionSize=65536, vBaseEnvHwRegionType=RAM
            DLMU1_Cached: vBaseEnvHwRegionStartAddress=2415984640, vBaseEnvHwRegionSize=65536, vBaseEnvHwRegionType=RAM
            DLMU1_NonCached: vBaseEnvHwRegionStartAddress=2952855552, vBaseEnvHwRegionSize=65536, vBaseEnvHwRegionType=RAM
            DAM0_Cached: vBaseEnvHwRegionStartAddress=2420113408, vBaseEnvHwRegionSize=32768, vBaseEnvHwRegionType=RAM
            DAM0_NonCached: vBaseEnvHwRegionStartAddress=2956984320, vBaseEnvHwRegionSize=32768, vBaseEnvHwRegionType=RAM
            DFlash0: vBaseEnvHwRegionStartAddress=2936012800, vBaseEnvHwRegionSize=131072, vBaseEnvHwRegionType=ROM
            DFlash1: vBaseEnvHwRegionStartAddress=2948595712, vBaseEnvHwRegionSize=131072, vBaseEnvHwRegionType=ROM
      6 x vBaseEnvMemLayoutHwRegion:
        DSPR3
        PSPR3
        PFlash2_Cached
        PFlash2_NonCached
        PFlash3_Cached
        PFlash3_NonCached
      4 x vBaseEnvDerivativeInformation, all with vBaseEnvCpuMaxFrequency=300000000, vBaseEnvTestedDerivative=TC38x, vBaseEnvTestedDerivativeDescription=Infineon Aurix 2G TC38x Family, vBaseEnvAvailableChannels_Can=12, vBaseEnvAvailableChannels_Ethernet=1, vBaseEnvAvailableChannels_Flexray=4, vBaseEnvAvailableChannels_Lin=24, vBaseEnvCpuCore=TC162, vBaseEnvAvailableChannels_Hyperbus=0, vBaseEnvAvailableChannels_I2c=0, vBaseEnvAvailableChannels_Spi=0:
        TC389Q: vBaseEnvCpuCoreAmount=4
          vBaseEnvAdditionalParameters: vBaseEnvWatchdogGroup=B, vBaseEnvPllGroup=B, vBaseEnvPortGroup=B, vBaseEnvResetGroup=B, vBaseEnvDerivativeGroup=TC3xx
          36 x vBaseEnvMemLayoutHwRegion:
            DSPR0: vBaseEnvHwRegionStartAddress=1879048192, vBaseEnvHwRegionSize=245760, vBaseEnvHwRegionType=RAM
            PSPR0: vBaseEnvHwRegionStartAddress=1880096768, vBaseEnvHwRegionSize=65536, vBaseEnvHwRegionType=RAM
            DSPR1: vBaseEnvHwRegionStartAddress=1610612736, vBaseEnvHwRegionSize=245760, vBaseEnvHwRegionType=RAM
            PSPR1: vBaseEnvHwRegionStartAddress=1611661312, vBaseEnvHwRegionSize=65536, vBaseEnvHwRegionType=RAM
            DSPR2: vBaseEnvHwRegionStartAddress=1342177280, vBaseEnvHwRegionSize=98304, vBaseEnvHwRegionType=RAM
            PSPR2: vBaseEnvHwRegionStartAddress=1343225856, vBaseEnvHwRegionSize=65536, vBaseEnvHwRegionType=RAM
            DSPR3: vBaseEnvHwRegionStartAddress=1073741824, vBaseEnvHwRegionSize=98304, vBaseEnvHwRegionType=RAM
            PSPR3: vBaseEnvHwRegionStartAddress=1074790400, vBaseEnvHwRegionSize=98304, vBaseEnvHwRegionType=RAM
            PFlash0_Cached: vBaseEnvHwRegionStartAddress=2147483648, vBaseEnvHwRegionSize=3145728, vBaseEnvHwRegionType=ROM
            PFlash0_NonCached: vBaseEnvHwRegionStartAddress=2684354560, vBaseEnvHwRegionSize=3145728, vBaseEnvHwRegionType=ROM
            PFlash1_Cached: vBaseEnvHwRegionStartAddress=2150629376, vBaseEnvHwRegionSize=3145728, vBaseEnvHwRegionType=ROM
            PFlash1_NonCached: vBaseEnvHwRegionStartAddress=2687500288, vBaseEnvHwRegionSize=3145728, vBaseEnvHwRegionType=ROM
            PFlash2_Cached: vBaseEnvHwRegionStartAddress=2153775104, vBaseEnvHwRegionSize=3145728, vBaseEnvHwRegionType=ROM
            PFlash2_NonCached: vBaseEnvHwRegionStartAddress=2690646016, vBaseEnvHwRegionSize=3145728, vBaseEnvHwRegionType=ROM
            PFlash3_Cached: vBaseEnvHwRegionStartAddress=2156920832, vBaseEnvHwRegionSize=1048576, vBaseEnvHwRegionType=ROM
            PFlash3_NonCached: vBaseEnvHwRegionStartAddress=2693791744, vBaseEnvHwRegionSize=1048576, vBaseEnvHwRegionType=ROM
            LMU0_Cached: vBaseEnvHwRegionStartAddress=2416181248, vBaseEnvHwRegionSize=131072, vBaseEnvHwRegionType=RAM
            LMU0_NonCached: vBaseEnvHwRegionStartAddress=2953052160, vBaseEnvHwRegionSize=131072, vBaseEnvHwRegionType=RAM
            BMHD0: vBaseEnvHwRegionStartAddress=2940207104, vBaseEnvHwRegionSize=512, vBaseEnvHwRegionType=ROM
            BMHD1: vBaseEnvHwRegionStartAddress=2940207616, vBaseEnvHwRegionSize=512, vBaseEnvHwRegionType=ROM
            BMHD2: vBaseEnvHwRegionStartAddress=2940208128, vBaseEnvHwRegionSize=512, vBaseEnvHwRegionType=ROM
            BMHD3: vBaseEnvHwRegionStartAddress=2940208640, vBaseEnvHwRegionSize=512, vBaseEnvHwRegionType=ROM
            OLDA_Cached: vBaseEnvHwRegionStartAddress=2413821952, vBaseEnvHwRegionSize=524288, vBaseEnvHwRegionType=RAM
            OLDA_NonCached: vBaseEnvHwRegionStartAddress=2950692864, vBaseEnvHwRegionSize=524288, vBaseEnvHwRegionType=RAM
            DLMU0_Cached: vBaseEnvHwRegionStartAddress=2415919104, vBaseEnvHwRegionSize=65536, vBaseEnvHwRegionType=RAM
            DLMU0_NonCached: vBaseEnvHwRegionStartAddress=2952790016, vBaseEnvHwRegionSize=65536, vBaseEnvHwRegionType=RAM
            DLMU1_Cached: vBaseEnvHwRegionStartAddress=2415984640, vBaseEnvHwRegionSize=65536, vBaseEnvHwRegionType=RAM
            DLMU1_NonCached: vBaseEnvHwRegionStartAddress=2952855552, vBaseEnvHwRegionSize=65536, vBaseEnvHwRegionType=RAM
            DLMU2_Cached: vBaseEnvHwRegionStartAddress=2416050176, vBaseEnvHwRegionSize=65536, vBaseEnvHwRegionType=RAM
            DLMU2_NonCached: vBaseEnvHwRegionStartAddress=2952921088, vBaseEnvHwRegionSize=65536, vBaseEnvHwRegionType=RAM
            DLMU3_Cached: vBaseEnvHwRegionStartAddress=2416115712, vBaseEnvHwRegionSize=65536, vBaseEnvHwRegionType=RAM
            DLMU3_NonCached: vBaseEnvHwRegionStartAddress=2952986624, vBaseEnvHwRegionSize=65536, vBaseEnvHwRegionType=RAM
            DAM0_Cached: vBaseEnvHwRegionStartAddress=2420113408, vBaseEnvHwRegionSize=65536, vBaseEnvHwRegionType=RAM
            DAM0_NonCached: vBaseEnvHwRegionStartAddress=2956984320, vBaseEnvHwRegionSize=65536, vBaseEnvHwRegionType=RAM
            DFlash0: vBaseEnvHwRegionStartAddress=2936012800, vBaseEnvHwRegionSize=524288, vBaseEnvHwRegionType=ROM
            DFlash1: vBaseEnvHwRegionStartAddress=2948595712, vBaseEnvHwRegionSize=131072, vBaseEnvHwRegionType=ROM
        TC387Q: vBaseEnvCpuCoreAmount=4
          vBaseEnvAdditionalParameters: vBaseEnvWatchdogGroup=B, vBaseEnvPllGroup=B, vBaseEnvPortGroup=B, vBaseEnvResetGroup=B, vBaseEnvDerivativeGroup=TC3xx
          36 x vBaseEnvMemLayoutHwRegion:
            DSPR0: vBaseEnvHwRegionStartAddress=1879048192, vBaseEnvHwRegionSize=245760, vBaseEnvHwRegionType=RAM
            PSPR0: vBaseEnvHwRegionStartAddress=1880096768, vBaseEnvHwRegionSize=65536, vBaseEnvHwRegionType=RAM
            DSPR1: vBaseEnvHwRegionStartAddress=1610612736, vBaseEnvHwRegionSize=245760, vBaseEnvHwRegionType=RAM
            PSPR1: vBaseEnvHwRegionStartAddress=1611661312, vBaseEnvHwRegionSize=65536, vBaseEnvHwRegionType=RAM
            DSPR2: vBaseEnvHwRegionStartAddress=1342177280, vBaseEnvHwRegionSize=98304, vBaseEnvHwRegionType=RAM
            PSPR2: vBaseEnvHwRegionStartAddress=1343225856, vBaseEnvHwRegionSize=65536, vBaseEnvHwRegionType=RAM
            DSPR3: vBaseEnvHwRegionStartAddress=1073741824, vBaseEnvHwRegionSize=98304, vBaseEnvHwRegionType=RAM
            PSPR3: vBaseEnvHwRegionStartAddress=1074790400, vBaseEnvHwRegionSize=98304, vBaseEnvHwRegionType=RAM
            PFlash0_Cached: vBaseEnvHwRegionStartAddress=2147483648, vBaseEnvHwRegionSize=3145728, vBaseEnvHwRegionType=ROM
            PFlash0_NonCached: vBaseEnvHwRegionStartAddress=2684354560, vBaseEnvHwRegionSize=3145728, vBaseEnvHwRegionType=ROM
            PFlash1_Cached: vBaseEnvHwRegionStartAddress=2150629376, vBaseEnvHwRegionSize=3145728, vBaseEnvHwRegionType=ROM
            PFlash1_NonCached: vBaseEnvHwRegionStartAddress=2687500288, vBaseEnvHwRegionSize=3145728, vBaseEnvHwRegionType=ROM
            PFlash2_Cached: vBaseEnvHwRegionStartAddress=2153775104, vBaseEnvHwRegionSize=3145728, vBaseEnvHwRegionType=ROM
            PFlash2_NonCached: vBaseEnvHwRegionStartAddress=2690646016, vBaseEnvHwRegionSize=3145728, vBaseEnvHwRegionType=ROM
            PFlash3_Cached: vBaseEnvHwRegionStartAddress=2156920832, vBaseEnvHwRegionSize=1048576, vBaseEnvHwRegionType=ROM
            PFlash3_NonCached: vBaseEnvHwRegionStartAddress=2693791744, vBaseEnvHwRegionSize=1048576, vBaseEnvHwRegionType=ROM
            LMU0_Cached: vBaseEnvHwRegionStartAddress=2416181248, vBaseEnvHwRegionSize=131072, vBaseEnvHwRegionType=RAM
            LMU0_NonCached: vBaseEnvHwRegionStartAddress=2953052160, vBaseEnvHwRegionSize=131072, vBaseEnvHwRegionType=RAM
            BMHD0: vBaseEnvHwRegionStartAddress=2940207104, vBaseEnvHwRegionSize=512, vBaseEnvHwRegionType=ROM
            BMHD1: vBaseEnvHwRegionStartAddress=2940207616, vBaseEnvHwRegionSize=512, vBaseEnvHwRegionType=ROM
            BMHD2: vBaseEnvHwRegionStartAddress=2940208128, vBaseEnvHwRegionSize=512, vBaseEnvHwRegionType=ROM
            BMHD3: vBaseEnvHwRegionStartAddress=2940208640, vBaseEnvHwRegionSize=512, vBaseEnvHwRegionType=ROM
            OLDA_Cached: vBaseEnvHwRegionStartAddress=2413821952, vBaseEnvHwRegionSize=524288, vBaseEnvHwRegionType=RAM
            OLDA_NonCached: vBaseEnvHwRegionStartAddress=2950692864, vBaseEnvHwRegionSize=524288, vBaseEnvHwRegionType=RAM
            DLMU0_Cached: vBaseEnvHwRegionStartAddress=2415919104, vBaseEnvHwRegionSize=65536, vBaseEnvHwRegionType=RAM
            DLMU0_NonCached: vBaseEnvHwRegionStartAddress=2952790016, vBaseEnvHwRegionSize=65536, vBaseEnvHwRegionType=RAM
            DLMU1_Cached: vBaseEnvHwRegionStartAddress=2415984640, vBaseEnvHwRegionSize=65536, vBaseEnvHwRegionType=RAM
            DLMU1_NonCached: vBaseEnvHwRegionStartAddress=2952855552, vBaseEnvHwRegionSize=65536, vBaseEnvHwRegionType=RAM
            DLMU2_Cached: vBaseEnvHwRegionStartAddress=2416050176, vBaseEnvHwRegionSize=65536, vBaseEnvHwRegionType=RAM
            DLMU2_NonCached: vBaseEnvHwRegionStartAddress=2952921088, vBaseEnvHwRegionSize=65536, vBaseEnvHwRegionType=RAM
            DLMU3_Cached: vBaseEnvHwRegionStartAddress=2416115712, vBaseEnvHwRegionSize=65536, vBaseEnvHwRegionType=RAM
            DLMU3_NonCached: vBaseEnvHwRegionStartAddress=2952986624, vBaseEnvHwRegionSize=65536, vBaseEnvHwRegionType=RAM
            DAM0_Cached: vBaseEnvHwRegionStartAddress=2420113408, vBaseEnvHwRegionSize=65536, vBaseEnvHwRegionType=RAM
            DAM0_NonCached: vBaseEnvHwRegionStartAddress=2956984320, vBaseEnvHwRegionSize=65536, vBaseEnvHwRegionType=RAM
            DFlash0: vBaseEnvHwRegionStartAddress=2936012800, vBaseEnvHwRegionSize=524288, vBaseEnvHwRegionType=ROM
            DFlash1: vBaseEnvHwRegionStartAddress=2948595712, vBaseEnvHwRegionSize=131072, vBaseEnvHwRegionType=ROM
        TC380Q: vBaseEnvCpuCoreAmount=4
          vBaseEnvAdditionalParameters: vBaseEnvWatchdogGroup=B, vBaseEnvPllGroup=B, vBaseEnvPortGroup=B, vBaseEnvResetGroup=B, vBaseEnvDerivativeGroup=TC3xx
          36 x vBaseEnvMemLayoutHwRegion:
            DSPR0: vBaseEnvHwRegionStartAddress=1879048192, vBaseEnvHwRegionSize=245760, vBaseEnvHwRegionType=RAM
            PSPR0: vBaseEnvHwRegionStartAddress=1880096768, vBaseEnvHwRegionSize=65536, vBaseEnvHwRegionType=RAM
            DSPR1: vBaseEnvHwRegionStartAddress=1610612736, vBaseEnvHwRegionSize=245760, vBaseEnvHwRegionType=RAM
            PSPR1: vBaseEnvHwRegionStartAddress=1611661312, vBaseEnvHwRegionSize=65536, vBaseEnvHwRegionType=RAM
            DSPR2: vBaseEnvHwRegionStartAddress=1342177280, vBaseEnvHwRegionSize=98304, vBaseEnvHwRegionType=RAM
            PSPR2: vBaseEnvHwRegionStartAddress=1343225856, vBaseEnvHwRegionSize=65536, vBaseEnvHwRegionType=RAM
            DSPR3: vBaseEnvHwRegionStartAddress=1073741824, vBaseEnvHwRegionSize=98304, vBaseEnvHwRegionType=RAM
            PSPR3: vBaseEnvHwRegionStartAddress=1074790400, vBaseEnvHwRegionSize=98304, vBaseEnvHwRegionType=RAM
            PFlash0_Cached: vBaseEnvHwRegionStartAddress=2147483648, vBaseEnvHwRegionSize=3145728, vBaseEnvHwRegionType=ROM
            PFlash0_NonCached: vBaseEnvHwRegionStartAddress=2684354560, vBaseEnvHwRegionSize=3145728, vBaseEnvHwRegionType=ROM
            PFlash1_Cached: vBaseEnvHwRegionStartAddress=2150629376, vBaseEnvHwRegionSize=3145728, vBaseEnvHwRegionType=ROM
            PFlash1_NonCached: vBaseEnvHwRegionStartAddress=2687500288, vBaseEnvHwRegionSize=3145728, vBaseEnvHwRegionType=ROM
            PFlash2_Cached: vBaseEnvHwRegionStartAddress=2153775104, vBaseEnvHwRegionSize=3145728, vBaseEnvHwRegionType=ROM
            PFlash2_NonCached: vBaseEnvHwRegionStartAddress=2690646016, vBaseEnvHwRegionSize=3145728, vBaseEnvHwRegionType=ROM
            PFlash3_Cached: vBaseEnvHwRegionStartAddress=2156920832, vBaseEnvHwRegionSize=1048576, vBaseEnvHwRegionType=ROM
            PFlash3_NonCached: vBaseEnvHwRegionStartAddress=2693791744, vBaseEnvHwRegionSize=1048576, vBaseEnvHwRegionType=ROM
            LMU0_Cached: vBaseEnvHwRegionStartAddress=2416181248, vBaseEnvHwRegionSize=131072, vBaseEnvHwRegionType=RAM
            LMU0_NonCached: vBaseEnvHwRegionStartAddress=2953052160, vBaseEnvHwRegionSize=131072, vBaseEnvHwRegionType=RAM
            BMHD0: vBaseEnvHwRegionStartAddress=2940207104, vBaseEnvHwRegionSize=512, vBaseEnvHwRegionType=ROM
            BMHD1: vBaseEnvHwRegionStartAddress=2940207616, vBaseEnvHwRegionSize=512, vBaseEnvHwRegionType=ROM
            BMHD2: vBaseEnvHwRegionStartAddress=2940208128, vBaseEnvHwRegionSize=512, vBaseEnvHwRegionType=ROM
            BMHD3: vBaseEnvHwRegionStartAddress=2940208640, vBaseEnvHwRegionSize=512, vBaseEnvHwRegionType=ROM
            OLDA_Cached: vBaseEnvHwRegionStartAddress=2413821952, vBaseEnvHwRegionSize=524288, vBaseEnvHwRegionType=RAM
            OLDA_NonCached: vBaseEnvHwRegionStartAddress=2950692864, vBaseEnvHwRegionSize=524288, vBaseEnvHwRegionType=RAM
            DLMU0_Cached: vBaseEnvHwRegionStartAddress=2415919104, vBaseEnvHwRegionSize=65536, vBaseEnvHwRegionType=RAM
            DLMU0_NonCached: vBaseEnvHwRegionStartAddress=2952790016, vBaseEnvHwRegionSize=65536, vBaseEnvHwRegionType=RAM
            DLMU1_Cached: vBaseEnvHwRegionStartAddress=2415984640, vBaseEnvHwRegionSize=65536, vBaseEnvHwRegionType=RAM
            DLMU1_NonCached: vBaseEnvHwRegionStartAddress=2952855552, vBaseEnvHwRegionSize=65536, vBaseEnvHwRegionType=RAM
            DLMU2_Cached: vBaseEnvHwRegionStartAddress=2416050176, vBaseEnvHwRegionSize=65536, vBaseEnvHwRegionType=RAM
            DLMU2_NonCached: vBaseEnvHwRegionStartAddress=2952921088, vBaseEnvHwRegionSize=65536, vBaseEnvHwRegionType=RAM
            DLMU3_Cached: vBaseEnvHwRegionStartAddress=2416115712, vBaseEnvHwRegionSize=65536, vBaseEnvHwRegionType=RAM
            DLMU3_NonCached: vBaseEnvHwRegionStartAddress=2952986624, vBaseEnvHwRegionSize=65536, vBaseEnvHwRegionType=RAM
            DAM0_Cached: vBaseEnvHwRegionStartAddress=2420113408, vBaseEnvHwRegionSize=65536, vBaseEnvHwRegionType=RAM
            DAM0_NonCached: vBaseEnvHwRegionStartAddress=2956984320, vBaseEnvHwRegionSize=65536, vBaseEnvHwRegionType=RAM
            DFlash0: vBaseEnvHwRegionStartAddress=2936012800, vBaseEnvHwRegionSize=524288, vBaseEnvHwRegionType=ROM
            DFlash1: vBaseEnvHwRegionStartAddress=2948595712, vBaseEnvHwRegionSize=131072, vBaseEnvHwRegionType=ROM
        TC387T: vBaseEnvCpuCoreAmount=3
          vBaseEnvAdditionalParameters: vBaseEnvWatchdogGroup=B, vBaseEnvPllGroup=B, vBaseEnvPortGroup=B, vBaseEnvResetGroup=B, vBaseEnvDerivativeGroup=TC3xx
          20 x vBaseEnvMemLayoutHwRegion:
            DSPR0: vBaseEnvHwRegionStartAddress=1879048192, vBaseEnvHwRegionSize=245760, vBaseEnvHwRegionType=RAM
            PSPR0: vBaseEnvHwRegionStartAddress=1880096768, vBaseEnvHwRegionSize=65536, vBaseEnvHwRegionType=RAM
            DSPR1: vBaseEnvHwRegionStartAddress=1610612736, vBaseEnvHwRegionSize=245760, vBaseEnvHwRegionType=RAM
            PSPR1: vBaseEnvHwRegionStartAddress=1611661312, vBaseEnvHwRegionSize=65536, vBaseEnvHwRegionType=RAM
            DSPR2: vBaseEnvHwRegionStartAddress=1342177280, vBaseEnvHwRegionSize=98304, vBaseEnvHwRegionType=RAM
            PSPR2: vBaseEnvHwRegionStartAddress=1343225856, vBaseEnvHwRegionSize=65536, vBaseEnvHwRegionType=RAM
            PFlash0_Cached: vBaseEnvHwRegionStartAddress=2147483648, vBaseEnvHwRegionSize=3145728, vBaseEnvHwRegionType=ROM
            PFlash0_NonCached: vBaseEnvHwRegionStartAddress=2684354560, vBaseEnvHwRegionSize=3145728, vBaseEnvHwRegionType=ROM
            PFlash1_Cached: vBaseEnvHwRegionStartAddress=2150629376, vBaseEnvHwRegionSize=3145728, vBaseEnvHwRegionType=ROM
            PFlash1_NonCached: vBaseEnvHwRegionStartAddress=2687500288, vBaseEnvHwRegionSize=3145728, vBaseEnvHwRegionType=ROM
            PFlash2_Cached: vBaseEnvHwRegionStartAddress=2153775104, vBaseEnvHwRegionSize=3145728, vBaseEnvHwRegionType=ROM
            PFlash2_NonCached: vBaseEnvHwRegionStartAddress=2690646016, vBaseEnvHwRegionSize=3145728, vBaseEnvHwRegionType=ROM
            PFlash3_Cached: vBaseEnvHwRegionStartAddress=2156920832, vBaseEnvHwRegionSize=1048576, vBaseEnvHwRegionType=ROM
            PFlash3_NonCached: vBaseEnvHwRegionStartAddress=2693791744, vBaseEnvHwRegionSize=1048576, vBaseEnvHwRegionType=ROM
            LMU0_Cached: vBaseEnvHwRegionStartAddress=2416181248, vBaseEnvHwRegionSize=131072, vBaseEnvHwRegionType=RAM
            LMU0_NonCached: vBaseEnvHwRegionStartAddress=2953052160, vBaseEnvHwRegionSize=131072, vBaseEnvHwRegionType=RAM
            BMHD0: vBaseEnvHwRegionStartAddress=2940207104, vBaseEnvHwRegionSize=512, vBaseEnvHwRegionType=ROM
            BMHD1: vBaseEnvHwRegionStartAddress=2940207616, vBaseEnvHwRegionSize=512, vBaseEnvHwRegionType=ROM
            BMHD2: vBaseEnvHwRegionStartAddress=2940208128, vBaseEnvHwRegionSize=512, vBaseEnvHwRegionType=ROM
            BMHD3: vBaseEnvHwRegionStartAddress=2940208640, vBaseEnvHwRegionSize=512, vBaseEnvHwRegionType=ROM
      6 x vBaseEnvMemLayoutHwRegion:
        PFlash4_Cached
        PFlash4_NonCached
        PFlash5_Cached
        PFlash5_NonCached
        LMU2_Cached
        LMU2_NonCached
      TC397Q_StepB (vBaseEnvDerivativeInformation):
        vBaseEnvCpuCoreAmount = 4
        vBaseEnvCpuMaxFrequency = 300000000
        vBaseEnvTestedDerivative = TC39x
        vBaseEnvTestedDerivativeDescription = Infineon Aurix 2G TC39x Family
        vBaseEnvAvailableChannels_Can = 12
        vBaseEnvAvailableChannels_Ethernet = 1
        vBaseEnvAvailableChannels_Flexray = 4
        vBaseEnvAvailableChannels_Lin = 12
        vBaseEnvCpuCore = TC162
        vBaseEnvAvailableChannels_Hyperbus = 0
        vBaseEnvAvailableChannels_I2c = 0
        vBaseEnvAvailableChannels_Spi = 0
        vBaseEnvAdditionalParameters: vBaseEnvWatchdogGroup=B, vBaseEnvPllGroup=B, vBaseEnvPortGroup=B, vBaseEnvResetGroup=B, vBaseEnvDerivativeGroup=TC3xx
        30 x vBaseEnvMemLayoutHwRegion:
          DSPR0: vBaseEnvHwRegionStartAddress=1879048192, vBaseEnvHwRegionSize=245760, vBaseEnvHwRegionType=RAM
          PSPR0: vBaseEnvHwRegionStartAddress=1880096768, vBaseEnvHwRegionSize=65536, vBaseEnvHwRegionType=RAM
          DSPR1: vBaseEnvHwRegionStartAddress=1610612736, vBaseEnvHwRegionSize=245760, vBaseEnvHwRegionType=RAM
          PSPR1: vBaseEnvHwRegionStartAddress=1611661312, vBaseEnvHwRegionSize=65536, vBaseEnvHwRegionType=RAM
          DSPR2: vBaseEnvHwRegionStartAddress=1342177280, vBaseEnvHwRegionSize=98304, vBaseEnvHwRegionType=RAM
          PSPR2: vBaseEnvHwRegionStartAddress=1343225856, vBaseEnvHwRegionSize=65536, vBaseEnvHwRegionType=RAM
          DSPR3: vBaseEnvHwRegionStartAddress=1073741824, vBaseEnvHwRegionSize=98304, vBaseEnvHwRegionType=RAM
          PSPR3: vBaseEnvHwRegionStartAddress=1074790400, vBaseEnvHwRegionSize=98304, vBaseEnvHwRegionType=RAM
          PFlash0_Cached: vBaseEnvHwRegionStartAddress=2147483648, vBaseEnvHwRegionSize=3145728, vBaseEnvHwRegionType=ROM
          PFlash0_NonCached: vBaseEnvHwRegionStartAddress=2684354560, vBaseEnvHwRegionSize=3145728, vBaseEnvHwRegionType=ROM
          PFlash1_Cached: vBaseEnvHwRegionStartAddress=2150629376, vBaseEnvHwRegionSize=3145728, vBaseEnvHwRegionType=ROM
          PFlash1_NonCached: vBaseEnvHwRegionStartAddress=2687500288, vBaseEnvHwRegionSize=3145728, vBaseEnvHwRegionType=ROM
          PFlash2_Cached: vBaseEnvHwRegionStartAddress=2153775104, vBaseEnvHwRegionSize=3145728, vBaseEnvHwRegionType=ROM
          PFlash2_NonCached: vBaseEnvHwRegionStartAddress=2690646016, vBaseEnvHwRegionSize=3145728, vBaseEnvHwRegionType=ROM
          PFlash3_Cached: vBaseEnvHwRegionStartAddress=2156920832, vBaseEnvHwRegionSize=3145728, vBaseEnvHwRegionType=ROM
          PFlash3_NonCached: vBaseEnvHwRegionStartAddress=2693791744, vBaseEnvHwRegionSize=3145728, vBaseEnvHwRegionType=ROM
          PFlash4_Cached: vBaseEnvHwRegionStartAddress=2160066560, vBaseEnvHwRegionSize=3145728, vBaseEnvHwRegionType=ROM
          PFlash4_NonCached: vBaseEnvHwRegionStartAddress=2696937472, vBaseEnvHwRegionSize=3145728, vBaseEnvHwRegionType=ROM
          PFlash5_Cached: vBaseEnvHwRegionStartAddress=2163212288, vBaseEnvHwRegionSize=1048576, vBaseEnvHwRegionType=ROM
          PFlash5_NonCached: vBaseEnvHwRegionStartAddress=2700083200, vBaseEnvHwRegionSize=1048576, vBaseEnvHwRegionType=ROM
          LMU0_Cached: vBaseEnvHwRegionStartAddress=2416181248, vBaseEnvHwRegionSize=262144, vBaseEnvHwRegionType=RAM
          LMU0_NonCached: vBaseEnvHwRegionStartAddress=2953052160, vBaseEnvHwRegionSize=262144, vBaseEnvHwRegionType=RAM
          LMU1_Cached: vBaseEnvHwRegionStartAddress=2416443392, vBaseEnvHwRegionSize=262144, vBaseEnvHwRegionType=RAM
          LMU1_NonCached: vBaseEnvHwRegionStartAddress=2953314304, vBaseEnvHwRegionSize=262144, vBaseEnvHwRegionType=RAM
          LMU2_Cached: vBaseEnvHwRegionStartAddress=2416705536, vBaseEnvHwRegionSize=262144, vBaseEnvHwRegionType=RAM
          LMU2_NonCached: vBaseEnvHwRegionStartAddress=2953576448, vBaseEnvHwRegionSize=262144, vBaseEnvHwRegionType=RAM
          BMHD0: vBaseEnvHwRegionStartAddress=2940207104, vBaseEnvHwRegionSize=512, vBaseEnvHwRegionType=ROM
          BMHD1: vBaseEnvHwRegionStartAddress=2940207616, vBaseEnvHwRegionSize=512, vBaseEnvHwRegionType=ROM
          BMHD2: vBaseEnvHwRegionStartAddress=2940208128, vBaseEnvHwRegionSize=512, vBaseEnvHwRegionType=ROM
          BMHD3: vBaseEnvHwRegionStartAddress=2940208640, vBaseEnvHwRegionSize=512, vBaseEnvHwRegionType=ROM
      4 x vBaseEnvMemLayoutHwRegion:
        DSPR4
        PSPR4
        DSPR5
        PSPR5
      10 x vBaseEnvDerivativeInformation, all with vBaseEnvCpuCore=TC162, vBaseEnvAvailableChannels_Hyperbus=0, vBaseEnvAvailableChannels_I2c=0, vBaseEnvAvailableChannels_Spi=0:
        TC399X_StepB: vBaseEnvCpuCoreAmount=6, vBaseEnvCpuMaxFrequency=300000000, vBaseEnvTestedDerivative=TC39x, vBaseEnvTestedDerivativeDescription=Infineon Aurix 2G TC39x Family, vBaseEnvAvailableChannels_Can=12, vBaseEnvAvailableChannels_Ethernet=1, vBaseEnvAvailableChannels_Flexray=4, vBaseEnvAvailableChannels_Lin=12
          vBaseEnvAdditionalParameters: vBaseEnvWatchdogGroup=B, vBaseEnvPllGroup=B, vBaseEnvPortGroup=B, vBaseEnvResetGroup=B, vBaseEnvDerivativeGroup=TC3xx
          62 x vBaseEnvMemLayoutHwRegion:
            DSPR0: vBaseEnvHwRegionStartAddress=1879048192, vBaseEnvHwRegionSize=245760, vBaseEnvHwRegionType=RAM
            PSPR0: vBaseEnvHwRegionStartAddress=1880096768, vBaseEnvHwRegionSize=65536, vBaseEnvHwRegionType=RAM
            DSPR1: vBaseEnvHwRegionStartAddress=1610612736, vBaseEnvHwRegionSize=245760, vBaseEnvHwRegionType=RAM
            PSPR1: vBaseEnvHwRegionStartAddress=1611661312, vBaseEnvHwRegionSize=65536, vBaseEnvHwRegionType=RAM
            DSPR2: vBaseEnvHwRegionStartAddress=1342177280, vBaseEnvHwRegionSize=98304, vBaseEnvHwRegionType=RAM
            PSPR2: vBaseEnvHwRegionStartAddress=1343225856, vBaseEnvHwRegionSize=65536, vBaseEnvHwRegionType=RAM
            DSPR3: vBaseEnvHwRegionStartAddress=1073741824, vBaseEnvHwRegionSize=98304, vBaseEnvHwRegionType=RAM
            PSPR3: vBaseEnvHwRegionStartAddress=1074790400, vBaseEnvHwRegionSize=98304, vBaseEnvHwRegionType=RAM
            DSPR4: vBaseEnvHwRegionStartAddress=805306368, vBaseEnvHwRegionSize=98304, vBaseEnvHwRegionType=RAM
            PSPR4: vBaseEnvHwRegionStartAddress=806354944, vBaseEnvHwRegionSize=98304, vBaseEnvHwRegionType=RAM
            DSPR5: vBaseEnvHwRegionSize=98304, vBaseEnvHwRegionStartAddress=268435456, vBaseEnvHwRegionType=RAM
            PSPR5: vBaseEnvHwRegionStartAddress=269484032, vBaseEnvHwRegionSize=98304, vBaseEnvHwRegionType=RAM
            PFlash0_Cached: vBaseEnvHwRegionStartAddress=2147483648, vBaseEnvHwRegionSize=3145728, vBaseEnvHwRegionType=ROM
            PFlash0_NonCached: vBaseEnvHwRegionStartAddress=2684354560, vBaseEnvHwRegionSize=3145728, vBaseEnvHwRegionType=ROM
            PFlash1_Cached: vBaseEnvHwRegionStartAddress=2150629376, vBaseEnvHwRegionSize=3145728, vBaseEnvHwRegionType=ROM
            PFlash1_NonCached: vBaseEnvHwRegionStartAddress=2687500288, vBaseEnvHwRegionSize=3145728, vBaseEnvHwRegionType=ROM
            PFlash2_Cached: vBaseEnvHwRegionStartAddress=2153775104, vBaseEnvHwRegionSize=3145728, vBaseEnvHwRegionType=ROM
            PFlash2_NonCached: vBaseEnvHwRegionStartAddress=2690646016, vBaseEnvHwRegionSize=3145728, vBaseEnvHwRegionType=ROM
            PFlash3_Cached: vBaseEnvHwRegionStartAddress=2156920832, vBaseEnvHwRegionSize=3145728, vBaseEnvHwRegionType=ROM
            PFlash3_NonCached: vBaseEnvHwRegionStartAddress=2693791744, vBaseEnvHwRegionSize=3145728, vBaseEnvHwRegionType=ROM
            PFlash4_Cached: vBaseEnvHwRegionStartAddress=2160066560, vBaseEnvHwRegionSize=3145728, vBaseEnvHwRegionType=ROM
            PFlash4_NonCached: vBaseEnvHwRegionStartAddress=2696937472, vBaseEnvHwRegionSize=3145728, vBaseEnvHwRegionType=ROM
            PFlash5_Cached: vBaseEnvHwRegionStartAddress=2163212288, vBaseEnvHwRegionSize=1048576, vBaseEnvHwRegionType=ROM
            PFlash5_NonCached: vBaseEnvHwRegionStartAddress=2700083200, vBaseEnvHwRegionSize=1048576, vBaseEnvHwRegionType=ROM
            LMU0_Cached: vBaseEnvHwRegionStartAddress=2416181248, vBaseEnvHwRegionSize=262144, vBaseEnvHwRegionType=RAM
            LMU0_NonCached: vBaseEnvHwRegionStartAddress=2953052160, vBaseEnvHwRegionSize=262144, vBaseEnvHwRegionType=RAM
            LMU1_Cached: vBaseEnvHwRegionStartAddress=2416443392, vBaseEnvHwRegionSize=262144, vBaseEnvHwRegionType=RAM
            LMU1_NonCached: vBaseEnvHwRegionStartAddress=2953314304, vBaseEnvHwRegionSize=262144, vBaseEnvHwRegionType=RAM
            LMU2_Cached: vBaseEnvHwRegionStartAddress=2416705536, vBaseEnvHwRegionSize=262144, vBaseEnvHwRegionType=RAM
            LMU2_NonCached: vBaseEnvHwRegionStartAddress=2953576448, vBaseEnvHwRegionSize=262144, vBaseEnvHwRegionType=RAM
            BMHD0: vBaseEnvHwRegionStartAddress=2940207104, vBaseEnvHwRegionSize=512, vBaseEnvHwRegionType=ROM
            BMHD1: vBaseEnvHwRegionStartAddress=2940207616, vBaseEnvHwRegionSize=512, vBaseEnvHwRegionType=ROM
            BMHD2: vBaseEnvHwRegionStartAddress=2940208128, vBaseEnvHwRegionSize=512, vBaseEnvHwRegionType=ROM
            BMHD3: vBaseEnvHwRegionStartAddress=2940208640, vBaseEnvHwRegionSize=512, vBaseEnvHwRegionType=ROM
            DLMU0_Cached: vBaseEnvHwRegionStartAddress=2415919104, vBaseEnvHwRegionSize=65536, vBaseEnvHwRegionType=RAM
            DLMU1_Cached: vBaseEnvHwRegionStartAddress=2415984640, vBaseEnvHwRegionSize=65536, vBaseEnvHwRegionType=RAM
            DLMU2_Cached: vBaseEnvHwRegionStartAddress=2416050176, vBaseEnvHwRegionSize=65536, vBaseEnvHwRegionType=RAM
            DLMU3_Cached: vBaseEnvHwRegionStartAddress=2416115712, vBaseEnvHwRegionSize=65536, vBaseEnvHwRegionType=RAM
            DLMU4_Cached: vBaseEnvHwRegionStartAddress=2416967680, vBaseEnvHwRegionSize=65536, vBaseEnvHwRegionType=RAM
            DLMU5_Cached: vBaseEnvHwRegionStartAddress=2417033216, vBaseEnvHwRegionSize=65536, vBaseEnvHwRegionType=RAM
            DLMU0_NonCached: vBaseEnvHwRegionStartAddress=2952790016, vBaseEnvHwRegionSize=65536, vBaseEnvHwRegionType=RAM
            DLMU1_NonCached: vBaseEnvHwRegionStartAddress=2952855552, vBaseEnvHwRegionSize=65536, vBaseEnvHwRegionType=RAM
            DLMU2_NonCached: vBaseEnvHwRegionStartAddress=2952921088, vBaseEnvHwRegionSize=65536, vBaseEnvHwRegionType=RAM
            DLMU3_NonCached: vBaseEnvHwRegionStartAddress=2952986624, vBaseEnvHwRegionSize=65536, vBaseEnvHwRegionType=RAM
            DLMU4_NonCached: vBaseEnvHwRegionStartAddress=2953838592, vBaseEnvHwRegionSize=65536, vBaseEnvHwRegionType=RAM
            DLMU5_NonCached: vBaseEnvHwRegionStartAddress=2953904128, vBaseEnvHwRegionSize=65536, vBaseEnvHwRegionType=RAM
            OLDA_Cached: vBaseEnvHwRegionStartAddress=2413821952, vBaseEnvHwRegionSize=524288, vBaseEnvHwRegionType=RAM
            OLDA_NonCached: vBaseEnvHwRegionStartAddress=2950692864, vBaseEnvHwRegionSize=524288, vBaseEnvHwRegionType=RAM
            DAM0_Cached: vBaseEnvHwRegionStartAddress=2420113408, vBaseEnvHwRegionSize=65536, vBaseEnvHwRegionType=RAM
            DAM0_NonCached: vBaseEnvHwRegionStartAddress=2956984320, vBaseEnvHwRegionSize=65536, vBaseEnvHwRegionType=RAM
            DAM1_Cached: vBaseEnvHwRegionStartAddress=2420178944, vBaseEnvHwRegionSize=65536, vBaseEnvHwRegionType=RAM
            DAM1_NonCached: vBaseEnvHwRegionStartAddress=2957049856, vBaseEnvHwRegionSize=65536, vBaseEnvHwRegionType=RAM
            EMEM0_Cached: vBaseEnvHwRegionStartAddress=2566914048, vBaseEnvHwRegionSize=1048576, vBaseEnvHwRegionType=RAM
            EMEM0_NonCached: vBaseEnvHwRegionStartAddress=3103784960, vBaseEnvHwRegionSize=1048576, vBaseEnvHwRegionType=RAM
            EMEM1_Cached: vBaseEnvHwRegionStartAddress=2567962624, vBaseEnvHwRegionSize=1048576, vBaseEnvHwRegionType=RAM
            EMEM1_NonCached: vBaseEnvHwRegionStartAddress=3104833536, vBaseEnvHwRegionSize=1048576, vBaseEnvHwRegionType=RAM
            EMEM2_Cached: vBaseEnvHwRegionStartAddress=2569011200, vBaseEnvHwRegionSize=1048576, vBaseEnvHwRegionType=RAM
            EMEM2_NonCached: vBaseEnvHwRegionStartAddress=3105882112, vBaseEnvHwRegionSize=1048576, vBaseEnvHwRegionType=RAM
            EMEM3_Cached: vBaseEnvHwRegionStartAddress=2570059776, vBaseEnvHwRegionSize=1048576, vBaseEnvHwRegionType=RAM
            EMEM3_NonCached: vBaseEnvHwRegionStartAddress=3106930688, vBaseEnvHwRegionSize=1048576, vBaseEnvHwRegionType=RAM
            DFlash0: vBaseEnvHwRegionStartAddress=2936012800, vBaseEnvHwRegionSize=1048576, vBaseEnvHwRegionType=ROM
            DFlash1: vBaseEnvHwRegionStartAddress=2948595712, vBaseEnvHwRegionSize=131072, vBaseEnvHwRegionType=ROM
        TC397X_StepB: vBaseEnvCpuCoreAmount=6, vBaseEnvCpuMaxFrequency=300000000, vBaseEnvTestedDerivative=TC39x, vBaseEnvTestedDerivativeDescription=Infineon Aurix 2G TC39x Family, vBaseEnvAvailableChannels_Can=12, vBaseEnvAvailableChannels_Ethernet=1, vBaseEnvAvailableChannels_Flexray=4, vBaseEnvAvailableChannels_Lin=12
          vBaseEnvAdditionalParameters: vBaseEnvWatchdogGroup=B, vBaseEnvPllGroup=B, vBaseEnvPortGroup=B, vBaseEnvResetGroup=B, vBaseEnvDerivativeGroup=TC3xx
          62 x vBaseEnvMemLayoutHwRegion:
            DSPR0: vBaseEnvHwRegionStartAddress=1879048192, vBaseEnvHwRegionSize=245760, vBaseEnvHwRegionType=RAM
            PSPR0: vBaseEnvHwRegionStartAddress=1880096768, vBaseEnvHwRegionSize=65536, vBaseEnvHwRegionType=RAM
            DSPR1: vBaseEnvHwRegionStartAddress=1610612736, vBaseEnvHwRegionSize=245760, vBaseEnvHwRegionType=RAM
            PSPR1: vBaseEnvHwRegionStartAddress=1611661312, vBaseEnvHwRegionSize=65536, vBaseEnvHwRegionType=RAM
            DSPR2: vBaseEnvHwRegionStartAddress=1342177280, vBaseEnvHwRegionSize=98304, vBaseEnvHwRegionType=RAM
            PSPR2: vBaseEnvHwRegionStartAddress=1343225856, vBaseEnvHwRegionSize=65536, vBaseEnvHwRegionType=RAM
            DSPR3: vBaseEnvHwRegionStartAddress=1073741824, vBaseEnvHwRegionSize=98304, vBaseEnvHwRegionType=RAM
            PSPR3: vBaseEnvHwRegionStartAddress=1074790400, vBaseEnvHwRegionSize=98304, vBaseEnvHwRegionType=RAM
            DSPR4: vBaseEnvHwRegionStartAddress=805306368, vBaseEnvHwRegionSize=98304, vBaseEnvHwRegionType=RAM
            PSPR4: vBaseEnvHwRegionStartAddress=806354944, vBaseEnvHwRegionSize=98304, vBaseEnvHwRegionType=RAM
            DSPR5: vBaseEnvHwRegionSize=98304, vBaseEnvHwRegionStartAddress=268435456, vBaseEnvHwRegionType=RAM
            PSPR5: vBaseEnvHwRegionStartAddress=269484032, vBaseEnvHwRegionSize=98304, vBaseEnvHwRegionType=RAM
            PFlash0_Cached: vBaseEnvHwRegionStartAddress=2147483648, vBaseEnvHwRegionSize=3145728, vBaseEnvHwRegionType=ROM
            PFlash0_NonCached: vBaseEnvHwRegionStartAddress=2684354560, vBaseEnvHwRegionSize=3145728, vBaseEnvHwRegionType=ROM
            PFlash1_Cached: vBaseEnvHwRegionStartAddress=2150629376, vBaseEnvHwRegionSize=3145728, vBaseEnvHwRegionType=ROM
            PFlash1_NonCached: vBaseEnvHwRegionStartAddress=2687500288, vBaseEnvHwRegionSize=3145728, vBaseEnvHwRegionType=ROM
            PFlash2_Cached: vBaseEnvHwRegionStartAddress=2153775104, vBaseEnvHwRegionSize=3145728, vBaseEnvHwRegionType=ROM
            PFlash2_NonCached: vBaseEnvHwRegionStartAddress=2690646016, vBaseEnvHwRegionSize=3145728, vBaseEnvHwRegionType=ROM
            PFlash3_Cached: vBaseEnvHwRegionStartAddress=2156920832, vBaseEnvHwRegionSize=3145728, vBaseEnvHwRegionType=ROM
            PFlash3_NonCached: vBaseEnvHwRegionStartAddress=2693791744, vBaseEnvHwRegionSize=3145728, vBaseEnvHwRegionType=ROM
            PFlash4_Cached: vBaseEnvHwRegionStartAddress=2160066560, vBaseEnvHwRegionSize=3145728, vBaseEnvHwRegionType=ROM
            PFlash4_NonCached: vBaseEnvHwRegionStartAddress=2696937472, vBaseEnvHwRegionSize=3145728, vBaseEnvHwRegionType=ROM
            PFlash5_Cached: vBaseEnvHwRegionStartAddress=2163212288, vBaseEnvHwRegionSize=1048576, vBaseEnvHwRegionType=ROM
            PFlash5_NonCached: vBaseEnvHwRegionStartAddress=2700083200, vBaseEnvHwRegionSize=1048576, vBaseEnvHwRegionType=ROM
            LMU0_Cached: vBaseEnvHwRegionStartAddress=2416181248, vBaseEnvHwRegionSize=262144, vBaseEnvHwRegionType=RAM
            LMU0_NonCached: vBaseEnvHwRegionStartAddress=2953052160, vBaseEnvHwRegionSize=262144, vBaseEnvHwRegionType=RAM
            LMU1_Cached: vBaseEnvHwRegionStartAddress=2416443392, vBaseEnvHwRegionSize=262144, vBaseEnvHwRegionType=RAM
            LMU1_NonCached: vBaseEnvHwRegionStartAddress=2953314304, vBaseEnvHwRegionSize=262144, vBaseEnvHwRegionType=RAM
            LMU2_Cached: vBaseEnvHwRegionStartAddress=2416705536, vBaseEnvHwRegionSize=262144, vBaseEnvHwRegionType=RAM
            LMU2_NonCached: vBaseEnvHwRegionStartAddress=2953576448, vBaseEnvHwRegionSize=262144, vBaseEnvHwRegionType=RAM
            BMHD0: vBaseEnvHwRegionStartAddress=2940207104, vBaseEnvHwRegionSize=512, vBaseEnvHwRegionType=ROM
            BMHD1: vBaseEnvHwRegionStartAddress=2940207616, vBaseEnvHwRegionSize=512, vBaseEnvHwRegionType=ROM
            BMHD2: vBaseEnvHwRegionStartAddress=2940208128, vBaseEnvHwRegionSize=512, vBaseEnvHwRegionType=ROM
            BMHD3: vBaseEnvHwRegionStartAddress=2940208640, vBaseEnvHwRegionSize=512, vBaseEnvHwRegionType=ROM
            DLMU0_Cached: vBaseEnvHwRegionStartAddress=2415919104, vBaseEnvHwRegionSize=65536, vBaseEnvHwRegionType=RAM
            DLMU1_Cached: vBaseEnvHwRegionStartAddress=2415984640, vBaseEnvHwRegionSize=65536, vBaseEnvHwRegionType=RAM
            DLMU2_Cached: vBaseEnvHwRegionStartAddress=2416050176, vBaseEnvHwRegionSize=65536, vBaseEnvHwRegionType=RAM
            DLMU3_Cached: vBaseEnvHwRegionStartAddress=2416115712, vBaseEnvHwRegionSize=65536, vBaseEnvHwRegionType=RAM
            DLMU4_Cached: vBaseEnvHwRegionStartAddress=2416967680, vBaseEnvHwRegionSize=65536, vBaseEnvHwRegionType=RAM
            DLMU5_Cached: vBaseEnvHwRegionStartAddress=2417033216, vBaseEnvHwRegionSize=65536, vBaseEnvHwRegionType=RAM
            DLMU0_NonCached: vBaseEnvHwRegionStartAddress=2952790016, vBaseEnvHwRegionSize=65536, vBaseEnvHwRegionType=RAM
            DLMU1_NonCached: vBaseEnvHwRegionStartAddress=2952855552, vBaseEnvHwRegionSize=65536, vBaseEnvHwRegionType=RAM
            DLMU2_NonCached: vBaseEnvHwRegionStartAddress=2952921088, vBaseEnvHwRegionSize=65536, vBaseEnvHwRegionType=RAM
            DLMU3_NonCached: vBaseEnvHwRegionStartAddress=2952986624, vBaseEnvHwRegionSize=65536, vBaseEnvHwRegionType=RAM
            DLMU4_NonCached: vBaseEnvHwRegionStartAddress=2953838592, vBaseEnvHwRegionSize=65536, vBaseEnvHwRegionType=RAM
            DLMU5_NonCached: vBaseEnvHwRegionStartAddress=2953904128, vBaseEnvHwRegionSize=65536, vBaseEnvHwRegionType=RAM
            OLDA_Cached: vBaseEnvHwRegionStartAddress=2413821952, vBaseEnvHwRegionSize=524288, vBaseEnvHwRegionType=RAM
            OLDA_NonCached: vBaseEnvHwRegionStartAddress=2950692864, vBaseEnvHwRegionSize=524288, vBaseEnvHwRegionType=RAM
            DAM0_Cached: vBaseEnvHwRegionStartAddress=2420113408, vBaseEnvHwRegionSize=65536, vBaseEnvHwRegionType=RAM
            DAM0_NonCached: vBaseEnvHwRegionStartAddress=2956984320, vBaseEnvHwRegionSize=65536, vBaseEnvHwRegionType=RAM
            DAM1_Cached: vBaseEnvHwRegionStartAddress=2420178944, vBaseEnvHwRegionSize=65536, vBaseEnvHwRegionType=RAM
            DAM1_NonCached: vBaseEnvHwRegionStartAddress=2957049856, vBaseEnvHwRegionSize=65536, vBaseEnvHwRegionType=RAM
            EMEM0_Cached: vBaseEnvHwRegionStartAddress=2566914048, vBaseEnvHwRegionSize=1048576, vBaseEnvHwRegionType=RAM
            EMEM0_NonCached: vBaseEnvHwRegionStartAddress=3103784960, vBaseEnvHwRegionSize=1048576, vBaseEnvHwRegionType=RAM
            EMEM1_Cached: vBaseEnvHwRegionStartAddress=2567962624, vBaseEnvHwRegionSize=1048576, vBaseEnvHwRegionType=RAM
            EMEM1_NonCached: vBaseEnvHwRegionStartAddress=3104833536, vBaseEnvHwRegionSize=1048576, vBaseEnvHwRegionType=RAM
            EMEM2_Cached: vBaseEnvHwRegionStartAddress=2569011200, vBaseEnvHwRegionSize=1048576, vBaseEnvHwRegionType=RAM
            EMEM2_NonCached: vBaseEnvHwRegionStartAddress=3105882112, vBaseEnvHwRegionSize=1048576, vBaseEnvHwRegionType=RAM
            EMEM3_Cached: vBaseEnvHwRegionStartAddress=2570059776, vBaseEnvHwRegionSize=1048576, vBaseEnvHwRegionType=RAM
            EMEM3_NonCached: vBaseEnvHwRegionStartAddress=3106930688, vBaseEnvHwRegionSize=1048576, vBaseEnvHwRegionType=RAM
            DFlash0: vBaseEnvHwRegionStartAddress=2936012800, vBaseEnvHwRegionSize=1048576, vBaseEnvHwRegionType=ROM
            DFlash1: vBaseEnvHwRegionStartAddress=2948595712, vBaseEnvHwRegionSize=131072, vBaseEnvHwRegionType=ROM
        TC322L: vBaseEnvCpuCoreAmount=1, vBaseEnvCpuMaxFrequency=160000000, vBaseEnvTestedDerivative=TC32x, vBaseEnvTestedDerivativeDescription=Infineon Aurix 2G TC32x Family, vBaseEnvAvailableChannels_Can=6, vBaseEnvAvailableChannels_Ethernet=0, vBaseEnvAvailableChannels_Flexray=0, vBaseEnvAvailableChannels_Lin=5
          vBaseEnvAdditionalParameters: vBaseEnvWatchdogGroup=B, vBaseEnvPllGroup=B, vBaseEnvPortGroup=B, vBaseEnvResetGroup=B, vBaseEnvDerivativeGroup=TC3xx
          16 x vBaseEnvMemLayoutHwRegion:
            DSPR0: vBaseEnvHwRegionStartAddress=1879048192, vBaseEnvHwRegionSize=196608, vBaseEnvHwRegionType=RAM
            PSPR0: vBaseEnvHwRegionStartAddress=1880096768, vBaseEnvHwRegionSize=8192, vBaseEnvHwRegionType=RAM
            PFlash0_Cached: vBaseEnvHwRegionStartAddress=2147483648, vBaseEnvHwRegionSize=1048576, vBaseEnvHwRegionType=ROM
            PFlash0_NonCached: vBaseEnvHwRegionStartAddress=2684354560, vBaseEnvHwRegionSize=1048576, vBaseEnvHwRegionType=ROM
            LMU0_Cached: vBaseEnvHwRegionStartAddress=2415919104, vBaseEnvHwRegionSize=8192, vBaseEnvHwRegionType=RAM
            LMU0_NonCached: vBaseEnvHwRegionStartAddress=2952790016, vBaseEnvHwRegionSize=8192, vBaseEnvHwRegionType=RAM
            BMHD0: vBaseEnvHwRegionStartAddress=2940207104, vBaseEnvHwRegionSize=512, vBaseEnvHwRegionType=ROM
            BMHD1: vBaseEnvHwRegionStartAddress=2940207616, vBaseEnvHwRegionSize=512, vBaseEnvHwRegionType=ROM
            BMHD2: vBaseEnvHwRegionStartAddress=2940208128, vBaseEnvHwRegionSize=512, vBaseEnvHwRegionType=ROM
            BMHD3: vBaseEnvHwRegionStartAddress=2940208640, vBaseEnvHwRegionSize=512, vBaseEnvHwRegionType=ROM
            OLDA_Cached: vBaseEnvHwRegionStartAddress=2413821952, vBaseEnvHwRegionSize=524288, vBaseEnvHwRegionType=RAM
            OLDA_NonCached: vBaseEnvHwRegionStartAddress=2950692864, vBaseEnvHwRegionSize=524288, vBaseEnvHwRegionType=RAM
            DLMU0_Cached: vBaseEnvHwRegionStartAddress=2415919104, vBaseEnvHwRegionSize=8192, vBaseEnvHwRegionType=RAM
            DLMU0_NonCached: vBaseEnvHwRegionStartAddress=2952790016, vBaseEnvHwRegionSize=8192, vBaseEnvHwRegionType=RAM
            DFlash0: vBaseEnvHwRegionStartAddress=2936012800, vBaseEnvHwRegionSize=1048576, vBaseEnvHwRegionType=ROM
            DFlash1: vBaseEnvHwRegionStartAddress=2948595712, vBaseEnvHwRegionSize=131072, vBaseEnvHwRegionType=ROM
        TC323L: vBaseEnvCpuCoreAmount=1, vBaseEnvCpuMaxFrequency=200000000, vBaseEnvTestedDerivative=TC32x, vBaseEnvTestedDerivativeDescription=Infineon Aurix 2G TC32x Family, vBaseEnvAvailableChannels_Can=6, vBaseEnvAvailableChannels_Ethernet=0, vBaseEnvAvailableChannels_Flexray=0, vBaseEnvAvailableChannels_Lin=5
          vBaseEnvAdditionalParameters: vBaseEnvWatchdogGroup=B, vBaseEnvPllGroup=B, vBaseEnvPortGroup=B, vBaseEnvResetGroup=B, vBaseEnvDerivativeGroup=TC3xx
          16 x vBaseEnvMemLayoutHwRegion:
            DSPR0: vBaseEnvHwRegionStartAddress=1879048192, vBaseEnvHwRegionSize=196608, vBaseEnvHwRegionType=RAM
            PSPR0: vBaseEnvHwRegionStartAddress=1880096768, vBaseEnvHwRegionSize=8192, vBaseEnvHwRegionType=RAM
            PFlash0_Cached: vBaseEnvHwRegionStartAddress=2147483648, vBaseEnvHwRegionSize=1572864, vBaseEnvHwRegionType=ROM
            PFlash0_NonCached: vBaseEnvHwRegionStartAddress=2684354560, vBaseEnvHwRegionSize=1572864, vBaseEnvHwRegionType=ROM
            LMU0_Cached: vBaseEnvHwRegionStartAddress=2415919104, vBaseEnvHwRegionSize=8192, vBaseEnvHwRegionType=RAM
            LMU0_NonCached: vBaseEnvHwRegionStartAddress=2952790016, vBaseEnvHwRegionSize=8192, vBaseEnvHwRegionType=RAM
            BMHD0: vBaseEnvHwRegionStartAddress=2940207104, vBaseEnvHwRegionSize=512, vBaseEnvHwRegionType=ROM
            BMHD1: vBaseEnvHwRegionStartAddress=2940207616, vBaseEnvHwRegionSize=512, vBaseEnvHwRegionType=ROM
            BMHD2: vBaseEnvHwRegionStartAddress=2940208128, vBaseEnvHwRegionSize=512, vBaseEnvHwRegionType=ROM
            BMHD3: vBaseEnvHwRegionStartAddress=2940208640, vBaseEnvHwRegionSize=512, vBaseEnvHwRegionType=ROM
            OLDA_Cached: vBaseEnvHwRegionStartAddress=2413821952, vBaseEnvHwRegionSize=524288, vBaseEnvHwRegionType=RAM
            OLDA_NonCached: vBaseEnvHwRegionStartAddress=2950692864, vBaseEnvHwRegionSize=524288, vBaseEnvHwRegionType=RAM
            DLMU0_Cached: vBaseEnvHwRegionStartAddress=2415919104, vBaseEnvHwRegionSize=8192, vBaseEnvHwRegionType=RAM
            DLMU0_NonCached: vBaseEnvHwRegionStartAddress=2952790016, vBaseEnvHwRegionSize=8192, vBaseEnvHwRegionType=RAM
            DFlash0: vBaseEnvHwRegionStartAddress=2936012800, vBaseEnvHwRegionSize=1048576, vBaseEnvHwRegionType=ROM
            DFlash1: vBaseEnvHwRegionStartAddress=2948595712, vBaseEnvHwRegionSize=131072, vBaseEnvHwRegionType=ROM
        TC324L: vBaseEnvCpuCoreAmount=1, vBaseEnvCpuMaxFrequency=200000000, vBaseEnvTestedDerivative=TC32x, vBaseEnvTestedDerivativeDescription=Infineon Aurix 2G TC32x Family, vBaseEnvAvailableChannels_Can=6, vBaseEnvAvailableChannels_Ethernet=0, vBaseEnvAvailableChannels_Flexray=0, vBaseEnvAvailableChannels_Lin=5
          vBaseEnvAdditionalParameters: vBaseEnvWatchdogGroup=B, vBaseEnvPllGroup=B, vBaseEnvPortGroup=B, vBaseEnvResetGroup=B, vBaseEnvDerivativeGroup=TC3xx
          16 x vBaseEnvMemLayoutHwRegion:
            DSPR0: vBaseEnvHwRegionStartAddress=1879048192, vBaseEnvHwRegionSize=196608, vBaseEnvHwRegionType=RAM
            PSPR0: vBaseEnvHwRegionStartAddress=1880096768, vBaseEnvHwRegionSize=8192, vBaseEnvHwRegionType=RAM
            PFlash0_Cached: vBaseEnvHwRegionStartAddress=2147483648, vBaseEnvHwRegionSize=1572864, vBaseEnvHwRegionType=ROM
            PFlash0_NonCached: vBaseEnvHwRegionStartAddress=2684354560, vBaseEnvHwRegionSize=1572864, vBaseEnvHwRegionType=ROM
            LMU0_Cached: vBaseEnvHwRegionStartAddress=2415919104, vBaseEnvHwRegionSize=8192, vBaseEnvHwRegionType=RAM
            LMU0_NonCached: vBaseEnvHwRegionStartAddress=2952790016, vBaseEnvHwRegionSize=8192, vBaseEnvHwRegionType=RAM
            BMHD0: vBaseEnvHwRegionStartAddress=2940207104, vBaseEnvHwRegionSize=512, vBaseEnvHwRegionType=ROM
            BMHD1: vBaseEnvHwRegionStartAddress=2940207616, vBaseEnvHwRegionSize=512, vBaseEnvHwRegionType=ROM
            BMHD2: vBaseEnvHwRegionStartAddress=2940208128, vBaseEnvHwRegionSize=512, vBaseEnvHwRegionType=ROM
            BMHD3: vBaseEnvHwRegionStartAddress=2940208640, vBaseEnvHwRegionSize=512, vBaseEnvHwRegionType=ROM
            OLDA_Cached: vBaseEnvHwRegionStartAddress=2413821952, vBaseEnvHwRegionSize=524288, vBaseEnvHwRegionType=RAM
            OLDA_NonCached: vBaseEnvHwRegionStartAddress=2950692864, vBaseEnvHwRegionSize=524288, vBaseEnvHwRegionType=RAM
            DLMU0_Cached: vBaseEnvHwRegionStartAddress=2415919104, vBaseEnvHwRegionSize=8192, vBaseEnvHwRegionType=RAM
            DLMU0_NonCached: vBaseEnvHwRegionStartAddress=2952790016, vBaseEnvHwRegionSize=8192, vBaseEnvHwRegionType=RAM
            DFlash0: vBaseEnvHwRegionStartAddress=2936012800, vBaseEnvHwRegionSize=1048576, vBaseEnvHwRegionType=ROM
            DFlash1: vBaseEnvHwRegionStartAddress=2948595712, vBaseEnvHwRegionSize=131072, vBaseEnvHwRegionType=ROM
        TC327L: vBaseEnvCpuCoreAmount=1, vBaseEnvCpuMaxFrequency=160000000, vBaseEnvTestedDerivative=TC32x, vBaseEnvTestedDerivativeDescription=Infineon Aurix 2G TC32x Family, vBaseEnvAvailableChannels_Can=6, vBaseEnvAvailableChannels_Ethernet=0, vBaseEnvAvailableChannels_Flexray=0, vBaseEnvAvailableChannels_Lin=6
          vBaseEnvAdditionalParameters: vBaseEnvWatchdogGroup=B, vBaseEnvPllGroup=B, vBaseEnvPortGroup=B, vBaseEnvResetGroup=B, vBaseEnvDerivativeGroup=TC3xx
          16 x vBaseEnvMemLayoutHwRegion:
            DSPR0: vBaseEnvHwRegionStartAddress=1879048192, vBaseEnvHwRegionSize=196608, vBaseEnvHwRegionType=RAM
            PSPR0: vBaseEnvHwRegionStartAddress=1880096768, vBaseEnvHwRegionSize=8192, vBaseEnvHwRegionType=RAM
            PFlash0_Cached: vBaseEnvHwRegionStartAddress=2147483648, vBaseEnvHwRegionSize=1048576, vBaseEnvHwRegionType=ROM
            PFlash0_NonCached: vBaseEnvHwRegionStartAddress=2684354560, vBaseEnvHwRegionSize=1048576, vBaseEnvHwRegionType=ROM
            LMU0_Cached: vBaseEnvHwRegionStartAddress=2415919104, vBaseEnvHwRegionSize=8192, vBaseEnvHwRegionType=RAM
            LMU0_NonCached: vBaseEnvHwRegionStartAddress=2952790016, vBaseEnvHwRegionSize=8192, vBaseEnvHwRegionType=RAM
            BMHD0: vBaseEnvHwRegionStartAddress=2940207104, vBaseEnvHwRegionSize=512, vBaseEnvHwRegionType=ROM
            BMHD1: vBaseEnvHwRegionStartAddress=2940207616, vBaseEnvHwRegionSize=512, vBaseEnvHwRegionType=ROM
            BMHD2: vBaseEnvHwRegionStartAddress=2940208128, vBaseEnvHwRegionSize=512, vBaseEnvHwRegionType=ROM
            BMHD3: vBaseEnvHwRegionStartAddress=2940208640, vBaseEnvHwRegionSize=512, vBaseEnvHwRegionType=ROM
            OLDA_Cached: vBaseEnvHwRegionStartAddress=2413821952, vBaseEnvHwRegionSize=524288, vBaseEnvHwRegionType=RAM
            OLDA_NonCached: vBaseEnvHwRegionStartAddress=2950692864, vBaseEnvHwRegionSize=524288, vBaseEnvHwRegionType=RAM
            DLMU0_Cached: vBaseEnvHwRegionStartAddress=2415919104, vBaseEnvHwRegionSize=8192, vBaseEnvHwRegionType=RAM
            DLMU0_NonCached: vBaseEnvHwRegionStartAddress=2952790016, vBaseEnvHwRegionSize=8192, vBaseEnvHwRegionType=RAM
            DFlash0: vBaseEnvHwRegionStartAddress=2936012800, vBaseEnvHwRegionSize=1048576, vBaseEnvHwRegionType=ROM
            DFlash1: vBaseEnvHwRegionStartAddress=2948595712, vBaseEnvHwRegionSize=131072, vBaseEnvHwRegionType=ROM
        TC337D: vBaseEnvCpuCoreAmount=2, vBaseEnvCpuMaxFrequency=300000000, vBaseEnvTestedDerivative=TC33x, vBaseEnvTestedDerivativeDescription=Infineon Aurix 2G TC33x Family, vBaseEnvAvailableChannels_Can=4, vBaseEnvAvailableChannels_Ethernet=1, vBaseEnvAvailableChannels_Flexray=0, vBaseEnvAvailableChannels_Lin=6
          vBaseEnvAdditionalParameters: vBaseEnvWatchdogGroup=B, vBaseEnvPllGroup=B, vBaseEnvPortGroup=B, vBaseEnvResetGroup=B, vBaseEnvDerivativeGroup=TC3xx
          24 x vBaseEnvMemLayoutHwRegion:
            DSPR0: vBaseEnvHwRegionStartAddress=1879048192, vBaseEnvHwRegionSize=196608, vBaseEnvHwRegionType=RAM
            PSPR0: vBaseEnvHwRegionStartAddress=1880096768, vBaseEnvHwRegionSize=32768, vBaseEnvHwRegionType=RAM
            DSPR1: vBaseEnvHwRegionStartAddress=1610612736, vBaseEnvHwRegionSize=98304, vBaseEnvHwRegionType=RAM
            PSPR1: vBaseEnvHwRegionStartAddress=1611661312, vBaseEnvHwRegionSize=65536, vBaseEnvHwRegionType=RAM
            PFlash0_Cached: vBaseEnvHwRegionStartAddress=2147483648, vBaseEnvHwRegionSize=2097152, vBaseEnvHwRegionType=ROM
            PFlash0_NonCached: vBaseEnvHwRegionStartAddress=2684354560, vBaseEnvHwRegionSize=2097152, vBaseEnvHwRegionType=ROM
            LMU0_Cached: vBaseEnvHwRegionStartAddress=2415919104, vBaseEnvHwRegionSize=8192, vBaseEnvHwRegionType=RAM
            LMU0_NonCached: vBaseEnvHwRegionStartAddress=2952790016, vBaseEnvHwRegionSize=8192, vBaseEnvHwRegionType=RAM
            LMU1_Cached: vBaseEnvHwRegionStartAddress=2415984640, vBaseEnvHwRegionSize=65536, vBaseEnvHwRegionType=RAM
            LMU1_NonCached: vBaseEnvHwRegionStartAddress=2952855552, vBaseEnvHwRegionSize=65536, vBaseEnvHwRegionType=RAM
            BMHD0: vBaseEnvHwRegionStartAddress=2940207104, vBaseEnvHwRegionSize=512, vBaseEnvHwRegionType=ROM
            BMHD1: vBaseEnvHwRegionStartAddress=2940207616, vBaseEnvHwRegionSize=512, vBaseEnvHwRegionType=ROM
            BMHD2: vBaseEnvHwRegionStartAddress=2940208128, vBaseEnvHwRegionSize=512, vBaseEnvHwRegionType=ROM
            BMHD3: vBaseEnvHwRegionStartAddress=2940208640, vBaseEnvHwRegionSize=512, vBaseEnvHwRegionType=ROM
            OLDA_Cached: vBaseEnvHwRegionStartAddress=2413821952, vBaseEnvHwRegionSize=524288, vBaseEnvHwRegionType=RAM
            OLDA_NonCached: vBaseEnvHwRegionStartAddress=2950692864, vBaseEnvHwRegionSize=524288, vBaseEnvHwRegionType=RAM
            DLMU0_Cached: vBaseEnvHwRegionStartAddress=2415919104, vBaseEnvHwRegionSize=8192, vBaseEnvHwRegionType=RAM
            DLMU0_NonCached: vBaseEnvHwRegionStartAddress=2952790016, vBaseEnvHwRegionSize=8192, vBaseEnvHwRegionType=RAM
            DLMU1_Cached: vBaseEnvHwRegionStartAddress=2415984640, vBaseEnvHwRegionSize=65536, vBaseEnvHwRegionType=RAM
            DLMU1_NonCached: vBaseEnvHwRegionStartAddress=2952855552, vBaseEnvHwRegionSize=65536, vBaseEnvHwRegionType=RAM
            DFlash0: vBaseEnvHwRegionStartAddress=2936012800, vBaseEnvHwRegionSize=1048576, vBaseEnvHwRegionType=ROM
            DFlash1: vBaseEnvHwRegionStartAddress=2948595712, vBaseEnvHwRegionSize=131072, vBaseEnvHwRegionType=ROM
            EMEM0_Cached: vBaseEnvHwRegionStartAddress=2566914048, vBaseEnvHwRegionSize=1048576, vBaseEnvHwRegionType=RAM
            EMEM1_NonCached: vBaseEnvHwRegionStartAddress=3103784960, vBaseEnvHwRegionSize=1048576, vBaseEnvHwRegionType=RAM
        TC336D: vBaseEnvCpuCoreAmount=2, vBaseEnvCpuMaxFrequency=300000000, vBaseEnvTestedDerivative=TC33x, vBaseEnvTestedDerivativeDescription=Infineon Aurix 2G TC33x Family, vBaseEnvAvailableChannels_Can=4, vBaseEnvAvailableChannels_Ethernet=1, vBaseEnvAvailableChannels_Flexray=0, vBaseEnvAvailableChannels_Lin=5
          vBaseEnvAdditionalParameters: vBaseEnvWatchdogGroup=B, vBaseEnvPllGroup=B, vBaseEnvPortGroup=B, vBaseEnvResetGroup=B, vBaseEnvDerivativeGroup=TC3xx
          24 x vBaseEnvMemLayoutHwRegion:
            DSPR0: vBaseEnvHwRegionStartAddress=1879048192, vBaseEnvHwRegionSize=196608, vBaseEnvHwRegionType=RAM
            PSPR0: vBaseEnvHwRegionStartAddress=1880096768, vBaseEnvHwRegionSize=32768, vBaseEnvHwRegionType=RAM
            DSPR1: vBaseEnvHwRegionStartAddress=1610612736, vBaseEnvHwRegionSize=98304, vBaseEnvHwRegionType=RAM
            PSPR1: vBaseEnvHwRegionStartAddress=1611661312, vBaseEnvHwRegionSize=65536, vBaseEnvHwRegionType=RAM
            PFlash0_Cached: vBaseEnvHwRegionStartAddress=2147483648, vBaseEnvHwRegionSize=2097152, vBaseEnvHwRegionType=ROM
            PFlash0_NonCached: vBaseEnvHwRegionStartAddress=2684354560, vBaseEnvHwRegionSize=2097152, vBaseEnvHwRegionType=ROM
            LMU0_Cached: vBaseEnvHwRegionStartAddress=2415919104, vBaseEnvHwRegionSize=8192, vBaseEnvHwRegionType=RAM
            LMU0_NonCached: vBaseEnvHwRegionStartAddress=2952790016, vBaseEnvHwRegionSize=8192, vBaseEnvHwRegionType=RAM
            LMU1_Cached: vBaseEnvHwRegionStartAddress=2415984640, vBaseEnvHwRegionSize=65536, vBaseEnvHwRegionType=RAM
            LMU1_NonCached: vBaseEnvHwRegionStartAddress=2952855552, vBaseEnvHwRegionSize=65536, vBaseEnvHwRegionType=RAM
            BMHD0: vBaseEnvHwRegionStartAddress=2940207104, vBaseEnvHwRegionSize=512, vBaseEnvHwRegionType=ROM
            BMHD1: vBaseEnvHwRegionStartAddress=2940207616, vBaseEnvHwRegionSize=512, vBaseEnvHwRegionType=ROM
            BMHD2: vBaseEnvHwRegionStartAddress=2940208128, vBaseEnvHwRegionSize=512, vBaseEnvHwRegionType=ROM
            BMHD3: vBaseEnvHwRegionStartAddress=2940208640, vBaseEnvHwRegionSize=512, vBaseEnvHwRegionType=ROM
            OLDA_Cached: vBaseEnvHwRegionStartAddress=2413821952, vBaseEnvHwRegionSize=524288, vBaseEnvHwRegionType=RAM
            OLDA_NonCached: vBaseEnvHwRegionStartAddress=2950692864, vBaseEnvHwRegionSize=524288, vBaseEnvHwRegionType=RAM
            DLMU0_Cached: vBaseEnvHwRegionStartAddress=2415919104, vBaseEnvHwRegionSize=8192, vBaseEnvHwRegionType=RAM
            DLMU0_NonCached: vBaseEnvHwRegionStartAddress=2952790016, vBaseEnvHwRegionSize=8192, vBaseEnvHwRegionType=RAM
            DLMU1_Cached: vBaseEnvHwRegionStartAddress=2415984640, vBaseEnvHwRegionSize=65536, vBaseEnvHwRegionType=RAM
            DLMU1_NonCached: vBaseEnvHwRegionStartAddress=2952855552, vBaseEnvHwRegionSize=65536, vBaseEnvHwRegionType=RAM
            DFlash0: vBaseEnvHwRegionStartAddress=2936012800, vBaseEnvHwRegionSize=1048576, vBaseEnvHwRegionType=ROM
            DFlash1: vBaseEnvHwRegionStartAddress=2948595712, vBaseEnvHwRegionSize=131072, vBaseEnvHwRegionType=ROM
            EMEM0_Cached: vBaseEnvHwRegionStartAddress=2566914048, vBaseEnvHwRegionSize=1048576, vBaseEnvHwRegionType=RAM
            EMEM1_NonCached: vBaseEnvHwRegionStartAddress=3103784960, vBaseEnvHwRegionSize=1048576, vBaseEnvHwRegionType=RAM
        TC399X_StepA: vBaseEnvCpuCoreAmount=6, vBaseEnvCpuMaxFrequency=300000000, vBaseEnvTestedDerivative=TC39x, vBaseEnvTestedDerivativeDescription=Infineon Aurix 2G TC39x Family, vBaseEnvAvailableChannels_Can=12, vBaseEnvAvailableChannels_Ethernet=1, vBaseEnvAvailableChannels_Flexray=4, vBaseEnvAvailableChannels_Lin=8
          vBaseEnvAdditionalParameters: vBaseEnvWatchdogGroup=B, vBaseEnvPllGroup=C, vBaseEnvPortGroup=B, vBaseEnvResetGroup=B, vBaseEnvDerivativeGroup=TC3xx
          62 x vBaseEnvMemLayoutHwRegion:
            DSPR0: vBaseEnvHwRegionStartAddress=1879048192, vBaseEnvHwRegionSize=245760, vBaseEnvHwRegionType=RAM
            PSPR0: vBaseEnvHwRegionStartAddress=1880096768, vBaseEnvHwRegionSize=65536, vBaseEnvHwRegionType=RAM
            DSPR1: vBaseEnvHwRegionStartAddress=1610612736, vBaseEnvHwRegionSize=245760, vBaseEnvHwRegionType=RAM
            PSPR1: vBaseEnvHwRegionStartAddress=1611661312, vBaseEnvHwRegionSize=65536, vBaseEnvHwRegionType=RAM
            DSPR2: vBaseEnvHwRegionStartAddress=1342177280, vBaseEnvHwRegionSize=98304, vBaseEnvHwRegionType=RAM
            PSPR2: vBaseEnvHwRegionStartAddress=1343225856, vBaseEnvHwRegionSize=65536, vBaseEnvHwRegionType=RAM
            DSPR3: vBaseEnvHwRegionStartAddress=1073741824, vBaseEnvHwRegionSize=98304, vBaseEnvHwRegionType=RAM
            PSPR3: vBaseEnvHwRegionStartAddress=1074790400, vBaseEnvHwRegionSize=98304, vBaseEnvHwRegionType=RAM
            DSPR4: vBaseEnvHwRegionStartAddress=805306368, vBaseEnvHwRegionSize=98304, vBaseEnvHwRegionType=RAM
            PSPR4: vBaseEnvHwRegionStartAddress=806354944, vBaseEnvHwRegionSize=98304, vBaseEnvHwRegionType=RAM
            DSPR5: vBaseEnvHwRegionSize=98304, vBaseEnvHwRegionStartAddress=268435456, vBaseEnvHwRegionType=RAM
            PSPR5: vBaseEnvHwRegionStartAddress=269484032, vBaseEnvHwRegionSize=98304, vBaseEnvHwRegionType=RAM
            PFlash0_Cached: vBaseEnvHwRegionStartAddress=2147483648, vBaseEnvHwRegionSize=3145728, vBaseEnvHwRegionType=ROM
            PFlash0_NonCached: vBaseEnvHwRegionStartAddress=2684354560, vBaseEnvHwRegionSize=3145728, vBaseEnvHwRegionType=ROM
            PFlash1_Cached: vBaseEnvHwRegionStartAddress=2150629376, vBaseEnvHwRegionSize=3145728, vBaseEnvHwRegionType=ROM
            PFlash1_NonCached: vBaseEnvHwRegionStartAddress=2687500288, vBaseEnvHwRegionSize=3145728, vBaseEnvHwRegionType=ROM
            PFlash2_Cached: vBaseEnvHwRegionStartAddress=2153775104, vBaseEnvHwRegionSize=3145728, vBaseEnvHwRegionType=ROM
            PFlash2_NonCached: vBaseEnvHwRegionStartAddress=2690646016, vBaseEnvHwRegionSize=3145728, vBaseEnvHwRegionType=ROM
            PFlash3_Cached: vBaseEnvHwRegionStartAddress=2156920832, vBaseEnvHwRegionSize=3145728, vBaseEnvHwRegionType=ROM
            PFlash3_NonCached: vBaseEnvHwRegionStartAddress=2693791744, vBaseEnvHwRegionSize=3145728, vBaseEnvHwRegionType=ROM
            PFlash4_Cached: vBaseEnvHwRegionStartAddress=2160066560, vBaseEnvHwRegionSize=3145728, vBaseEnvHwRegionType=ROM
            PFlash4_NonCached: vBaseEnvHwRegionStartAddress=2696937472, vBaseEnvHwRegionSize=3145728, vBaseEnvHwRegionType=ROM
            PFlash5_Cached: vBaseEnvHwRegionStartAddress=2163212288, vBaseEnvHwRegionSize=1048576, vBaseEnvHwRegionType=ROM
            PFlash5_NonCached: vBaseEnvHwRegionStartAddress=2700083200, vBaseEnvHwRegionSize=1048576, vBaseEnvHwRegionType=ROM
            LMU0_Cached: vBaseEnvHwRegionStartAddress=2416181248, vBaseEnvHwRegionSize=262144, vBaseEnvHwRegionType=RAM
            LMU0_NonCached: vBaseEnvHwRegionStartAddress=2953052160, vBaseEnvHwRegionSize=262144, vBaseEnvHwRegionType=RAM
            LMU1_Cached: vBaseEnvHwRegionStartAddress=2416443392, vBaseEnvHwRegionSize=262144, vBaseEnvHwRegionType=RAM
            LMU1_NonCached: vBaseEnvHwRegionStartAddress=2953314304, vBaseEnvHwRegionSize=262144, vBaseEnvHwRegionType=RAM
            LMU2_Cached: vBaseEnvHwRegionStartAddress=2416705536, vBaseEnvHwRegionSize=262144, vBaseEnvHwRegionType=RAM
            LMU2_NonCached: vBaseEnvHwRegionStartAddress=2953576448, vBaseEnvHwRegionSize=262144, vBaseEnvHwRegionType=RAM
            BMHD0: vBaseEnvHwRegionStartAddress=2940207104, vBaseEnvHwRegionSize=512, vBaseEnvHwRegionType=ROM
            BMHD1: vBaseEnvHwRegionStartAddress=2940207616, vBaseEnvHwRegionSize=512, vBaseEnvHwRegionType=ROM
            BMHD2: vBaseEnvHwRegionStartAddress=2940208128, vBaseEnvHwRegionSize=512, vBaseEnvHwRegionType=ROM
            BMHD3: vBaseEnvHwRegionStartAddress=2940208640, vBaseEnvHwRegionSize=512, vBaseEnvHwRegionType=ROM
            DLMU0_Cached: vBaseEnvHwRegionStartAddress=2415919104, vBaseEnvHwRegionSize=65536, vBaseEnvHwRegionType=RAM
            DLMU1_Cached: vBaseEnvHwRegionStartAddress=2415984640, vBaseEnvHwRegionSize=65536, vBaseEnvHwRegionType=RAM
            DLMU2_Cached: vBaseEnvHwRegionStartAddress=2416050176, vBaseEnvHwRegionSize=65536, vBaseEnvHwRegionType=RAM
            DLMU3_Cached: vBaseEnvHwRegionStartAddress=2416115712, vBaseEnvHwRegionSize=65536, vBaseEnvHwRegionType=RAM
            DLMU4_Cached: vBaseEnvHwRegionStartAddress=2416967680, vBaseEnvHwRegionSize=65536, vBaseEnvHwRegionType=RAM
            DLMU5_Cached: vBaseEnvHwRegionStartAddress=2417033216, vBaseEnvHwRegionSize=65536, vBaseEnvHwRegionType=RAM
            DLMU0_NonCached: vBaseEnvHwRegionStartAddress=2952790016, vBaseEnvHwRegionSize=65536, vBaseEnvHwRegionType=RAM
            DLMU1_NonCached: vBaseEnvHwRegionStartAddress=2952855552, vBaseEnvHwRegionSize=65536, vBaseEnvHwRegionType=RAM
            DLMU2_NonCached: vBaseEnvHwRegionStartAddress=2952921088, vBaseEnvHwRegionSize=65536, vBaseEnvHwRegionType=RAM
            DLMU3_NonCached: vBaseEnvHwRegionStartAddress=2952986624, vBaseEnvHwRegionSize=65536, vBaseEnvHwRegionType=RAM
            DLMU4_NonCached: vBaseEnvHwRegionStartAddress=2953838592, vBaseEnvHwRegionSize=65536, vBaseEnvHwRegionType=RAM
            DLMU5_NonCached: vBaseEnvHwRegionStartAddress=2953904128, vBaseEnvHwRegionSize=65536, vBaseEnvHwRegionType=RAM
            OLDA_Cached: vBaseEnvHwRegionStartAddress=2413821952, vBaseEnvHwRegionSize=524288, vBaseEnvHwRegionType=RAM
            OLDA_NonCached: vBaseEnvHwRegionStartAddress=2950692864, vBaseEnvHwRegionSize=524288, vBaseEnvHwRegionType=RAM
            DAM0_Cached: vBaseEnvHwRegionStartAddress=2420113408, vBaseEnvHwRegionSize=65536, vBaseEnvHwRegionType=RAM
            DAM0_NonCached: vBaseEnvHwRegionStartAddress=2956984320, vBaseEnvHwRegionSize=65536, vBaseEnvHwRegionType=RAM
            DAM1_Cached: vBaseEnvHwRegionStartAddress=2420178944, vBaseEnvHwRegionSize=65536, vBaseEnvHwRegionType=RAM
            DAM1_NonCached: vBaseEnvHwRegionStartAddress=2957049856, vBaseEnvHwRegionSize=65536, vBaseEnvHwRegionType=RAM
            EMEM0_Cached: vBaseEnvHwRegionStartAddress=2566914048, vBaseEnvHwRegionSize=1048576, vBaseEnvHwRegionType=RAM
            EMEM0_NonCached: vBaseEnvHwRegionStartAddress=3103784960, vBaseEnvHwRegionSize=1048576, vBaseEnvHwRegionType=RAM
            EMEM1_Cached: vBaseEnvHwRegionStartAddress=2567962624, vBaseEnvHwRegionSize=1048576, vBaseEnvHwRegionType=RAM
            EMEM1_NonCached: vBaseEnvHwRegionStartAddress=3104833536, vBaseEnvHwRegionSize=1048576, vBaseEnvHwRegionType=RAM
            EMEM2_Cached: vBaseEnvHwRegionStartAddress=2569011200, vBaseEnvHwRegionSize=1048576, vBaseEnvHwRegionType=RAM
            EMEM2_NonCached: vBaseEnvHwRegionStartAddress=3105882112, vBaseEnvHwRegionSize=1048576, vBaseEnvHwRegionType=RAM
            EMEM3_Cached: vBaseEnvHwRegionStartAddress=2570059776, vBaseEnvHwRegionSize=1048576, vBaseEnvHwRegionType=RAM
            EMEM3_NonCached: vBaseEnvHwRegionStartAddress=3106930688, vBaseEnvHwRegionSize=1048576, vBaseEnvHwRegionType=RAM
            DFlash0: vBaseEnvHwRegionStartAddress=2936012800, vBaseEnvHwRegionSize=1048576, vBaseEnvHwRegionType=ROM
            DFlash1: vBaseEnvHwRegionStartAddress=2948595712, vBaseEnvHwRegionSize=131072, vBaseEnvHwRegionType=ROM
        TC397X_StepA: vBaseEnvCpuCoreAmount=6, vBaseEnvCpuMaxFrequency=300000000, vBaseEnvTestedDerivative=TC39x, vBaseEnvTestedDerivativeDescription=Infineon Aurix 2G TC39x Family, vBaseEnvAvailableChannels_Can=12, vBaseEnvAvailableChannels_Ethernet=1, vBaseEnvAvailableChannels_Flexray=4, vBaseEnvAvailableChannels_Lin=8
          vBaseEnvAdditionalParameters: vBaseEnvWatchdogGroup=B, vBaseEnvPllGroup=C, vBaseEnvPortGroup=B, vBaseEnvResetGroup=B, vBaseEnvDerivativeGroup=TC3xx
          62 x vBaseEnvMemLayoutHwRegion:
            DSPR0: vBaseEnvHwRegionStartAddress=1879048192, vBaseEnvHwRegionSize=245760, vBaseEnvHwRegionType=RAM
            PSPR0: vBaseEnvHwRegionStartAddress=1880096768, vBaseEnvHwRegionSize=65536, vBaseEnvHwRegionType=RAM
            DSPR1: vBaseEnvHwRegionStartAddress=1610612736, vBaseEnvHwRegionSize=245760, vBaseEnvHwRegionType=RAM
            PSPR1: vBaseEnvHwRegionStartAddress=1611661312, vBaseEnvHwRegionSize=65536, vBaseEnvHwRegionType=RAM
            DSPR2: vBaseEnvHwRegionStartAddress=1342177280, vBaseEnvHwRegionSize=98304, vBaseEnvHwRegionType=RAM
            PSPR2: vBaseEnvHwRegionStartAddress=1343225856, vBaseEnvHwRegionSize=65536, vBaseEnvHwRegionType=RAM
            DSPR3: vBaseEnvHwRegionStartAddress=1073741824, vBaseEnvHwRegionSize=98304, vBaseEnvHwRegionType=RAM
            PSPR3: vBaseEnvHwRegionStartAddress=1074790400, vBaseEnvHwRegionSize=98304, vBaseEnvHwRegionType=RAM
            DSPR4: vBaseEnvHwRegionStartAddress=805306368, vBaseEnvHwRegionSize=98304, vBaseEnvHwRegionType=RAM
            PSPR4: vBaseEnvHwRegionStartAddress=806354944, vBaseEnvHwRegionSize=98304, vBaseEnvHwRegionType=RAM
            DSPR5: vBaseEnvHwRegionSize=98304, vBaseEnvHwRegionStartAddress=268435456, vBaseEnvHwRegionType=RAM
            PSPR5: vBaseEnvHwRegionStartAddress=269484032, vBaseEnvHwRegionSize=98304, vBaseEnvHwRegionType=RAM
            PFlash0_Cached: vBaseEnvHwRegionStartAddress=2147483648, vBaseEnvHwRegionSize=3145728, vBaseEnvHwRegionType=ROM
            PFlash0_NonCached: vBaseEnvHwRegionStartAddress=2684354560, vBaseEnvHwRegionSize=3145728, vBaseEnvHwRegionType=ROM
            PFlash1_Cached: vBaseEnvHwRegionStartAddress=2150629376, vBaseEnvHwRegionSize=3145728, vBaseEnvHwRegionType=ROM
            PFlash1_NonCached: vBaseEnvHwRegionStartAddress=2687500288, vBaseEnvHwRegionSize=3145728, vBaseEnvHwRegionType=ROM
            PFlash2_Cached: vBaseEnvHwRegionStartAddress=2153775104, vBaseEnvHwRegionSize=3145728, vBaseEnvHwRegionType=ROM
            PFlash2_NonCached: vBaseEnvHwRegionStartAddress=2690646016, vBaseEnvHwRegionSize=3145728, vBaseEnvHwRegionType=ROM
            PFlash3_Cached: vBaseEnvHwRegionStartAddress=2156920832, vBaseEnvHwRegionSize=3145728, vBaseEnvHwRegionType=ROM
            PFlash3_NonCached: vBaseEnvHwRegionStartAddress=2693791744, vBaseEnvHwRegionSize=3145728, vBaseEnvHwRegionType=ROM
            PFlash4_Cached: vBaseEnvHwRegionStartAddress=2160066560, vBaseEnvHwRegionSize=3145728, vBaseEnvHwRegionType=ROM
            PFlash4_NonCached: vBaseEnvHwRegionStartAddress=2696937472, vBaseEnvHwRegionSize=3145728, vBaseEnvHwRegionType=ROM
            PFlash5_Cached: vBaseEnvHwRegionStartAddress=2163212288, vBaseEnvHwRegionSize=1048576, vBaseEnvHwRegionType=ROM
            PFlash5_NonCached: vBaseEnvHwRegionStartAddress=2700083200, vBaseEnvHwRegionSize=1048576, vBaseEnvHwRegionType=ROM
            LMU0_Cached: vBaseEnvHwRegionStartAddress=2416181248, vBaseEnvHwRegionSize=262144, vBaseEnvHwRegionType=RAM
            LMU0_NonCached: vBaseEnvHwRegionStartAddress=2953052160, vBaseEnvHwRegionSize=262144, vBaseEnvHwRegionType=RAM
            LMU1_Cached: vBaseEnvHwRegionStartAddress=2416443392, vBaseEnvHwRegionSize=262144, vBaseEnvHwRegionType=RAM
            LMU1_NonCached: vBaseEnvHwRegionStartAddress=2953314304, vBaseEnvHwRegionSize=262144, vBaseEnvHwRegionType=RAM
            LMU2_Cached: vBaseEnvHwRegionStartAddress=2416705536, vBaseEnvHwRegionSize=262144, vBaseEnvHwRegionType=RAM
            LMU2_NonCached: vBaseEnvHwRegionStartAddress=2953576448, vBaseEnvHwRegionSize=262144, vBaseEnvHwRegionType=RAM
            BMHD0: vBaseEnvHwRegionStartAddress=2940207104, vBaseEnvHwRegionSize=512, vBaseEnvHwRegionType=ROM
            BMHD1: vBaseEnvHwRegionStartAddress=2940207616, vBaseEnvHwRegionSize=512, vBaseEnvHwRegionType=ROM
            BMHD2: vBaseEnvHwRegionStartAddress=2940208128, vBaseEnvHwRegionSize=512, vBaseEnvHwRegionType=ROM
            BMHD3: vBaseEnvHwRegionStartAddress=2940208640, vBaseEnvHwRegionSize=512, vBaseEnvHwRegionType=ROM
            DLMU0_Cached: vBaseEnvHwRegionStartAddress=2415919104, vBaseEnvHwRegionSize=65536, vBaseEnvHwRegionType=RAM
            DLMU1_Cached: vBaseEnvHwRegionStartAddress=2415984640, vBaseEnvHwRegionSize=65536, vBaseEnvHwRegionType=RAM
            DLMU2_Cached: vBaseEnvHwRegionStartAddress=2416050176, vBaseEnvHwRegionSize=65536, vBaseEnvHwRegionType=RAM
            DLMU3_Cached: vBaseEnvHwRegionStartAddress=2416115712, vBaseEnvHwRegionSize=65536, vBaseEnvHwRegionType=RAM
            DLMU4_Cached: vBaseEnvHwRegionStartAddress=2416967680, vBaseEnvHwRegionSize=65536, vBaseEnvHwRegionType=RAM
            DLMU5_Cached: vBaseEnvHwRegionStartAddress=2417033216, vBaseEnvHwRegionSize=65536, vBaseEnvHwRegionType=RAM
            DLMU0_NonCached: vBaseEnvHwRegionStartAddress=2952790016, vBaseEnvHwRegionSize=65536, vBaseEnvHwRegionType=RAM
            DLMU1_NonCached: vBaseEnvHwRegionStartAddress=2952855552, vBaseEnvHwRegionSize=65536, vBaseEnvHwRegionType=RAM
            DLMU2_NonCached: vBaseEnvHwRegionStartAddress=2952921088, vBaseEnvHwRegionSize=65536, vBaseEnvHwRegionType=RAM
            DLMU3_NonCached: vBaseEnvHwRegionStartAddress=2952986624, vBaseEnvHwRegionSize=65536, vBaseEnvHwRegionType=RAM
            DLMU4_NonCached: vBaseEnvHwRegionStartAddress=2953838592, vBaseEnvHwRegionSize=65536, vBaseEnvHwRegionType=RAM
            DLMU5_NonCached: vBaseEnvHwRegionStartAddress=2953904128, vBaseEnvHwRegionSize=65536, vBaseEnvHwRegionType=RAM
            OLDA_Cached: vBaseEnvHwRegionStartAddress=2413821952, vBaseEnvHwRegionSize=524288, vBaseEnvHwRegionType=RAM
            OLDA_NonCached: vBaseEnvHwRegionStartAddress=2950692864, vBaseEnvHwRegionSize=524288, vBaseEnvHwRegionType=RAM
            DAM0_Cached: vBaseEnvHwRegionStartAddress=2420113408, vBaseEnvHwRegionSize=65536, vBaseEnvHwRegionType=RAM
            DAM0_NonCached: vBaseEnvHwRegionStartAddress=2956984320, vBaseEnvHwRegionSize=65536, vBaseEnvHwRegionType=RAM
            DAM1_Cached: vBaseEnvHwRegionStartAddress=2420178944, vBaseEnvHwRegionSize=65536, vBaseEnvHwRegionType=RAM
            DAM1_NonCached: vBaseEnvHwRegionStartAddress=2957049856, vBaseEnvHwRegionSize=65536, vBaseEnvHwRegionType=RAM
            EMEM0_Cached: vBaseEnvHwRegionStartAddress=2566914048, vBaseEnvHwRegionSize=1048576, vBaseEnvHwRegionType=RAM
            EMEM0_NonCached: vBaseEnvHwRegionStartAddress=3103784960, vBaseEnvHwRegionSize=1048576, vBaseEnvHwRegionType=RAM
            EMEM1_Cached: vBaseEnvHwRegionStartAddress=2567962624, vBaseEnvHwRegionSize=1048576, vBaseEnvHwRegionType=RAM
            EMEM1_NonCached: vBaseEnvHwRegionStartAddress=3104833536, vBaseEnvHwRegionSize=1048576, vBaseEnvHwRegionType=RAM
            EMEM2_Cached: vBaseEnvHwRegionStartAddress=2569011200, vBaseEnvHwRegionSize=1048576, vBaseEnvHwRegionType=RAM
            EMEM2_NonCached: vBaseEnvHwRegionStartAddress=3105882112, vBaseEnvHwRegionSize=1048576, vBaseEnvHwRegionType=RAM
            EMEM3_Cached: vBaseEnvHwRegionStartAddress=2570059776, vBaseEnvHwRegionSize=1048576, vBaseEnvHwRegionType=RAM
            EMEM3_NonCached: vBaseEnvHwRegionStartAddress=3106930688, vBaseEnvHwRegionSize=1048576, vBaseEnvHwRegionType=RAM
            DFlash0: vBaseEnvHwRegionStartAddress=2936012800, vBaseEnvHwRegionSize=1048576, vBaseEnvHwRegionType=ROM
            DFlash1: vBaseEnvHwRegionStartAddress=2948595712, vBaseEnvHwRegionSize=131072, vBaseEnvHwRegionType=ROM
      12 x vBaseEnvMemLayoutHwRegion:
        OLDA_Cached
        OLDA_NonCached
        DLMU0_Cached
        DLMU0_NonCached
        DLMU1_Cached
        DLMU1_NonCached
        DFlash0
        DFlash1
        EMEM0_Cached
        EMEM1_NonCached
        DAM0_Cached
        DAM0_NonCached
      TC3E7Q (vBaseEnvDerivativeInformation):
        vBaseEnvCpuCoreAmount = 4
        vBaseEnvCpuMaxFrequency = 300000000
        vBaseEnvTestedDerivative = TC38x
        vBaseEnvTestedDerivativeDescription = Infineon Aurix 2G TC38x Family
        vBaseEnvAvailableChannels_Can = 20
        vBaseEnvAvailableChannels_Ethernet = 1
        vBaseEnvAvailableChannels_Flexray = 4
        vBaseEnvAvailableChannels_Lin = 24
        vBaseEnvCpuCore = TC162
        vBaseEnvAvailableChannels_Spi = 0
        vBaseEnvAvailableChannels_I2c = 0
        vBaseEnvAvailableChannels_Hyperbus = 0
        vBaseEnvAdditionalParameters: vBaseEnvWatchdogGroup=B, vBaseEnvPllGroup=B, vBaseEnvPortGroup=B, vBaseEnvResetGroup=B, vBaseEnvDerivativeGroup=TC3xx
        36 x vBaseEnvMemLayoutHwRegion:
          DSPR0: vBaseEnvHwRegionStartAddress=1879048192, vBaseEnvHwRegionSize=245760, vBaseEnvHwRegionType=RAM
          PSPR0: vBaseEnvHwRegionStartAddress=1880096768, vBaseEnvHwRegionSize=65536, vBaseEnvHwRegionType=RAM
          DSPR1: vBaseEnvHwRegionStartAddress=1610612736, vBaseEnvHwRegionSize=245760, vBaseEnvHwRegionType=RAM
          PSPR1: vBaseEnvHwRegionStartAddress=1611661312, vBaseEnvHwRegionSize=65536, vBaseEnvHwRegionType=RAM
          DSPR2: vBaseEnvHwRegionStartAddress=1342177280, vBaseEnvHwRegionSize=98304, vBaseEnvHwRegionType=RAM
          PSPR2: vBaseEnvHwRegionStartAddress=1343225856, vBaseEnvHwRegionSize=65536, vBaseEnvHwRegionType=RAM
          DSPR3: vBaseEnvHwRegionStartAddress=1073741824, vBaseEnvHwRegionSize=98304, vBaseEnvHwRegionType=RAM
          PSPR3: vBaseEnvHwRegionStartAddress=1074790400, vBaseEnvHwRegionSize=65536, vBaseEnvHwRegionType=RAM
          PFlash0_Cached: vBaseEnvHwRegionStartAddress=2147483648, vBaseEnvHwRegionSize=3145728, vBaseEnvHwRegionType=ROM
          PFlash0_NonCached: vBaseEnvHwRegionStartAddress=2684354560, vBaseEnvHwRegionSize=3145728, vBaseEnvHwRegionType=ROM
          PFlash1_Cached: vBaseEnvHwRegionStartAddress=2150629376, vBaseEnvHwRegionSize=3145728, vBaseEnvHwRegionType=ROM
          PFlash1_NonCached: vBaseEnvHwRegionStartAddress=2687500288, vBaseEnvHwRegionSize=3145728, vBaseEnvHwRegionType=ROM
          PFlash2_Cached: vBaseEnvHwRegionStartAddress=2153775104, vBaseEnvHwRegionSize=3145728, vBaseEnvHwRegionType=ROM
          PFlash2_NonCached: vBaseEnvHwRegionStartAddress=2690646016, vBaseEnvHwRegionSize=3145728, vBaseEnvHwRegionType=ROM
          PFlash3_Cached: vBaseEnvHwRegionStartAddress=2156920832, vBaseEnvHwRegionSize=3145728, vBaseEnvHwRegionType=ROM
          PFlash3_NonCached: vBaseEnvHwRegionStartAddress=2693791744, vBaseEnvHwRegionSize=3145728, vBaseEnvHwRegionType=ROM
          LMU0_Cached: vBaseEnvHwRegionStartAddress=2416181248, vBaseEnvHwRegionSize=262144, vBaseEnvHwRegionType=RAM
          LMU0_NonCached: vBaseEnvHwRegionStartAddress=2953052160, vBaseEnvHwRegionSize=262144, vBaseEnvHwRegionType=RAM
          BMHD0: vBaseEnvHwRegionStartAddress=2940207104, vBaseEnvHwRegionSize=512, vBaseEnvHwRegionType=ROM
          BMHD1: vBaseEnvHwRegionStartAddress=2940207616, vBaseEnvHwRegionSize=512, vBaseEnvHwRegionType=ROM
          BMHD2: vBaseEnvHwRegionStartAddress=2940208128, vBaseEnvHwRegionSize=512, vBaseEnvHwRegionType=ROM
          BMHD3: vBaseEnvHwRegionStartAddress=2940208640, vBaseEnvHwRegionSize=512, vBaseEnvHwRegionType=ROM
          OLDA_Cached: vBaseEnvHwRegionStartAddress=2413821952, vBaseEnvHwRegionSize=524288, vBaseEnvHwRegionType=RAM
          OLDA_NonCached: vBaseEnvHwRegionStartAddress=2950692864, vBaseEnvHwRegionSize=524288, vBaseEnvHwRegionType=RAM
          DLMU0_Cached: vBaseEnvHwRegionStartAddress=2415919104, vBaseEnvHwRegionSize=65536, vBaseEnvHwRegionType=RAM
          DLMU0_NonCached: vBaseEnvHwRegionStartAddress=2952790016, vBaseEnvHwRegionSize=65536, vBaseEnvHwRegionType=RAM
          DLMU1_Cached: vBaseEnvHwRegionStartAddress=2415984640, vBaseEnvHwRegionSize=65536, vBaseEnvHwRegionType=RAM
          DLMU1_NonCached: vBaseEnvHwRegionStartAddress=2952855552, vBaseEnvHwRegionSize=65536, vBaseEnvHwRegionType=RAM
          DLMU2_Cached: vBaseEnvHwRegionStartAddress=2416050176, vBaseEnvHwRegionSize=65536, vBaseEnvHwRegionType=RAM
          DLMU2_NonCached: vBaseEnvHwRegionStartAddress=2952921088, vBaseEnvHwRegionSize=65536, vBaseEnvHwRegionType=RAM
          DLMU3_Cached: vBaseEnvHwRegionStartAddress=2416115712, vBaseEnvHwRegionSize=65536, vBaseEnvHwRegionType=RAM
          DLMU3_NonCached: vBaseEnvHwRegionStartAddress=2952986624, vBaseEnvHwRegionSize=65536, vBaseEnvHwRegionType=RAM
          DAM0_Cached: vBaseEnvHwRegionStartAddress=2956984320, vBaseEnvHwRegionSize=65536, vBaseEnvHwRegionType=RAM
          DAM0_NonCached: vBaseEnvHwRegionStartAddress=2420113408, vBaseEnvHwRegionSize=65536, vBaseEnvHwRegionType=RAM
          DFlash0: vBaseEnvHwRegionStartAddress=2936012800, vBaseEnvHwRegionSize=524288, vBaseEnvHwRegionType=ROM
          DFlash1: vBaseEnvHwRegionStartAddress=2948595712, vBaseEnvHwRegionSize=131072, vBaseEnvHwRegionType=ROM
      6 x vBaseEnvMemLayoutHwRegion:
        DLMU2_Cached
        DLMU2_NonCached
        DLMU3_Cached
        DLMU3_NonCached
        EMEM0_NonCached
        EMEM1_Cached
      TC377V (vBaseEnvDerivativeInformation):
        vBaseEnvCpuCoreAmount = 3
        vBaseEnvCpuMaxFrequency = 300000000
        vBaseEnvTestedDerivative = TC37x
        vBaseEnvTestedDerivativeDescription = Infineon Aurix 2G TC37x Family
        vBaseEnvAvailableChannels_Can = 8
        vBaseEnvAvailableChannels_Ethernet = 1
        vBaseEnvAvailableChannels_Flexray = 2
        vBaseEnvAvailableChannels_Lin = 12
        vBaseEnvCpuCore = TC162
        vBaseEnvAvailableChannels_Hyperbus = 0
        vBaseEnvAvailableChannels_I2c = 0
        vBaseEnvAvailableChannels_Spi = 0
        vBaseEnvAdditionalParameters: vBaseEnvWatchdogGroup=B, vBaseEnvPllGroup=B, vBaseEnvPortGroup=B, vBaseEnvResetGroup=B, vBaseEnvDerivativeGroup=TC3xx
        26 x vBaseEnvMemLayoutHwRegion:
          DSPR0: vBaseEnvHwRegionStartAddress=1879048192, vBaseEnvHwRegionSize=245760, vBaseEnvHwRegionType=RAM
          PSPR0: vBaseEnvHwRegionStartAddress=1880096768, vBaseEnvHwRegionSize=65536, vBaseEnvHwRegionType=RAM
          DSPR1: vBaseEnvHwRegionStartAddress=1610612736, vBaseEnvHwRegionSize=245760, vBaseEnvHwRegionType=RAM
          PSPR1: vBaseEnvHwRegionStartAddress=1611661312, vBaseEnvHwRegionSize=65536, vBaseEnvHwRegionType=RAM
          DSPR2: vBaseEnvHwRegionStartAddress=1342177280, vBaseEnvHwRegionSize=98304, vBaseEnvHwRegionType=RAM
          PSPR2: vBaseEnvHwRegionStartAddress=1343225856, vBaseEnvHwRegionSize=65536, vBaseEnvHwRegionType=RAM
          PFlash0_Cached: vBaseEnvHwRegionStartAddress=2147483648, vBaseEnvHwRegionSize=3145728, vBaseEnvHwRegionType=ROM
          PFlash0_NonCached: vBaseEnvHwRegionStartAddress=2684354560, vBaseEnvHwRegionSize=3145728, vBaseEnvHwRegionType=ROM
          PFlash1_Cached: vBaseEnvHwRegionStartAddress=2150629376, vBaseEnvHwRegionSize=3145728, vBaseEnvHwRegionType=ROM
          PFlash1_NonCached: vBaseEnvHwRegionStartAddress=2687500288, vBaseEnvHwRegionSize=3145728, vBaseEnvHwRegionType=ROM
          BMHD0: vBaseEnvHwRegionStartAddress=2940207104, vBaseEnvHwRegionSize=512, vBaseEnvHwRegionType=ROM
          BMHD1: vBaseEnvHwRegionStartAddress=2940207616, vBaseEnvHwRegionSize=512, vBaseEnvHwRegionType=ROM
          BMHD2: vBaseEnvHwRegionStartAddress=2940208128, vBaseEnvHwRegionSize=512, vBaseEnvHwRegionType=ROM
          BMHD3: vBaseEnvHwRegionStartAddress=2940208640, vBaseEnvHwRegionSize=512, vBaseEnvHwRegionType=ROM
          OLDA_Cached: vBaseEnvHwRegionStartAddress=2413821952, vBaseEnvHwRegionSize=524288, vBaseEnvHwRegionType=RAM
          OLDA_NonCached: vBaseEnvHwRegionStartAddress=2950692864, vBaseEnvHwRegionSize=524288, vBaseEnvHwRegionType=RAM
          DLMU0_Cached: vBaseEnvHwRegionStartAddress=2415919104, vBaseEnvHwRegionSize=65536, vBaseEnvHwRegionType=RAM
          DLMU0_NonCached: vBaseEnvHwRegionStartAddress=2952790016, vBaseEnvHwRegionSize=65536, vBaseEnvHwRegionType=RAM
          DLMU1_Cached: vBaseEnvHwRegionStartAddress=2415984640, vBaseEnvHwRegionSize=65536, vBaseEnvHwRegionType=RAM
          DLMU1_NonCached: vBaseEnvHwRegionStartAddress=2952855552, vBaseEnvHwRegionSize=65536, vBaseEnvHwRegionType=RAM
          DLMU2_Cached: vBaseEnvHwRegionStartAddress=2416050176, vBaseEnvHwRegionSize=65536, vBaseEnvHwRegionType=RAM
          DLMU2_NonCached: vBaseEnvHwRegionStartAddress=2952921088, vBaseEnvHwRegionSize=65536, vBaseEnvHwRegionType=RAM
          DAM0_Cached: vBaseEnvHwRegionStartAddress=2420113408, vBaseEnvHwRegionSize=32768, vBaseEnvHwRegionType=RAM
          DAM0_NonCached: vBaseEnvHwRegionStartAddress=2956984320, vBaseEnvHwRegionSize=32768, vBaseEnvHwRegionType=RAM
          DFlash0: vBaseEnvHwRegionStartAddress=2936012800, vBaseEnvHwRegionSize=131072, vBaseEnvHwRegionType=ROM
          DFlash1: vBaseEnvHwRegionStartAddress=2948595712, vBaseEnvHwRegionSize=131072, vBaseEnvHwRegionType=ROM
      10 x vBaseEnvMemLayoutHwRegion:
        DLMU4_Cached
        DLMU5_Cached
        DLMU4_NonCached
        DLMU5_NonCached
        DAM1_Cached
        DAM1_NonCached
        EMEM2_Cached
        EMEM2_NonCached
        EMEM3_Cached
        EMEM3_NonCached
