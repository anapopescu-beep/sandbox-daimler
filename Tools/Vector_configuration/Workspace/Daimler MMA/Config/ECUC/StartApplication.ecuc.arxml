AUTOSAR XML (schema 00049)
package /ActiveEcuC
  ecuc value collection ActiveEcuC: ecu-extract=SYSTEM
    ecuc-values:
      Com
      Os
      CanSM
      CanTp
      ComXf
      EcuC
      BswM
      vSet
      IpduM
      Rte
      EcuM
      E2EXf
      CanNm
      PduR
      Dcm
      Nm
      Can
      CanIf
      Det
      ComM
      Dem
      vBRS
      vBaseEnv
      vLinkGen
      McalLib
      ResourceM
      Mcu
      Port
      Dio
      Irq
      Dma
      Spi
      Icu
      Stm
      Wdg
      WdgIf
      WdgM
      Fls
      Fee
      MemIf
      NvM
      Crc
      SecOC
      CryIf
      Crypto_30_vHsm
      Crypto
      KeyM
      Ssa
      Csm
      vSecPrim
      SBC
      Adc
      AdcIf
      Gpt
      Pwm
      MemMap
      Smu
      RCM
      VTTMemMap
      Rtm
      CanTSyn
      StbM
