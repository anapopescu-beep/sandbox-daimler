AUTOSAR XML (schema 00049)
package /ActiveEcuC
  module config Rtm: implementation-config-variant=VARIANT-PRE-COMPILE, module-description=Rtm_Impl
    RtmGeneral:
      RtmSafeBswChecks = true
      RtmDevErrorDetect = true
      RtmGetMeasurementTimestampFct = Rtm_GetTimeMeasurement
      RtmMeasurementCtrFrequency = 5000
      RtmCtrDirection = RTM_UP
      RtmMainfunctionCycleTime = 0.01
      RtmTimerOverrunSupport = false
      Rtm32BitTimer = true
      RtmUseNestingCounter = true
      RtmUsedCoreMask = 1
      RtmControl = false
      RtmEcuName = Rtm
      RtmNvMTaskStackUsage = Rtm_MaxTaskStackUsage
    RtmCoreDefinition:
      RtmCoreDefinitionId = 0
      RtmBSWCore = true
      RtmCore = 0
      RtmNumberOfTaskResponseTimePercentiles = 10
      RtmBackgroundTaskName = BackgroundTask_Core0
      RtmNvMCpuLoadPersistencyBlock = Rtm_CpuLoadPersistencyData
    46 x RtmMeasurementPoint, all with RtmMeasurementEnabled=true, RtmDisableInterrupts=false, RtmMeasurementType=GrossExecutionTime, RtmTargetRuntime=0, RtmAssignedToCore=RtmCoreDefinition:
      Can_Init: RtmAutostartEnabled=false, RtmMeasurementId=16, RtmMeasurementPointType=Runtime, RtmMeasurementGroup=Can  # Can PLAIN_TEXT global initialization of the CAN module
      Can_SetControllerMode: RtmAutostartEnabled=false, RtmMeasurementId=17, RtmMeasurementPointType=Runtime, RtmMeasurementGroup=Can  # Can PLAIN_TEXT change hardware mode of the CAN controller
      Can_Write: RtmAutostartEnabled=false, RtmMeasurementId=18, RtmMeasurementPointType=Runtime, RtmMeasurementGroup=Can  # Can PLAIN_TEXT send CAN message
      CanInterrupt: RtmAutostartEnabled=false, RtmMeasurementId=15, RtmMeasurementPointType=Runtime, RtmMeasurementGroup=Can  # Can PLAIN_TEXT CanIsr
      CANNM_SID_INIT: RtmAutostartEnabled=false, RtmMeasurementId=7, RtmMeasurementPointType=Runtime, RtmMeasurementGroup=CanNm  # CanNm PLAIN_TEXT Measurement point that measures the CanNm_Init function
      CANNM_SID_PASSIVESTARTUP: RtmAutostartEnabled=false, RtmMeasurementId=11, RtmMeasurementPointType=Runtime, RtmMeasurementGroup=CanNm  # CanNm PLAIN_TEXT Measurement point that measures the CanNm_PassiveStartUp function
      CANNM_SID_GETSTATE: RtmAutostartEnabled=false, RtmMeasurementId=6, RtmMeasurementPointType=Runtime, RtmMeasurementGroup=CanNm  # CanNm PLAIN_TEXT Measurement point that measures the CanNm_GetState function
      CANNM_SID_MAINFUNCTION: RtmAutostartEnabled=false, RtmMeasurementId=8, RtmMeasurementPointType=Runtime, RtmMeasurementGroup=CanNm  # CanNm PLAIN_TEXT Measurement point that measures the CanNm_MainFunction function
      CANNM_SID_RXINDICATION: RtmAutostartEnabled=false, RtmMeasurementId=12, RtmMeasurementPointType=Runtime, RtmMeasurementGroup=CanNm  # CanNm PLAIN_TEXT Measurement point that measures the CanNm_RxIndication function
      CANNM_SID_CONFIRMPNAVAILABILITY: RtmAutostartEnabled=false, RtmMeasurementId=3, RtmMeasurementPointType=Runtime, RtmMeasurementGroup=CanNm  # CanNm PLAIN_TEXT Measurement point that measures the CanNm_ConfirmPnAvailability function
      CANNM_SID_NETWORKREQUEST: RtmAutostartEnabled=false, RtmMeasurementId=10, RtmMeasurementPointType=Runtime, RtmMeasurementGroup=CanNm  # CanNm PLAIN_TEXT Measurement point that measures the CanNm_NetworkRequest function
      CANNM_SID_NETWORKRELEASE: RtmAutostartEnabled=false, RtmMeasurementId=9, RtmMeasurementPointType=Runtime, RtmMeasurementGroup=CanNm  # CanNm PLAIN_TEXT Measurement point that measures the CanNm_NetworkRelease function
      CANNM_SID_CHECKREMOTESLEEPIND: RtmAutostartEnabled=false, RtmMeasurementId=2, RtmMeasurementPointType=Runtime, RtmMeasurementGroup=CanNm  # CanNm PLAIN_TEXT Measurement point that measures the CanNm_CheckRemoteSleepIndication function
      CANNM_SID_TXCONFIRMATION: RtmAutostartEnabled=false, RtmMeasurementId=14, RtmMeasurementPointType=Runtime, RtmMeasurementGroup=CanNm  # CanNm PLAIN_TEXT Measurement point that measures the CanNm_TxConfirmation function
      CANNM_SID_ENABLECOMMUNICATION: RtmAutostartEnabled=false, RtmMeasurementId=5, RtmMeasurementPointType=Runtime, RtmMeasurementGroup=CanNm  # CanNm PLAIN_TEXT Measurement point that measures the CanNm_EnableCommunication function
      CANNM_SID_DISABLECOMMUNICATION: RtmAutostartEnabled=false, RtmMeasurementId=4, RtmMeasurementPointType=Runtime, RtmMeasurementGroup=CanNm  # CanNm PLAIN_TEXT Measurement point that measures the CanNm_DisableCommunication function
      CANNM_SID_TRANSMIT: RtmAutostartEnabled=false, RtmMeasurementId=13, RtmMeasurementPointType=Runtime, RtmMeasurementGroup=CanNm  # CanNm PLAIN_TEXT Measurement point that measures the CanNm_Transmit function
      NM_SID_PASSIVESTARTUP: RtmAutostartEnabled=false, RtmMeasurementId=30, RtmMeasurementPointType=Runtime, RtmMeasurementGroup=Nm  # Nm PLAIN_TEXT Measurement point that measures the Nm_PassiveStartUp function
      NM_SID_GETSTATE: RtmAutostartEnabled=false, RtmMeasurementId=23, RtmMeasurementPointType=Runtime, RtmMeasurementGroup=Nm  # Nm PLAIN_TEXT Measurement point that measures the Nm_GetState function
      NM_SID_MAINFUNCTION: RtmAutostartEnabled=false, RtmMeasurementId=25, RtmMeasurementPointType=Runtime, RtmMeasurementGroup=Nm  # Nm PLAIN_TEXT Measurement point that measures the Nm_MainFunction functions
      NM_SID_NETWORKSTARTINDICATION: RtmAutostartEnabled=false, RtmMeasurementId=29, RtmMeasurementPointType=Runtime, RtmMeasurementGroup=Nm  # Nm PLAIN_TEXT Measurement point that measures the Nm_NetworkStartIndication function
      NM_SID_NETWORKMODE: RtmAutostartEnabled=false, RtmMeasurementId=26, RtmMeasurementPointType=Runtime, RtmMeasurementGroup=Nm  # Nm PLAIN_TEXT Measurement point that measures the Nm_NetworkMode function
      NM_SID_BUSSLEEPMODE: RtmAutostartEnabled=false, RtmMeasurementId=19, RtmMeasurementPointType=Runtime, RtmMeasurementGroup=Nm  # Nm PLAIN_TEXT Measurement point that measures the Nm_BusSleepMode function
      NM_SID_ENABLECOMMUNICATION: RtmAutostartEnabled=false, RtmMeasurementId=22, RtmMeasurementPointType=Runtime, RtmMeasurementGroup=Nm  # Nm PLAIN_TEXT Measurement point that measures the Nm_EnableCommunication function
      NM_SID_DISABLECOMMUNICATION: RtmAutostartEnabled=false, RtmMeasurementId=21, RtmMeasurementPointType=Runtime, RtmMeasurementGroup=Nm  # Nm PLAIN_TEXT Measurement point that measures the Nm_DisableCommunication function
      NM_SID_NETWORKREQUEST: RtmAutostartEnabled=false, RtmMeasurementId=28, RtmMeasurementPointType=Runtime, RtmMeasurementGroup=Nm  # Nm PLAIN_TEXT Measurement point that measures the Nm_NetworkRequest function
      NM_SID_NETWORKRELEASE: RtmAutostartEnabled=false, RtmMeasurementId=27, RtmMeasurementPointType=Runtime, RtmMeasurementGroup=Nm  # Nm PLAIN_TEXT Measurement point that measures the Nm_NetworkRelease function
      NM_SID_TXTIMEOUTEXCEPTION: RtmAutostartEnabled=false, RtmMeasurementId=35, RtmMeasurementPointType=Runtime, RtmMeasurementGroup=Nm  # Nm PLAIN_TEXT Measurement point that measures the Nm_TxTimeoutException function
      NM_SID_STATECHANGENOTIFICATION: RtmAutostartEnabled=false, RtmMeasurementId=34, RtmMeasurementPointType=Runtime, RtmMeasurementGroup=Nm  # Nm PLAIN_TEXT Measurement point that measures the Nm_StateChangeNotification function
      NM_SID_CHECKREMOTESLEEPINDICATION: RtmAutostartEnabled=false, RtmMeasurementId=20, RtmMeasurementPointType=Runtime, RtmMeasurementGroup=Nm  # Nm PLAIN_TEXT !NmMeasurePointValidatorFactory.NM_SID_CHECKREMOTESLEEPINDICATION!
      NM_SID_REMOTESLEEPINDICATION: RtmAutostartEnabled=false, RtmMeasurementId=33, RtmMeasurementPointType=Runtime, RtmMeasurementGroup=Nm  # Nm PLAIN_TEXT Measurement point that measures the Nm_RemoteSleepIndication function
      NM_SID_REMOTESLEEPCANCELLATION: RtmAutostartEnabled=false, RtmMeasurementId=32, RtmMeasurementPointType=Runtime, RtmMeasurementGroup=Nm  # Nm PLAIN_TEXT Measurement point that measures the Nm_RemoteSleepCancellation function
      NM_SID_PREPAREBUSSLEEPMODE: RtmAutostartEnabled=false, RtmMeasurementId=31, RtmMeasurementPointType=Runtime, RtmMeasurementGroup=Nm  # Nm PLAIN_TEXT Measurement point that measures the Nm_PrepareBusSleepMode function
      NM_SID_INIT: RtmAutostartEnabled=false, RtmMeasurementId=24, RtmMeasurementPointType=Runtime, RtmMeasurementGroup=Nm  # Nm PLAIN_TEXT Measurement point that measures the Nm_Init function
      Task_IdleTask_OsCore0: RtmAutostartEnabled=true, RtmMeasurementId=46, RtmMeasurementPointType=Task
      Task_BswTask_Core0_LowPrio: RtmAutostartEnabled=true, RtmMeasurementId=43, RtmMeasurementPointType=Task
      Task_BswTask_Core0_HighPrio: RtmAutostartEnabled=true, RtmMeasurementId=42, RtmMeasurementPointType=Task
      Task_BackgroundTask_Core0: RtmAutostartEnabled=true, RtmMeasurementId=41, RtmMeasurementPointType=Task
      Task_ApplInitTask_Core0: RtmAutostartEnabled=true, RtmMeasurementId=38, RtmMeasurementPointType=Task
      Task_ApplTask_Core0_LowPrio: RtmAutostartEnabled=true, RtmMeasurementId=40, RtmMeasurementPointType=Task
      Task_ApplTask_Core0_HighPrio: RtmAutostartEnabled=true, RtmMeasurementId=39, RtmMeasurementPointType=Task
      Task_ApplBackgroundTask_Core0: RtmAutostartEnabled=true, RtmMeasurementId=37, RtmMeasurementPointType=Task
      Task_Default_Init_Task_Trusted: RtmAutostartEnabled=true, RtmMeasurementId=45, RtmMeasurementPointType=Task
      Task_Default_Init_Task: RtmAutostartEnabled=true, RtmMeasurementId=44, RtmMeasurementPointType=Task
      Task_OsTask_ALV_BeltFunctionAlgo: RtmAutostartEnabled=true, RtmMeasurementId=47, RtmMeasurementPointType=Task
      Rtm_CpuLoadMeasurement: RtmAutostartEnabled=true, RtmMeasurementId=36, RtmMeasurementPointType=CPU_Load, RtmMeasurementGroup=Rtm
    RtmCpuLoadMeasurement: RtmHyperperiod=0.1, RtmCpuLoadControlMode=C_API, RtmNumberOfCpuLoadPercentiles=10
