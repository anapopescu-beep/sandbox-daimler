AUTOSAR XML (schema 00049)
package /ActiveEcuC
  module config PduR: implementation-config-variant=VARIANT-POST-BUILD-SELECTABLE, module-description=PduR_Impl
    PduRGeneral:
      PduRDevErrorDetect = false
      PduRVersionInfoApi = false
      PduRMetaDataSupport = false
      PduRPduCallback = false
      PduRSwitching = false
      PduRSafeBswChecks = true
      PduREnableDeferredTransmission = false
      PduREnableDeferredReception = false
      PduRSupportMulticore = false
      PduRRoutingTypeGateway = false
      PduRSpinlockRetryCounter = 4294967295
      PduRExtendedErrorChecks = false
      PduRGeneration:
        PduROutOfBoundsWriteProtectionStrategy = NONE
        PduROutOfBoundsWriteSanitizer = false
        PduROutOfBoundsReadSanitizer = false
        PduRNumericalDataTypeMinimizationStrategy = WITH_CAST
        PduRReduceConstantData2Define = false
        PduRBoolDataInArrayOfStructStrategy = BITMASKING
        PduRDeduplicateIndirectedData = true
        PduRDataDeduplicationStrategy = WITH_CAST
        PduRReduceBoolDataByNegationThreshold = 2
        PduRReduceBoolDataByNumericalComparisonThreshold = 2
        PduRReduceBoolDataByNumericalRelationThreshold = 2
        PduRReduceBoolDataByNumericalOperandStrategy = WITH_ANY_VALUE
        PduRReduceNumericalDataByOffsetThreshold = 2
        PduRReduceNumericalDataByArraySubtractionThreshold = 2
        PduRReduceDataByStreaming = false
        PduRShortSymbols = false
        PduRInterfacesForDeactivatedData = false
        PduRReferringKeysInComments = false
    PduRRoutingTables: PduRConfigurationId=0
      PduRRoutingTable
        73 x PduRRoutingPath, all with PduRMulticoreRoutingPath=false, PduRLockRef=PduRLock_PduRExclusiveArea:
          Meas8_RBTM_FL_ST3_a92f14da_Tx: PduRRoutingPathCommunicationType=COMMUNICATION_INTERFACE, variation-point=post-build-variant-condition{matching-criterion=SideAllocation, value=0}
            PduRSrcPdu_d98cd95c (PduRSrcPdu): PduRSourcePduHandleId=3, PduRSrcPduDirection=TRANSMIT, PduRSrcPduRef=Meas8_RBTM_FL_ST3_a92f14da_Tx, PduRSrcPduPduRBswModulesRef=Com
            Meas8_RBTM_FL_ST3_b4f3e350_Tx (PduRDestPdu):
              PduRDestPduHandleId = 3
              PduRDestPduDirection = TRANSMIT
              PduRDestPduRoutingType = API_FORWARDING
              PduRDestPduDataProcessing = IMMEDIATE
              PduRPduLengthHandlingStrategy = IGNORE
              PduRDestPduCrossPartitionDestination = false
              PduRDestPduDataProvision = PDUR_DIRECT
              PduRTransmissionConfirmation = true
              PduRDestPduRef = Meas8_RBTM_FL_ST3_b4f3e350_Tx
              PduRDestPduPduRBswModulesRef = CanIf
          ADAS_PROFILE_SHORT_ST3_1_506b5dfc_Rx: PduRRoutingPathCommunicationType=COMMUNICATION_INTERFACE
            ADAS_PROFILE_SHORT_ST3_1_506b5dfc_Rx (PduRDestPdu):
              PduRDestPduHandleId = 4
              PduRDestPduDirection = RECEIVE
              PduRDestPduRoutingType = API_FORWARDING
              PduRDestPduDataProcessing = IMMEDIATE
              PduRPduLengthHandlingStrategy = IGNORE
              PduRDestPduCrossPartitionDestination = false
              PduRTransmissionConfirmation = false
              PduRDestPduRef = ADAS_PROFILE_SHORT_ST3_1_506b5dfc_Rx
              PduRDestPduPduRBswModulesRef = Com
            PduRSrcPdu_d645a86c (PduRSrcPdu): PduRSourcePduHandleId=4, PduRSrcPduDirection=RECEIVE, PduRSrcPduRef=ADAS_PROFILE_SHORT_ST3_1_506b5dfc_Rx, PduRSrcPduPduRBswModulesRef=IpduM
          DPC_Md_Rq_ESP_d1_ST3_5573a8b2_Rx: PduRRoutingPathCommunicationType=COMMUNICATION_INTERFACE
            PduRSrcPdu_ee8d9c90 (PduRSrcPdu): PduRSourcePduHandleId=14, PduRSrcPduDirection=RECEIVE, PduRSrcPduRef=DPC_Md_Rq_ESP_d1_ST3_5573a8b2_Rx, PduRSrcPduPduRBswModulesRef=CanIf
            DPC_Md_Rq_ESP_d1_ST3_5573a8b2_Rx_ee8d9c90_Rx (PduRDestPdu):
              PduRDestPduHandleId = 13
              PduRDestPduDirection = RECEIVE
              PduRDestPduRoutingType = API_FORWARDING
              PduRDestPduDataProcessing = IMMEDIATE
              PduRPduLengthHandlingStrategy = IGNORE
              PduRDestPduCrossPartitionDestination = false
              PduRTransmissionConfirmation = false
              PduRDestPduRef = DPC_Md_Rq_ESP_d1_ST3_e30f951d_Rx
              PduRDestPduPduRBswModulesRef = Com
          ECU_Stat_RBTM_FL_ST3_f703b6eb_Tx: PduRRoutingPathCommunicationType=COMMUNICATION_INTERFACE, variation-point=post-build-variant-condition{matching-criterion=SideAllocation, value=0}
            PduRSrcPdu_140ec449 (PduRSrcPdu): PduRSourcePduHandleId=2, PduRSrcPduDirection=TRANSMIT, PduRSrcPduRef=ECU_Stat_RBTM_FL_ST3_f703b6eb_Tx, PduRSrcPduPduRBswModulesRef=Com
            ECU_Stat_RBTM_FL_ST3_42655720_Tx (PduRDestPdu):
              PduRDestPduHandleId = 2
              PduRDestPduDirection = TRANSMIT
              PduRDestPduRoutingType = API_FORWARDING
              PduRDestPduDataProcessing = IMMEDIATE
              PduRPduLengthHandlingStrategy = IGNORE
              PduRDestPduCrossPartitionDestination = false
              PduRDestPduDataProvision = PDUR_DIRECT
              PduRTransmissionConfirmation = true
              PduRDestPduRef = ECU_Stat_RBTM_FL_ST3_42655720_Tx
              PduRDestPduPduRBswModulesRef = CanIf
          DIAG_Stat_ST3_d3ec8369_Rx: PduRRoutingPathCommunicationType=COMMUNICATION_INTERFACE
            PduRSrcPdu_65d40bec (PduRSrcPdu): PduRSourcePduHandleId=12, PduRSrcPduDirection=RECEIVE, PduRSrcPduRef=DIAG_Stat_ST3_d3ec8369_Rx, PduRSrcPduPduRBswModulesRef=CanIf
            DIAG_Stat_ST3_d3ec8369_Rx_65d40bec_Rx (PduRDestPdu):
              PduRDestPduHandleId = 11
              PduRDestPduDirection = RECEIVE
              PduRDestPduRoutingType = API_FORWARDING
              PduRDestPduDataProcessing = IMMEDIATE
              PduRPduLengthHandlingStrategy = IGNORE
              PduRDestPduCrossPartitionDestination = false
              PduRTransmissionConfirmation = false
              PduRDestPduRef = DIAG_Stat_ST3_3a031d4a_Rx
              PduRDestPduPduRBswModulesRef = Com
          VSS_TP_SharedSecret_ST3_6d7ca724_Rx: PduRRoutingPathCommunicationType=COMMUNICATION_INTERFACE
            VSS_TP_SharedSecret_ST3_6d7ca724_Rx_44cfb2dc_Rx (PduRDestPdu):
              PduRDestPduHandleId = 32
              PduRDestPduDirection = RECEIVE
              PduRDestPduRoutingType = API_FORWARDING
              PduRDestPduDataProcessing = IMMEDIATE
              PduRPduLengthHandlingStrategy = IGNORE
              PduRDestPduCrossPartitionDestination = false
              PduRTransmissionConfirmation = false
              PduRDestPduRef = VSS_TP_SharedSecret_ST3_605b0fee_Rx
              PduRDestPduPduRBswModulesRef = Com
            PduRSrcPdu_44cfb2dc (PduRSrcPdu): PduRSourcePduHandleId=32, PduRSrcPduDirection=RECEIVE, PduRSrcPduRef=VSS_TP_SharedSecret_ST3_6d7ca724_Rx, PduRSrcPduPduRBswModulesRef=CanIf
          PT4_PTCoor9_d1_BC_F_ST3_f2a4ec1b_Rx: PduRRoutingPathCommunicationType=COMMUNICATION_INTERFACE
            PduRSrcPdu_470e8c8b (PduRSrcPdu): PduRSourcePduHandleId=25, PduRSrcPduDirection=RECEIVE, PduRSrcPduRef=PT4_PTCoor9_d1_BC_F_ST3_f2a4ec1b_Rx, PduRSrcPduPduRBswModulesRef=CanIf
            PT4_PTCoor9_d1_BC_F_ST3_f2a4ec1b_Rx_470e8c8b_Rx (PduRDestPdu):
              PduRDestPduHandleId = 24
              PduRDestPduDirection = RECEIVE
              PduRDestPduRoutingType = API_FORWARDING
              PduRDestPduDataProcessing = IMMEDIATE
              PduRPduLengthHandlingStrategy = IGNORE
              PduRDestPduCrossPartitionDestination = false
              PduRTransmissionConfirmation = false
              PduRDestPduRef = PT4_PTCoor9_d1_BC_F_ST3_da786b84_Rx
              PduRDestPduPduRBswModulesRef = Com
          PT4_PTCoor_DrvPosn_Gear_ST3_f70358bf_Rx: PduRRoutingPathCommunicationType=COMMUNICATION_INTERFACE
            PduRSrcPdu_3ba6bace (PduRSrcPdu): PduRSourcePduHandleId=26, PduRSrcPduDirection=RECEIVE, PduRSrcPduRef=PT4_PTCoor_DrvPosn_Gear_ST3_f70358bf_Rx, PduRSrcPduPduRBswModulesRef=CanIf
            PT4_PTCoor_DrvPosn_Gear_ST3_f70358bf_Rx_3ba6bace_Rx (PduRDestPdu):
              PduRDestPduHandleId = 25
              PduRDestPduDirection = RECEIVE
              PduRDestPduRoutingType = API_FORWARDING
              PduRDestPduDataProcessing = IMMEDIATE
              PduRPduLengthHandlingStrategy = IGNORE
              PduRDestPduCrossPartitionDestination = false
              PduRTransmissionConfirmation = false
              PduRDestPduRef = PT4_PTCoor_DrvPosn_Gear_ST3_6b508375_Rx
              PduRDestPduPduRBswModulesRef = Com
          RBTM_FL_Stat_ST3_dd2436a1_Tx: PduRRoutingPathCommunicationType=COMMUNICATION_INTERFACE, variation-point=post-build-variant-condition{matching-criterion=SideAllocation, value=0}
            PduRSrcPdu_9690baaa (PduRSrcPdu): PduRSourcePduHandleId=5, PduRSrcPduDirection=TRANSMIT, PduRSrcPduRef=RBTM_FL_Stat_ST3_dd2436a1_Tx, PduRSrcPduPduRBswModulesRef=Com
            RBTM_FL_Stat_ST3_d76d14af_Tx (PduRDestPdu):
              PduRDestPduHandleId = 5
              PduRDestPduDirection = TRANSMIT
              PduRDestPduRoutingType = API_FORWARDING
              PduRDestPduDataProcessing = IMMEDIATE
              PduRPduLengthHandlingStrategy = IGNORE
              PduRDestPduCrossPartitionDestination = false
              PduRDestPduDataProvision = PDUR_DIRECT
              PduRTransmissionConfirmation = true
              PduRDestPduRef = RBTM_FL_Stat_ST3_d76d14af_Tx
              PduRDestPduPduRBswModulesRef = CanIf
          ADAS_POSITION_ST3_1ca04d74_Rx: PduRRoutingPathCommunicationType=COMMUNICATION_INTERFACE
            PduRSrcPdu_fa09a036 (PduRSrcPdu): PduRSourcePduHandleId=0, PduRSrcPduDirection=RECEIVE, PduRSrcPduRef=ADAS_POSITION_ST3_1ca04d74_Rx, PduRSrcPduPduRBswModulesRef=CanIf
            ADAS_POSITION_ST3_1ca04d74_Rx_fa09a036_Rx (PduRDestPdu):
              PduRDestPduHandleId = 0
              PduRDestPduDirection = RECEIVE
              PduRDestPduRoutingType = API_FORWARDING
              PduRDestPduDataProcessing = IMMEDIATE
              PduRPduLengthHandlingStrategy = IGNORE
              PduRDestPduCrossPartitionDestination = false
              PduRTransmissionConfirmation = false
              PduRDestPduRef = ADAS_POSITION_ST3_0b61d436_Rx
              PduRDestPduPduRBswModulesRef = Com
          CLkS_Dr_State_ST3_74337ed5_Rx: PduRRoutingPathCommunicationType=COMMUNICATION_INTERFACE
            PduRSrcPdu_0fa9281f (PduRSrcPdu): PduRSourcePduHandleId=10, PduRSrcPduDirection=RECEIVE, PduRSrcPduRef=CLkS_Dr_State_ST3_74337ed5_Rx, PduRSrcPduPduRBswModulesRef=CanIf
            CLkS_Dr_State_ST3_74337ed5_Rx_0fa9281f_Rx (PduRDestPdu):
              PduRDestPduHandleId = 10
              PduRDestPduDirection = RECEIVE
              PduRDestPduRoutingType = API_FORWARDING
              PduRDestPduDataProcessing = IMMEDIATE
              PduRPduLengthHandlingStrategy = IGNORE
              PduRDestPduCrossPartitionDestination = false
              PduRTransmissionConfirmation = false
              PduRDestPduRef = CLkS_Dr_State_ST3_513e9c19_Rx
              PduRDestPduPduRBswModulesRef = Com
          ComIPduPnc_EIRA_CAN_Rx_cca0f11f_Rx: PduRRoutingPathCommunicationType=COMMUNICATION_INTERFACE
            ComIPduPnc_EIRA_CAN_Rx_cca0f11f_Rx_bb7efc37_Rx (PduRDestPdu):
              PduRDestPduHandleId = 26
              PduRDestPduDirection = RECEIVE
              PduRDestPduRoutingType = API_FORWARDING
              PduRDestPduDataProcessing = IMMEDIATE
              PduRPduLengthHandlingStrategy = IGNORE
              PduRDestPduCrossPartitionDestination = false
              PduRTransmissionConfirmation = false
              PduRDestPduRef = PduPnc_EIRA_CAN_Rx
              PduRDestPduPduRBswModulesRef = Com
            PduRSrcPdu_bb7efc37 (PduRSrcPdu): PduRSourcePduHandleId=11, PduRSrcPduDirection=RECEIVE, PduRSrcPduRef=PduPnc_EIRA_CAN_Rx, PduRSrcPduPduRBswModulesRef=CanNm
          BeltHdOvr_FL_State_ST3_0b4fb3a9_Rx: PduRRoutingPathCommunicationType=COMMUNICATION_INTERFACE, variation-point=post-build-variant-condition{matching-criterion=SideAllocation, value=0}
            PduRSrcPdu_11170208 (PduRSrcPdu): PduRSourcePduHandleId=35, PduRSrcPduDirection=RECEIVE, PduRSrcPduRef=BeltHdOvr_FL_State_ST3_0b4fb3a9_Rx, PduRSrcPduPduRBswModulesRef=CanIf
            BeltHdOvr_FL_State_ST3_0b4fb3a9_Rx_11170208_Rx (PduRDestPdu):
              PduRDestPduHandleId = 35
              PduRDestPduDirection = RECEIVE
              PduRDestPduRoutingType = API_FORWARDING
              PduRDestPduDataProcessing = IMMEDIATE
              PduRPduLengthHandlingStrategy = IGNORE
              PduRDestPduCrossPartitionDestination = false
              PduRTransmissionConfirmation = false
              PduRDestPduRef = BeltHdOvr_FL_State_ST3_342163b7_Rx
              PduRDestPduPduRBswModulesRef = Com
          SDU_DIAG_RBTM_FL_03_ExtCAN_RS_BODY3_ST3_b462d7d3_Tx: PduRRoutingPathCommunicationType=TRANSPORT_PROTOCOL, variation-point=post-build-variant-condition{matching-criterion=SideAllocation, value=0}
            SDU_DIAG_RBTM_FL_03_ExtCAN_RS_BODY3_ST3_92b91e83_Tx (PduRDestPdu):
              PduRDestPduHandleId = 0
              PduRDestPduDirection = TRANSMIT
              PduRDestPduRoutingType = API_FORWARDING
              PduRDestPduDataProcessing = IMMEDIATE
              PduRPduLengthHandlingStrategy = UNUSED
              PduRDestPduCrossPartitionDestination = false
              PduRDestPduRef = SDU_DIAG_RBTM_FL_03_ExtCAN_RS_BODY3_ST3_92b91e83_Tx
              PduRDestPduPduRBswModulesRef = CanTp
            PduRSrcPdu_7f35c914 (PduRSrcPdu):
              PduRSourcePduHandleId = 8
              PduRSrcPduDirection = TRANSMIT
              PduRSrcPduRef = SDU_DIAG_RBTM_FL_03_ExtCAN_RS_BODY3_ST3_b462d7d3_Tx
              PduRSrcPduPduRBswModulesRef = Dcm
          ROE_RBTM_FL_ST3_a66ccb5f_Tx: PduRRoutingPathCommunicationType=COMMUNICATION_INTERFACE, variation-point=post-build-variant-condition{matching-criterion=SideAllocation, value=0}
            ROE_RBTM_FL_ST3_75ad963a_Tx (PduRDestPdu):
              PduRDestPduHandleId = 7
              PduRDestPduDirection = TRANSMIT
              PduRDestPduRoutingType = API_FORWARDING
              PduRDestPduDataProcessing = IMMEDIATE
              PduRPduLengthHandlingStrategy = IGNORE
              PduRDestPduCrossPartitionDestination = false
              PduRDestPduDataProvision = PDUR_DIRECT
              PduRTransmissionConfirmation = true
              PduRDestPduRef = ROE_RBTM_FL_ST3_75ad963a_Tx
              PduRDestPduPduRBswModulesRef = CanIf
            PduRSrcPdu_25bb0169 (PduRSrcPdu): PduRSourcePduHandleId=7, PduRSrcPduDirection=TRANSMIT, PduRSrcPduRef=ROE_RBTM_FL_ST3_a66ccb5f_Tx, PduRSrcPduPduRBswModulesRef=Com
          BeltAdj_FL_Stat_ST3_d2ce0dbb_Tx: PduRRoutingPathCommunicationType=COMMUNICATION_INTERFACE, variation-point=post-build-variant-condition{matching-criterion=SideAllocation, value=0}
            PduRSrcPdu_4459b19c (PduRSrcPdu): PduRSourcePduHandleId=0, PduRSrcPduDirection=TRANSMIT, PduRSrcPduRef=BeltAdj_FL_Stat_ST3_d2ce0dbb_Tx, PduRSrcPduPduRBswModulesRef=Com
            BeltAdj_FL_Stat_ST3_71e5093a_Tx (PduRDestPdu):
              PduRDestPduHandleId = 0
              PduRDestPduDirection = TRANSMIT
              PduRDestPduRoutingType = API_FORWARDING
              PduRDestPduDataProcessing = IMMEDIATE
              PduRPduLengthHandlingStrategy = IGNORE
              PduRDestPduCrossPartitionDestination = false
              PduRDestPduDataProvision = PDUR_DIRECT
              PduRTransmissionConfirmation = true
              PduRDestPduRef = BeltAdj_FL_Stat_ST3_71e5093a_Tx
              PduRDestPduPduRBswModulesRef = CanIf
          VSS_TP_SecTickCount_Lvl2_ST3_c0c3ca3b_Rx: PduRRoutingPathCommunicationType=COMMUNICATION_INTERFACE
            VSS_TP_SecTickCount_Lvl2_ST3_c0c3ca3b_Rx_13123c17_Rx (PduRDestPdu):
              PduRDestPduHandleId = 31
              PduRDestPduDirection = RECEIVE
              PduRDestPduRoutingType = API_FORWARDING
              PduRDestPduDataProcessing = IMMEDIATE
              PduRPduLengthHandlingStrategy = IGNORE
              PduRDestPduCrossPartitionDestination = false
              PduRTransmissionConfirmation = false
              PduRDestPduRef = VSS_TP_SecTickCount_Lvl2_ST3_4917056b_Rx
              PduRDestPduPduRBswModulesRef = Com
            PduRSrcPdu_13123c17 (PduRSrcPdu): PduRSourcePduHandleId=31, PduRSrcPduDirection=RECEIVE, PduRSrcPduRef=VSS_TP_SecTickCount_Lvl2_ST3_c0c3ca3b_Rx, PduRSrcPduPduRBswModulesRef=CanIf
          ADAS_PREDICTION_ST3_1de136c9_Rx: PduRRoutingPathCommunicationType=COMMUNICATION_INTERFACE
            PduRSrcPdu_0518217c (PduRSrcPdu): PduRSourcePduHandleId=1, PduRSrcPduDirection=RECEIVE, PduRSrcPduRef=ADAS_PREDICTION_ST3_1de136c9_Rx, PduRSrcPduPduRBswModulesRef=CanIf
            ADAS_PREDICTION_ST3_1de136c9_Rx_0518217c_Rx (PduRDestPdu):
              PduRDestPduHandleId = 3
              PduRDestPduDirection = RECEIVE
              PduRDestPduRoutingType = API_FORWARDING
              PduRDestPduDataProcessing = IMMEDIATE
              PduRPduLengthHandlingStrategy = IGNORE
              PduRDestPduCrossPartitionDestination = false
              PduRTransmissionConfirmation = false
              PduRDestPduRef = ADAS_PREDICTION_ST3_549e2a63_Rx
              PduRDestPduPduRBswModulesRef = IpduM
          NM_RBTM_FL_ST3_0cdf2d0f_Tx: PduRRoutingPathCommunicationType=COMMUNICATION_INTERFACE, variation-point=post-build-variant-condition{matching-criterion=SideAllocation, value=0}
            NM_RBTM_FL_ST3_0cdf2d0f_Tx_78db9cf2_Tx (PduRDestPdu):
              PduRDestPduHandleId = 4
              PduRDestPduDirection = TRANSMIT
              PduRDestPduRoutingType = API_FORWARDING
              PduRDestPduDataProcessing = IMMEDIATE
              PduRPduLengthHandlingStrategy = IGNORE
              PduRDestPduCrossPartitionDestination = false
              PduRDestPduDataProvision = PDUR_TRIGGERTRANSMIT
              PduRTransmissionConfirmation = true
              PduRDestPduRef = NM_RBTM_FL_ST3_0cdf2d0f_Tx
              PduRDestPduPduRBswModulesRef = CanNm
            PduRSrcPdu_78db9cf2 (PduRSrcPdu): PduRSourcePduHandleId=4, PduRSrcPduDirection=TRANSMIT, PduRSrcPduRef=NM_RBTM_FL_ST3_0cdf2d0f_Tx, PduRSrcPduPduRBswModulesRef=Com
          ADAS_PREDICTION_ST3_6_262b63d1_Rx: PduRRoutingPathCommunicationType=COMMUNICATION_INTERFACE
            PduRSrcPdu_27f93d01 (PduRSrcPdu): PduRSourcePduHandleId=2, PduRSrcPduDirection=RECEIVE, PduRSrcPduRef=ADAS_PREDICTION_ST3_6_262b63d1_Rx, PduRSrcPduPduRBswModulesRef=IpduM
            ADAS_PREDICTION_ST3_6_262b63d1_Rx (PduRDestPdu):
              PduRDestPduHandleId = 1
              PduRDestPduDirection = RECEIVE
              PduRDestPduRoutingType = API_FORWARDING
              PduRDestPduDataProcessing = IMMEDIATE
              PduRPduLengthHandlingStrategy = IGNORE
              PduRDestPduCrossPartitionDestination = false
              PduRTransmissionConfirmation = false
              PduRDestPduRef = ADAS_PREDICTION_ST3_6_262b63d1_Rx
              PduRDestPduPduRBswModulesRef = Com
          PN14_Master_Stat1_ST3_69644078_Rx: PduRRoutingPathCommunicationType=COMMUNICATION_INTERFACE
            PduRSrcPdu_a0c57bb3 (PduRSrcPdu): PduRSourcePduHandleId=23, PduRSrcPduDirection=RECEIVE, PduRSrcPduRef=PN14_Master_Stat1_ST3_69644078_Rx, PduRSrcPduPduRBswModulesRef=CanIf
            PN14_Master_Stat1_ST3_69644078_Rx_a0c57bb3_Rx (PduRDestPdu):
              PduRDestPduHandleId = 22
              PduRDestPduDirection = RECEIVE
              PduRDestPduRoutingType = API_FORWARDING
              PduRDestPduDataProcessing = IMMEDIATE
              PduRPduLengthHandlingStrategy = IGNORE
              PduRDestPduCrossPartitionDestination = false
              PduRTransmissionConfirmation = false
              PduRDestPduRef = PN14_Master_Stat1_ST3_eba3e383_Rx
              PduRDestPduPduRBswModulesRef = Com
          PresfAct_Adj_ST3_81976f17_Rx: PduRRoutingPathCommunicationType=COMMUNICATION_INTERFACE
            PresfAct_Adj_ST3_81976f17_Rx_7d3a747f_Rx (PduRDestPdu):
              PduRDestPduHandleId = 27
              PduRDestPduDirection = RECEIVE
              PduRDestPduRoutingType = API_FORWARDING
              PduRDestPduDataProcessing = IMMEDIATE
              PduRPduLengthHandlingStrategy = IGNORE
              PduRDestPduCrossPartitionDestination = false
              PduRTransmissionConfirmation = false
              PduRDestPduRef = PresfAct_Adj_ST3_61c58c91_Rx
              PduRDestPduPduRBswModulesRef = Com
            PduRSrcPdu_7d3a747f (PduRSrcPdu): PduRSourcePduHandleId=27, PduRSrcPduDirection=RECEIVE, PduRSrcPduRef=PresfAct_Adj_ST3_81976f17_Rx, PduRSrcPduPduRBswModulesRef=CanIf
          VSS_TP_Auth_ST3_29a0d419_Rx: PduRRoutingPathCommunicationType=COMMUNICATION_INTERFACE
            PduRSrcPdu_c76c8221 (PduRSrcPdu): PduRSourcePduHandleId=29, PduRSrcPduDirection=RECEIVE, PduRSrcPduRef=VSS_TP_Auth_ST3_29a0d419_Rx, PduRSrcPduPduRBswModulesRef=CanIf
            VSS_TP_Auth_ST3_29a0d419_Rx_c76c8221_Rx (PduRDestPdu):
              PduRDestPduHandleId = 29
              PduRDestPduDirection = RECEIVE
              PduRDestPduRoutingType = API_FORWARDING
              PduRDestPduDataProcessing = IMMEDIATE
              PduRPduLengthHandlingStrategy = IGNORE
              PduRDestPduCrossPartitionDestination = false
              PduRTransmissionConfirmation = false
              PduRDestPduRef = VSS_TP_Auth_ST3_7c9f23ce_Rx
              PduRDestPduPduRBswModulesRef = Com
          ADAS_PROFILE_SHORT_ST3_894b8265_Rx: PduRRoutingPathCommunicationType=COMMUNICATION_INTERFACE
            PduRSrcPdu_e0198081 (PduRSrcPdu): PduRSourcePduHandleId=6, PduRSrcPduDirection=RECEIVE, PduRSrcPduRef=ADAS_PROFILE_SHORT_ST3_894b8265_Rx, PduRSrcPduPduRBswModulesRef=CanIf
            ADAS_PROFILE_SHORT_ST3_894b8265_Rx_e0198081_Rx (PduRDestPdu):
              PduRDestPduHandleId = 6
              PduRDestPduDirection = RECEIVE
              PduRDestPduRoutingType = API_FORWARDING
              PduRDestPduDataProcessing = IMMEDIATE
              PduRPduLengthHandlingStrategy = IGNORE
              PduRDestPduCrossPartitionDestination = false
              PduRTransmissionConfirmation = false
              PduRDestPduRef = ADAS_PROFILE_SHORT_ST3_2225c4a7_Rx
              PduRDestPduPduRBswModulesRef = IpduM
          DI_OdoSpeedometer_ST3_0665a232_Rx: PduRRoutingPathCommunicationType=COMMUNICATION_INTERFACE
            DI_OdoSpeedometer_ST3_0665a232_Rx_3e9512b9_Rx (PduRDestPdu):
              PduRDestPduHandleId = 12
              PduRDestPduDirection = RECEIVE
              PduRDestPduRoutingType = API_FORWARDING
              PduRDestPduDataProcessing = IMMEDIATE
              PduRPduLengthHandlingStrategy = IGNORE
              PduRDestPduCrossPartitionDestination = false
              PduRTransmissionConfirmation = false
              PduRDestPduRef = DI_OdoSpeedometer_ST3_6fef7507_Rx
              PduRDestPduPduRBswModulesRef = Com
            PduRSrcPdu_3e9512b9 (PduRSrcPdu): PduRSourcePduHandleId=13, PduRSrcPduDirection=RECEIVE, PduRSrcPduRef=DI_OdoSpeedometer_ST3_0665a232_Rx, PduRSrcPduPduRBswModulesRef=CanIf
          PT4_PTCoor4_ST3_868ca7d3_Rx: PduRRoutingPathCommunicationType=COMMUNICATION_INTERFACE
            PduRSrcPdu_a7894e67 (PduRSrcPdu): PduRSourcePduHandleId=24, PduRSrcPduDirection=RECEIVE, PduRSrcPduRef=PT4_PTCoor4_ST3_868ca7d3_Rx, PduRSrcPduPduRBswModulesRef=CanIf
            PT4_PTCoor4_ST3_868ca7d3_Rx_a7894e67_Rx (PduRDestPdu):
              PduRDestPduHandleId = 23
              PduRDestPduDirection = RECEIVE
              PduRDestPduRoutingType = API_FORWARDING
              PduRDestPduDataProcessing = IMMEDIATE
              PduRPduLengthHandlingStrategy = IGNORE
              PduRDestPduCrossPartitionDestination = false
              PduRTransmissionConfirmation = false
              PduRDestPduRef = PT4_PTCoor4_ST3_bf069154_Rx
              PduRDestPduPduRBswModulesRef = Com
          EVC_CfgList_01_08_Pr5_ST3_be03dd9d_Rx: PduRRoutingPathCommunicationType=COMMUNICATION_INTERFACE
            EVC_CfgList_01_08_Pr5_ST3_be03dd9d_Rx_4b27d50a_Rx (PduRDestPdu):
              PduRDestPduHandleId = 16
              PduRDestPduDirection = RECEIVE
              PduRDestPduRoutingType = API_FORWARDING
              PduRDestPduDataProcessing = IMMEDIATE
              PduRPduLengthHandlingStrategy = IGNORE
              PduRDestPduCrossPartitionDestination = false
              PduRTransmissionConfirmation = false
              PduRDestPduRef = EVC_CfgList_01_08_Pr5_ST3_32c5e6fb_Rx
              PduRDestPduPduRBswModulesRef = Com
            PduRSrcPdu_4b27d50a (PduRSrcPdu): PduRSourcePduHandleId=17, PduRSrcPduDirection=RECEIVE, PduRSrcPduRef=EVC_CfgList_01_08_Pr5_ST3_be03dd9d_Rx, PduRSrcPduPduRBswModulesRef=CanIf
          SDU_DIAG_RBTM_FL_03_ExtCAN_RQ_BODY3_ST3_6d2a29a5_Rx: PduRRoutingPathCommunicationType=TRANSPORT_PROTOCOL, variation-point=post-build-variant-condition{matching-criterion=SideAllocation, value=0}
            PduRSrcPdu_a44b5ded (PduRSrcPdu):
              PduRSourcePduHandleId = 3
              PduRSrcPduDirection = RECEIVE
              PduRSrcPduRef = SDU_DIAG_RBTM_FL_03_ExtCAN_RQ_BODY3_ST3_6d2a29a5_Rx
              PduRSrcPduPduRBswModulesRef = CanTp
            SDU_DIAG_RBTM_FL_03_ExtCAN_RQ_BODY3_ST3_6d2a29a5_Rx_a44b5ded_Rx (PduRDestPdu):
              PduRDestPduHandleId = 3
              PduRDestPduDirection = RECEIVE
              PduRDestPduRoutingType = API_FORWARDING
              PduRDestPduDataProcessing = IMMEDIATE
              PduRPduLengthHandlingStrategy = UNUSED
              PduRDestPduCrossPartitionDestination = false
              PduRDestPduRef = SDU_DIAG_RBTM_FL_03_ExtCAN_RQ_BODY3_ST3_ec0e6e12_Rx
              PduRDestPduPduRBswModulesRef = Dcm
          ADAS_PREDICTION_ST3_7_512c5347_Rx: PduRRoutingPathCommunicationType=COMMUNICATION_INTERFACE
            PduRSrcPdu_d1b2606a (PduRSrcPdu): PduRSourcePduHandleId=3, PduRSrcPduDirection=RECEIVE, PduRSrcPduRef=ADAS_PREDICTION_ST3_7_512c5347_Rx, PduRSrcPduPduRBswModulesRef=IpduM
            ADAS_PREDICTION_ST3_7_512c5347_Rx (PduRDestPdu):
              PduRDestPduHandleId = 2
              PduRDestPduDirection = RECEIVE
              PduRDestPduRoutingType = API_FORWARDING
              PduRDestPduDataProcessing = IMMEDIATE
              PduRPduLengthHandlingStrategy = IGNORE
              PduRDestPduCrossPartitionDestination = false
              PduRTransmissionConfirmation = false
              PduRDestPduRef = ADAS_PREDICTION_ST3_7_512c5347_Rx
              PduRDestPduPduRBswModulesRef = Com
          BeltAdj_UI_Set_Rq_ST3_7be22993_Rx: PduRRoutingPathCommunicationType=COMMUNICATION_INTERFACE
            BeltAdj_UI_Set_Rq_ST3_7be22993_Rx_350798fb_Rx (PduRDestPdu):
              PduRDestPduHandleId = 9
              PduRDestPduDirection = RECEIVE
              PduRDestPduRoutingType = API_FORWARDING
              PduRDestPduDataProcessing = IMMEDIATE
              PduRPduLengthHandlingStrategy = IGNORE
              PduRDestPduCrossPartitionDestination = false
              PduRTransmissionConfirmation = false
              PduRDestPduRef = BeltAdj_UI_Set_Rq_ST3_1223a83d_Rx
              PduRDestPduPduRBswModulesRef = Com
            PduRSrcPdu_350798fb (PduRSrcPdu): PduRSourcePduHandleId=9, PduRSrcPduDirection=RECEIVE, PduRSrcPduRef=BeltAdj_UI_Set_Rq_ST3_7be22993_Rx, PduRSrcPduPduRBswModulesRef=CanIf
          Develop8_Rq_RBTM_FL_ST3_0a7cffe6_Rx: PduRRoutingPathCommunicationType=COMMUNICATION_INTERFACE, variation-point=post-build-variant-condition{matching-criterion=SideAllocation, value=0}
            PduRSrcPdu_c2dcef25 (PduRSrcPdu): PduRSourcePduHandleId=36, PduRSrcPduDirection=RECEIVE, PduRSrcPduRef=Develop8_Rq_RBTM_FL_ST3_0a7cffe6_Rx, PduRSrcPduPduRBswModulesRef=CanIf
            Develop8_Rq_RBTM_FL_ST3_0a7cffe6_Rx_c2dcef25_Rx (PduRDestPdu):
              PduRDestPduHandleId = 36
              PduRDestPduDirection = RECEIVE
              PduRDestPduRoutingType = API_FORWARDING
              PduRDestPduDataProcessing = IMMEDIATE
              PduRPduLengthHandlingStrategy = IGNORE
              PduRDestPduCrossPartitionDestination = false
              PduRTransmissionConfirmation = false
              PduRDestPduRef = Develop8_Rq_RBTM_FL_ST3_fa67f89a_Rx
              PduRDestPduPduRBswModulesRef = Com
          VSS_TP_VIN_ST3_f7ab6516_Rx: PduRRoutingPathCommunicationType=COMMUNICATION_INTERFACE
            VSS_TP_VIN_ST3_f7ab6516_Rx_da8efc5d_Rx (PduRDestPdu):
              PduRDestPduHandleId = 33
              PduRDestPduDirection = RECEIVE
              PduRDestPduRoutingType = API_FORWARDING
              PduRDestPduDataProcessing = IMMEDIATE
              PduRPduLengthHandlingStrategy = IGNORE
              PduRDestPduCrossPartitionDestination = false
              PduRTransmissionConfirmation = false
              PduRDestPduRef = VSS_TP_VIN_ST3_8e87972a_Rx
              PduRDestPduPduRBswModulesRef = Com
            PduRSrcPdu_da8efc5d (PduRSrcPdu): PduRSourcePduHandleId=33, PduRSrcPduDirection=RECEIVE, PduRSrcPduRef=VSS_TP_VIN_ST3_f7ab6516_Rx, PduRSrcPduPduRBswModulesRef=CanIf
          VSS_TP_RealTmOffset_ST3_d6d134b3_Rx: PduRRoutingPathCommunicationType=COMMUNICATION_INTERFACE
            PduRSrcPdu_9136979d (PduRSrcPdu): PduRSourcePduHandleId=30, PduRSrcPduDirection=RECEIVE, PduRSrcPduRef=VSS_TP_RealTmOffset_ST3_d6d134b3_Rx, PduRSrcPduPduRBswModulesRef=CanIf
            VSS_TP_RealTmOffset_ST3_d6d134b3_Rx_9136979d_Rx (PduRDestPdu):
              PduRDestPduHandleId = 30
              PduRDestPduDirection = RECEIVE
              PduRDestPduRoutingType = API_FORWARDING
              PduRDestPduDataProcessing = IMMEDIATE
              PduRPduLengthHandlingStrategy = IGNORE
              PduRDestPduCrossPartitionDestination = false
              PduRTransmissionConfirmation = false
              PduRDestPduRef = VSS_TP_RealTmOffset_ST3_62955a84_Rx
              PduRDestPduPduRBswModulesRef = Com
          ADAS_PROFILE_SHORT_ST3_31_05b1585f_Rx: PduRRoutingPathCommunicationType=COMMUNICATION_INTERFACE
            PduRSrcPdu_9e880434 (PduRSrcPdu): PduRSourcePduHandleId=5, PduRSrcPduDirection=RECEIVE, PduRSrcPduRef=ADAS_PROFILE_SHORT_ST3_31_05b1585f_Rx, PduRSrcPduPduRBswModulesRef=IpduM
            ADAS_PROFILE_SHORT_ST3_31_05b1585f_Rx (PduRDestPdu):
              PduRDestPduHandleId = 5
              PduRDestPduDirection = RECEIVE
              PduRDestPduRoutingType = API_FORWARDING
              PduRDestPduDataProcessing = IMMEDIATE
              PduRPduLengthHandlingStrategy = IGNORE
              PduRDestPduCrossPartitionDestination = false
              PduRTransmissionConfirmation = false
              PduRDestPduRef = ADAS_PROFILE_SHORT_ST3_31_05b1585f_Rx
              PduRDestPduPduRBswModulesRef = Com
          Impact3_ST3_993f4b56_Rx: PduRRoutingPathCommunicationType=COMMUNICATION_INTERFACE
            Impact3_ST3_993f4b56_Rx_7842cc32_Rx (PduRDestPdu):
              PduRDestPduHandleId = 20
              PduRDestPduDirection = RECEIVE
              PduRDestPduRoutingType = API_FORWARDING
              PduRDestPduDataProcessing = IMMEDIATE
              PduRPduLengthHandlingStrategy = IGNORE
              PduRDestPduCrossPartitionDestination = false
              PduRTransmissionConfirmation = false
              PduRDestPduRef = Impact3_ST3_d832457c_Rx
              PduRDestPduPduRBswModulesRef = Com
            PduRSrcPdu_7842cc32 (PduRSrcPdu): PduRSourcePduHandleId=21, PduRSrcPduDirection=RECEIVE, PduRSrcPduRef=Impact3_ST3_993f4b56_Rx, PduRSrcPduPduRBswModulesRef=CanIf
          BeltAdj_FR_Stat_ST3_2b5906f9_Rx: PduRRoutingPathCommunicationType=COMMUNICATION_INTERFACE, variation-point=post-build-variant-condition{matching-criterion=SideAllocation, value=0}
            PduRSrcPdu_f252e81e (PduRSrcPdu): PduRSourcePduHandleId=34, PduRSrcPduDirection=RECEIVE, PduRSrcPduRef=BeltAdj_FR_Stat_ST3_2b5906f9_Rx, PduRSrcPduPduRBswModulesRef=CanIf
            BeltAdj_FR_Stat_ST3_2b5906f9_Rx_f252e81e_Rx (PduRDestPdu):
              PduRDestPduHandleId = 34
              PduRDestPduDirection = RECEIVE
              PduRDestPduRoutingType = API_FORWARDING
              PduRDestPduDataProcessing = IMMEDIATE
              PduRPduLengthHandlingStrategy = IGNORE
              PduRDestPduCrossPartitionDestination = false
              PduRTransmissionConfirmation = false
              PduRDestPduRef = BeltAdj_FR_Stat_ST3_eba9bce0_Rx
              PduRDestPduPduRBswModulesRef = Com
          SDU_DIAG_GLOBAL_ExtCAN_RQ_BODY3_ST3_1d96a036_Rx: PduRRoutingPathCommunicationType=TRANSPORT_PROTOCOL
            PduRSrcPdu_19a79fac (PduRSrcPdu):
              PduRSourcePduHandleId = 0
              PduRSrcPduDirection = RECEIVE
              PduRSrcPduRef = SDU_DIAG_GLOBAL_ExtCAN_RQ_BODY3_ST3_1d96a036_Rx
              PduRSrcPduPduRBswModulesRef = CanTp
            SDU_DIAG_GLOBAL_ExtCAN_RQ_BODY3_ST3_1d96a036_Rx_19a79fac_Rx (PduRDestPdu):
              PduRDestPduHandleId = 0
              PduRDestPduDirection = RECEIVE
              PduRDestPduRoutingType = API_FORWARDING
              PduRDestPduDataProcessing = IMMEDIATE
              PduRPduLengthHandlingStrategy = UNUSED
              PduRDestPduCrossPartitionDestination = false
              PduRDestPduRef = SDU_DIAG_GLOBAL_ExtCAN_RQ_BODY3_ST3_18e7f235_Rx
              PduRDestPduPduRBswModulesRef = Dcm
          Develop8_Rs_RBTM_FL_ST3_9a3b4dd1_Tx: PduRRoutingPathCommunicationType=COMMUNICATION_INTERFACE, variation-point=post-build-variant-condition{matching-criterion=SideAllocation, value=0}
            PduRSrcPdu_b7de4975 (PduRSrcPdu): PduRSourcePduHandleId=1, PduRSrcPduDirection=TRANSMIT, PduRSrcPduRef=Develop8_Rs_RBTM_FL_ST3_9a3b4dd1_Tx, PduRSrcPduPduRBswModulesRef=Com
            Develop8_Rs_RBTM_FL_ST3_711f265e_Tx (PduRDestPdu):
              PduRDestPduHandleId = 1
              PduRDestPduDirection = TRANSMIT
              PduRDestPduRoutingType = API_FORWARDING
              PduRDestPduDataProcessing = IMMEDIATE
              PduRPduLengthHandlingStrategy = IGNORE
              PduRDestPduCrossPartitionDestination = false
              PduRDestPduDataProvision = PDUR_DIRECT
              PduRTransmissionConfirmation = true
              PduRDestPduRef = Develop8_Rs_RBTM_FL_ST3_711f265e_Tx
              PduRDestPduPduRBswModulesRef = CanIf
          NTG_Master_Navi_ST3_1032e485_Rx: PduRRoutingPathCommunicationType=COMMUNICATION_INTERFACE
            NTG_Master_Navi_ST3_1032e485_Rx_8a45ba67_Rx (PduRDestPdu):
              PduRDestPduHandleId = 21
              PduRDestPduDirection = RECEIVE
              PduRDestPduRoutingType = API_FORWARDING
              PduRDestPduDataProcessing = IMMEDIATE
              PduRPduLengthHandlingStrategy = IGNORE
              PduRDestPduCrossPartitionDestination = false
              PduRTransmissionConfirmation = false
              PduRDestPduRef = NTG_Master_Navi_ST3_dea580a6_Rx
              PduRDestPduPduRBswModulesRef = Com
            PduRSrcPdu_8a45ba67 (PduRSrcPdu): PduRSourcePduHandleId=22, PduRSrcPduDirection=RECEIVE, PduRSrcPduRef=NTG_Master_Navi_ST3_1032e485_Rx, PduRSrcPduPduRBswModulesRef=CanIf
          RBTM_FR_Stat_ST3_8dd11b6c_Rx: PduRRoutingPathCommunicationType=COMMUNICATION_INTERFACE, variation-point=post-build-variant-condition{matching-criterion=SideAllocation, value=0}
            RBTM_FR_Stat_ST3_8dd11b6c_Rx_7234ddac_Rx (PduRDestPdu):
              PduRDestPduHandleId = 37
              PduRDestPduDirection = RECEIVE
              PduRDestPduRoutingType = API_FORWARDING
              PduRDestPduDataProcessing = IMMEDIATE
              PduRPduLengthHandlingStrategy = IGNORE
              PduRDestPduCrossPartitionDestination = false
              PduRTransmissionConfirmation = false
              PduRDestPduRef = RBTM_FR_Stat_ST3_e44387fa_Rx
              PduRDestPduPduRBswModulesRef = Com
            PduRSrcPdu_7234ddac (PduRSrcPdu): PduRSourcePduHandleId=37, PduRSrcPduDirection=RECEIVE, PduRSrcPduRef=RBTM_FR_Stat_ST3_8dd11b6c_Rx, PduRSrcPduPduRBswModulesRef=CanIf
          Ign_Stat_ST3_1e3dc39f_Rx: PduRRoutingPathCommunicationType=COMMUNICATION_INTERFACE
            Ign_Stat_ST3_1e3dc39f_Rx (PduRDestPdu):
              PduRDestPduHandleId = 17
              PduRDestPduDirection = RECEIVE
              PduRDestPduRoutingType = API_FORWARDING
              PduRDestPduDataProcessing = IMMEDIATE
              PduRPduLengthHandlingStrategy = IGNORE
              PduRDestPduCrossPartitionDestination = false
              PduRTransmissionConfirmation = false
              PduRDestPduRef = Ign_Stat_ST3_1e3dc39f_Rx
              PduRDestPduPduRBswModulesRef = Com
            PduRSrcPdu_c9c2269b (PduRSrcPdu): PduRSourcePduHandleId=18, PduRSrcPduDirection=RECEIVE, PduRSrcPduRef=Ign_Stat_ST3_1e3dc39f_Rx, PduRSrcPduPduRBswModulesRef=SecOc
          Ign_Stat_ST3_secured_fb0d4f19_Rx: PduRRoutingPathCommunicationType=COMMUNICATION_INTERFACE
            Ign_Stat_ST3_secured_fb0d4f19_Rx_f57d7485_Rx (PduRDestPdu):
              PduRDestPduHandleId = 18
              PduRDestPduDirection = RECEIVE
              PduRDestPduRoutingType = API_FORWARDING
              PduRDestPduDataProcessing = IMMEDIATE
              PduRPduLengthHandlingStrategy = IGNORE
              PduRDestPduCrossPartitionDestination = false
              PduRTransmissionConfirmation = false
              PduRDestPduRef = Ign_Stat_ST3_secured_87afaf29_Rx
              PduRDestPduPduRBswModulesRef = SecOc
            PduRSrcPdu_f57d7485 (PduRSrcPdu): PduRSourcePduHandleId=19, PduRSrcPduDirection=RECEIVE, PduRSrcPduRef=Ign_Stat_ST3_secured_fb0d4f19_Rx, PduRSrcPduPduRBswModulesRef=CanIf
          Bckl_Sw_Fx_Stat_ST3_9c2de10c_Rx: PduRRoutingPathCommunicationType=COMMUNICATION_INTERFACE
            Bckl_Sw_Fx_Stat_ST3_9c2de10c_Rx (PduRDestPdu):
              PduRDestPduHandleId = 7
              PduRDestPduDirection = RECEIVE
              PduRDestPduRoutingType = API_FORWARDING
              PduRDestPduDataProcessing = IMMEDIATE
              PduRPduLengthHandlingStrategy = IGNORE
              PduRDestPduCrossPartitionDestination = false
              PduRTransmissionConfirmation = false
              PduRDestPduRef = Bckl_Sw_Fx_Stat_ST3_9c2de10c_Rx
              PduRDestPduPduRBswModulesRef = Com
            PduRSrcPdu_6e617592 (PduRSrcPdu): PduRSourcePduHandleId=7, PduRSrcPduDirection=RECEIVE, PduRSrcPduRef=Bckl_Sw_Fx_Stat_ST3_9c2de10c_Rx, PduRSrcPduPduRBswModulesRef=SecOc
          ELC_Lvr_Stat_ST3_d97bab99_Rx: PduRRoutingPathCommunicationType=COMMUNICATION_INTERFACE
            ELC_Lvr_Stat_ST3_d97bab99_Rx (PduRDestPdu):
              PduRDestPduHandleId = 14
              PduRDestPduDirection = RECEIVE
              PduRDestPduRoutingType = API_FORWARDING
              PduRDestPduDataProcessing = IMMEDIATE
              PduRPduLengthHandlingStrategy = IGNORE
              PduRDestPduCrossPartitionDestination = false
              PduRTransmissionConfirmation = false
              PduRDestPduRef = ELC_Lvr_Stat_ST3_d97bab99_Rx
              PduRDestPduPduRBswModulesRef = Com
            PduRSrcPdu_ae29c120 (PduRSrcPdu): PduRSourcePduHandleId=15, PduRSrcPduDirection=RECEIVE, PduRSrcPduRef=ELC_Lvr_Stat_ST3_d97bab99_Rx, PduRSrcPduPduRBswModulesRef=SecOc
          Impact2_ST3_e5526ccc_Rx: PduRRoutingPathCommunicationType=COMMUNICATION_INTERFACE
            Impact2_ST3_e5526ccc_Rx (PduRDestPdu):
              PduRDestPduHandleId = 19
              PduRDestPduDirection = RECEIVE
              PduRDestPduRoutingType = API_FORWARDING
              PduRDestPduDataProcessing = IMMEDIATE
              PduRPduLengthHandlingStrategy = IGNORE
              PduRDestPduCrossPartitionDestination = false
              PduRTransmissionConfirmation = false
              PduRDestPduRef = Impact2_ST3_e5526ccc_Rx
              PduRDestPduPduRBswModulesRef = Com
            PduRSrcPdu_22492bdd (PduRSrcPdu): PduRSourcePduHandleId=20, PduRSrcPduDirection=RECEIVE, PduRSrcPduRef=Impact2_ST3_e5526ccc_Rx, PduRSrcPduPduRBswModulesRef=CanIf
          SDU_DIAG_GLOBAL_ExtEth_RQ_BODY3_ST3_38ac71dd_Rx: PduRRoutingPathCommunicationType=TRANSPORT_PROTOCOL
            SDU_DIAG_GLOBAL_ExtEth_RQ_BODY3_ST3_38ac71dd_Rx_0e266b08_Rx (PduRDestPdu):
              PduRDestPduHandleId = 1
              PduRDestPduDirection = RECEIVE
              PduRDestPduRoutingType = API_FORWARDING
              PduRDestPduDataProcessing = IMMEDIATE
              PduRPduLengthHandlingStrategy = UNUSED
              PduRDestPduCrossPartitionDestination = false
              PduRDestPduRef = SDU_DIAG_GLOBAL_ExtEth_RQ_BODY3_ST3_81f0b7e5_Rx
              PduRDestPduPduRBswModulesRef = Dcm
            PduRSrcPdu_0e266b08 (PduRSrcPdu):
              PduRSourcePduHandleId = 1
              PduRSrcPduDirection = RECEIVE
              PduRSrcPduRef = SDU_DIAG_GLOBAL_ExtEth_RQ_BODY3_ST3_38ac71dd_Rx
              PduRSrcPduPduRBswModulesRef = CanTp
          SDU_DIAG_GLOBAL_IntEth_RQ_BODY3_ST3_6efa2066_Rx: PduRRoutingPathCommunicationType=TRANSPORT_PROTOCOL
            SDU_DIAG_GLOBAL_IntEth_RQ_BODY3_ST3_6efa2066_Rx_1a629478_Rx (PduRDestPdu):
              PduRDestPduHandleId = 2
              PduRDestPduDirection = RECEIVE
              PduRDestPduRoutingType = API_FORWARDING
              PduRDestPduDataProcessing = IMMEDIATE
              PduRPduLengthHandlingStrategy = UNUSED
              PduRDestPduCrossPartitionDestination = false
              PduRDestPduRef = SDU_DIAG_GLOBAL_IntEth_RQ_BODY3_ST3_41e6471f_Rx
              PduRDestPduPduRBswModulesRef = Dcm
            PduRSrcPdu_1a629478 (PduRSrcPdu):
              PduRSourcePduHandleId = 2
              PduRSrcPduDirection = RECEIVE
              PduRSrcPduRef = SDU_DIAG_GLOBAL_IntEth_RQ_BODY3_ST3_6efa2066_Rx
              PduRSrcPduPduRBswModulesRef = CanTp
          SDU_DIAG_RBTM_FL_03_ExtEth_RQ_BODY3_ST3_4810f84e_Rx: PduRRoutingPathCommunicationType=TRANSPORT_PROTOCOL, variation-point=post-build-variant-condition{matching-criterion=SideAllocation, value=0}
            SDU_DIAG_RBTM_FL_03_ExtEth_RQ_BODY3_ST3_4810f84e_Rx_80d1f2da_Rx (PduRDestPdu):
              PduRDestPduHandleId = 4
              PduRDestPduDirection = RECEIVE
              PduRDestPduRoutingType = API_FORWARDING
              PduRDestPduDataProcessing = IMMEDIATE
              PduRPduLengthHandlingStrategy = UNUSED
              PduRDestPduCrossPartitionDestination = false
              PduRDestPduRef = SDU_DIAG_RBTM_FL_03_ExtEth_RQ_BODY3_ST3_75192bc2_Rx
              PduRDestPduPduRBswModulesRef = Dcm
            PduRSrcPdu_80d1f2da (PduRSrcPdu):
              PduRSourcePduHandleId = 4
              PduRSrcPduDirection = RECEIVE
              PduRSrcPduRef = SDU_DIAG_RBTM_FL_03_ExtEth_RQ_BODY3_ST3_4810f84e_Rx
              PduRSrcPduPduRBswModulesRef = CanTp
          SDU_DIAG_RBTM_FL_03_ExtEth_RS_BODY3_ST3_2d759203_Tx: PduRRoutingPathCommunicationType=TRANSPORT_PROTOCOL, variation-point=post-build-variant-condition{matching-criterion=SideAllocation, value=0}
            SDU_DIAG_RBTM_FL_03_ExtEth_RS_BODY3_ST3_b783cf68_Tx (PduRDestPdu):
              PduRDestPduHandleId = 1
              PduRDestPduDirection = TRANSMIT
              PduRDestPduRoutingType = API_FORWARDING
              PduRDestPduDataProcessing = IMMEDIATE
              PduRPduLengthHandlingStrategy = UNUSED
              PduRDestPduCrossPartitionDestination = false
              PduRDestPduRef = SDU_DIAG_RBTM_FL_03_ExtEth_RS_BODY3_ST3_b783cf68_Tx
              PduRDestPduPduRBswModulesRef = CanTp
            PduRSrcPdu_249a1158 (PduRSrcPdu):
              PduRSourcePduHandleId = 9
              PduRSrcPduDirection = TRANSMIT
              PduRSrcPduRef = SDU_DIAG_RBTM_FL_03_ExtEth_RS_BODY3_ST3_2d759203_Tx
              PduRSrcPduPduRBswModulesRef = Dcm
          SDU_DIAG_RBTM_FL_03_IntEth_RQ_BODY3_ST3_1e46a9f5_Rx: PduRRoutingPathCommunicationType=TRANSPORT_PROTOCOL, variation-point=post-build-variant-condition{matching-criterion=SideAllocation, value=0}
            SDU_DIAG_RBTM_FL_03_IntEth_RQ_BODY3_ST3_1e46a9f5_Rx_03bff274_Rx (PduRDestPdu):
              PduRDestPduHandleId = 5
              PduRDestPduDirection = RECEIVE
              PduRDestPduRoutingType = API_FORWARDING
              PduRDestPduDataProcessing = IMMEDIATE
              PduRPduLengthHandlingStrategy = UNUSED
              PduRDestPduCrossPartitionDestination = false
              PduRDestPduRef = SDU_DIAG_RBTM_FL_03_IntEth_RQ_BODY3_ST3_b50fdb38_Rx
              PduRDestPduPduRBswModulesRef = Dcm
            PduRSrcPdu_03bff274 (PduRSrcPdu):
              PduRSourcePduHandleId = 5
              PduRSrcPduDirection = RECEIVE
              PduRSrcPduRef = SDU_DIAG_RBTM_FL_03_IntEth_RQ_BODY3_ST3_1e46a9f5_Rx
              PduRSrcPduPduRBswModulesRef = CanTp
          SDU_DIAG_RBTM_FL_03_IntEth_RS_BODY3_ST3_ed6362f9_Tx: PduRRoutingPathCommunicationType=TRANSPORT_PROTOCOL, variation-point=post-build-variant-condition{matching-criterion=SideAllocation, value=0}
            SDU_DIAG_RBTM_FL_03_IntEth_RS_BODY3_ST3_e1d59ed3_Tx (PduRDestPdu):
              PduRDestPduHandleId = 2
              PduRDestPduDirection = TRANSMIT
              PduRDestPduRoutingType = API_FORWARDING
              PduRDestPduDataProcessing = IMMEDIATE
              PduRPduLengthHandlingStrategy = UNUSED
              PduRDestPduCrossPartitionDestination = false
              PduRDestPduRef = SDU_DIAG_RBTM_FL_03_IntEth_RS_BODY3_ST3_e1d59ed3_Tx
              PduRDestPduPduRBswModulesRef = CanTp
            PduRSrcPdu_3fa3fd23 (PduRSrcPdu):
              PduRSourcePduHandleId = 10
              PduRSrcPduDirection = TRANSMIT
              PduRSrcPduRef = SDU_DIAG_RBTM_FL_03_IntEth_RS_BODY3_ST3_ed6362f9_Tx
              PduRSrcPduPduRBswModulesRef = Dcm
          Bckl_Sw_Fx_Stat_ST3_secured_62272d37_Rx: PduRRoutingPathCommunicationType=COMMUNICATION_INTERFACE
            Bckl_Sw_Fx_Stat_ST3_secured_62272d37_Rx_79ab8c0b_Rx (PduRDestPdu):
              PduRDestPduHandleId = 8
              PduRDestPduDirection = RECEIVE
              PduRDestPduRoutingType = API_FORWARDING
              PduRDestPduDataProcessing = IMMEDIATE
              PduRPduLengthHandlingStrategy = IGNORE
              PduRDestPduCrossPartitionDestination = false
              PduRTransmissionConfirmation = false
              PduRDestPduRef = Bckl_Sw_Fx_Stat_ST3_secured_b672d5e7_Rx
              PduRDestPduPduRBswModulesRef = SecOc
            PduRSrcPdu_79ab8c0b (PduRSrcPdu): PduRSourcePduHandleId=8, PduRSrcPduDirection=RECEIVE, PduRSrcPduRef=Bckl_Sw_Fx_Stat_ST3_secured_62272d37_Rx, PduRSrcPduPduRBswModulesRef=CanIf
          ELC_Lvr_Stat_ST3_secured_29d2456c_Rx: PduRRoutingPathCommunicationType=COMMUNICATION_INTERFACE
            ELC_Lvr_Stat_ST3_secured_29d2456c_Rx_d27a099a_Rx (PduRDestPdu):
              PduRDestPduHandleId = 15
              PduRDestPduDirection = RECEIVE
              PduRDestPduRoutingType = API_FORWARDING
              PduRDestPduDataProcessing = IMMEDIATE
              PduRPduLengthHandlingStrategy = IGNORE
              PduRDestPduCrossPartitionDestination = false
              PduRTransmissionConfirmation = false
              PduRDestPduRef = ELC_Lvr_Stat_ST3_secured_7bad7996_Rx
              PduRDestPduPduRBswModulesRef = SecOc
            PduRSrcPdu_d27a099a (PduRSrcPdu): PduRSourcePduHandleId=16, PduRSrcPduDirection=RECEIVE, PduRSrcPduRef=ELC_Lvr_Stat_ST3_secured_29d2456c_Rx, PduRSrcPduPduRBswModulesRef=CanIf
          RBTM_FL_Tens_ST3_553ec607_Tx: PduRRoutingPathCommunicationType=COMMUNICATION_INTERFACE, variation-point=post-build-variant-condition{matching-criterion=SideAllocation, value=0}
            PduRSrcPdu_074527d1 (PduRSrcPdu): PduRSourcePduHandleId=6, PduRSrcPduDirection=TRANSMIT, PduRSrcPduRef=RBTM_FL_Tens_ST3_553ec607_Tx, PduRSrcPduPduRBswModulesRef=Com
            RBTM_FL_Tens_ST3_49d8a970_Tx (PduRDestPdu):
              PduRDestPduHandleId = 6
              PduRDestPduDirection = TRANSMIT
              PduRDestPduRoutingType = API_FORWARDING
              PduRDestPduDataProcessing = IMMEDIATE
              PduRPduLengthHandlingStrategy = IGNORE
              PduRDestPduCrossPartitionDestination = false
              PduRDestPduDataProvision = PDUR_DIRECT
              PduRTransmissionConfirmation = true
              PduRDestPduRef = RBTM_FL_Tens_ST3_49d8a970_Tx
              PduRDestPduPduRBswModulesRef = CanIf
          SBeltTens_SP_Lvl_ST3_73b20851_Rx: PduRRoutingPathCommunicationType=COMMUNICATION_INTERFACE
            SBeltTens_SP_Lvl_ST3_73b20851_Rx_c609bb6e_Rx (PduRDestPdu):
              PduRDestPduHandleId = 28
              PduRDestPduDirection = RECEIVE
              PduRDestPduRoutingType = API_FORWARDING
              PduRDestPduDataProcessing = IMMEDIATE
              PduRPduLengthHandlingStrategy = IGNORE
              PduRDestPduCrossPartitionDestination = false
              PduRTransmissionConfirmation = false
              PduRDestPduRef = SBeltTens_SP_Lvl_ST3_46421e11_Rx
              PduRDestPduPduRBswModulesRef = Com
            PduRSrcPdu_c609bb6e (PduRSrcPdu): PduRSourcePduHandleId=28, PduRSrcPduDirection=RECEIVE, PduRSrcPduRef=SBeltTens_SP_Lvl_ST3_73b20851_Rx, PduRSrcPduPduRBswModulesRef=CanIf
          BeltHdOvr_FR_State_ST3_09789cac_Rx: PduRRoutingPathCommunicationType=COMMUNICATION_INTERFACE, variation-point=post-build-variant-condition{matching-criterion=SideAllocation, value=1}
            PduRSrcPdu_4c2f4fea (PduRSrcPdu): PduRSourcePduHandleId=35, PduRSrcPduDirection=RECEIVE, PduRSrcPduRef=BeltHdOvr_FR_State_ST3_09789cac_Rx, PduRSrcPduPduRBswModulesRef=CanIf
            BeltHdOvr_FR_State_ST3_09789cac_Rx_4c2f4fea_Rx (PduRDestPdu):
              PduRDestPduHandleId = 35
              PduRDestPduDirection = RECEIVE
              PduRDestPduRoutingType = API_FORWARDING
              PduRDestPduDataProcessing = IMMEDIATE
              PduRPduLengthHandlingStrategy = IGNORE
              PduRDestPduCrossPartitionDestination = false
              PduRTransmissionConfirmation = false
              PduRDestPduRef = BeltHdOvr_FR_State_ST3_c8a18c7a_Rx
              PduRDestPduPduRBswModulesRef = Com
          SDU_DIAG_RBTM_FR_03_ExtEth_RQ_BODY3_ST3_3a3e8176_Rx: PduRRoutingPathCommunicationType=TRANSPORT_PROTOCOL, variation-point=post-build-variant-condition{matching-criterion=SideAllocation, value=1}
            SDU_DIAG_RBTM_FR_03_ExtEth_RQ_BODY3_ST3_3a3e8176_Rx_4d07a2cf_Rx (PduRDestPdu):
              PduRDestPduHandleId = 4
              PduRDestPduDirection = RECEIVE
              PduRDestPduRoutingType = API_FORWARDING
              PduRDestPduDataProcessing = IMMEDIATE
              PduRPduLengthHandlingStrategy = UNUSED
              PduRDestPduCrossPartitionDestination = false
              PduRDestPduRef = SDU_DIAG_RBTM_FR_03_ExtEth_RQ_BODY3_ST3_68423a11_Rx
              PduRDestPduPduRBswModulesRef = Dcm
            PduRSrcPdu_4d07a2cf (PduRSrcPdu):
              PduRSourcePduHandleId = 4
              PduRSrcPduDirection = RECEIVE
              PduRSrcPduRef = SDU_DIAG_RBTM_FR_03_ExtEth_RQ_BODY3_ST3_3a3e8176_Rx
              PduRSrcPduPduRBswModulesRef = CanTp
          ECU_Stat_RBTM_FR_ST3_28d39f08_Tx: PduRRoutingPathCommunicationType=COMMUNICATION_INTERFACE, variation-point=post-build-variant-condition{matching-criterion=SideAllocation, value=1}
            ECU_Stat_RBTM_FR_ST3_9988b431_Tx (PduRDestPdu):
              PduRDestPduHandleId = 2
              PduRDestPduDirection = TRANSMIT
              PduRDestPduRoutingType = API_FORWARDING
              PduRDestPduDataProcessing = IMMEDIATE
              PduRPduLengthHandlingStrategy = IGNORE
              PduRDestPduCrossPartitionDestination = false
              PduRTransmissionConfirmation = true
              PduRDestPduDataProvision = PDUR_DIRECT
              PduRDestPduRef = ECU_Stat_RBTM_FR_ST3_9988b431_Tx
              PduRDestPduPduRBswModulesRef = CanIf
            PduRSrcPdu_2db65a34 (PduRSrcPdu): PduRSourcePduHandleId=2, PduRSrcPduDirection=TRANSMIT, PduRSrcPduRef=ECU_Stat_RBTM_FR_ST3_28d39f08_Tx, PduRSrcPduPduRBswModulesRef=Com
          Meas8_RBTM_FR_ST3_76ff3d39_Tx: PduRRoutingPathCommunicationType=COMMUNICATION_INTERFACE, variation-point=post-build-variant-condition{matching-criterion=SideAllocation, value=1}
            PduRSrcPdu_dedcc96f (PduRSrcPdu): PduRSourcePduHandleId=3, PduRSrcPduDirection=TRANSMIT, PduRSrcPduRef=Meas8_RBTM_FR_ST3_76ff3d39_Tx, PduRSrcPduPduRBswModulesRef=Com
            Meas8_RBTM_FR_ST3_6f1e0041_Tx (PduRDestPdu):
              PduRDestPduHandleId = 3
              PduRDestPduDirection = TRANSMIT
              PduRDestPduRoutingType = API_FORWARDING
              PduRDestPduDataProcessing = IMMEDIATE
              PduRPduLengthHandlingStrategy = IGNORE
              PduRDestPduCrossPartitionDestination = false
              PduRTransmissionConfirmation = true
              PduRDestPduDataProvision = PDUR_DIRECT
              PduRDestPduRef = Meas8_RBTM_FR_ST3_6f1e0041_Tx
              PduRDestPduPduRBswModulesRef = CanIf
          BeltAdj_FR_Stat_ST3_eba9bce0_Tx: PduRRoutingPathCommunicationType=COMMUNICATION_INTERFACE, variation-point=post-build-variant-condition{matching-criterion=SideAllocation, value=1}
            BeltAdj_FR_Stat_ST3_2b5906f9_Tx (PduRDestPdu):
              PduRDestPduHandleId = 0
              PduRDestPduDirection = TRANSMIT
              PduRDestPduRoutingType = API_FORWARDING
              PduRDestPduDataProcessing = IMMEDIATE
              PduRPduLengthHandlingStrategy = IGNORE
              PduRDestPduCrossPartitionDestination = false
              PduRTransmissionConfirmation = true
              PduRDestPduDataProvision = PDUR_DIRECT
              PduRDestPduRef = BeltAdj_FR_Stat_ST3_2b5906f9_Tx
              PduRDestPduPduRBswModulesRef = CanIf
            PduRSrcPdu_0892c3c5 (PduRSrcPdu): PduRSourcePduHandleId=0, PduRSrcPduDirection=TRANSMIT, PduRSrcPduRef=BeltAdj_FR_Stat_ST3_eba9bce0_Tx, PduRSrcPduPduRBswModulesRef=Com
          SDU_DIAG_RBTM_FR_03_ExtCAN_RQ_BODY3_ST3_1f04509d_Rx: PduRRoutingPathCommunicationType=TRANSPORT_PROTOCOL, variation-point=post-build-variant-condition{matching-criterion=SideAllocation, value=1}
            SDU_DIAG_RBTM_FR_03_ExtCAN_RQ_BODY3_ST3_1f04509d_Rx_7beeea72_Rx (PduRDestPdu):
              PduRDestPduHandleId = 3
              PduRDestPduDirection = RECEIVE
              PduRDestPduRoutingType = API_FORWARDING
              PduRDestPduDataProcessing = IMMEDIATE
              PduRPduLengthHandlingStrategy = UNUSED
              PduRDestPduCrossPartitionDestination = false
              PduRDestPduRef = SDU_DIAG_RBTM_FR_03_ExtCAN_RQ_BODY3_ST3_f1557fc1_Rx
              PduRDestPduPduRBswModulesRef = Dcm
            PduRSrcPdu_7beeea72 (PduRSrcPdu):
              PduRSourcePduHandleId = 3
              PduRSrcPduDirection = RECEIVE
              PduRSrcPduRef = SDU_DIAG_RBTM_FR_03_ExtCAN_RQ_BODY3_ST3_1f04509d_Rx
              PduRSrcPduPduRBswModulesRef = CanTp
          SDU_DIAG_RBTM_FR_03_ExtEth_RS_BODY3_ST3_302e83d0_Tx: PduRRoutingPathCommunicationType=TRANSPORT_PROTOCOL, variation-point=post-build-variant-condition{matching-criterion=SideAllocation, value=1}
            PduRSrcPdu_a0766459 (PduRSrcPdu):
              PduRSourcePduHandleId = 9
              PduRSrcPduDirection = TRANSMIT
              PduRSrcPduRef = SDU_DIAG_RBTM_FR_03_ExtEth_RS_BODY3_ST3_302e83d0_Tx
              PduRSrcPduPduRBswModulesRef = Dcm
            SDU_DIAG_RBTM_FR_03_ExtEth_RS_BODY3_ST3_c5adb650_Tx (PduRDestPdu):
              PduRDestPduHandleId = 1
              PduRDestPduDirection = TRANSMIT
              PduRDestPduRoutingType = API_FORWARDING
              PduRDestPduDataProcessing = IMMEDIATE
              PduRPduLengthHandlingStrategy = UNUSED
              PduRDestPduCrossPartitionDestination = false
              PduRDestPduRef = SDU_DIAG_RBTM_FR_03_ExtEth_RS_BODY3_ST3_c5adb650_Tx
              PduRDestPduPduRBswModulesRef = CanTp
          SDU_DIAG_RBTM_FR_03_ExtCAN_RS_BODY3_ST3_a939c600_Tx: PduRRoutingPathCommunicationType=TRANSPORT_PROTOCOL, variation-point=post-build-variant-condition{matching-criterion=SideAllocation, value=1}
            PduRSrcPdu_8d2872fc (PduRSrcPdu):
              PduRSourcePduHandleId = 8
              PduRSrcPduDirection = TRANSMIT
              PduRSrcPduRef = SDU_DIAG_RBTM_FR_03_ExtCAN_RS_BODY3_ST3_a939c600_Tx
              PduRSrcPduPduRBswModulesRef = Dcm
            SDU_DIAG_RBTM_FR_03_ExtCAN_RS_BODY3_ST3_e09767bb_Tx (PduRDestPdu):
              PduRDestPduHandleId = 0
              PduRDestPduDirection = TRANSMIT
              PduRDestPduRoutingType = API_FORWARDING
              PduRDestPduDataProcessing = IMMEDIATE
              PduRPduLengthHandlingStrategy = UNUSED
              PduRDestPduCrossPartitionDestination = false
              PduRDestPduRef = SDU_DIAG_RBTM_FR_03_ExtCAN_RS_BODY3_ST3_e09767bb_Tx
              PduRDestPduPduRBswModulesRef = CanTp
          RBTM_FR_Stat_ST3_e44387fa_Tx: PduRRoutingPathCommunicationType=COMMUNICATION_INTERFACE, variation-point=post-build-variant-condition{matching-criterion=SideAllocation, value=1}
            PduRSrcPdu_45e6f19d (PduRSrcPdu): PduRSourcePduHandleId=5, PduRSrcPduDirection=TRANSMIT, PduRSrcPduRef=RBTM_FR_Stat_ST3_e44387fa_Tx, PduRSrcPduPduRBswModulesRef=Com
            RBTM_FR_Stat_ST3_8dd11b6c_Tx (PduRDestPdu):
              PduRDestPduHandleId = 5
              PduRDestPduDirection = TRANSMIT
              PduRDestPduRoutingType = API_FORWARDING
              PduRDestPduDataProcessing = IMMEDIATE
              PduRPduLengthHandlingStrategy = IGNORE
              PduRDestPduCrossPartitionDestination = false
              PduRTransmissionConfirmation = true
              PduRDestPduDataProvision = PDUR_DIRECT
              PduRDestPduRef = RBTM_FR_Stat_ST3_8dd11b6c_Tx
              PduRDestPduPduRBswModulesRef = CanIf
          BeltAdj_FL_Stat_ST3_71e5093a_Rx: PduRRoutingPathCommunicationType=COMMUNICATION_INTERFACE, variation-point=post-build-variant-condition{matching-criterion=SideAllocation, value=1}
            PduRSrcPdu_9982cecc (PduRSrcPdu): PduRSourcePduHandleId=34, PduRSrcPduDirection=RECEIVE, PduRSrcPduRef=BeltAdj_FL_Stat_ST3_71e5093a_Rx, PduRSrcPduPduRBswModulesRef=CanIf
            BeltAdj_FL_Stat_ST3_71e5093a_Rx_9982cecc_Rx (PduRDestPdu):
              PduRDestPduHandleId = 34
              PduRDestPduDirection = RECEIVE
              PduRDestPduRoutingType = API_FORWARDING
              PduRDestPduDataProcessing = IMMEDIATE
              PduRPduLengthHandlingStrategy = IGNORE
              PduRDestPduCrossPartitionDestination = false
              PduRTransmissionConfirmation = false
              PduRDestPduRef = BeltAdj_FL_Stat_ST3_d2ce0dbb_Rx
              PduRDestPduPduRBswModulesRef = Com
          ROE_RBTM_FR_ST3_79bce2bc_Tx: PduRRoutingPathCommunicationType=COMMUNICATION_INTERFACE, variation-point=post-build-variant-condition{matching-criterion=SideAllocation, value=1}
            ROE_RBTM_FR_ST3_ae40752b_Tx (PduRDestPdu):
              PduRDestPduHandleId = 7
              PduRDestPduDirection = TRANSMIT
              PduRDestPduRoutingType = API_FORWARDING
              PduRDestPduDataProcessing = IMMEDIATE
              PduRPduLengthHandlingStrategy = IGNORE
              PduRDestPduCrossPartitionDestination = false
              PduRTransmissionConfirmation = true
              PduRDestPduDataProvision = PDUR_DIRECT
              PduRDestPduRef = ROE_RBTM_FR_ST3_ae40752b_Tx
              PduRDestPduPduRBswModulesRef = CanIf
            PduRSrcPdu_efc3e236 (PduRSrcPdu): PduRSourcePduHandleId=7, PduRSrcPduDirection=TRANSMIT, PduRSrcPduRef=ROE_RBTM_FR_ST3_79bce2bc_Tx, PduRSrcPduPduRBswModulesRef=Com
          SDU_DIAG_RBTM_FR_03_IntEth_RQ_BODY3_ST3_6c68d0cd_Rx: PduRRoutingPathCommunicationType=TRANSPORT_PROTOCOL, variation-point=post-build-variant-condition{matching-criterion=SideAllocation, value=1}
            SDU_DIAG_RBTM_FR_03_IntEth_RQ_BODY3_ST3_6c68d0cd_Rx_8aa11052_Rx (PduRDestPdu):
              PduRDestPduHandleId = 5
              PduRDestPduDirection = RECEIVE
              PduRDestPduRoutingType = API_FORWARDING
              PduRDestPduDataProcessing = IMMEDIATE
              PduRPduLengthHandlingStrategy = UNUSED
              PduRDestPduCrossPartitionDestination = false
              PduRDestPduRef = SDU_DIAG_RBTM_FR_03_IntEth_RQ_BODY3_ST3_a854caeb_Rx
              PduRDestPduPduRBswModulesRef = Dcm
            PduRSrcPdu_8aa11052 (PduRSrcPdu):
              PduRSourcePduHandleId = 5
              PduRSrcPduDirection = RECEIVE
              PduRSrcPduRef = SDU_DIAG_RBTM_FR_03_IntEth_RQ_BODY3_ST3_6c68d0cd_Rx
              PduRSrcPduPduRBswModulesRef = CanTp
          SDU_DIAG_RBTM_FR_03_IntEth_RS_BODY3_ST3_f038732a_Tx: PduRRoutingPathCommunicationType=TRANSPORT_PROTOCOL, variation-point=post-build-variant-condition{matching-criterion=SideAllocation, value=1}
            PduRSrcPdu_f76356d0 (PduRSrcPdu):
              PduRSourcePduHandleId = 10
              PduRSrcPduDirection = TRANSMIT
              PduRSrcPduRef = SDU_DIAG_RBTM_FR_03_IntEth_RS_BODY3_ST3_f038732a_Tx
              PduRSrcPduPduRBswModulesRef = Dcm
            SDU_DIAG_RBTM_FR_03_IntEth_RS_BODY3_ST3_93fbe7eb_Tx (PduRDestPdu):
              PduRDestPduHandleId = 2
              PduRDestPduDirection = TRANSMIT
              PduRDestPduRoutingType = API_FORWARDING
              PduRDestPduDataProcessing = IMMEDIATE
              PduRPduLengthHandlingStrategy = UNUSED
              PduRDestPduCrossPartitionDestination = false
              PduRDestPduRef = SDU_DIAG_RBTM_FR_03_IntEth_RS_BODY3_ST3_93fbe7eb_Tx
              PduRDestPduPduRBswModulesRef = CanTp
          NM_RBTM_FR_ST3_d30f04ec_Tx: PduRRoutingPathCommunicationType=COMMUNICATION_INTERFACE, variation-point=post-build-variant-condition{matching-criterion=SideAllocation, value=1}
            NM_RBTM_FR_ST3_d30f04ec_Tx_2c5f6cda_Tx (PduRDestPdu):
              PduRDestPduHandleId = 4
              PduRDestPduDirection = TRANSMIT
              PduRDestPduRoutingType = API_FORWARDING
              PduRDestPduDataProcessing = IMMEDIATE
              PduRPduLengthHandlingStrategy = IGNORE
              PduRDestPduCrossPartitionDestination = false
              PduRTransmissionConfirmation = true
              PduRDestPduDataProvision = PDUR_TRIGGERTRANSMIT
              PduRDestPduRef = NM_RBTM_FR_ST3_d30f04ec_Tx
              PduRDestPduPduRBswModulesRef = CanNm
            PduRSrcPdu_2c5f6cda (PduRSrcPdu): PduRSourcePduHandleId=4, PduRSrcPduDirection=TRANSMIT, PduRSrcPduRef=NM_RBTM_FR_ST3_d30f04ec_Tx, PduRSrcPduPduRBswModulesRef=Com
          RBTM_FL_Stat_ST3_d76d14af_Rx: PduRRoutingPathCommunicationType=COMMUNICATION_INTERFACE, variation-point=post-build-variant-condition{matching-criterion=SideAllocation, value=1}
            RBTM_FL_Stat_ST3_d76d14af_Rx_16ae0594_Rx (PduRDestPdu):
              PduRDestPduHandleId = 37
              PduRDestPduDirection = RECEIVE
              PduRDestPduRoutingType = API_FORWARDING
              PduRDestPduDataProcessing = IMMEDIATE
              PduRPduLengthHandlingStrategy = IGNORE
              PduRDestPduCrossPartitionDestination = false
              PduRTransmissionConfirmation = false
              PduRDestPduRef = RBTM_FL_Stat_ST3_dd2436a1_Rx
              PduRDestPduPduRBswModulesRef = Com
            PduRSrcPdu_16ae0594 (PduRSrcPdu): PduRSourcePduHandleId=37, PduRSrcPduDirection=RECEIVE, PduRSrcPduRef=RBTM_FL_Stat_ST3_d76d14af_Rx, PduRSrcPduPduRBswModulesRef=CanIf
          Develop8_Rq_RBTM_FR_ST3_d1911cf7_Rx: PduRRoutingPathCommunicationType=COMMUNICATION_INTERFACE, variation-point=post-build-variant-condition{matching-criterion=SideAllocation, value=1}
            Develop8_Rq_RBTM_FR_ST3_d1911cf7_Rx_73b8d236_Rx (PduRDestPdu):
              PduRDestPduHandleId = 36
              PduRDestPduDirection = RECEIVE
              PduRDestPduRoutingType = API_FORWARDING
              PduRDestPduDataProcessing = IMMEDIATE
              PduRPduLengthHandlingStrategy = IGNORE
              PduRDestPduCrossPartitionDestination = false
              PduRTransmissionConfirmation = false
              PduRDestPduRef = Develop8_Rq_RBTM_FR_ST3_25b7d179_Rx
              PduRDestPduPduRBswModulesRef = Com
            PduRSrcPdu_73b8d236 (PduRSrcPdu): PduRSourcePduHandleId=36, PduRSrcPduDirection=RECEIVE, PduRSrcPduRef=Develop8_Rq_RBTM_FR_ST3_d1911cf7_Rx, PduRSrcPduPduRBswModulesRef=CanIf
          Develop8_Rs_RBTM_FR_ST3_45eb6432_Tx: PduRRoutingPathCommunicationType=COMMUNICATION_INTERFACE, variation-point=post-build-variant-condition{matching-criterion=SideAllocation, value=1}
            PduRSrcPdu_981fdebc (PduRSrcPdu): PduRSourcePduHandleId=1, PduRSrcPduDirection=TRANSMIT, PduRSrcPduRef=Develop8_Rs_RBTM_FR_ST3_45eb6432_Tx, PduRSrcPduPduRBswModulesRef=Com
            Develop8_Rs_RBTM_FR_ST3_aaf2c54f_Tx (PduRDestPdu):
              PduRDestPduHandleId = 1
              PduRDestPduDirection = TRANSMIT
              PduRDestPduRoutingType = API_FORWARDING
              PduRDestPduDataProcessing = IMMEDIATE
              PduRPduLengthHandlingStrategy = IGNORE
              PduRDestPduCrossPartitionDestination = false
              PduRTransmissionConfirmation = true
              PduRDestPduDataProvision = PDUR_DIRECT
              PduRDestPduRef = Develop8_Rs_RBTM_FR_ST3_aaf2c54f_Tx
              PduRDestPduPduRBswModulesRef = CanIf
          RBTM_FR_Tens_ST3_6c59775c_Tx: PduRRoutingPathCommunicationType=COMMUNICATION_INTERFACE, variation-point=post-build-variant-condition{matching-criterion=SideAllocation, value=1}
            PduRSrcPdu_a9321799 (PduRSrcPdu): PduRSourcePduHandleId=6, PduRSrcPduDirection=TRANSMIT, PduRSrcPduRef=RBTM_FR_Tens_ST3_6c59775c_Tx, PduRSrcPduPduRBswModulesRef=Com
            RBTM_FR_Tens_ST3_1364a6b3_Tx (PduRDestPdu):
              PduRDestPduHandleId = 6
              PduRDestPduDirection = TRANSMIT
              PduRDestPduRoutingType = API_FORWARDING
              PduRDestPduDataProcessing = IMMEDIATE
              PduRPduLengthHandlingStrategy = IGNORE
              PduRDestPduCrossPartitionDestination = false
              PduRTransmissionConfirmation = true
              PduRDestPduDataProvision = PDUR_DIRECT
              PduRDestPduRef = RBTM_FR_Tens_ST3_1364a6b3_Tx
              PduRDestPduPduRBswModulesRef = CanIf
      PduRLock_PduRExclusiveArea (PduRLock)
        PduRExclusiveArea: PduRExclusiveAreaId=0
    7 x PduRBswModules, all with PduRChangeParameterRequestApi=false, PduRCancelReceive=false:
      CanIf: PduRCancelTransmit=true, PduRCommunicationInterface=true, PduRLowerModule=true, PduRTransportProtocol=false, PduRTriggertransmit=false, PduRTxConfirmation=true, PduRUpperModule=false, PduRUseTag=false, PduRBswModuleRef=CanIf
      CanNm: PduRCancelTransmit=true, PduRCommunicationInterface=true, PduRLowerModule=true, PduRTransportProtocol=false, PduRTriggertransmit=true, PduRTxConfirmation=true, PduRUpperModule=false, PduRUseTag=false, PduRBswModuleRef=CanNm
      CanTp: PduRCancelTransmit=true, PduRCommunicationInterface=false, PduRLowerModule=true, PduRTransportProtocol=true, PduRTriggertransmit=false, PduRTxConfirmation=false, PduRUpperModule=false, PduRUseTag=false, PduRBswModuleRef=CanTp
      Com: PduRCancelTransmit=true, PduRCommunicationInterface=true, PduRLowerModule=false, PduRTransportProtocol=false, PduRTriggertransmit=true, PduRTxConfirmation=true, PduRUpperModule=true, PduRUseTag=true, PduRBswModuleRef=Com
      Dcm: PduRCancelTransmit=true, PduRCommunicationInterface=false, PduRLowerModule=false, PduRTransportProtocol=true, PduRTriggertransmit=false, PduRTxConfirmation=false, PduRUpperModule=true, PduRUseTag=true, PduRBswModuleRef=Dcm
      IpduM: PduRCancelTransmit=false, PduRCommunicationInterface=true, PduRLowerModule=true, PduRTransportProtocol=false, PduRTriggertransmit=false, PduRTxConfirmation=false, PduRUpperModule=true, PduRUseTag=false, PduRBswModuleRef=IpduM
      SecOc: PduRCancelTransmit=false, PduRCommunicationInterface=true, PduRLowerModule=true, PduRTransportProtocol=false, PduRTriggertransmit=false, PduRTxConfirmation=false, PduRUpperModule=true, PduRUseTag=false, PduRBswModuleRef=SecOC
