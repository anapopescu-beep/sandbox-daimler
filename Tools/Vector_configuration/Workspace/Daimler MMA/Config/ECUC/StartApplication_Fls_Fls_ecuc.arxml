AUTOSAR XML (schema 00049)
package /Fls
  module config Fls: implementation-config-variant=VARIANT-POST-BUILD, module-description=Fls_Impl
    CommonPublishedInformation:
      ArMajorVersion = 4
      ArMinorVersion = 4
      ArPatchVersion = 0
      ModuleId = 92
      Release = _TRICORE_TC332
      SwMajorVersion = 20
      SwMinorVersion = 1
      SwPatchVersion = 0
      VendorApiInfix = Dmu
      VendorId = 17
    FlsConfigSet:
      FlsAcErase = 0
      FlsAcWrite = 0
      FlsCallCycle = 0.01
      FlsDefaultMode = MEMIF_MODE_SLOW
      FlsEraseVerifyErrNotif = Fee_17_JobEraseErrorNotification
      FlsJobEndNotification = Fee_JobEndNotification
      FlsJobErrorNotification = Fee_JobErrorNotification
      FlsMaxReadFastMode = 64
      FlsMaxReadNormalMode = 32
      FlsMaxWriteFastMode = 32
      FlsMaxWriteNormalMode = 32
      FlsProtection = 0
      FlsWaitStateErrorCorrection = FLS_17_DMU_WAITSTATE_ERRCOREC_1
      FlsWaitStateRead = FLS_17_DMU_WAITSTATE_READ_9
      FlsSectorList_0 (FlsSectorList)
        FlsSector_0 (FlsSector): FlsNumberOfSectors=2, FlsPageSize=8, FlsSectorSize=49152, FlsSectorStartaddress=0
    FlsGeneral:
      FlsAcLoadOnJobStart = false
      FlsBaseAddress = 2936012800
      FlsBlankCheckApi = false
      FlsCancelApi = false
      FlsCompareApi = false
      FlsDevErrorDetect = true
      FlsDriverIndex = 0
      FlsGetJobResultApi = true
      FlsGetStatusApi = true
      FlsIfxFeeUse = true
      FlsInitApiMode = FLS_17_DMU_MCAL_SUPERVISOR
      FlsInitCheckApi = false
      FlsRunTimeErrorDetect = true
      FlsRuntimeApiMode = FLS_17_DMU_MCAL_SUPERVISOR
      FlsSafetyEnable = false
      FlsSetModeApi = true
      FlsTotalSize = 98304
      FlsUseInterrupts = false
      FlsVersionInfoApi = false
      FlsEccErrorInfoApi = true
      FlsEraseVerificationEnabled = false
      FlsTimeoutSupervisionEnabled = false
      FlsWriteVerificationEnabled = false
    FlsIfxSpecificConfig: FlsEraseSuspendTimeout=12000, FlsIllegalStateNotification=NULL_PTR, FlsStateVarStruct=FlsStateVar, FlsUseEraseSuspend=false
    FlsPublishedInformation:
      FlsAcLocationErase = 0
      FlsAcLocationWrite = 0
      FlsAcSizeErase = 0
      FlsAcSizeWrite = 0
      FlsEraseTime = 1897500
      FlsErasedValue = 0
      FlsExpectedHwId = 0
      FlsSpecifiedEraseCycles = 125000
      FlsWriteTime = 5154
