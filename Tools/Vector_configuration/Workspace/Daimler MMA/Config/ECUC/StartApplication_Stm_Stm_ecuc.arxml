AUTOSAR XML (schema 00049)
package /Stm
  module config Stm: implementation-config-variant=VARIANT-PRE-COMPILE, module-description=Stm_Impl
    CommonPublishedInformation:
      ArMajorVersion = 4
      ArMinorVersion = 4
      ArPatchVersion = 0
      ModuleId = 255
      Release = _TRICORE_TC332
      SwMajorVersion = 20
      SwMinorVersion = 0
      SwPatchVersion = 0
      VendorId = 17
    StmGeneral: StmDevErrorDetect=true, StmRuntimeApiMode=STM_MCAL_SUPERVISOR, StmVersionInfoApi=false
