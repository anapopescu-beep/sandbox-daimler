AUTOSAR XML (schema 00049)
package /ActiveEcuC
  module config CanNm: implementation-config-variant=VARIANT-POST-BUILD-SELECTABLE, module-description=CanNm_Impl
    CanNmGlobalConfig:
      CanNmBusLoadReductionEnabled = false
      CanNmComControlEnabled = true
      CanNmComUserDataSupport = true
      CanNmImmediateRestartEnabled = false
      CanNmPassiveModeEnabled = false
      CanNmPnEiraCalcEnabled = true
      CanNmPnResetTime = 1.1
      CanNmRemoteSleepIndEnabled = true
      CanNmUserDataEnabled = false
      CanNmBusSynchronizationEnabled = false
      CanNmCoordinatorSyncSupport = false
      CanNmDevErrorDetect = false
      CanNmImmediateTxconfEnabled = false
      CanNmMainFunctionPeriod = 0.01
      CanNmPduRxIndicationEnabled = false
      CanNmStateChangeIndEnabled = true
      CanNmVersionInfoApi = false
      CanNmDisableTxErrReport = false
      CanNmApiOptimization = true
      CanNmCanIfRangeConfigDLCCheck = false
      CanNmRuntimeMeasurementSupport = true
      CanNmSafeBswChecks = true
      CanNmPnSyncShutdownErrorReactionEnabled = false
      CanNmRuntimeErrorReport = true
      CanNmPnEiraRxNSduRef = PduPnc_EIRA_CAN_Rx
      BODY3_8b033453 (CanNmChannelConfig):
        CanNmBusLoadReductionActive = false
        CanNmImmediateNmCycleTime = 0.02
        CanNmImmediateNmTransmissions = 6
        CanNmMsgCycleOffset = 0
        CanNmMsgCycleTime = 1
        CanNmMsgTimeoutTime = 0.5
        CanNmPduCbvPosition = CANNM_PDU_BYTE_0
        CanNmPduNidPosition = CANNM_PDU_OFF
        CanNmPnEnabled = true
        CanNmPnEraCalcEnabled = false
        CanNmRemoteSleepIndTime = 2.5
        CanNmRepeatMessageTime = 3
        CanNmTimeoutTime = 2.5
        CanNmUserDataLength = 7
        CanNmWaitBusSleepTime = 1.5
        CanNmCarWakeUpRxEnabled = false
        CanNmMsgReducedTime = 0.08
        CanNmNodeId = 0
        CanNmActiveWakeupBitEnabled = true
        CanNmNodeIdEnabled = false
        CanNmNodeDetectionEnabled = false
        CanNmRepeatMsgIndEnabled = false
        CanNmImmediateRestartEnabled = false
        CanNmComControlEnabled = true
        CanNmCriBitAlwaysEnabled = false
        CanNmAllNmMessagesKeepAwake = true
        CanNmPnHandleMultipleNetworkRequests = true
        CanNmRetryFirstMessageRequest = false
        CanNmComMNetworkHandleRef = RBTM_FL_BODY3_8uqv9blm85ehm0msat385m76v_03d5f5f6 if post-build-variant-condition{matching-criterion=SideAllocation, value=0}
        CanNmComMNetworkHandleRef = RBTM_FR_BODY3_4xwwtd59665s787n6ctawh7k8_23a94727 if post-build-variant-condition{matching-criterion=SideAllocation, value=1}
        BODY3_8b033453_Rx (CanNmRxPdu):
          CanNmRxPduId = 0
          CanNmRxPduRef = RBTM_FL_BODY3NMNODE_34236992_Rx if post-build-variant-condition{matching-criterion=SideAllocation, value=0}
          CanNmRxPduRef = RBTM_FR_BODY3NMNODE_e285a2b9_Rx if post-build-variant-condition{matching-criterion=SideAllocation, value=1}
        NM_RBTM_FL_ST3_b7c99fb7_Tx (CanNmTxPdu):
          CanNmTxConfirmationPduId = 0
          CanNmTxPduRef = NM_RBTM_FL_ST3_b7c99fb7_Tx
          variation-point = post-build-variant-condition{matching-criterion=SideAllocation, value=0}
        NM_RBTM_FL_ST3_e414ee7b (CanNmUserDataTxPdu):
          CanNmTxUserDataPduId = 0
          CanNmTxUserDataPduRef = NM_RBTM_FL_ST3_0cdf2d0f_Tx
          variation-point = post-build-variant-condition{matching-criterion=SideAllocation, value=0}
        NM_RBTM_FR_ST3_6c247ca6_Tx (CanNmTxPdu):
          CanNmTxConfirmationPduId = 0
          CanNmTxPduRef = NM_RBTM_FR_ST3_6c247ca6_Tx
          variation-point = post-build-variant-condition{matching-criterion=SideAllocation, value=1}
        NM_RBTM_FR_ST3_f94fffa8 (CanNmUserDataTxPdu):
          CanNmTxUserDataPduId = 0
          CanNmTxUserDataPduRef = NM_RBTM_FR_ST3_d30f04ec_Tx
          variation-point = post-build-variant-condition{matching-criterion=SideAllocation, value=1}
      CanNmPnInfo: CanNmPnInfoLength=7, CanNmPnInfoOffset=1
        7 x CanNmPnFilterMaskByte:
          CanNmPnFilterMaskByte_2: CanNmPnFilterMaskByteIndex=2, CanNmPnFilterMaskByteValue=16
          CanNmPnFilterMaskByte_{3..5}: CanNmPnFilterMaskByteIndex={3..5}, CanNmPnFilterMaskByteValue=0
          CanNmPnFilterMaskByte_0: CanNmPnFilterMaskByteIndex=0, CanNmPnFilterMaskByteValue=1
          CanNmPnFilterMaskByte_1: CanNmPnFilterMaskByteIndex=1, CanNmPnFilterMaskByteValue=0
          CanNmPnFilterMaskByte_6: CanNmPnFilterMaskByteIndex=6, CanNmPnFilterMaskByteValue=0
      CanNmGeneration: CanNmOutOfBoundsWriteSanitizer=false, CanNmOutOfBoundsReadSanitizer=false, CanNmInterfacesForDeactivatedData=false
