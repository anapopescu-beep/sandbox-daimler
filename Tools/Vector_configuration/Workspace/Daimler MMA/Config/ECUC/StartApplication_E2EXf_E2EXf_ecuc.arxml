AUTOSAR XML (schema 00049)
package /ActiveEcuC
  module config E2EXf: implementation-config-variant=VARIANT-PRE-COMPILE, module-description=E2EXf_Impl
    XfrmGeneral: XfrmDevErrorDetect=true, XfrmVersionInfoApi=false, XfrmSafeBswChecks=true
