AUTOSAR XML (schema 00049)
package /ActiveEcuC
  module config CryIf: implementation-config-variant=VARIANT-PRE-COMPILE, module-description=CryIf_Impl
    11 x CryIfKey:
      Ssa_SignatureRamKey: CryIfKeyId=43, CryIfKeyRef=Ssa_SignatureRamKey
      Ssa_SharedSecretExchangeKey: CryIfKeyId=41, CryIfKeyRef=Ssa_SharedSecretExchangeKey
      Saa_BackendCert: CryIfKeyId=33, CryIfKeyRef=Ssa_BackendCert
      Saa_RootCert: CryIfKeyId=34, CryIfKeyRef=Ssa_RootCert
      Ssa_RandomSeed: CryIfKeyId=38, CryIfKeyRef=Ssa_RandomSeed
      Ssa_AesRamKey: CryIfKeyId=35, CryIfKeyRef=Ssa_AesRamKey
      Ssa_Authentication: CryIfKeyId=36, CryIfKeyRef=Ssa_Authentication
      Ssa_VIN: CryIfKeyId=47, CryIfKeyRef=Ssa_VIN
      Ssa_RealTime: CryIfKeyId=39, CryIfKeyRef=Ssa_RealTime
      Ssa_TickCount: CryIfKeyId=44, CryIfKeyRef=Ssa_TickCount
      Ssa_SharedSecretHash: CryIfKeyId=42, CryIfKeyRef=Ssa_SharedSecretHash
    CryIfGeneral:
      CryIfVersionInfoApi = false
      CryIfDevErrorDetect = false
      CryIfMaxNumberOfKeyElements = 10
      CryIfMaxSizeOfKeyElement = 32
      CryIfRedirection = true
      CryIfSafeBswChecks = false
    CryIfChannel: CryIfChannelId=0, CryIfDriverObjectRef=Crypto_30_vHsm_LibCv
    CryIfCryptoModule: CryIfSupportsKeyElementCopyPartial=true, CryIfCancelJobApiUsesJobType=true, CryIfCryptoModuleRef=Crypto_30_vHsm
    CryIfKey_TRNG (CryIfKey): CryIfKeyId=13, CryIfKeyRef=vHsm_TRNG
    CryIfChannel_KeyM (CryIfChannel): CryIfChannelId=3, CryIfDriverObjectRef=Crypto_30_vHsm_LibCv
    3 x CryIfKey:
      KeyM_SigVerifyKey_TrustModelBackend: CryIfKeyId=15, CryIfKeyRef=KeyM_SigVerifyKey_TrustModelBackend
      KeyM_SigVerifyKey_TrustModelIntermediate: CryIfKeyId=20, CryIfKeyRef=KeyM_SigVerifyKey_TrustModelIntermediate
      KeyM_SigVerifyKey_TrustModelRoot: CryIfKeyId=22, CryIfKeyRef=KeyM_SigVerifyKey_TrustModelRoot
    SSA_SecOC_Int_CryIfChannel (CryIfChannel): CryIfChannelId=6, CryIfDriverObjectRef=Crypto_30_vHsm_Hwa_HighPrio
    15 x CryIfKey:
      SSA_SecOC_Int_MacVerify_Ign_Stat: CryIfKeyId=29, CryIfKeyRef=SSA_SecOC_Int_MacVerify_Ign_Stat
      SSA_SecOC_Int_MacVerify_PN14_Master_Stat1: CryIfKeyId=30, CryIfKeyRef=SSA_SecOC_Int_MacVerify_PN14_Master_Stat1
      SSA_SecOC_Int_MacVerify_PT4_PTCoor4: CryIfKeyId=31, CryIfKeyRef=SSA_SecOC_Int_MacVerify_PT4_PTCoor4
      SSA_SecOC_Int_MacVerify_VehSpd_8: CryIfKeyId=32, CryIfKeyRef=SSA_SecOC_Int_MacVerify_VehSpd_8
      SSA_SecOC_Int_MacVerify_DI_OdoSpeedometer: CryIfKeyId=28, CryIfKeyRef=SSA_SecOC_Int_MacVerify_DI_OdoSpeedometer
      SSA_SecOC_Int_MacVerify_COM_C0X_Pdu20_secured_3ef6961f_Rx: CryIfKeyId=26, CryIfKeyRef=SSA_SecOC_Int_MacVerify_COM_C0X_Pdu20_secured_3ef6961f_Rx
      SSA_SecOC_Int_MacVerify_COM_C0X_Pdu21_secured_298d825c_Rx: CryIfKeyId=27, CryIfKeyRef=SSA_SecOC_Int_MacVerify_COM_C0X_Pdu21_secured_298d825c_Rx
      SSA_SecOC_Int_MacGen_COM_C04_Pdu20_secured_393d7a18_Tx: CryIfKeyId=24, CryIfKeyRef=SSA_SecOC_Int_MacGen_COM_C04_Pdu20_secured_393d7a18_Tx
      SSA_SecOC_Int_MacGen_COM_C04_Pdu03_secured_044596e0_Tx: CryIfKeyId=23, CryIfKeyRef=SSA_SecOC_Int_MacGen_COM_C04_Pdu03_secured_044596e0_Tx
      SSA_SecOC_Int_MacGen_COM_C04_Pdu21_secured_2e466e5b_Tx: CryIfKeyId=25, CryIfKeyRef=SSA_SecOC_Int_MacGen_COM_C04_Pdu21_secured_2e466e5b_Tx
      KeyM_SigVerifyKey_TrustModelBackendPeer: CryIfKeyId=16, CryIfKeyRef=KeyM_SigVerifyKey_TrustModelBackendPeer
      KeyM_SigVerifyKey_TrustModelEcuPeer: CryIfKeyId=19, CryIfKeyRef=KeyM_SigVerifyKey_TrustModelEcuPeer
      KeyM_SigVerifyKey_TrustModelIntermediatePeer: CryIfKeyId=21, CryIfKeyRef=KeyM_SigVerifyKey_TrustModelIntermediatePeer
      Ssa_PduKeysMac: CryIfKeyId=37, CryIfKeyRef=Ssa_PduKeysMac
      Ssa_SecurityAccessPublicKey: CryIfKeyId=40, CryIfKeyRef=Ssa_SecurityAccessPublicKey
    CryIfChannel_TRNG (CryIfChannel): CryIfChannelId=5, CryIfDriverObjectRef=Crypto_30_vHsm_Hwa
    CryIfCryptoModule_LibCV (CryIfCryptoModule): CryIfSupportsKeyElementCopyPartial=true, CryIfCancelJobApiUsesJobType=true, CryIfCryptoModuleRef=Crypto
    CryIfChannel_BcTp (CryIfChannel): CryIfChannelId=2, CryIfDriverObjectRef=Crypto_30_vHsm_LibCv_HighPrio
    10 x CryIfKey:
      CryIfKey_CryIfKey_Ssa_SignatureRamKey_replacementAuthority: CryIfKeyId=4, CryIfKeyRef=CryIfKey_Ssa_SignatureRamKey_replacementAuthority
      KeyM_SigVerifyKey_TrustModelEcu: CryIfKeyId=17, CryIfKeyRef=Ssa_TrustModelEcuPublic_LiveKey
      KeyM_SigVerifyKey_TrustModelEcuCsr: CryIfKeyId=18, CryIfKeyRef=Ssa_TrustModelEcuPublicCsr_StagingKey
      Ssa_TrustModelEcuPrivateKey: CryIfKeyId=45, CryIfKeyRef=Ssa_TrustModelPrivateEcu_LiveKey
      CryIfKey_CryIfKey_Ssa_TrustModelEcuCert_inHSM: CryIfKeyId=6, CryIfKeyRef=CryIfKey_Ssa_TrustModelEcuCert_inHSM
      CryIfKey_CryIfKey_Ssa_TrustModel_Ecu_CsrPrivateKey: CryIfKeyId=9, CryIfKeyRef=CryIfKey_Ssa_TrustModel_Ecu_CsrPrivateKey
      CryIfKey_CryIfKey_Ssa_TrustModelRootCert_inHSM: CryIfKeyId=8, CryIfKeyRef=CryIfKey_Ssa_TrustModelRootCert_inHSM
      CryIfKey_CryIfKey_Ssa_TrustModel_Ecu_CsrPublicKey: CryIfKeyId=10, CryIfKeyRef=CryIfKey_Ssa_TrustModel_Ecu_CsrPublicKey
      CryIfKey_CryIfKey_Ssa_TrustModelIntermediateCert_inHSM: CryIfKeyId=7, CryIfKeyRef=CryIfKey_Ssa_TrustModelIntermediateCert_inHSM
      CryIfKey_CryIfKey_Ssa_TrustModelBackendCert_inHSM: CryIfKeyId=5, CryIfKeyRef=CryIfKey_Ssa_TrustModelBackendCert_inHSM
    CryIfChannel_Ssa_Hash (CryIfChannel): CryIfChannelId=4, CryIfDriverObjectRef=CryptoDriverObject_Ssa_Hash
    3 x CryIfKey:
      CryIfKey_Ssa_Hash: CryIfKeyId=12, CryIfKeyRef=CryptoKey_Ssa_Hash
      Ssa_TrustModelEcuPrivateUniqueKey: CryIfKeyId=46, CryIfKeyRef=CryIfKey_Ssa_TrustModelPrivateEcuUnique_StagingKey
      CryIfKey_CryIfKey_vHsm_Info: CryIfKeyId=11, CryIfKeyRef=CryIfKey_vHsm_Info
    CryIfChannel_Hwa (CryIfChannel): CryIfChannelId=1, CryIfDriverObjectRef=Crypto_30_vHsm_Hwa
    6 x CryIfKey:
      CryIfKey_CSK_15576CRYPTO_ALGOFAM_AES128_3d4fd2d7: CryIfKeyId=0, CryIfKeyRef=CryptoKey_CSK_15576CRYPTO_ALGOFAM_AES128_3d4fd2d7
      CryIfKey_CSK_27103CRYPTO_ALGOFAM_AES128_0b48e843: CryIfKeyId=1, CryIfKeyRef=CryptoKey_CSK_27103CRYPTO_ALGOFAM_AES128_0b48e843
      CryIfKey_CSK_28212CRYPTO_ALGOFAM_AES128_3d56a060: CryIfKeyId=2, CryIfKeyRef=CryptoKey_CSK_28212CRYPTO_ALGOFAM_AES128_3d56a060
      CryIfKey_CSK_37177CRYPTO_ALGOFAM_AES128_c64d457a: CryIfKeyId=3, CryIfKeyRef=CryptoKey_CSK_37177CRYPTO_ALGOFAM_AES128_c64d457a
      vHSM_Version: CryIfKeyId=48, CryIfKeyRef=vHSM_Custom_HSM_Version
      CryIfKey_vHsm_Info: CryIfKeyId=14, CryIfKeyRef=vHsm_Info
