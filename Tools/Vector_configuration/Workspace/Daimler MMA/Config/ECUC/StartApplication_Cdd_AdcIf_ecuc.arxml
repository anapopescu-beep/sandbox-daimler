AUTOSAR XML (schema 00049)
package /ActiveEcuC
  module config AdcIf: definition=Cdd, implementation-config-variant=VARIANT-PRE-COMPILE
