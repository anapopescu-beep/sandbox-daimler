AUTOSAR XML (schema 00049)
package /Mcu
  module config Mcu: implementation-config-variant=VARIANT-POST-BUILD, module-description=Mcu_Impl
    CommonPublishedInformation:
      ArMajorVersion = 4
      ArMinorVersion = 4
      ArPatchVersion = 0
      ModuleId = 101
      Release = _TRICORE_TC332
      SwMajorVersion = 20
      SwMinorVersion = 0
      SwPatchVersion = 1
      VendorId = 17
    McuGeneralConfiguration:
      McuCcu60SleepModeEnabled = false
      McuCcu61SleepModeEnabled = false
      McuClearColdResetStatusApi = false
      McuClockSourceFailureNotification = true
      McuDevErrorDetect = true
      McuGetRamStateApi = false
      McuGpt12SleepModeEnabled = false
      McuGtmSleepModeEnabled = false
      McuIdleModeCpuCore = INDIVIDUAL_IDLE_CORES_SEL0
      McuIfxCpuCcuconApi = false
      McuIfxDeInitApi = false
      McuIfxLpmApi = false
      McuIfxTrapApi = false
      McuInitCheckApi = false
      McuInitClock = true
      McuInitDeInitApiMode = MCU_MCAL_SUPERVISOR
      McuMainOscillatorFrequency = 20
      McuMultiCoreErrorDetect = false
      McuNoPll = false
      McuOscAmpRegulationEnable = false
      McuOscCapacitance{0..3}Enable = false
      McuOscillatorMode = EXT_CRYSTAL_CERAMIC_RES_MODE_SEL0
      McuPerformResetApi = true
      McuRuntimeApiMode = MCU_MCAL_SUPERVISOR
      McuSafetyEnable = false
      McuStandbyEntryMode = STANDBY_ENTRY_REQ_SLEEP_SEL0
      McuSysClkFrequency = 20
      McuSystemModeCpuCore = CPU_SYSTEM_CORE0_SEL0
      McuVersionInfoApi = false
    McuHardwareResourceAllocationConf_0 (McuHardwareResourceAllocationConf)
      5 x McuAscLinAllocationConf:
        McuAscLinAllocationConf_0
          McuAscLinChannelAllocationConf: McuAscLinChannelAllocationConf=ASCLIN_CH_NOT_USED, McuAscLinKernelId=ASCLIN0
        McuAscLinAllocationConf_1
          McuAscLinChannelAllocationConf: McuAscLinChannelAllocationConf=ASCLIN_CH_USED_BY_LIN_DRIVER, McuAscLinKernelId=ASCLIN1
        McuAscLinAllocationConf_2
          McuAscLinChannelAllocationConf: McuAscLinChannelAllocationConf=ASCLIN_CH_NOT_USED, McuAscLinKernelId=ASCLIN3
        McuAscLinAllocationConf_3
          McuAscLinChannelAllocationConf: McuAscLinChannelAllocationConf=ASCLIN_CH_NOT_USED, McuAscLinKernelId=ASCLIN3
        McuAscLinAllocationConf_4
          McuAscLinChannelAllocationConf: McuAscLinChannelAllocationConf=ASCLIN_CH_NOT_USED, McuAscLinKernelId=ASCLIN3
      McuCcu6ModuleAllocationConf_0 (McuCcu6ModuleAllocationConf): McuCcu6ModuleAllocationConf=CCU6_MODULE_USED_BY_PWM_DRIVER
      McuCcu6ModuleAllocationConf_1 (McuCcu6ModuleAllocationConf): McuCcu6ModuleAllocationConf=CCU6_MODULE_USED_BY_ICU_DRIVER
      McuEruAllocationConf_0 (McuEruAllocationConf)
        8 x McuEruChannelInputLineConf, all with McuEruChannelInputLineConf=ERU_CHANNEL_INP_NOT_USED:
          McuEruChannelInputLineConf_{0..7}
        8 x McuEruChannelOutputUnitConf, all with McuEruChannelOutputUnitConf=ERU_CHANNEL_OUT_NOT_USED:
          McuEruChannelOutputUnitConf_{0..7}
      5 x McuGpt12ModuleAllocationConf:
        McuGpt12ModuleAllocationConf_0: McuGpt12ModuleAllocationConf=GPT_TIMER_NOT_USED, McuGpt12TimerAllocation=GPT_TIMER_2
        McuGpt12ModuleAllocationConf_1: McuGpt12ModuleAllocationConf=GPT_TIMER_USED_BY_GPT_DRIVER, McuGpt12TimerAllocation=GPT_TIMER_3
        McuGpt12ModuleAllocationConf_2: McuGpt12ModuleAllocationConf=GPT_TIMER_NOT_USED, McuGpt12TimerAllocation=GPT_TIMER_4
        McuGpt12ModuleAllocationConf_3: McuGpt12ModuleAllocationConf=GPT_TIMER_USED_BY_GPT_DRIVER, McuGpt12TimerAllocation=GPT_TIMER_5
        McuGpt12ModuleAllocationConf_4: McuGpt12ModuleAllocationConf=GPT_TIMER_NOT_USED, McuGpt12TimerAllocation=GPT_TIMER_6
      McuGtmAllocationConf_0 (McuGtmAllocationConf)
        McuGtmAtomAllocationConf_0 (McuGtmAtomAllocationConf)
          8 x McuGtmAtomChannelAllocationConf, all with McuAtomChannelEventHandledByDsadc=false:
            McuGtmAtomChannelAllocationConf_0: McuGtmAtomChannelAllocationConf=GTM_ATOM_CHANNEL_USED_BY_GPT
            McuGtmAtomChannelAllocationConf_{1..7}: McuGtmAtomChannelAllocationConf=GTM_ATOM_CHANNEL_NOT_USED
        McuGtmTimAllocationConf_0 (McuGtmTimAllocationConf)
          8 x McuGtmTimChannelAllocationConf, all with McuGtmTimChannelAllocationConf=GTM_TIM_CHANNEL_NOT_USED:
            McuGtmTimChannelAllocationConf_{0..7}
        McuGtmTimAllocationConf_1 (McuGtmTimAllocationConf)
          8 x McuGtmTimChannelAllocationConf, all with McuGtmTimChannelAllocationConf=GTM_TIM_CHANNEL_NOT_USED:
            McuGtmTimChannelAllocationConf_{0..7}
        McuGtmTomAllocationConf_0 (McuGtmTomAllocationConf)
          16 x McuGtmTomChannelAllocationConf, all with McuTomChannelEventHandledByDsadc=false:
            McuGtmTomChannelAllocationConf_0: McuGtmTomChannelAllocationConf=GTM_TOM_CHANNEL_NOT_USED
            McuGtmTomChannelAllocationConf_1: McuGtmTomChannelAllocationConf=GTM_TOM_CHANNEL_NOT_USED
            McuGtmTomChannelAllocationConf_{10..15}: McuGtmTomChannelAllocationConf=GTM_TOM_CHANNEL_NOT_USED
            McuGtmTomChannelAllocationConf_{2..7}: McuGtmTomChannelAllocationConf=GTM_TOM_CHANNEL_NOT_USED
            McuGtmTomChannelAllocationConf_8: McuGtmTomChannelAllocationConf=GTM_TOM_CHANNEL_USED_BY_PWM
            McuGtmTomChannelAllocationConf_9: McuGtmTomChannelAllocationConf=GTM_TOM_CHANNEL_NOT_USED
        McuGtmTomAllocationConf_1 (McuGtmTomAllocationConf)
          16 x McuGtmTomChannelAllocationConf, all with McuGtmTomChannelAllocationConf=GTM_TOM_CHANNEL_NOT_USED, McuTomChannelEventHandledByDsadc=false:
            McuGtmTomChannelAllocationConf_0
            McuGtmTomChannelAllocationConf_1
            McuGtmTomChannelAllocationConf_{10..15}
            McuGtmTomChannelAllocationConf_{2..9}
      McuStmAllocationConf_0 (McuStmAllocationConf): McuStmCmp0RegAllocationConf=STM_CMP0_USED_BY_WDG, McuStmCmp1RegAllocationConf=STM_CMP1_USED_BY_STM
    McuModuleConfiguration: McuClockSrcFailureNotification=DISABLED, McuNumberOfMcuModes=1, McuRamSectors=0
      GtmGlobalConfiguration_0 (GtmGlobalConfiguration)
        GtmAtomGlobalConf_0 (GtmAtomGlobalConf)
          8 x GtmAtomChannelConf, all with GtmAtomChInternalTriggerEnable=false, GtmAtomChResetCn0OnTriggerEnable=false, GtmTimerPortPinSelect=NONE:
            GtmAtomChannelConf_{0..7}
          GtmAtomGroupConf
            GtmAtomActionTimeBaseUnitConf: GtmAtomActionTimeBaseSelection=ATOM_ACT_TB_TBU_TS0, GtmAtomActionTimeBaseValue=1
        GtmClusterConf_0 (GtmClusterConf): GtmCmuClusterInputClockDividerEnable=CLS_CLK_CFG_ENABLED_WITH_DIV_SEL2
          GtmClusterConfClockSetting:
            GtmClusterConfClock{0..7}Src = CMU_CONF_CLOCK{0..7}_SEL0
          GtmClusterFixedClockSetting: GtmClusterFixedClockSrc=CMU_FIXED_CLOCK0_SEL0
        GtmClusterConf_1 (GtmClusterConf): GtmCmuClusterInputClockDividerEnable=CLS_CLK_CFG_ENABLED_WITH_DIV_SEL2
          GtmClusterConfClockSetting:
            GtmClusterConfClock{0..7}Src = CMU_CONF_CLOCK{0..7}_SEL0
          GtmClusterFixedClockSetting: GtmClusterFixedClockSrc=CMU_FIXED_CLOCK0_SEL0
        3 x GtmTbuChannelConf, all with GtmTbuChClockSourceSelection=CMU_CLOCK0_SEL0, GtmTbuChMode=FREE_RUNNING_COUNTER_SEL0, GtmTbuChModuloCntrSel=TBU_CH1_SEL0, GtmTbuChResolutionSel=TBU_CH_LOWER_COUNT_BITS_SEL0:
          GtmTbuChannelConf_0: GtmTbuChannelEnable=true
          GtmTbuChannelConf_1: GtmTbuChannelEnable=false
          GtmTbuChannelConf_2: GtmTbuChannelEnable=false
        GtmTimGlobalConf_0 (GtmTimGlobalConf)
          8 x GtmTimChannelConf, all with GtmTimInpPortPinSel=SEL0_NONE:
            GtmTimChannelConf_{0..7}
        GtmTimGlobalConf_1 (GtmTimGlobalConf)
          8 x GtmTimChannelConf, all with GtmTimInpPortPinSel=SEL0_NONE:
            GtmTimChannelConf_{0..7}
        GtmTomGlobalConf_0 (GtmTomGlobalConf)
          16 x GtmTomChannelConf, all with GtmTomChInternalTriggerEnable=false, GtmTomChResetCn0OnTriggerEnable=false:
            GtmTomChannelConf_0: GtmTimerPortPinSelect=NONE
            GtmTomChannelConf_1: GtmTimerPortPinSelect=NONE
            GtmTomChannelConf_{10..15}: GtmTimerPortPinSelect=NONE
            GtmTomChannelConf_{2..7}: GtmTimerPortPinSelect=NONE
            GtmTomChannelConf_8: GtmTimerPortPinSelect=TOUT8_SELA_0_PORT02_PIN8
            GtmTomChannelConf_9: GtmTimerPortPinSelect=NONE
          GtmTomGroupConf_0 (GtmTomGroupConf)
            GtmTomActionTimeBaseUnitConf: GtmTomActionTimeBaseSelection=TOM_ACT_TB_TBU_TS0, GtmTomActionTimeBaseValue=1
          GtmTomGroupConf_1 (GtmTomGroupConf)
            GtmTomActionTimeBaseUnitConf: GtmTomActionTimeBaseSelection=TOM_ACT_TB_TBU_TS0, GtmTomActionTimeBaseValue=1
        GtmTomGlobalConf_1 (GtmTomGlobalConf)
          16 x GtmTomChannelConf, all with GtmTimerPortPinSelect=NONE, GtmTomChInternalTriggerEnable=false, GtmTomChResetCn0OnTriggerEnable=false:
            GtmTomChannelConf_0
            GtmTomChannelConf_1
            GtmTomChannelConf_{10..15}
            GtmTomChannelConf_{2..9}
          GtmTomGroupConf_0 (GtmTomGroupConf)
            GtmTomActionTimeBaseUnitConf: GtmTomActionTimeBaseSelection=TOM_ACT_TB_TBU_TS0, GtmTomActionTimeBaseValue=1
          GtmTomGroupConf_1 (GtmTomGroupConf)
            GtmTomActionTimeBaseUnitConf: GtmTomActionTimeBaseSelection=TOM_ACT_TB_TBU_TS0, GtmTomActionTimeBaseValue=1
        9 x GtmTriggerForAdc, all with GtmAdcTrigger1Select=TRIG_0_NO_TRIGGER, GtmAdcTrigger2Select=TRIG_0_NO_TRIGGER, GtmAdcTrigger3Select=TRIG_0_NO_TRIGGER, GtmAdcTrigger4Select=TRIG_0_NO_TRIGGER:
          GtmTriggerForAdc_0: GtmAdcTrigger0Select=TRIG_1
          GtmTriggerForAdc_{1..8}: GtmAdcTrigger0Select=TRIG_0_NO_TRIGGER
        McuGtmClockManagementConf: GtmCmuGlobalClockDenominator=1, GtmCmuGlobalClockNumerator=1
          GtmConfigClockSetting:
            GtmCmuConfigClock0Div = 0
            GtmCmuConfigClock0Enable = true
            GtmCmuConfigClock1Div = 0
            GtmCmuConfigClock1Enable = true
            GtmCmuConfigClock2Div = 0
            GtmCmuConfigClock2Enable = true
            GtmCmuConfigClock3Div = 0
            GtmCmuConfigClock3Enable = true
            GtmCmuConfigClock4Div = 0
            GtmCmuConfigClock4Enable = true
            GtmCmuConfigClock5Div = 0
            GtmCmuConfigClock5Enable = true
            GtmCmuConfigClock6Div = 0
            GtmCmuConfigClock6Enable = true
            GtmCmuConfigClock7Div = 0
            GtmCmuConfigClock7Enable = true
          GtmExtClockSetting:
            GtmCmuExtClock0Denominator = 1
            GtmCmuExtClock0Enable = false
            GtmCmuExtClock0Numerator = 1
            GtmCmuExtClock1Denominator = 1
            GtmCmuExtClock1Enable = false
            GtmCmuExtClock1Numerator = 1
            GtmCmuExtClock2Denominator = 1
            GtmCmuExtClock2Enable = false
            GtmCmuExtClock2Numerator = 1
          GtmFixedClockSetting: GtmCmuFixedClockEnable=true, GtmCmuFixedClockSel=CMU_GLOBAL_CLOCK_SEL0
      McuClockSettingConfig_0 (McuClockSettingConfig): McuClockSettingId=0
        15 x McuClockReferencePoint:
          McuClockReferencePoint_ADC: McuClockRefSelection=MCU_ADC_FREQUENCY, McuClockReferencePointFrequency=160000000
          McuClockReferencePoint_ASCLINFAST: McuClockRefSelection=MCU_ASCLINFAST_FREQUENCY, McuClockReferencePointFrequency=80000000
          McuClockReferencePoint_ASCLINSLOW: McuClockRefSelection=MCU_ASCLINSLOW_FREQUENCY, McuClockReferencePointFrequency=20000000
          McuClockReferencePoint_BBB: McuClockRefSelection=MCU_BBB_FREQUENCY, McuClockReferencePointFrequency=80000000
          McuClockReferencePoint_CPU0: McuClockRefSelection=MCU_CPU0_FREQUENCY, McuClockReferencePointFrequency=160000000
          McuClockReferencePoint_FSI: McuClockRefSelection=MCU_FSI_FREQUENCY, McuClockReferencePointFrequency=80000000
          McuClockReferencePoint_FSI2: McuClockRefSelection=MCU_FSI2_FREQUENCY, McuClockReferencePointFrequency=160000000
          McuClockReferencePoint_GTM: McuClockRefSelection=MCU_GTM_FREQUENCY, McuClockReferencePointFrequency=80000000
          McuClockReferencePoint_HSCT: McuClockRefSelection=MCU_HSCT_FREQUENCY, McuClockReferencePointFrequency=320000000
          McuClockReferencePoint_MCAN: McuClockRefSelection=MCU_MCAN_FREQUENCY, McuClockReferencePointFrequency=80000000
          McuClockReferencePoint_MCANH: McuClockRefSelection=MCU_MCANH_FREQUENCY, McuClockReferencePointFrequency=80000000
          McuClockReferencePoint_QSPI: McuClockRefSelection=MCU_QSPI_FREQUENCY, McuClockReferencePointFrequency=160000000
          McuClockReferencePoint_SPB: McuClockRefSelection=MCU_SPB_FREQUENCY, McuClockReferencePointFrequency=80000000
          McuClockReferencePoint_SRI: McuClockRefSelection=MCU_SRI_FREQUENCY, McuClockReferencePointFrequency=160000000
          McuClockReferencePoint_STM: McuClockRefSelection=MCU_STM_FREQUENCY, McuClockReferencePointFrequency=80000000
        McuClockReferencePointConfig
          McuClockMonitorConfig:
            McuBackupClockMonEnable = false
            McuBackupClockRangeMonEnable = false
            McuPll{0..2}ClockMonEnable = false
            McuSpbClockMonEnable = false
          McuExternalClockOutputConfig:
            McuExtClock0Enable = false
            McuExtClock1Enable = false
            McuExtClock1Inverted = false
            McuExtClockOutSel0 = FOUT_EXT_CLOCK0_SEL0
            McuExtClockOutSel1 = FOUT_EXT_CLOCK1_SEL0
            McuFoutClockDiv = 1
          McuPeripheralPllSettingConfig:
            McuClockReferencePointFrequency1 = 160000000
            McuClockReferencePointFrequency2 = 160000000
            McuFreqSource1ClockDivSelect = DIV_FACTOR_2_NOT_BYPASSED_SEL0
            McuPerPllK2DivStepDownChangeDelay = 10
            McuPerPllK2DivStepUpChangeDelay = 10
            McuPerPllK3DivStepDownChangeDelay = 10
            McuPerPllK3DivStepUpChangeDelay = 10
            McuPeripheralPllK2Divider = 1
            McuPeripheralPllK3Divider = 1
            McuPeripheralPllNDivider = 31
            McuPeripheralPllPDivider = 0
            McuPll2DivSelect = MCU_K3_DIV_FACTOR_BYPASSED_SEL1
          McuPllDistributionSettingConfig:
            McuAdasFrequency = 0
            McuAdcFrequency = 160000000
            McuAscLinFastFrequency = 80000000
            McuAscLinSlowClockSourceSelection = ASCLINS_CLOCK_SOURCE_ASCLINSI_SEL1
            McuAscLinSlowFrequency = 20000000
            McuBBBFrequency = 80000000
            McuCPU0Frequency = 160000000
            McuCPU{1..3}Frequency = 300000000
            McuCPU4Frequency = 0
            McuCPU5Frequency = 0
            McuClockDistributionInpClockSel = PLL_INPUT_CLOCK_SRC_SELECT_SEL1
            McuConvCtrlPhaseSynchConf = PHASE_SYNCH_CONST_ACTIVE_SEL0
            McuEbuClkEnable = false
            McuEbuFrequency = 0
            McuErayClkEnable = true
            McuErayFrequency = 80000000
            McuFSI2Frequency = 160000000
            McuFSIFrequency = 80000000
            McuGEthFrequency = 80000000
            McuGTMFrequency = 80000000
            McuHsctFrequency = 320000000
            McuHspdm160Frequency = 0
            McuHspdm320Frequency = 0
            McuHspdmClkEnable = false
            McuI2CFrequency = 6000000
            McuLowPowerDivValue = LOW_POWER_DIVIDER_DISABLE_SEL0
            McuMCanClockSourceSelection = MCAN_CLOCK_SOURCE_MCANI_SEL1
            McuMCanFrequency = 80000000
            McuMcanHFrequency = 80000000
            McuMscClockSourceSelection = MSC_CLOCK_SOURCE_DISABLED_SEL0
            McuMscFrequency = 0
            McuQspiClockSourceSelection = QSPI_CLOCK_SOURCE_SOURCE2_SEL2
            McuQspiFrequency = 160000000
            McuReferenceFrequency1 = 6666667
            McuReferenceFrequency2 = 6666667
            McuSPBFrequency = 80000000
            McuSRIFrequency = 160000000
            McuSTMFrequency = 80000000
          McuSystemPllSettingConfig:
            McuClockReferencePointFrequency0 = 160000000
            McuFMPllModAmp = 1.25
            McuFmPllEnable = false
            McuPllInputSrcSelection = OSC_CLOCK_SRC_SELECT_SEL1
            McuSysPllK2DivStepDownChangeDelay = 10
            McuSysPllK2DivStepUpChangeDelay = 10
            McuSystemPllK2Divider = 2
            McuSystemPllNDivider = 23
            McuSystemPllPDivider = 0
      McuDemEventParameterRefs_0 (McuDemEventParameterRefs)
      McuEruGlobalConf: McuEruInputFilterRegVal=0
      McuGpt12PrescalerConf: Gpt1BlockPrescalerSel=GPT1_PRESCALING_FACTOR_4, Gpt2BlockPrescalerSel=GPT2_PRESCALING_FACTOR_2
      McuModeSettingConf_0 (McuModeSettingConf): McuEvrcLPMOnSleepReqEnable=false, McuMode=0
        McuStdbyModeSettingConf:
          McuStdbyModeBlankingFilterDelay = DELAY_0_MS_SEL0
          McuStdbyModeClkSelection = SCR_CLOCK_SEL0
          McuStdbyModeESR0TriStateEnable = false
          McuStdbyModePORSTFilterEnable = false
          McuStdbyModePortTriStateEnable = false
          McuStdbyModeRamEnable = MCU_STANDBYRAM_DISABLED_SEL0
          McuStdbyModeWakeupFromEVR = false
          McuStdbyModeWakeupFromPORST = true
          McuStdbyModeWakeupFromSCR = false
          McuStdbyModeESR0Conf: McuStdbyModeESR0EdgeDetection=ESR0_TRIG_RISING_EDGE_SEL1, McuStdbyModeESR0FltEnable=false, McuStdbyModeESR0WakeupEnable=false
          McuStdbyModeESR1Conf: McuStdbyModeESR1EdgeDetection=ESR1_TRIG_RISING_EDGE_SEL1, McuStdbyModeESR1FltEnable=false, McuStdbyModeESR1WakeupEnable=false
          McuStdbyModePinAConf: McuStdbyModePinAEdgeDetection=PINA_TRIG_RISING_EDGE_SEL1, McuStdbyModePinAFltEnable=false, McuStdbyModePinAWakeupEnable=false
          McuStdbyModePinBConf: McuStdbyModePinBEdgeDetection=PINB_TRIG_RISING_EDGE_SEL1, McuStdbyModePinBFltEnable=false, McuStdbyModePinBWakeupEnable=false
          McuStdbyModeVddVextConf:
            McuStdbyModeEntryOnVDDRampDown = false
            McuStdbyModeEntryOnVEXTRampDown = false
            McuStdbyModeVddUMMonMode = VDD_UV_MON_MODE_SEL2
            McuStdbyModeVddUVThres = 184
            McuStdbyModeVextUMMonMode = VEXT_UV_MON_MODE_SEL2
            McuStdbyModeVextUVThres = 117
          McuStdbyModeWakeupTimerConf:
            McuStdbyModeWakeupTimerClkDiv = WUT_70KHZ_NO_DIV_CLK_SEL0
            McuStdbyModeWakeupTimerEnable = false
            McuStdbyModeWakeupTimerMode = WUT_AUTO_RELOAD_MODE_SEL0
            McuStdbyModeWakeupTimerValue = 16777215
      McuResetSettingConf:
        McuESR0ResetConf = MCU_ESR0_NO_RESET_SEL0
        McuESR1ResetConf = MCU_ESR1_NO_RESET_SEL0
        McuSMUResetConf = MCU_SMU_NO_RESET_SEL0
        McuSTM0ResetConf = MCU_STM0_NO_RESET_SEL0
        McuSTM0ResetOnApplResetEnable = true
        McuSTM1ResetConf = MCU_STM1_NO_RESET_SEL0
        McuSTM1ResetOnApplResetEnable = true
        McuSTM2ResetConf = MCU_STM2_NO_RESET_SEL0
        McuSTM2ResetOnApplResetEnable = true
        McuSTM3ResetConf = MCU_STM3_NO_RESET_SEL0
        McuSTM3ResetOnApplResetEnable = true
        McuSTM4ResetConf = MCU_STM4_NO_RESET_SEL0
        McuSTM4ResetOnApplResetEnable = true
        McuSTM5ResetConf = MCU_STM5_NO_RESET_SEL0
        McuSTM5ResetOnApplResetEnable = true
        McuSWResetConf = MCU_SW_APPLICATION_RESET_SEL2
      McuTrapSettingConf:
        McuCPU0ESR0TrapEnable = false
        McuCPU0ESR1TrapEnable = false
        McuCPU0SMUTrapEnable = false
        McuCPU0Trap2Enable = false
        McuCPU1ESR0TrapEnable = false
        McuCPU1ESR1TrapEnable = false
        McuCPU1SMUTrapEnable = false
        McuCPU1Trap2Enable = false
        McuCPU2ESR0TrapEnable = false
        McuCPU2ESR1TrapEnable = false
        McuCPU2SMUTrapEnable = false
        McuCPU2Trap2Enable = false
        McuCPU3ESR0TrapEnable = false
        McuCPU3ESR1TrapEnable = false
        McuCPU3SMUTrapEnable = false
        McuCPU3Trap2Enable = false
        McuCPU4ESR0TrapEnable = false
        McuCPU4ESR1TrapEnable = false
        McuCPU4SMUTrapEnable = false
        McuCPU4Trap2Enable = false
        McuCPU5ESR0TrapEnable = false
        McuCPU5ESR1TrapEnable = false
        McuCPU5SMUTrapEnable = false
        McuCPU5Trap2Enable = false
    McuPublishedInformation
      21 x McuResetReasonConf:
        MCU_CB0_RESET: McuResetReason=11
        MCU_CB1_RESET: McuResetReason=12
        MCU_CB3_RESET: McuResetReason=13
        MCU_ESR0_RESET: McuResetReason=0
        MCU_ESR1_RESET: McuResetReason=1
        MCU_EVR33_RESET: McuResetReason=15
        MCU_EVRC_RESET: McuResetReason=14
        MCU_LBIST_RESET: McuResetReason=18
        MCU_POWER_ON_RESET: McuResetReason=10
        MCU_RESET_MULTIPLE: McuResetReason=254
        MCU_RESET_UNDEFINED: McuResetReason=255
        MCU_SMU_RESET: McuResetReason=2
        MCU_STBYR_RESET: McuResetReason=17
        MCU_STM0_RESET: McuResetReason=4
        MCU_STM1_RESET: McuResetReason=5
        MCU_STM2_RESET: McuResetReason=6
        MCU_STM3_RESET: McuResetReason=7
        MCU_STM4_RESET: McuResetReason=8
        MCU_STM5_RESET: McuResetReason=9
        MCU_SUPPLY_WDOG_RESET: McuResetReason=16
        MCU_SW_RESET: McuResetReason=3
    McuDemEventParameterRefsConf: MCU_E_OSC_FAILURE=MCU_E_OSC_FAILURE, MCU_E_SYSTEM_PLL_LOCK_LOSS=MCU_E_SYSTEM_PLL_LOCK_LOSS
