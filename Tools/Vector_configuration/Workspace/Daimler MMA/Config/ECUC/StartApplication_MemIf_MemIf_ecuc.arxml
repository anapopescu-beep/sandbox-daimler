AUTOSAR XML (schema 00049)
package /ActiveEcuC
  module config MemIf: implementation-config-variant=VARIANT-PRE-COMPILE, module-description=MemIf_Impl
    MemIfGeneral: MemIfDevErrorDetect=true, MemIfVersionInfoApi=false, MemIfSafeBswChecks=false
    MemIfMemHwA: MemIfMemHwAId=0, MemIfMemHwARef=FeeGeneral
      MemIfMemHwAAPI:
        MemIfMemHwACancel = Fee_Cancel
        MemIfMemHwAEraseImmediateBlock = Fee_EraseImmediateBlock
        MemIfMemHwAGetJobResult = Fee_GetJobResult
        MemIfMemHwAGetStatus = Fee_GetStatus
        MemIfMemHwAIncludeFile = Fee.h
        MemIfMemHwAInvalidateBlock = Fee_InvalidateBlock
        MemIfMemHwARead = Fee_Read
        MemIfMemHwASetMode = Fee_SetMode
        MemIfMemHwAWrite = Fee_Write
