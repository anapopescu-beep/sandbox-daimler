[part 2 of 2: package /ActiveEcuC]
AUTOSAR XML (schema 00049)
package /ActiveEcuC  (continued)
  module config Dcm: implementation-config-variant=VARIANT-POST-BUILD-SELECTABLE, module-description=Dcm_Impl  (continued)
    DcmConfigSet  (continued)
      DcmDsp: DcmDspMaxDidToRead=1, DcmDspReadDIDReportsNODIByte=false, DcmDspPowerDownTime=255, DcmDspDDDidCheckPerSourceDid=false  (continued)
        DidInfo_Vehicle_Equipment_Read (DcmDspDidInfo)
          DcmDspDidAccess
            DcmDspDidWrite:  # COVERS: PLAIN_TEXT ARCH_SW_DIA_0105
              DcmDspDidWriteSessionRef = DcmDspSession/Default
              DcmDspDidWriteSessionRef = DcmDspSession/Extended
              DcmDspDidWriteSessionRef = Development
              DcmDspDidWriteRoleRef = Supplier
              DcmDspDidWriteRoleRef = Development_ENHANCED
              DcmDspDidWriteRoleRef = Production
              DcmDspDidWriteRoleRef = After_Sales_ENHANCED
            DcmDspDidRead:  # COVERS: PLAIN_TEXT ARCH_SW_DIA_0102
              DcmDspDidReadSessionRef = DcmDspSession/Default
              DcmDspDidReadSessionRef = DcmDspSession/Extended
              DcmDspDidReadSessionRef = Development
              DcmDspDidReadRoleRef = Supplier
              DcmDspDidReadRoleRef = Development_ENHANCED
              DcmDspDidReadRoleRef = Production
              DcmDspDidReadRoleRef = After_Sales_ENHANCED
              DcmDspDidReadRoleRef = After_Sales_STANDARD
              DcmDspDidReadRoleRef = After_Sales_BASIC
              DcmDspDidReadRoleRef = Internal_Diagnostic_Test_Tool
              DcmDspDidReadRoleRef = ePTI_Test_Tool
        DidInfo_Backend_CA_Certificate_Read (DcmDspDidInfo)
          DcmDspDidAccess
            DcmDspDidRead:
              DcmDspDidReadRoleRef = Supplier
              DcmDspDidReadRoleRef = Development_ENHANCED
              DcmDspDidReadRoleRef = Production
              DcmDspDidReadRoleRef = After_Sales_ENHANCED
              DcmDspDidReadRoleRef = After_Sales_STANDARD
              DcmDspDidReadRoleRef = After_Sales_BASIC
              DcmDspDidReadRoleRef = Internal_Diagnostic_Test_Tool
              DcmDspDidReadRoleRef = ePTI_Test_Tool
        Vehicle_Equipment_Read_Ueberspannungsabbruchschwelle (DcmDspData):
          DcmDspDataSize = 16
          DcmDspDataType = UINT16
          DcmDspDataUsePort = USE_DATA_ASYNCH_CLIENT_SERVER
          DcmDspDataInfoRef = Info_Vehicle_Equipment_Read_Ueberspannungsabbruchschwelle
        Access_Control_List_Version_Read_ECU_indvidual_ACL_Version_Candela_File_Version_Minor (DcmDspData):
          DcmDspDataSize = 8
          DcmDspDataType = UINT8
          DcmDspDataUsePort = USE_DATA_ASYNCH_CLIENT_SERVER
          DcmDspDataInfoRef = Info_Access_Control_List_Version_Read_ECU_indvidual_ACL_Version_Candela_File_Version_Minor
        DidInfo_SecOC_Vehicle_Shared_Secret_Hash_Read (DcmDspDidInfo)
          DcmDspDidAccess
            DcmDspDidRead
        DidInfo_Diagnostic_User_Role_Read (DcmDspDidInfo)
          DcmDspDidAccess
            DcmDspDidRead
        Vehicle_Odometer_in_Low_Resolution_Read_Vehicle_Odometer_in_Low_Resolution (DcmDspData):
          DcmDspDataSize = 16
          DcmDspDataType = UINT16
          DcmDspDataUsePort = USE_DATA_ASYNCH_CLIENT_SERVER
          DcmDspDataInfoRef = Info_Vehicle_Odometer_in_Low_Resolution_Read_Vehicle_Odometer_in_Low_Resolution
        Info_SecOC_Vehicle_Shared_Secret_Hash_Read_SecOC_Vehicle_Shared_Secret_Hash (DcmDspDataInfo): DcmDspDataFixedLength=true
        Info_Access_Control_List_Version_Read_Basic_ACL_Version_Candela_File_Version_Minor (DcmDspDataInfo): DcmDspDataFixedLength=true
        DidInfo_Customer_Settings_Read (DcmDspDidInfo)
          DcmDspDidAccess
            DcmDspDidRead:
              DcmDspDidReadRoleRef = Supplier
              DcmDspDidReadRoleRef = Development_ENHANCED
              DcmDspDidReadRoleRef = Production
              DcmDspDidReadRoleRef = After_Sales_ENHANCED
              DcmDspDidReadRoleRef = After_Sales_STANDARD
              DcmDspDidReadRoleRef = After_Sales_BASIC
              DcmDspDidReadRoleRef = Internal_Diagnostic_Test_Tool
              DcmDspDidReadRoleRef = ePTI_Test_Tool
        DID_Vehicle_Odometer_in_Low_Resolution_Read (DcmDspDid):
          DcmDspDidIdentifier = 266
          DcmDspDidUsed = true
          DcmDspDidUsePort = USE_DATA_ELEMENT_SPECIFIC_INTERFACES
          DcmDspDidInfoRef = DidInfo_Vehicle_Odometer_in_Low_Resolution_Read
          Vehicle_Odometer_in_Low_Resolution (DcmDspDidSignal): DcmDspDidDataPos=0, DcmDspDidDataRef=Vehicle_Odometer_in_Low_Resolution_Read_Vehicle_Odometer_in_Low_Resolution
        CAN_input_Read_Neues_Bitfeld_6 (DcmDspData): DcmDspDataSize=8, DcmDspDataType=UINT8, DcmDspDataUsePort=USE_DATA_ASYNCH_CLIENT_SERVER, DcmDspDataInfoRef=Info_CAN_input_Read_Neues_Bitfeld_6
        DidInfo_Diagnostic_Authentication_Certificate_Identification_Read (DcmDspDidInfo)
          DcmDspDidAccess
            DcmDspDidRead
        DidInfo_ECU_Name_Read (DcmDspDidInfo)
          DcmDspDidAccess
            DcmDspDidRead
        DID_HardwareSupplier_Read (DcmDspDid):
          DcmDspDidIdentifier = 61780
          DcmDspDidUsed = true
          DcmDspDidUsePort = USE_DATA_ELEMENT_SPECIFIC_INTERFACES
          DcmDspDidInfoRef = DidInfo_HardwareSupplier_Read
          Hardware_Supplier_Identification (DcmDspDidSignal): DcmDspDidDataPos=0, DcmDspDidDataRef=HardwareSupplier_Read_Hardware_Supplier_Identification
        DidInfo_Security_Event_Log_Current_Counter_Values_Read (DcmDspDidInfo)
          DcmDspDidAccess
            DcmDspDidRead: DcmDspDidReadRoleRef=Supplier, DcmDspDidReadRoleRef=Development_ENHANCED, DcmDspDidReadRoleRef=Internal_Diagnostic_Test_Tool
        CAN_input_Read_Neues_Bitfeld_2 (DcmDspData): DcmDspDataSize=8, DcmDspDataType=UINT8, DcmDspDataUsePort=USE_DATA_ASYNCH_CLIENT_SERVER, DcmDspDataInfoRef=Info_CAN_input_Read_Neues_Bitfeld_2
        DID_MercedesCarGroupSoftware_Read (DcmDspDid):
          DcmDspDidIdentifier = 61729
          DcmDspDidUsed = true
          DcmDspDidUsePort = USE_DATA_ELEMENT_SPECIFIC_INTERFACES
          DcmDspDidInfoRef = DidInfo_MercedesCarGroupSoftware_Read
          Software_Logical_Block_Numbers (DcmDspDidSignal): DcmDspDidDataPos=0, DcmDspDidDataRef=MercedesCarGroupSoftware_Read_Software_Logical_Block_Numbers
        7 x DcmDspData, all with DcmDspDataUsePort=USE_DATA_ASYNCH_CLIENT_SERVER:
          CAN_input_Read_Neues_Bitfeld_{3..5}: DcmDspDataSize=8, DcmDspDataType=UINT8, DcmDspDataInfoRef=Info_CAN_input_Read_Neues_Bitfeld_{3..5}
          Status_SSA_Pre_Compile_Switches_Read_Precompile_switch: DcmDspDataSize=32, DcmDspDataType=UINT8_N, DcmDspDataInfoRef=Info_Status_SSA_Pre_Compile_Switches_Read_Precompile_switch
          CAN_input_Read_Neues_Bitfeld_1: DcmDspDataSize=8, DcmDspDataType=UINT8, DcmDspDataInfoRef=Info_CAN_input_Read_Neues_Bitfeld_1
          HardwareVersion_Read_HW_patch_level: DcmDspDataSize=8, DcmDspDataType=UINT8, DcmDspDataInfoRef=Info_HardwareVersion_Read_HW_patch_level
          HardwareSupplier_Read_Hardware_Supplier_Identification: DcmDspDataSize=16, DcmDspDataType=UINT16, DcmDspDataInfoRef=Info_HardwareSupplier_Read_Hardware_Supplier_Identification
        RoutineInfo_Trust_Model_Generate_Key_Pair_Start (DcmDspRoutineInfo)
          DcmDspRoutineAuthorization: DcmDspRoutineSessionRef=DcmDspSession/Default, DcmDspRoutineSessionRef=DcmDspSession/Extended, DcmDspRoutineSessionRef=Development
          DcmDspStartRoutineOut
            4 x DcmDspStartRoutineOutSignal:
              Verification_Result: DcmDspRoutineSignalLength=8, DcmDspRoutineSignalType=UINT8, DcmDspRoutineSignalPos=8
              routineInfo: DcmDspRoutineSignalLength=8, DcmDspRoutineSignalType=UINT8, DcmDspRoutineSignalPos=0
              Trust_Model_ECU_CSR: DcmDspRoutineSignalLength=8016, DcmDspRoutineSignalType=VARIABLE_LENGTH, DcmDspRoutineSignalEndianness=opaque, DcmDspRoutineSignalPos=528
              CSR_Signature: DcmDspRoutineSignalLength=512, DcmDspRoutineSignalType=UINT8_N, DcmDspRoutineSignalEndianness=opaque, DcmDspRoutineSignalPos=16
        DidInfo_SoftwareVersion_Read (DcmDspDidInfo)
          DcmDspDidAccess
            DcmDspDidRead
        Access_Control_List_Version_Read_ECU_indvidual_ACL_Version_Generation_Time_GTC (DcmDspData):
          DcmDspDataSize = 120
          DcmDspDataType = UINT8_N
          DcmDspDataUsePort = USE_DATA_ASYNCH_CLIENT_SERVER
          DcmDspDataInfoRef = Info_Access_Control_List_Version_Read_ECU_indvidual_ACL_Version_Generation_Time_GTC
        DidInfo_Secured_System_Date_and_Time_Read (DcmDspDidInfo)
          DcmDspDidAccess
            DcmDspDidRead
        Info_Access_Control_List_Version_Read_Basic_ACL_Version_Generation_Time_GTC (DcmDspDataInfo): DcmDspDataFixedLength=true
        VINDataIdentifier_Read_VINDataIdentifier (DcmDspData):
          DcmDspDataSize = 136
          DcmDspDataType = UINT8_N
          DcmDspDataUsePort = USE_DATA_ASYNCH_CLIENT_SERVER
          DcmDspDataInfoRef = Info_VINDataIdentifier_Read_VINDataIdentifier
        DidInfo_Dump_of_Vedoc_Relevant_Information_Read (DcmDspDidInfo)
          DcmDspDidAccess
            DcmDspDidRead:
              DcmDspDidReadRoleRef = Supplier
              DcmDspDidReadRoleRef = Development_ENHANCED
              DcmDspDidReadRoleRef = Production
              DcmDspDidReadRoleRef = After_Sales_ENHANCED
              DcmDspDidReadRoleRef = After_Sales_STANDARD
              DcmDspDidReadRoleRef = After_Sales_BASIC
              DcmDspDidReadRoleRef = Internal_Diagnostic_Test_Tool
              DcmDspDidReadRoleRef = ePTI_Test_Tool
        Dump_of_Vedoc_Relevant_Information_Read_PatchedObject (DcmDspData):
          DcmDspDataSize = 384
          DcmDspDataType = UINT8_N
          DcmDspDataUsePort = USE_DATA_ASYNCH_CLIENT_SERVER
          DcmDspDataInfoRef = Info_Dump_of_Vedoc_Relevant_Information_Read_PatchedObject
        Info_VIN_Status_Read_VIN_Lock_Status (DcmDspDataInfo): DcmDspDataFixedLength=true
        Info_Standard_Application_SW_Package_Information_Read_Standard_Application_SW_Package_Minor_Version (DcmDspDataInfo): DcmDspDataFixedLength=true
        Routine_Replace_Trust_model_Certificates_Start (DcmDspRoutine):
          DcmDspRequestResultsRoutineSupported = false
          DcmDspStopRoutineSupported = false
          DcmDspRoutineIdentifier = 628
          DcmDspRoutineFixedLength = false
          DcmDspRoutineUsePort = true
          DcmDspRoutineUsed = true
          DcmDspRoutineInfoRef = RoutineInfo_Replace_Trust_model_Certificates_Start
        DidInfo_Supported_configuration_mechanisms_Read (DcmDspDidInfo)
          DcmDspDidAccess
            DcmDspDidRead: DcmDspDidReadSessionRef=DcmDspSession/Default, DcmDspDidReadSessionRef=DcmDspSession/Extended, DcmDspDidReadSessionRef=Development
        DDS_Package_Release_Read_DDS_Package_Release_of_Application_Software_Year_Appl (DcmDspData):
          DcmDspDataSize = 8
          DcmDspDataType = UINT8
          DcmDspDataUsePort = USE_DATA_ASYNCH_CLIENT_SERVER
          DcmDspDataInfoRef = Info_DDS_Package_Release_Read_DDS_Package_Release_of_Application_Software_Year_Appl
        Info_SoftwareVersion_Read_Software_Logical_Block_Version_Information (DcmDspDataInfo): DcmDspDataFixedLength=false
        Info_Access_Control_List_Version_Read_ECU_indvidual_ACL_Version_Candela_File_Version_Minor (DcmDspDataInfo): DcmDspDataFixedLength=true
        RoutineInfo_Verify_Signature_Start (DcmDspRoutineInfo)
          DcmDspStartRoutineIn
            Signature_Value (DcmDspStartRoutineInSignal): DcmDspRoutineSignalLength=512, DcmDspRoutineSignalType=UINT8_N, DcmDspRoutineSignalEndianness=opaque, DcmDspRoutineSignalPos=8
            Data_to_be_checked (DcmDspStartRoutineInSignal): DcmDspRoutineSignalLength=8, DcmDspRoutineSignalType=UINT8, DcmDspRoutineSignalPos=0
          DcmDspRoutineAuthorization:
            DcmDspRoutineSessionRef = DcmDspSession/Programming
            DcmDspRoutineSessionRef = DcmDspSession/Extended
            DcmDspRoutineSessionRef = Development
            DcmDspRoutineRoleRef = Supplier
            DcmDspRoutineRoleRef = Development_ENHANCED
            DcmDspRoutineRoleRef = Production
            DcmDspRoutineRoleRef = After_Sales_ENHANCED
          DcmDspStartRoutineOut
            Verification_Result (DcmDspStartRoutineOutSignal): DcmDspRoutineSignalLength=8, DcmDspRoutineSignalType=UINT8, DcmDspRoutineSignalPos=8
            routineInfo (DcmDspStartRoutineOutSignal): DcmDspRoutineSignalLength=8, DcmDspRoutineSignalType=UINT8, DcmDspRoutineSignalPos=0
        ECU_Extract_Version_Read_ECU_Extract_Minor_Version (DcmDspData):
          DcmDspDataSize = 8
          DcmDspDataType = UINT8
          DcmDspDataUsePort = USE_DATA_ASYNCH_CLIENT_SERVER
          DcmDspDataConstantValue = 29
          DcmDspDataConstantValueType = HEX
          DcmDspDataInfoRef = Info_ECU_Extract_Version_Read_ECU_Extract_Minor_Version
        DID_SecOC_PDU_Data_IDs_and_Key_CMACs_Read (DcmDspDid):
          DcmDspDidIdentifier = 399
          DcmDspDidUsed = true
          DcmDspDidUsePort = USE_DATA_ELEMENT_SPECIFIC_INTERFACES
          DcmDspDidInfoRef = DidInfo_SecOC_PDU_Data_IDs_and_Key_CMACs_Read
          Secured_PDU_Data_IDs_and_Key_CMACs (DcmDspDidSignal): DcmDspDidDataPos=0, DcmDspDidDataRef=SecOC_PDU_Data_IDs_and_Key_CMACs_Read_Secured_PDU_Data_IDs_and_Key_CMACs
        DID_Current_Operating_Time_Read (DcmDspDid):
          DcmDspDidIdentifier = 307
          DcmDspDidUsed = true
          DcmDspDidUsePort = USE_DATA_ELEMENT_SPECIFIC_INTERFACES
          DcmDspDidInfoRef = DidInfo_Current_Operating_Time_Read
          Current_Operating_Time (DcmDspDidSignal): DcmDspDidDataPos=0, DcmDspDidDataRef=Current_Operating_Time_Read_Current_Operating_Time
          Operating_Time_Status (DcmDspDidSignal): DcmDspDidDataPos=32, DcmDspDidDataRef=Current_Operating_Time_Read_Operating_Time_Status
        Routine_Verify_Signature_Start (DcmDspRoutine):
          DcmDspRequestResultsRoutineSupported = false
          DcmDspStopRoutineSupported = false
          DcmDspRoutineIdentifier = 611
          DcmDspRoutineFixedLength = false
          DcmDspRoutineUsePort = true
          DcmDspRoutineUsed = true
          DcmDspRoutineInfoRef = RoutineInfo_Verify_Signature_Start
        DID_Global_Time_Sync_Measured_Values_Read (DcmDspDid):
          DcmDspDidIdentifier = 263
          DcmDspDidUsed = true
          DcmDspDidUsePort = USE_DATA_ELEMENT_SPECIFIC_INTERFACES
          DcmDspDidInfoRef = DidInfo_Global_Time_Sync_Measured_Values_Read
          GTSM (DcmDspDidSignal): DcmDspDidDataPos=0, DcmDspDidDataRef=Global_Time_Sync_Measured_Values_Read_GTSM
        BootSoftwareVersion_Read_Boot_SW_year (DcmDspData):
          DcmDspDataSize = 8
          DcmDspDataType = UINT8
          DcmDspDataUsePort = USE_DATA_ASYNCH_CLIENT_SERVER
          DcmDspDataInfoRef = Info_BootSoftwareVersion_Read_Boot_SW_year
        DID_Trust_model_Root_CA_certificate_Read (DcmDspDid):
          DcmDspDidIdentifier = 414
          DcmDspDidUsed = true
          DcmDspDidUsePort = USE_DATA_ELEMENT_SPECIFIC_INTERFACES
          DcmDspDidInfoRef = DidInfo_Trust_model_Root_CA_certificate_Read
          Trust_model_Root_CA_certificate (DcmDspDidSignal): DcmDspDidDataPos=0, DcmDspDidDataRef=Trust_model_Root_CA_certificate_Read_Trust_model_Root_CA_certificate
        DID_RandomNumber_Read (DcmDspDid): DcmDspDidIdentifier=401, DcmDspDidUsed=true, DcmDspDidUsePort=USE_DATA_ELEMENT_SPECIFIC_INTERFACES, DcmDspDidInfoRef=DidInfo_RandomNumber_Read
          Generated_Random_Number_Result (DcmDspDidSignal): DcmDspDidDataPos=0, DcmDspDidDataRef=RandomNumber_Read_Generated_Random_Number_Result
          Generated_Random_Number (DcmDspDidSignal): DcmDspDidDataPos=8, DcmDspDidDataRef=RandomNumber_Read_Generated_Random_Number
        ComControl (DcmDspComControl)
          DspComContolAllChannel (DcmDspComControlAllChannel):
            DcmDspAllComMChannelRef = RBTM_FL_BODY3_8uqv9blm85ehm0msat385m76v_03d5f5f6 if post-build-variant-condition{matching-criterion=SideAllocation, value=0}
            DcmDspAllComMChannelRef = RBTM_FR_BODY3_4xwwtd59665s787n6ctawh7k8_23a94727 if post-build-variant-condition{matching-criterion=SideAllocation, value=1}
        DidInfo_Status_SSA_Pre_Compile_Switches_Read (DcmDspDidInfo)
          DcmDspDidAccess
            DcmDspDidRead:
              DcmDspDidReadSessionRef = DcmDspSession/Default
              DcmDspDidReadSessionRef = DcmDspSession/Extended
              DcmDspDidReadSessionRef = Development
              DcmDspDidReadRoleRef = Supplier
              DcmDspDidReadRoleRef = Development_ENHANCED
              DcmDspDidReadRoleRef = Production
        Info_Diagnostic_Trace_Memory_Read_Diagnostic_Trace_Memory (DcmDspDataInfo): DcmDspDataFixedLength=true
        Info_Trust_Model_Request_ephemeral_public_key_Read_Ephemeral_ECU_Public_Key (DcmDspDataInfo): DcmDspDataFixedLength=true
        3 x DcmDspData, all with DcmDspDataUsePort=USE_DATA_ASYNCH_CLIENT_SERVER:
          Diagnostic_Extract_Version_Read_CANdela_Version: DcmDspDataSize=80, DcmDspDataType=UINT8_N, DcmDspDataInfoRef=Info_Diagnostic_Extract_Version_Read_CANdela_Version
          Trust_Model_Request_ephemeral_public_key_Read_Data_Signature: DcmDspDataSize=512, DcmDspDataType=UINT8_N, DcmDspDataInfoRef=Info_Trust_Model_Request_ephemeral_public_key_Read_Data_Signature
          Diagnostic_User_Role_Read_Cebas_UserRole: DcmDspDataSize=8, DcmDspDataType=UINT8, DcmDspDataInfoRef=Info_Diagnostic_User_Role_Read_Cebas_UserRole
        DID_MercedesCarGroupHardware_Read (DcmDspDid):
          DcmDspDidIdentifier = 61713
          DcmDspDidUsed = true
          DcmDspDidUsePort = USE_DATA_ELEMENT_SPECIFIC_INTERFACES
          DcmDspDidInfoRef = DidInfo_MercedesCarGroupHardware_Read
          Hardware_Part_Number (DcmDspDidSignal): DcmDspDidDataPos=0, DcmDspDidDataRef=MercedesCarGroupHardware_Read_Hardware_Part_Number
        Routine_Synchronize_Secured_System_Date_and_Time_Start (DcmDspRoutine):
          DcmDspRequestResultsRoutineSupported = false
          DcmDspStopRoutineSupported = false
          DcmDspRoutineIdentifier = 614
          DcmDspRoutineFixedLength = false
          DcmDspRoutineUsePort = true
          DcmDspRoutineUsed = true
          DcmDspRoutineInfoRef = RoutineInfo_Synchronize_Secured_System_Date_and_Time_Start
        Standard_Application_SW_Package_Information_Read_Standard_Application_SW_Package_Build_Version (DcmDspData):
          DcmDspDataSize = 8
          DcmDspDataType = UINT8
          DcmDspDataUsePort = USE_DATA_ASYNCH_CLIENT_SERVER
          DcmDspDataInfoRef = Info_Standard_Application_SW_Package_Information_Read_Standard_Application_SW_Package_Build_Version
        Info_Diagnostic_Authentication_Certificate_Identification_Read_Diagnostic_Authentication_Certificate_Serial_Number (DcmDspDataInfo): DcmDspDataFixedLength=false
        DidInfo_Diagnostic_Extract_Version_Read (DcmDspDidInfo)
          DcmDspDidAccess
            DcmDspDidRead: DcmDspDidReadSessionRef=DcmDspSession/Default, DcmDspDidReadSessionRef=DcmDspSession/Extended, DcmDspDidReadSessionRef=Development
        ECU_Extract_Version_Read_ECU_Extract_Information_ECU_Name (DcmDspData):
          DcmDspDataSize = 248
          DcmDspDataType = UINT8_N
          DcmDspDataUsePort = USE_DATA_ASYNCH_CLIENT_SERVER
          DcmDspDataConstantValue = RBTM_FL_STAR_3_2023_29a0 [33]
          DcmDspDataConstantValueType = ASCII
          DcmDspDataInfoRef = Info_ECU_Extract_Version_Read_ECU_Extract_Information_ECU_Name
        Access_Control_List_Version_Read_Basic_ACL_Hash (DcmDspData):
          DcmDspDataSize = 512
          DcmDspDataType = UINT8_N
          DcmDspDataUsePort = USE_DATA_ASYNCH_CLIENT_SERVER
          DcmDspDataInfoRef = Info_Access_Control_List_Version_Read_Basic_ACL_Hash
        Info_DDS_Package_Release_Read_DDS_Package_Release_of_Boot_Software_Year_Boot (DcmDspDataInfo): DcmDspDataFixedLength=true
        SecOC_PDU_Data_IDs_and_Key_Checksum_Read_Secured_PDU_Data_IDs_and_Key_Checksum (DcmDspData):
          DcmDspDataSize = 32736
          DcmDspDataType = UINT8_N
          DcmDspDataUsePort = USE_DATA_ASYNCH_CLIENT_SERVER
          DcmDspDataInfoRef = Info_SecOC_PDU_Data_IDs_and_Key_Checksum_Read_Secured_PDU_Data_IDs_and_Key_Checksum
        DidInfo_ReadFingerprint_Read (DcmDspDidInfo)
          DcmDspDidAccess
            DcmDspDidRead:
              DcmDspDidReadRoleRef = Supplier
              DcmDspDidReadRoleRef = Development_ENHANCED
              DcmDspDidReadRoleRef = Production
              DcmDspDidReadRoleRef = After_Sales_ENHANCED
              DcmDspDidReadRoleRef = After_Sales_STANDARD
              DcmDspDidReadRoleRef = After_Sales_BASIC
              DcmDspDidReadRoleRef = Internal_Diagnostic_Test_Tool
              DcmDspDidReadRoleRef = ePTI_Test_Tool
        DidInfo_Trust_model_Intermediate_CA_certificate_Read (DcmDspDidInfo)
          DcmDspDidAccess
            DcmDspDidRead:
              DcmDspDidReadSessionRef = DcmDspSession/Default
              DcmDspDidReadSessionRef = DcmDspSession/Extended
              DcmDspDidReadSessionRef = Development
              DcmDspDidReadRoleRef = Supplier
              DcmDspDidReadRoleRef = Development_ENHANCED
              DcmDspDidReadRoleRef = Production
              DcmDspDidReadRoleRef = After_Sales_ENHANCED
              DcmDspDidReadRoleRef = After_Sales_STANDARD
              DcmDspDidReadRoleRef = After_Sales_BASIC
              DcmDspDidReadRoleRef = Internal_Diagnostic_Test_Tool
              DcmDspDidReadRoleRef = ePTI_Test_Tool
        Info_Diagnostic_Extract_Version_Read_Exported_Diagnostic_Variant (DcmDspDataInfo): DcmDspDataFixedLength=true
        DID_Internal_ECU_information_Read (DcmDspDid):
          DcmDspDidIdentifier = 576
          DcmDspDidUsed = true
          DcmDspDidUsePort = USE_DATA_ELEMENT_SPECIFIC_INTERFACES
          DcmDspDidInfoRef = DidInfo_Internal_ECU_information_Read
          3 x DcmDspDidSignal:
            ECU_Temperature: DcmDspDidDataPos=8, DcmDspDidDataRef=Internal_ECU_information_Read_ECU_Temperature
            MOTOR_Current: DcmDspDidDataPos=24, DcmDspDidDataRef=Internal_ECU_information_Read_MOTOR_Current
            Autosar_System_State_EcuM_State: DcmDspDidDataPos=0, DcmDspDidDataRef=Internal_ECU_information_Read_Autosar_System_State_EcuM_State
        Info_Access_Control_List_Version_Read_Basic_ACL_Hash (DcmDspDataInfo): DcmDspDataFixedLength=true
        DidInfo_Backend_CA_Certificate_Identification_Read (DcmDspDidInfo)
          DcmDspDidAccess
            DcmDspDidRead
        DID_Backend_CA_Certificate_Read (DcmDspDid):
          DcmDspDidIdentifier = 385
          DcmDspDidUsed = true
          DcmDspDidUsePort = USE_DATA_ELEMENT_SPECIFIC_INTERFACES
          DcmDspDidInfoRef = DidInfo_Backend_CA_Certificate_Read
          Backend_CA_Certificate (DcmDspDidSignal): DcmDspDidDataPos=0, DcmDspDidDataRef=Backend_CA_Certificate_Read_Backend_CA_Certificate
        Trust_model_full_chain_of_trust_certificates_Read_Trust_model_certificates (DcmDspData):
          DcmDspDataSize = 32064
          DcmDspDataType = UINT8_N
          DcmDspDataUsePort = USE_DATA_ASYNCH_CLIENT_SERVER
          DcmDspDataInfoRef = Info_Trust_model_full_chain_of_trust_certificates_Read_Trust_model_certificates
        DID_Trust_model_Intermediate_CA_certificate_Read (DcmDspDid):
          DcmDspDidIdentifier = 412
          DcmDspDidUsed = true
          DcmDspDidUsePort = USE_DATA_ELEMENT_SPECIFIC_INTERFACES
          DcmDspDidInfoRef = DidInfo_Trust_model_Intermediate_CA_certificate_Read
          Trust_model_Intermediate_CA_Certificate (DcmDspDidSignal): DcmDspDidDataPos=0, DcmDspDidDataRef=Trust_model_Intermediate_CA_certificate_Read_Trust_model_Intermediate_CA_Certificate
        DID_Diagnostic_Authentication_Certificate_Identification_Read (DcmDspDid):
          DcmDspDidIdentifier = 388
          DcmDspDidUsed = true
          DcmDspDidUsePort = USE_DATA_ELEMENT_SPECIFIC_INTERFACES
          DcmDspDidInfoRef = DidInfo_Diagnostic_Authentication_Certificate_Identification_Read
          Diagnostic_Authentication_Certificate_Serial_Number (DcmDspDidSignal):
            DcmDspDidDataPos = 120
            DcmDspDidDataRef = Diagnostic_Authentication_Certificate_Identification_Read_Diagnostic_Authentication_Certificate_Serial_Number
          Diagnostic_Authentication_Certificate_Issuer (DcmDspDidSignal): DcmDspDidDataPos=0, DcmDspDidDataRef=Diagnostic_Authentication_Certificate_Identification_Read_Diagnostic_Authentication_Certificate_Issuer
        RoutineInfo_Evaluate_Data_Verification_Certificate_Start (DcmDspRoutineInfo)
          DcmDspStartRoutineIn
            Data_Verification_Certificate (DcmDspStartRoutineInSignal): DcmDspRoutineSignalLength=16016, DcmDspRoutineSignalType=VARIABLE_LENGTH, DcmDspRoutineSignalEndianness=opaque, DcmDspRoutineSignalPos=0
          DcmDspRoutineAuthorization:
            DcmDspRoutineSessionRef = DcmDspSession/Programming
            DcmDspRoutineSessionRef = DcmDspSession/Extended
            DcmDspRoutineSessionRef = Development
            DcmDspRoutineRoleRef = Supplier
            DcmDspRoutineRoleRef = Development_ENHANCED
            DcmDspRoutineRoleRef = Production
            DcmDspRoutineRoleRef = After_Sales_ENHANCED
          DcmDspStartRoutineOut
            Verification_Result (DcmDspStartRoutineOutSignal): DcmDspRoutineSignalLength=8, DcmDspRoutineSignalType=UINT8, DcmDspRoutineSignalPos=8
            routineInfo (DcmDspStartRoutineOutSignal): DcmDspRoutineSignalLength=8, DcmDspRoutineSignalType=UINT8, DcmDspRoutineSignalPos=0
        Info_Standard_Application_SW_Package_Information_Read_Standard_Application_SW_Package_Major_Version (DcmDspDataInfo): DcmDspDataFixedLength=true
        Info_Adjust_ISO_15765_2_Block_Size_and_STmin_Parameter_Read_Block_Size_Value_as_defined_in_ISO_15765_2 (DcmDspDataInfo): DcmDspDataFixedLength=true
        DID_SecOC_PDU_Data_IDs_and_Key_Checksum_Read (DcmDspDid):
          DcmDspDidIdentifier = 392
          DcmDspDidUsed = true
          DcmDspDidUsePort = USE_DATA_ELEMENT_SPECIFIC_INTERFACES
          DcmDspDidInfoRef = DidInfo_SecOC_PDU_Data_IDs_and_Key_Checksum_Read
          Secured_PDU_Data_IDs_and_Key_Checksum (DcmDspDidSignal): DcmDspDidDataPos=0, DcmDspDidDataRef=SecOC_PDU_Data_IDs_and_Key_Checksum_Read_Secured_PDU_Data_IDs_and_Key_Checksum
        Info_ECU_Extract_Version_Read_ECU_Extract_Minor_Version (DcmDspDataInfo): DcmDspDataFixedLength=true
        Trust_model_ECU_CSR_Read_Trust_model_ECU_CSR (DcmDspData):
          DcmDspDataSize = 8016
          DcmDspDataType = UINT8_N
          DcmDspDataUsePort = USE_DATA_ASYNCH_CLIENT_SERVER
          DcmDspDataInfoRef = Info_Trust_model_ECU_CSR_Read_Trust_model_ECU_CSR
        DidInfo_VIN_Status_Read (DcmDspDidInfo)
          DcmDspDidAccess
            DcmDspDidRead:
              DcmDspDidReadRoleRef = Supplier
              DcmDspDidReadRoleRef = Development_ENHANCED
              DcmDspDidReadRoleRef = Production
              DcmDspDidReadRoleRef = After_Sales_ENHANCED
        DidInfo_CAN_output_Read (DcmDspDidInfo)
          DcmDspDidAccess
            DcmDspDidRead:
              DcmDspDidReadSessionRef = DcmDspSession/Default
              DcmDspDidReadSessionRef = DcmDspSession/Extended
              DcmDspDidReadSessionRef = Development
              DcmDspDidReadRoleRef = Supplier
              DcmDspDidReadRoleRef = Development_ENHANCED
              DcmDspDidReadRoleRef = Production
              DcmDspDidReadRoleRef = After_Sales_ENHANCED
              DcmDspDidReadRoleRef = After_Sales_STANDARD
              DcmDspDidReadRoleRef = After_Sales_BASIC
              DcmDspDidReadRoleRef = Internal_Diagnostic_Test_Tool
              DcmDspDidReadRoleRef = ePTI_Test_Tool
        5 x DcmDspDid, all with DcmDspDidUsed=true, DcmDspDidUsePort=USE_DATA_ELEMENT_SPECIFIC_INTERFACES:
          DID_PreSafe_Cycles_Level_1_8_Read: DcmDspDidIdentifier=768, DcmDspDidInfoRef=DidInfo_PreSafe_Cycles_Level_1_8_Read
            CombinedSignal (DcmDspDidSignal): DcmDspDidDataPos=0, DcmDspDidDataRef=PreSafe_Cycles_Level_1_8_Read_CombinedSignal
          DID_System_Time_read_Read: DcmDspDidIdentifier=746, DcmDspDidInfoRef=DidInfo_System_Time_read_Read
            System_time (DcmDspDidSignal): DcmDspDidDataPos=0, DcmDspDidDataRef=System_Time_read_Read_System_time
          DID_Trust_Model_Request_ephemeral_public_key_Read: DcmDspDidIdentifier=409, DcmDspDidInfoRef=DidInfo_Trust_Model_Request_ephemeral_public_key_Read
            4 x DcmDspDidSignal:
              Data_Signature: DcmDspDidDataPos=512, DcmDspDidDataRef=Trust_Model_Request_ephemeral_public_key_Read_Data_Signature
              Ephemeral_ECU_Public_Key: DcmDspDidDataPos=256, DcmDspDidDataRef=Trust_Model_Request_ephemeral_public_key_Read_Ephemeral_ECU_Public_Key
              Certificates: DcmDspDidDataPos=1024, DcmDspDidDataRef=Trust_Model_Request_ephemeral_public_key_Read_Certificates
              Nonce: DcmDspDidDataPos=0, DcmDspDidDataRef=Trust_Model_Request_ephemeral_public_key_Read_Nonce
          DID_HW_input_Read: DcmDspDidIdentifier=544, DcmDspDidInfoRef=DidInfo_HW_input_Read
            Voltage_KL30t (DcmDspDidSignal): DcmDspDidDataPos=0, DcmDspDidDataRef=HW_input_Read_Voltage_KL30t
            Voltage_Motor (DcmDspDidSignal): DcmDspDidDataPos=8, DcmDspDidDataRef=HW_input_Read_Voltage_Motor
          DID_Diagnostic_Trace_Memory_Read: DcmDspDidIdentifier=258, DcmDspDidInfoRef=DidInfo_Diagnostic_Trace_Memory_Read
            Diagnostic_Trace_Memory (DcmDspDidSignal): DcmDspDidDataPos=0, DcmDspDidDataRef=Diagnostic_Trace_Memory_Read_Diagnostic_Trace_Memory
        DidInfo_Availability_Data_Read (DcmDspDidInfo)
          DcmDspDidAccess
            DcmDspDidRead:
              DcmDspDidReadRoleRef = Supplier
              DcmDspDidReadRoleRef = Development_ENHANCED
              DcmDspDidReadRoleRef = Production
              DcmDspDidReadRoleRef = After_Sales_ENHANCED
              DcmDspDidReadRoleRef = After_Sales_STANDARD
              DcmDspDidReadRoleRef = After_Sales_BASIC
              DcmDspDidReadRoleRef = Internal_Diagnostic_Test_Tool
              DcmDspDidReadRoleRef = ePTI_Test_Tool
        DID_ReadFingerprint_Read (DcmDspDid):
          DcmDspDidIdentifier = 61787
          DcmDspDidUsed = true
          DcmDspDidUsePort = USE_DATA_ELEMENT_SPECIFIC_INTERFACES
          DcmDspDidInfoRef = DidInfo_ReadFingerprint_Read
          Software_Fingerprint_s (DcmDspDidSignal): DcmDspDidDataPos=0, DcmDspDidDataRef=ReadFingerprint_Read_Software_Fingerprint_s
        DidInfo_MercedesCarGroupSoftware_Read (DcmDspDidInfo)
          DcmDspDidAccess
            DcmDspDidRead
        DidInfo_Adjust_ISO_15765_2_Block_Size_and_STmin_Parameter_Read (DcmDspDidInfo)
          DcmDspDidAccess
            DcmDspDidWrite:
              DcmDspDidWriteSessionRef = DcmDspSession/Programming
              DcmDspDidWriteSessionRef = DcmDspSession/Extended
              DcmDspDidWriteSessionRef = Development
              DcmDspDidWriteRoleRef = Supplier
              DcmDspDidWriteRoleRef = Development_ENHANCED
              DcmDspDidWriteRoleRef = Production
              DcmDspDidWriteRoleRef = After_Sales_ENHANCED
              DcmDspDidWriteRoleRef = After_Sales_STANDARD
              DcmDspDidWriteRoleRef = Internal_Diagnostic_Test_Tool
            DcmDspDidRead:
              DcmDspDidReadRoleRef = Supplier
              DcmDspDidReadRoleRef = Development_ENHANCED
              DcmDspDidReadRoleRef = Production
              DcmDspDidReadRoleRef = After_Sales_ENHANCED
              DcmDspDidReadRoleRef = After_Sales_STANDARD
              DcmDspDidReadRoleRef = After_Sales_BASIC
              DcmDspDidReadRoleRef = Internal_Diagnostic_Test_Tool
              DcmDspDidReadRoleRef = ePTI_Test_Tool
        System_Time_read_Read_System_time (DcmDspData):
          DcmDspDataSize = 32
          DcmDspDataType = UINT32
          DcmDspDataUsePort = USE_DATA_ASYNCH_CLIENT_SERVER
          DcmDspDataInfoRef = Info_System_Time_read_Read_System_time
        7 x DcmDspDataInfo:
          Info_Trust_Model_Request_ephemeral_public_key_Read_Nonce: DcmDspDataFixedLength=true
          Info_Vehicle_Equipment_Read_Equipment_2: DcmDspDataFixedLength=true
          Info_Vehicle_Equipment_Read_Equipment_3: DcmDspDataFixedLength=true
          Info_Standard_Application_SW_Package_Information_Read_Supplier_Identification: DcmDspDataFixedLength=true
          Info_Trust_model_ECU_CSR_Read_Trust_model_ECU_CSR: DcmDspDataFixedLength=false
          Info_Vehicle_Equipment_Read_Equipment_1: DcmDspDataFixedLength=true
          Info_ECU_Extract_Version_Read_ECU_Extract_Patch_Version: DcmDspDataFixedLength=true
        DID_Trust_model_full_chain_of_trust_certificates_Read (DcmDspDid):
          DcmDspDidIdentifier = 415
          DcmDspDidUsed = true
          DcmDspDidUsePort = USE_DATA_ELEMENT_SPECIFIC_INTERFACES
          DcmDspDidInfoRef = DidInfo_Trust_model_full_chain_of_trust_certificates_Read
          Trust_model_certificates (DcmDspDidSignal): DcmDspDidDataPos=0, DcmDspDidDataRef=Trust_model_full_chain_of_trust_certificates_Read_Trust_model_certificates
        PRE_SAFE_Counter_read_Read_CombinedDataElement (DcmDspData):
          DcmDspDataSize = 64
          DcmDspDataType = UINT8_N
          DcmDspDataUsePort = USE_DATA_ASYNCH_CLIENT_SERVER
          DcmDspDataInfoRef = Info_PRE_SAFE_Counter_read_Read_CombinedDataElement
        DidInfo_Vehicle_Odometer_in_Low_Resolution_Read (DcmDspDidInfo)
          DcmDspDidAccess
            DcmDspDidRead:
              DcmDspDidReadRoleRef = Supplier
              DcmDspDidReadRoleRef = Development_ENHANCED
              DcmDspDidReadRoleRef = Production
              DcmDspDidReadRoleRef = After_Sales_ENHANCED
              DcmDspDidReadRoleRef = After_Sales_STANDARD
              DcmDspDidReadRoleRef = After_Sales_BASIC
              DcmDspDidReadRoleRef = Internal_Diagnostic_Test_Tool
              DcmDspDidReadRoleRef = ePTI_Test_Tool
        Info_Diagnostic_Extract_Version_Read_DDM_Version (DcmDspDataInfo): DcmDspDataFixedLength=true
        DidInfo_Security_Event_Log_Read (DcmDspDidInfo)
          DcmDspDidAccess
            DcmDspDidRead: DcmDspDidReadRoleRef=Supplier, DcmDspDidReadRoleRef=Development_ENHANCED, DcmDspDidReadRoleRef=Internal_Diagnostic_Test_Tool
        4 x DcmDspDataInfo:
          Info_Trust_model_ECU_certificate_Read_Trust_model_ECU_Certificate: DcmDspDataFixedLength=false
          Info_Seatbelt_Serial_Number_Read_Unique_Seatbelt_Serialnumber: DcmDspDataFixedLength=true
          Info_System_Time_read_Read_System_time: DcmDspDataFixedLength=true
          Info_VINDataIdentifier_Read_VINDataIdentifier: DcmDspDataFixedLength=true
        DID_ZZZ_Vehicle_Equipment_Development_Read (DcmDspDid):
          DcmDspDidIdentifier = 785
          DcmDspDidUsed = true
          DcmDspDidUsePort = USE_DATA_ELEMENT_SPECIFIC_INTERFACES
          DcmDspDidInfoRef = DidInfo_ZZZ_Vehicle_Equipment_Development_Read
          Zykluszeit_Messtechnik (DcmDspDidSignal): DcmDspDidDataPos=16, DcmDspDidDataRef=ZZZ_Vehicle_Equipment_Development_Read_Zykluszeit_Messtechnik
          Bitfield (DcmDspDidSignal): DcmDspDidDataPos=0, DcmDspDidDataRef=ZZZ_Vehicle_Equipment_Development_Read_Bitfield
        Seatbelt_Serial_Number_Read_Unique_Seatbelt_Serialnumber (DcmDspData):
          DcmDspDataSize = 224
          DcmDspDataType = UINT8_N
          DcmDspDataUsePort = USE_DATA_ASYNCH_CLIENT_SERVER
          DcmDspDataInfoRef = Info_Seatbelt_Serial_Number_Read_Unique_Seatbelt_Serialnumber
        Info_MercedesCarGroupHardware_Read_Hardware_Part_Number (DcmDspDataInfo): DcmDspDataFixedLength=true
        ECU_Extract_Version_Read_ECU_Extract_Patch_Version (DcmDspData):
          DcmDspDataSize = 8
          DcmDspDataType = UINT8
          DcmDspDataUsePort = USE_DATA_ASYNCH_CLIENT_SERVER
          DcmDspDataConstantValue = 00
          DcmDspDataConstantValueType = HEX
          DcmDspDataInfoRef = Info_ECU_Extract_Version_Read_ECU_Extract_Patch_Version
        Info_HardwareVersion_Read_HW_patch_level (DcmDspDataInfo): DcmDspDataFixedLength=true
        ZZZ_Vehicle_Equipment_Development_Read_Zykluszeit_Messtechnik (DcmDspData):
          DcmDspDataSize = 8
          DcmDspDataType = UINT8
          DcmDspDataUsePort = USE_DATA_ASYNCH_CLIENT_SERVER
          DcmDspDataInfoRef = Info_ZZZ_Vehicle_Equipment_Development_Read_Zykluszeit_Messtechnik
        Access_Control_List_Version_Read_Basic_ACL_Version_Candela_File_Version_Minor (DcmDspData):
          DcmDspDataSize = 8
          DcmDspDataType = UINT8
          DcmDspDataUsePort = USE_DATA_ASYNCH_CLIENT_SERVER
          DcmDspDataInfoRef = Info_Access_Control_List_Version_Read_Basic_ACL_Version_Candela_File_Version_Minor
        3 x DcmDspDid, all with DcmDspDidUsed=true, DcmDspDidUsePort=USE_DATA_ELEMENT_SPECIFIC_INTERFACES:
          DID_PRE_SAFE_Counter_read_Read: DcmDspDidIdentifier=580, DcmDspDidInfoRef=DidInfo_PRE_SAFE_Counter_read_Read
            CombinedDataElement (DcmDspDidSignal): DcmDspDidDataPos=0, DcmDspDidDataRef=PRE_SAFE_Counter_read_Read_CombinedDataElement
          DID_Trust_model_Backend_CA_certificate_Read: DcmDspDidIdentifier=413, DcmDspDidInfoRef=DidInfo_Trust_model_Backend_CA_certificate_Read
            Trust_model_Backend_CA_certificate (DcmDspDidSignal): DcmDspDidDataPos=0, DcmDspDidDataRef=Trust_model_Backend_CA_certificate_Read_Trust_model_Backend_CA_certificate
          DID_ActiveDiagnosticInformation_Read: DcmDspDidIdentifier=61696, DcmDspDidInfoRef=DidInfo_ActiveDiagnosticInformation_Read
            Session (DcmDspDidSignal): DcmDspDidDataPos=24, DcmDspDidDataRef=ActiveDiagnosticInformation_Read_Session
            Identification (DcmDspDidSignal): DcmDspDidDataPos=0, DcmDspDidDataRef=ActiveDiagnosticInformation_Read_Identification
        DidInfo_Obsolescence_Data_Read (DcmDspDidInfo)
          DcmDspDidAccess
            DcmDspDidRead:
              DcmDspDidReadRoleRef = Supplier
              DcmDspDidReadRoleRef = Development_ENHANCED
              DcmDspDidReadRoleRef = Production
              DcmDspDidReadRoleRef = After_Sales_ENHANCED
              DcmDspDidReadRoleRef = After_Sales_STANDARD
              DcmDspDidReadRoleRef = After_Sales_BASIC
              DcmDspDidReadRoleRef = Internal_Diagnostic_Test_Tool
              DcmDspDidReadRoleRef = ePTI_Test_Tool
        Info_Reprogramming_Attempt_Counter_Read_Reprogramming_Attempts (DcmDspDataInfo): DcmDspDataFixedLength=false
        DID_Real_Time_Offset_Read (DcmDspDid): DcmDspDidIdentifier=397, DcmDspDidUsed=true, DcmDspDidUsePort=USE_DATA_ELEMENT_SPECIFIC_INTERFACES, DcmDspDidInfoRef=DidInfo_Real_Time_Offset_Read
          TickCount (DcmDspDidSignal): DcmDspDidDataPos=120, DcmDspDidDataRef=Real_Time_Offset_Read_TickCount
          Real_Time_Offset (DcmDspDidSignal): DcmDspDidDataPos=0, DcmDspDidDataRef=Real_Time_Offset_Read_Real_Time_Offset
        DidInfo_BSR_Counter_read_Read (DcmDspDidInfo)
          DcmDspDidAccess
            DcmDspDidRead:  # COVERS: PLAIN_TEXT ARCH_SW_DIA_0079
              DcmDspDidReadSessionRef = DcmDspSession/Default
              DcmDspDidReadSessionRef = DcmDspSession/Extended
              DcmDspDidReadSessionRef = Development
              DcmDspDidReadRoleRef = Supplier
              DcmDspDidReadRoleRef = Development_ENHANCED
              DcmDspDidReadRoleRef = Production
              DcmDspDidReadRoleRef = After_Sales_ENHANCED
              DcmDspDidReadRoleRef = After_Sales_STANDARD
              DcmDspDidReadRoleRef = After_Sales_BASIC
              DcmDspDidReadRoleRef = Internal_Diagnostic_Test_Tool
              DcmDspDidReadRoleRef = ePTI_Test_Tool
        Info_RandomNumber_Read_Generated_Random_Number (DcmDspDataInfo): DcmDspDataFixedLength=true
        Routine_Synchronize_to_Non_volatile_Memory_Start (DcmDspRoutine):
          DcmDspRequestResultsRoutineSupported = true
          DcmDspStopRoutineSupported = true
          DcmDspRoutineIdentifier = 581
          DcmDspRoutineFixedLength = false
          DcmDspRoutineUsePort = true
          DcmDspRoutineUsed = true
          DcmDspRoutineInfoRef = RoutineInfo_Synchronize_to_Non_volatile_Memory_Start
        DidInfo_ActiveDiagnosticInformation_Read (DcmDspDidInfo)
          DcmDspDidAccess
            DcmDspDidRead
        Info_RandomNumber_Read_Generated_Random_Number_Result (DcmDspDataInfo): DcmDspDataFixedLength=true
        DID_SoftwareVersion_Read (DcmDspDid):
          DcmDspDidIdentifier = 61777
          DcmDspDidUsed = true
          DcmDspDidUsePort = USE_DATA_ELEMENT_SPECIFIC_INTERFACES
          DcmDspDidInfoRef = DidInfo_SoftwareVersion_Read
          Software_Logical_Block_Version_Information (DcmDspDidSignal): DcmDspDidDataPos=0, DcmDspDidDataRef=SoftwareVersion_Read_Software_Logical_Block_Version_Information
        Info_SSA_Version_Information_Read_SSA_Major_Version (DcmDspDataInfo): DcmDspDataFixedLength=true
        ActiveDiagnosticInformation_Read_Session (DcmDspData):
          DcmDspDataSize = 8
          DcmDspDataType = UINT8
          DcmDspDataUsePort = USE_DATA_ASYNCH_CLIENT_SERVER
          DcmDspDataInfoRef = Info_ActiveDiagnosticInformation_Read_Session
        Info_Diagnostic_Extract_Version_Read_Diagnostic_Extract_Minor_Version (DcmDspDataInfo): DcmDspDataFixedLength=true
        DidInfo_Trust_Model_Request_ephemeral_public_key_Read (DcmDspDidInfo)
          DcmDspDidAccess
            DcmDspDidRead:
              DcmDspDidReadSessionRef = DcmDspSession/Default
              DcmDspDidReadSessionRef = DcmDspSession/Extended
              DcmDspDidReadSessionRef = Development
              DcmDspDidReadRoleRef = Supplier
              DcmDspDidReadRoleRef = Development_ENHANCED
              DcmDspDidReadRoleRef = Production
              DcmDspDidReadRoleRef = After_Sales_ENHANCED
        Backend_CA_Certificate_Identification_Read_Backend_CA_SubjectKeyIdentifier (DcmDspData):
          DcmDspDataSize = 160
          DcmDspDataType = UINT8_N
          DcmDspDataUsePort = USE_DATA_ASYNCH_CLIENT_SERVER
          DcmDspDataInfoRef = Info_Backend_CA_Certificate_Identification_Read_Backend_CA_SubjectKeyIdentifier
        DidInfo_Trust_model_Root_CA_certificate_Read (DcmDspDidInfo)
          DcmDspDidAccess
            DcmDspDidRead:
              DcmDspDidReadSessionRef = DcmDspSession/Default
              DcmDspDidReadSessionRef = DcmDspSession/Extended
              DcmDspDidReadSessionRef = Development
              DcmDspDidReadRoleRef = Supplier
              DcmDspDidReadRoleRef = Development_ENHANCED
              DcmDspDidReadRoleRef = Production
              DcmDspDidReadRoleRef = After_Sales_ENHANCED
              DcmDspDidReadRoleRef = After_Sales_STANDARD
              DcmDspDidReadRoleRef = After_Sales_BASIC
              DcmDspDidReadRoleRef = Internal_Diagnostic_Test_Tool
              DcmDspDidReadRoleRef = ePTI_Test_Tool
        DidInfo_Global_Time_Sync_Measured_Values_Read (DcmDspDidInfo)
          DcmDspDidAccess
            DcmDspDidRead
        4 x DcmDspData, all with DcmDspDataUsePort=USE_DATA_ASYNCH_CLIENT_SERVER:
          ActiveDiagnosticInformation_Read_Identification: DcmDspDataSize=24, DcmDspDataType=UINT8_N, DcmDspDataInfoRef=Info_ActiveDiagnosticInformation_Read_Identification
          ECU_Extract_Version_Read_ECU_Extract_Information_Export_Date: DcmDspDataSize=80, DcmDspDataType=UINT8_N, DcmDspDataConstantValue=2023-07-20, DcmDspDataConstantValueType=ASCII, DcmDspDataInfoRef=Info_ECU_Extract_Version_Read_ECU_Extract_Information_Export_Date
          DDS_Package_Release_Read_DDS_Package_Release_of_Boot_Software_Year_Boot: DcmDspDataSize=8, DcmDspDataType=UINT8, DcmDspDataInfoRef=Info_DDS_Package_Release_Read_DDS_Package_Release_of_Boot_Software_Year_Boot
          Access_Control_List_Version_Read_ECU_indvidual_ACL_Hash: DcmDspDataSize=512, DcmDspDataType=UINT8_N, DcmDspDataInfoRef=Info_Access_Control_List_Version_Read_ECU_indvidual_ACL_Hash
        DidInfo_SoftwareSupplier_Read (DcmDspDidInfo)
          DcmDspDidAccess
            DcmDspDidRead
        Info_ActiveDiagnosticInformation_Read_Identification (DcmDspDataInfo): DcmDspDataFixedLength=true
        Info_Access_Control_List_Version_Read_ECU_indvidual_ACL_Version_Candela_File_Version_Patch (DcmDspDataInfo): DcmDspDataFixedLength=true
        Routine_Replace_Trust_model_Root_Certificate_Start (DcmDspRoutine):
          DcmDspRequestResultsRoutineSupported = false
          DcmDspStopRoutineSupported = false
          DcmDspRoutineIdentifier = 631
          DcmDspRoutineFixedLength = false
          DcmDspRoutineUsePort = true
          DcmDspRoutineUsed = true
          DcmDspRoutineInfoRef = RoutineInfo_Replace_Trust_model_Root_Certificate_Start
        Info_ECU_Extract_Version_Read_ECU_Extract_Information_Checksum (DcmDspDataInfo): DcmDspDataFixedLength=true
        Info_Current_Operating_Time_Read_Current_Operating_Time (DcmDspDataInfo): DcmDspDataFixedLength=true
        DID_CAN_output_Read (DcmDspDid): DcmDspDidIdentifier=528, DcmDspDidUsed=true, DcmDspDidUsePort=USE_DATA_ELEMENT_SPECIFIC_INTERFACES, DcmDspDidInfoRef=DidInfo_CAN_output_Read
          5 x DcmDspDidSignal:
            CANoutput1: DcmDspDidDataPos=0, DcmDspDidDataRef=CAN_output_Read_CANoutput1
            PS_Curve_XX_Stat_ST3: DcmDspDidDataPos=40, DcmDspDidDataRef=CAN_output_Read_PS_Curve_XX_Stat_ST3
            RBTMxx_Actv_Lvl_ST35: DcmDspDidDataPos=24, DcmDspDidDataRef=CAN_output_Read_RBTMxx_Actv_Lvl_ST35
            RBTMxx_SP_ActvClient_ST35: DcmDspDidDataPos=32, DcmDspDidDataRef=CAN_output_Read_RBTMxx_SP_ActvClient_ST35
            RBTMxx_SP_FctPrecond_Stat_ST35: DcmDspDidDataPos=8, DcmDspDidDataRef=CAN_output_Read_RBTMxx_SP_FctPrecond_Stat_ST35
        Internal_ECU_information_Read_ECU_Temperature (DcmDspData):
          DcmDspDataSize = 16
          DcmDspDataType = UINT16
          DcmDspDataUsePort = USE_DATA_ASYNCH_CLIENT_SERVER
          DcmDspDataInfoRef = Info_Internal_ECU_information_Read_ECU_Temperature
        Current_Operating_Time_Read_Current_Operating_Time (DcmDspData):
          DcmDspDataSize = 32
          DcmDspDataType = UINT32
          DcmDspDataUsePort = USE_DATA_ASYNCH_CLIENT_SERVER
          DcmDspDataInfoRef = Info_Current_Operating_Time_Read_Current_Operating_Time
        Info_Dump_of_Vedoc_Relevant_Information_Read_PatchedObject (DcmDspDataInfo): DcmDspDataFixedLength=false
        Info_Status_SSA_Pre_Compile_Switches_Read_Precompile_switch (DcmDspDataInfo): DcmDspDataFixedLength=true
        Trust_model_Backend_CA_certificate_Read_Trust_model_Backend_CA_certificate (DcmDspData):
          DcmDspDataSize = 8016
          DcmDspDataType = UINT8_N
          DcmDspDataUsePort = USE_DATA_ASYNCH_CLIENT_SERVER
          DcmDspDataInfoRef = Info_Trust_model_Backend_CA_certificate_Read_Trust_model_Backend_CA_certificate
        Info_SecOC_PDU_Data_IDs_and_Key_CMACs_Read_Secured_PDU_Data_IDs_and_Key_CMACs (DcmDspDataInfo): DcmDspDataFixedLength=false
        Standard_Application_SW_Package_Information_Read_Standard_Application_SW_Package_Patch_Level (DcmDspData):
          DcmDspDataSize = 8
          DcmDspDataType = UINT8
          DcmDspDataUsePort = USE_DATA_ASYNCH_CLIENT_SERVER
          DcmDspDataInfoRef = Info_Standard_Application_SW_Package_Information_Read_Standard_Application_SW_Package_Patch_Level
        DID_Access_Control_List_Version_Read (DcmDspDid):
          DcmDspDidIdentifier = 389
          DcmDspDidUsed = true
          DcmDspDidUsePort = USE_DATA_ELEMENT_SPECIFIC_INTERFACES
          DcmDspDidInfoRef = DidInfo_Access_Control_List_Version_Read
          10 x DcmDspDidSignal:
            Basic_ACL_Version_Generation_Time_GTC: DcmDspDidDataPos=0, DcmDspDidDataRef=Access_Control_List_Version_Read_Basic_ACL_Version_Generation_Time_GTC
            ECU_indvidual_ACL_Version_Generation_Time_GTC: DcmDspDidDataPos=656, DcmDspDidDataRef=Access_Control_List_Version_Read_ECU_indvidual_ACL_Version_Generation_Time_GTC
            Basic_ACL_Hash: DcmDspDidDataPos=144, DcmDspDidDataRef=Access_Control_List_Version_Read_Basic_ACL_Hash
            Basic_ACL_Version_Candela_File_Version_Patch: DcmDspDidDataPos=136, DcmDspDidDataRef=Access_Control_List_Version_Read_Basic_ACL_Version_Candela_File_Version_Patch
            ECU_indvidual_ACL_Version_Candela_File_Version_Patch: DcmDspDidDataPos=792, DcmDspDidDataRef=Access_Control_List_Version_Read_ECU_indvidual_ACL_Version_Candela_File_Version_Patch
            ECU_indvidual_ACL_Hash: DcmDspDidDataPos=800, DcmDspDidDataRef=Access_Control_List_Version_Read_ECU_indvidual_ACL_Hash
            ECU_indvidual_ACL_Version_Candela_File_Version_Minor: DcmDspDidDataPos=784, DcmDspDidDataRef=Access_Control_List_Version_Read_ECU_indvidual_ACL_Version_Candela_File_Version_Minor
            ECU_indvidual_ACL_Version_Candela_File_Version_Major: DcmDspDidDataPos=776, DcmDspDidDataRef=Access_Control_List_Version_Read_ECU_indvidual_ACL_Version_Candela_File_Version_Major
            Basic_ACL_Version_Candela_File_Version_Minor: DcmDspDidDataPos=128, DcmDspDidDataRef=Access_Control_List_Version_Read_Basic_ACL_Version_Candela_File_Version_Minor
            Basic_ACL_Version_Candela_File_Version_Major: DcmDspDidDataPos=120, DcmDspDidDataRef=Access_Control_List_Version_Read_Basic_ACL_Version_Candela_File_Version_Major
        PRE_SAFE_Recorder_1_read_Read_CombinedDataElement (DcmDspData):
          DcmDspDataSize = 176
          DcmDspDataType = UINT8_N
          DcmDspDataUsePort = USE_DATA_ASYNCH_CLIENT_SERVER
          DcmDspDataInfoRef = Info_PRE_SAFE_Recorder_1_read_Read_CombinedDataElement
        Info_Trust_model_Root_CA_certificate_Read_Trust_model_Root_CA_certificate (DcmDspDataInfo): DcmDspDataFixedLength=false
        RoutineInfo_Replace_Trust_model_Root_Certificate_Start (DcmDspRoutineInfo)
          DcmDspStartRoutineIn
            3 x DcmDspStartRoutineInSignal, all with DcmDspRoutineSignalEndianness=opaque:
              Certificates: DcmDspRoutineSignalLength=16032, DcmDspRoutineSignalType=VARIABLE_LENGTH, DcmDspRoutineSignalPos=1024
              signature_new_Root: DcmDspRoutineSignalLength=512, DcmDspRoutineSignalType=UINT8_N, DcmDspRoutineSignalPos=0
              signature: DcmDspRoutineSignalLength=512, DcmDspRoutineSignalType=UINT8_N, DcmDspRoutineSignalPos=512
          DcmDspRoutineAuthorization:
            DcmDspRoutineSessionRef = DcmDspSession/Default
            DcmDspRoutineSessionRef = DcmDspSession/Extended
            DcmDspRoutineSessionRef = Development
            DcmDspRoutineRoleRef = Production
          DcmDspStartRoutineOut
            Verification_Result (DcmDspStartRoutineOutSignal): DcmDspRoutineSignalLength=8, DcmDspRoutineSignalType=UINT8, DcmDspRoutineSignalPos=8
            routineInfo (DcmDspStartRoutineOutSignal): DcmDspRoutineSignalLength=8, DcmDspRoutineSignalType=UINT8, DcmDspRoutineSignalPos=0
        DID_SecOC_Local_TickCount_Read (DcmDspDid):
          DcmDspDidIdentifier = 394
          DcmDspDidUsed = true
          DcmDspDidUsePort = USE_DATA_ELEMENT_SPECIFIC_INTERFACES
          DcmDspDidInfoRef = DidInfo_SecOC_Local_TickCount_Read
          TickCount (DcmDspDidSignal): DcmDspDidDataPos=0, DcmDspDidDataRef=SecOC_Local_TickCount_Read_TickCount
        SecOC_Local_TickCount_Read_TickCount (DcmDspData):
          DcmDspDataSize = 48
          DcmDspDataType = UINT8_N
          DcmDspDataUsePort = USE_DATA_ASYNCH_CLIENT_SERVER
          DcmDspDataInfoRef = Info_SecOC_Local_TickCount_Read_TickCount
        Adjust_ISO_15765_2_Block_Size_and_STmin_Parameter_Read_Block_Size_Value_as_defined_in_ISO_15765_2 (DcmDspData):
          DcmDspDataSize = 8
          DcmDspDataType = UINT8
          DcmDspDataUsePort = USE_DATA_ASYNCH_CLIENT_SERVER
          DcmDspDataInfoRef = Info_Adjust_ISO_15765_2_Block_Size_and_STmin_Parameter_Read_Block_Size_Value_as_defined_in_ISO_15765_2
        DidInfo_SecOC_PDU_Data_IDs_and_Key_CMACs_Read (DcmDspDidInfo)
          DcmDspDidAccess
            DcmDspDidRead: DcmDspDidReadSessionRef=DcmDspSession/Default, DcmDspDidReadSessionRef=DcmDspSession/Extended, DcmDspDidReadSessionRef=Development
        Internal_ECU_information_Read_Autosar_System_State_EcuM_State (DcmDspData):
          DcmDspDataSize = 8
          DcmDspDataType = UINT8
          DcmDspDataUsePort = USE_DATA_ASYNCH_CLIENT_SERVER
          DcmDspDataInfoRef = Info_Internal_ECU_information_Read_Autosar_System_State_EcuM_State
        DidInfo_Trust_model_full_chain_of_trust_certificates_Read (DcmDspDidInfo)
          DcmDspDidAccess
            DcmDspDidRead:
              DcmDspDidReadSessionRef = DcmDspSession/Default
              DcmDspDidReadSessionRef = DcmDspSession/Extended
              DcmDspDidReadSessionRef = Development
              DcmDspDidReadRoleRef = Supplier
              DcmDspDidReadRoleRef = Development_ENHANCED
              DcmDspDidReadRoleRef = Production
              DcmDspDidReadRoleRef = After_Sales_ENHANCED
              DcmDspDidReadRoleRef = After_Sales_STANDARD
              DcmDspDidReadRoleRef = After_Sales_BASIC
              DcmDspDidReadRoleRef = Internal_Diagnostic_Test_Tool
              DcmDspDidReadRoleRef = ePTI_Test_Tool
        VIN_Status_Read_VIN_Lock_Status (DcmDspData): DcmDspDataSize=8, DcmDspDataType=UINT8, DcmDspDataUsePort=USE_DATA_ASYNCH_CLIENT_SERVER, DcmDspDataInfoRef=Info_VIN_Status_Read_VIN_Lock_Status
        DID_HardwareVersion_Read (DcmDspDid):
          DcmDspDidIdentifier = 61776
          DcmDspDidUsed = true
          DcmDspDidUsePort = USE_DATA_ELEMENT_SPECIFIC_INTERFACES
          DcmDspDidInfoRef = DidInfo_HardwareVersion_Read
          3 x DcmDspDidSignal:
            HW_year: DcmDspDidDataPos=0, DcmDspDidDataRef=HardwareVersion_Read_HW_year
            HW_week: DcmDspDidDataPos=8, DcmDspDidDataRef=HardwareVersion_Read_HW_week
            HW_patch_level: DcmDspDidDataPos=16, DcmDspDidDataRef=HardwareVersion_Read_HW_patch_level
        DidInfo_Standard_Application_SW_Package_Information_Read (DcmDspDidInfo)
          DcmDspDidAccess
            DcmDspDidRead:
              DcmDspDidReadRoleRef = Supplier
              DcmDspDidReadRoleRef = Development_ENHANCED
              DcmDspDidReadRoleRef = Production
              DcmDspDidReadRoleRef = Internal_Diagnostic_Test_Tool
        DID_ECU_Location_Read (DcmDspDid): DcmDspDidIdentifier=64815, DcmDspDidUsed=true, DcmDspDidUsePort=USE_DATA_ELEMENT_SPECIFIC_INTERFACES, DcmDspDidInfoRef=DidInfo_ECU_Location_Read
          Side_Allocation (DcmDspDidSignal): DcmDspDidDataPos=0, DcmDspDidDataRef=ECU_Location_Read_Side_Allocation
        DidInfo_Steps_library_Read (DcmDspDidInfo)
          DcmDspDidAccess
            DcmDspDidRead: DcmDspDidReadSessionRef=Development  # COVERS: PLAIN_TEXT ARCH_SW_DIA_0068
            DcmDspDidWrite: DcmDspDidWriteSessionRef=Development, DcmDspDidWriteRoleRef=Supplier, DcmDspDidWriteRoleRef=Development_ENHANCED, DcmDspDidWriteRoleRef=Production  # COVERS: PLAIN_TEXT ARCH_SW_DIA_0070
        DID_Cycle_configuration_Read (DcmDspDid):
          DcmDspDidIdentifier = 64784
          DcmDspDidUsed = true
          DcmDspDidUsePort = USE_DATA_ELEMENT_SPECIFIC_INTERFACES
          DcmDspDidInfoRef = DidInfo_Cycle_configuration_Read
          Cycles (DcmDspDidSignal): DcmDspDidDataPos=0, DcmDspDidDataRef=Cycle_configuration_Read_Cycles
        Info_ECU_Location_Read_Side_Allocation (DcmDspDataInfo): DcmDspDataFixedLength=true
        ECU_Location_Read_Side_Allocation (DcmDspData):
          DcmDspDataSize = 8
          DcmDspDataType = UINT8
          DcmDspDataUsePort = USE_DATA_ASYNCH_CLIENT_SERVER
          DcmDspDataConditionCheckReadFncUsed = false
          DcmDspDataInfoRef = Info_ECU_Location_Read_Side_Allocation
        DID_Steps_library_Read (DcmDspDid): DcmDspDidIdentifier=64810, DcmDspDidUsed=true, DcmDspDidUsePort=USE_DATA_ELEMENT_SPECIFIC_INTERFACES, DcmDspDidInfoRef=DidInfo_Steps_library_Read
          Steps (DcmDspDidSignal): DcmDspDidDataPos=0, DcmDspDidDataRef=Steps_library_Read_Steps
        DidInfo_Cycle_configuration_Read (DcmDspDidInfo)
          DcmDspDidAccess
            DcmDspDidRead: DcmDspDidReadSessionRef=Development  # COVERS: PLAIN_TEXT ARCH_SW_DIA_0064
            DcmDspDidWrite: DcmDspDidWriteSessionRef=Development, DcmDspDidWriteRoleRef=Supplier, DcmDspDidWriteRoleRef=Development_ENHANCED, DcmDspDidWriteRoleRef=Production  # COVERS: PLAIN_TEXT ARCH_SW_DIA_0066
        DidInfo_ECU_Location_Read (DcmDspDidInfo)
          DcmDspDidAccess
            DcmDspDidRead: DcmDspDidReadSessionRef=Development  # COVERS: PLAIN_TEXT ARCH_SW_DIA_0062
            DcmDspDidWrite: DcmDspDidWriteSessionRef=Development, DcmDspDidWriteRoleRef=Supplier, DcmDspDidWriteRoleRef=Development_ENHANCED, DcmDspDidWriteRoleRef=Production  # COVERS: PLAIN_TEXT ARCH_SW_DIA_0060
        Info_Cycle_configuration_Read_Cycles (DcmDspDataInfo): DcmDspDataFixedLength=true
        Cycle_configuration_Read_Cycles (DcmDspData):
          DcmDspDataSize = 3360
          DcmDspDataType = UINT8_N
          DcmDspDataUsePort = USE_DATA_ASYNCH_CLIENT_SERVER
          DcmDspDataConditionCheckReadFncUsed = false
          DcmDspDataInfoRef = Info_Cycle_configuration_Read_Cycles
        Steps_library_Read_Steps (DcmDspData):
          DcmDspDataSize = 9280
          DcmDspDataType = UINT8_N
          DcmDspDataUsePort = USE_DATA_ASYNCH_CLIENT_SERVER
          DcmDspDataConditionCheckReadFncUsed = false
          DcmDspDataInfoRef = Info_Steps_library_Read_Steps
        Info_Steps_library_Read_Steps (DcmDspDataInfo): DcmDspDataFixedLength=true
        Info_Obsolescence_Data_Read_Obsolescence_Data_PRE_SAFE_Lvl_4_5_Threshold_Yellow_to_Red (DcmDspDataInfo): DcmDspDataFixedLength=true
        Obsolescence_Data_Read_Obsolescence_Data_PRE_CRASH_Threshold_Yellow_to_Red (DcmDspData):
          DcmDspDataSize = 16
          DcmDspDataType = UINT16
          DcmDspDataUsePort = USE_DATA_ASYNCH_CLIENT_SERVER
          DcmDspDataInfoRef = Info_Obsolescence_Data_Read_Obsolescence_Data_PRE_CRASH_Threshold_Yellow_to_Red
        Info_CAN_output_Read_PS_Curve_XX_Stat_ST3 (DcmDspDataInfo): DcmDspDataFixedLength=true
        Info_CAN_output_Read_RBTMxx_SP_FctPrecond_Stat_ST35 (DcmDspDataInfo): DcmDspDataFixedLength=true
        Routine_Status_of_Post_Production_Flag_Start (DcmDspRoutine):
          DcmDspRequestResultsRoutineSupported = true
          DcmDspStopRoutineSupported = true
          DcmDspRoutineIdentifier = 616
          DcmDspRoutineFixedLength = false
          DcmDspRoutineUsePort = true
          DcmDspRoutineUsed = true
          DcmDspRoutineInfoRef = RoutineInfo_Status_of_Post_Production_Flag_Start
        Info_Obsolescence_Data_Read_Obsolescence_Data_BSR_Threshold_Green_to_Yellow (DcmDspDataInfo): DcmDspDataFixedLength=true
        Obsolescence_Data_Read_Obsolescence_Data_haptic_Warning_Threshold_Yellow_to_Red (DcmDspData):
          DcmDspDataSize = 16
          DcmDspDataType = UINT16
          DcmDspDataUsePort = USE_DATA_ASYNCH_CLIENT_SERVER
          DcmDspDataInfoRef = Info_Obsolescence_Data_Read_Obsolescence_Data_haptic_Warning_Threshold_Yellow_to_Red
        RoutineInfo_Trigger_Tensioning_Cycle_Start (DcmDspRoutineInfo)
          DcmDspRoutineRequestResOut
            Result (DcmDspRoutineRequestResOutSignal): DcmDspRoutineSignalLength=8, DcmDspRoutineSignalType=UINT8, DcmDspRoutineSignalPos=8
            routineInfo (DcmDspRoutineRequestResOutSignal): DcmDspRoutineSignalLength=8, DcmDspRoutineSignalType=UINT8, DcmDspRoutineSignalPos=0
          DcmDspStartRoutineIn
            PreSafe_Duration (DcmDspStartRoutineInSignal): DcmDspRoutineSignalLength=8, DcmDspRoutineSignalType=UINT8, DcmDspRoutineSignalPos=8
            Type_of_tensioning_cycle (DcmDspStartRoutineInSignal): DcmDspRoutineSignalLength=8, DcmDspRoutineSignalType=UINT8, DcmDspRoutineSignalPos=0
          DcmDspRoutineAuthorization:
            DcmDspRoutineSessionRef = DcmDspSession/Extended
            DcmDspRoutineSessionRef = Development
            DcmDspRoutineRoleRef = Supplier
            DcmDspRoutineRoleRef = Development_ENHANCED
            DcmDspRoutineRoleRef = Production
            DcmDspRoutineRoleRef = After_Sales_ENHANCED
            DcmDspRoutineRoleRef = After_Sales_STANDARD
          DcmDspRoutineStopOut
            routineInfo (DcmDspRoutineStopOutSignal): DcmDspRoutineSignalLength=8, DcmDspRoutineSignalType=UINT8, DcmDspRoutineSignalPos=0
          DcmDspStartRoutineOut
            routineInfo (DcmDspStartRoutineOutSignal): DcmDspRoutineSignalLength=8, DcmDspRoutineSignalType=UINT8, DcmDspRoutineSignalPos=0
            Result (DcmDspStartRoutineOutSignal): DcmDspRoutineSignalLength=8, DcmDspRoutineSignalType=UINT8, DcmDspRoutineSignalPos=8
        Info_Obsolescence_Data_Read_Obsolescence_Data_haptic_Warning_Current_Value (DcmDspDataInfo): DcmDspDataFixedLength=true
        Info_Standard_Application_SW_Package_Information_Read_AUTOSAR_Platform (DcmDspDataInfo): DcmDspDataFixedLength=true
        RoutineInfo_Trigger_Presafe_Display_Request_Start (DcmDspRoutineInfo)
          DcmDspRoutineRequestResOut
            Result (DcmDspRoutineRequestResOutSignal): DcmDspRoutineSignalLength=8, DcmDspRoutineSignalType=UINT8, DcmDspRoutineSignalPos=8
            routineInfo (DcmDspRoutineRequestResOutSignal): DcmDspRoutineSignalLength=8, DcmDspRoutineSignalType=UINT8, DcmDspRoutineSignalPos=0
          DcmDspRoutineAuthorization:
            DcmDspRoutineSessionRef = DcmDspSession/Extended
            DcmDspRoutineSessionRef = Development
            DcmDspRoutineRoleRef = Supplier
            DcmDspRoutineRoleRef = Development_ENHANCED
            DcmDspRoutineRoleRef = Production
            DcmDspRoutineRoleRef = After_Sales_ENHANCED
            DcmDspRoutineRoleRef = After_Sales_STANDARD
          DcmDspRoutineStopOut
            routineInfo (DcmDspRoutineStopOutSignal): DcmDspRoutineSignalLength=8, DcmDspRoutineSignalType=UINT8, DcmDspRoutineSignalPos=0
          DcmDspStartRoutineOut
            routineInfo (DcmDspStartRoutineOutSignal): DcmDspRoutineSignalLength=8, DcmDspRoutineSignalType=UINT8, DcmDspRoutineSignalPos=0
            Result (DcmDspStartRoutineOutSignal): DcmDspRoutineSignalLength=8, DcmDspRoutineSignalType=UINT8, DcmDspRoutineSignalPos=8
        DidInfo_Trust_Model_Root_Replacement_Key_Read (DcmDspDidInfo)
          DcmDspDidAccess
            DcmDspDidRead:
              DcmDspDidReadSessionRef = DcmDspSession/Default
              DcmDspDidReadSessionRef = DcmDspSession/Extended
              DcmDspDidReadSessionRef = Development
              DcmDspDidReadRoleRef = Supplier
              DcmDspDidReadRoleRef = Development_ENHANCED
              DcmDspDidReadRoleRef = Production
              DcmDspDidReadRoleRef = After_Sales_ENHANCED
              DcmDspDidReadRoleRef = After_Sales_STANDARD
              DcmDspDidReadRoleRef = After_Sales_BASIC
              DcmDspDidReadRoleRef = Internal_Diagnostic_Test_Tool
              DcmDspDidReadRoleRef = ePTI_Test_Tool
        Obsolescence_Data_Read_Obsolescence_Data_PRE_CRASH_Threshold_Green_to_Yellow (DcmDspData):
          DcmDspDataSize = 16
          DcmDspDataType = UINT16
          DcmDspDataUsePort = USE_DATA_ASYNCH_CLIENT_SERVER
          DcmDspDataInfoRef = Info_Obsolescence_Data_Read_Obsolescence_Data_PRE_CRASH_Threshold_Green_to_Yellow
        Info_Availability_Data_Read_Availability_Data_PRE_SAFE_haptic_warning (DcmDspDataInfo): DcmDspDataFixedLength=true
        CAN_output_Read_PS_Curve_XX_Stat_ST3 (DcmDspData):
          DcmDspDataSize = 8
          DcmDspDataType = UINT8
          DcmDspDataUsePort = USE_DATA_ASYNCH_CLIENT_SERVER
          DcmDspDataInfoRef = Info_CAN_output_Read_PS_Curve_XX_Stat_ST3
        Info_Trust_Model_Root_Replacement_Key_Read_Root_Replacement_Key (DcmDspDataInfo): DcmDspDataFixedLength=true
        Info_Obsolescence_Data_Read_Obsolescence_Data_PRE_CRASH_Threshold_Yellow_to_Red (DcmDspDataInfo): DcmDspDataFixedLength=true
        CAN_output_Read_RBTMxx_SP_FctPrecond_Stat_ST35 (DcmDspData):
          DcmDspDataSize = 16
          DcmDspDataType = UINT8_N
          DcmDspDataUsePort = USE_DATA_ASYNCH_CLIENT_SERVER
          DcmDspDataInfoRef = Info_CAN_output_Read_RBTMxx_SP_FctPrecond_Stat_ST35
        Obsolescence_Data_Read_Obsolescence_Data_BSR_Threshold_Green_to_Yellow (DcmDspData):
          DcmDspDataSize = 16
          DcmDspDataType = UINT16
          DcmDspDataUsePort = USE_DATA_ASYNCH_CLIENT_SERVER
          DcmDspDataInfoRef = Info_Obsolescence_Data_Read_Obsolescence_Data_BSR_Threshold_Green_to_Yellow
        RoutineInfo_Trigger_BSR_Start (DcmDspRoutineInfo)
          DcmDspRoutineRequestResOut
            Result (DcmDspRoutineRequestResOutSignal): DcmDspRoutineSignalLength=8, DcmDspRoutineSignalType=UINT8, DcmDspRoutineSignalPos=8
            routineInfo (DcmDspRoutineRequestResOutSignal): DcmDspRoutineSignalLength=8, DcmDspRoutineSignalType=UINT8, DcmDspRoutineSignalPos=0
          DcmDspRoutineAuthorization:
            DcmDspRoutineSessionRef = DcmDspSession/Extended
            DcmDspRoutineSessionRef = Development
            DcmDspRoutineRoleRef = Supplier
            DcmDspRoutineRoleRef = Development_ENHANCED
            DcmDspRoutineRoleRef = Production
            DcmDspRoutineRoleRef = After_Sales_ENHANCED
            DcmDspRoutineRoleRef = After_Sales_STANDARD
          DcmDspRoutineStopOut
            routineInfo (DcmDspRoutineStopOutSignal): DcmDspRoutineSignalLength=8, DcmDspRoutineSignalType=UINT8, DcmDspRoutineSignalPos=0
          DcmDspStartRoutineOut
            routineInfo (DcmDspStartRoutineOutSignal): DcmDspRoutineSignalLength=8, DcmDspRoutineSignalType=UINT8, DcmDspRoutineSignalPos=0
            Result (DcmDspStartRoutineOutSignal): DcmDspRoutineSignalLength=8, DcmDspRoutineSignalType=UINT8, DcmDspRoutineSignalPos=8
        Info_Obsolescence_Data_Read_Obsolescence_Data_BSR_Threshold_Yellow_to_Red (DcmDspDataInfo): DcmDspDataFixedLength=true
        Info_Obsolescence_Data_Read_Obsolescence_Data_PRE_SAFE_Lvl_4_5_Threshold_Green_to_Yellow (DcmDspDataInfo): DcmDspDataFixedLength=true
        RoutineInfo_Status_of_Post_Production_Flag_Start (DcmDspRoutineInfo)
          DcmDspRoutineStopIn
            In_Post_Production_Flag (DcmDspRoutineStopInSignal): DcmDspRoutineSignalLength=8, DcmDspRoutineSignalType=UINT8, DcmDspRoutineSignalPos=0
          DcmDspRoutineRequestResOut
            routineInfo (DcmDspRoutineRequestResOutSignal): DcmDspRoutineSignalLength=8, DcmDspRoutineSignalType=UINT8, DcmDspRoutineSignalPos=0
            Post_Production_Flag (DcmDspRoutineRequestResOutSignal): DcmDspRoutineSignalLength=8, DcmDspRoutineSignalType=UINT8, DcmDspRoutineSignalPos=8
          DcmDspStartRoutineIn
            In_Post_Production_Flag (DcmDspStartRoutineInSignal): DcmDspRoutineSignalLength=8, DcmDspRoutineSignalType=UINT8, DcmDspRoutineSignalPos=0
          DcmDspRoutineAuthorization: DcmDspRoutineSessionRef=DcmDspSession/Default, DcmDspRoutineSessionRef=DcmDspSession/Extended, DcmDspRoutineSessionRef=Development
          DcmDspRoutineStopOut
            routineInfo (DcmDspRoutineStopOutSignal): DcmDspRoutineSignalLength=8, DcmDspRoutineSignalType=UINT8, DcmDspRoutineSignalPos=0
            Out_Post_Production_Flag (DcmDspRoutineStopOutSignal): DcmDspRoutineSignalLength=8, DcmDspRoutineSignalType=UINT8, DcmDspRoutineSignalPos=8
          DcmDspStartRoutineOut
            routineInfo (DcmDspStartRoutineOutSignal): DcmDspRoutineSignalLength=8, DcmDspRoutineSignalType=UINT8, DcmDspRoutineSignalPos=0
            Out_Post_Production_Flag (DcmDspStartRoutineOutSignal): DcmDspRoutineSignalLength=8, DcmDspRoutineSignalType=UINT8, DcmDspRoutineSignalPos=8
        Obsolescence_Data_Read_Obsolescence_Data_BSR_Threshold_Yellow_to_Red (DcmDspData):
          DcmDspDataSize = 16
          DcmDspDataType = UINT16
          DcmDspDataUsePort = USE_DATA_ASYNCH_CLIENT_SERVER
          DcmDspDataInfoRef = Info_Obsolescence_Data_Read_Obsolescence_Data_BSR_Threshold_Yellow_to_Red
        Info_Obsolescence_Data_Read_Obsolescence_Data_haptic_Warning_Threshold_Green_to_Yellow (DcmDspDataInfo): DcmDspDataFixedLength=true
        Info_CAN_output_Read_RBTMxx_SP_ActvClient_ST35 (DcmDspDataInfo): DcmDspDataFixedLength=true
        Routine_Trigger_Tensioning_Cycle_Start (DcmDspRoutine):
          DcmDspRequestResultsRoutineSupported = true
          DcmDspStopRoutineSupported = true
          DcmDspRoutineIdentifier = 816
          DcmDspRoutineFixedLength = false
          DcmDspRoutineUsePort = true
          DcmDspRoutineUsed = true
          DcmDspRoutineInfoRef = RoutineInfo_Trigger_Tensioning_Cycle_Start
        Standard_Application_SW_Package_Information_Read_AUTOSAR_Platform (DcmDspData):
          DcmDspDataSize = 8
          DcmDspDataType = UINT8
          DcmDspDataUsePort = USE_DATA_ASYNCH_CLIENT_SERVER
          DcmDspDataInfoRef = Info_Standard_Application_SW_Package_Information_Read_AUTOSAR_Platform
        Info_Obsolescence_Data_Read_Obsolescence_Data_BSR_Current_Value (DcmDspDataInfo): DcmDspDataFixedLength=true
        Routine_Trigger_BSR_Start (DcmDspRoutine):
          DcmDspRequestResultsRoutineSupported = true
          DcmDspStopRoutineSupported = true
          DcmDspRoutineIdentifier = 809
          DcmDspRoutineFixedLength = false
          DcmDspRoutineUsePort = true
          DcmDspRoutineUsed = true
          DcmDspRoutineInfoRef = RoutineInfo_Trigger_BSR_Start
        Info_CAN_output_Read_RBTMxx_Actv_Lvl_ST35 (DcmDspDataInfo): DcmDspDataFixedLength=true
        Info_Obsolescence_Data_Read_Obsolescence_Data_PRE_CRASH_Current_Value (DcmDspDataInfo): DcmDspDataFixedLength=true
        Trust_Model_Root_Replacement_Key_Read_Root_Replacement_Key (DcmDspData):
          DcmDspDataSize = 256
          DcmDspDataType = UINT8_N
          DcmDspDataUsePort = USE_DATA_ASYNCH_CLIENT_SERVER
          DcmDspDataInfoRef = Info_Trust_Model_Root_Replacement_Key_Read_Root_Replacement_Key
        Obsolescence_Data_Read_Obsolescence_Data_PRE_SAFE_Lvl_4_5_Threshold_Yellow_to_Red (DcmDspData):
          DcmDspDataSize = 16
          DcmDspDataType = UINT16
          DcmDspDataUsePort = USE_DATA_ASYNCH_CLIENT_SERVER
          DcmDspDataInfoRef = Info_Obsolescence_Data_Read_Obsolescence_Data_PRE_SAFE_Lvl_4_5_Threshold_Yellow_to_Red
        Info_Obsolescence_Data_Read_Obsolescence_Data_PRE_CRASH_Threshold_Green_to_Yellow (DcmDspDataInfo): DcmDspDataFixedLength=true
        4 x DcmDspData, all with DcmDspDataUsePort=USE_DATA_ASYNCH_CLIENT_SERVER:
          Obsolescence_Data_Read_Obsolescence_Data_haptic_Warning_Current_Value: DcmDspDataSize=16, DcmDspDataType=UINT16, DcmDspDataInfoRef=Info_Obsolescence_Data_Read_Obsolescence_Data_haptic_Warning_Current_Value
          Obsolescence_Data_Read_Obsolescence_Data_PRE_SAFE_Lvl_4_5_Current_Value: DcmDspDataSize=16, DcmDspDataType=UINT16, DcmDspDataInfoRef=Info_Obsolescence_Data_Read_Obsolescence_Data_PRE_SAFE_Lvl_4_5_Current_Value
          CAN_output_Read_RBTMxx_SP_ActvClient_ST35: DcmDspDataSize=8, DcmDspDataType=UINT8, DcmDspDataInfoRef=Info_CAN_output_Read_RBTMxx_SP_ActvClient_ST35
          CAN_output_Read_RBTMxx_Actv_Lvl_ST35: DcmDspDataSize=8, DcmDspDataType=UINT8, DcmDspDataInfoRef=Info_CAN_output_Read_RBTMxx_Actv_Lvl_ST35
        Info_Obsolescence_Data_Read_Obsolescence_Data_haptic_Warning_Threshold_Yellow_to_Red (DcmDspDataInfo): DcmDspDataFixedLength=true
        Obsolescence_Data_Read_Obsolescence_Data_BSR_Current_Value (DcmDspData):
          DcmDspDataSize = 16
          DcmDspDataType = UINT16
          DcmDspDataUsePort = USE_DATA_ASYNCH_CLIENT_SERVER
          DcmDspDataInfoRef = Info_Obsolescence_Data_Read_Obsolescence_Data_BSR_Current_Value
        Routine_Trigger_Presafe_Display_Request_Start (DcmDspRoutine):
          DcmDspRequestResultsRoutineSupported = true
          DcmDspStopRoutineSupported = true
          DcmDspRoutineIdentifier = 770
          DcmDspRoutineFixedLength = false
          DcmDspRoutineUsePort = true
          DcmDspRoutineUsed = true
          DcmDspRoutineInfoRef = RoutineInfo_Trigger_Presafe_Display_Request_Start
        Info_Obsolescence_Data_Read_Obsolescence_Data_PRE_SAFE_Lvl_4_5_Current_Value (DcmDspDataInfo): DcmDspDataFixedLength=true
        DID_Trust_Model_Root_Replacement_Key_Read (DcmDspDid):
          DcmDspDidIdentifier = 408
          DcmDspDidUsed = true
          DcmDspDidUsePort = USE_DATA_ELEMENT_SPECIFIC_INTERFACES
          DcmDspDidInfoRef = DidInfo_Trust_Model_Root_Replacement_Key_Read
          Root_Replacement_Key (DcmDspDidSignal): DcmDspDidDataPos=0, DcmDspDidDataRef=Trust_Model_Root_Replacement_Key_Read_Root_Replacement_Key
        5 x DcmDspData, all with DcmDspDataUsePort=USE_DATA_ASYNCH_CLIENT_SERVER:
          Obsolescence_Data_Read_Obsolescence_Data_PRE_SAFE_Lvl_4_5_Threshold_Green_to_Yellow: DcmDspDataSize=16, DcmDspDataType=UINT16, DcmDspDataInfoRef=Info_Obsolescence_Data_Read_Obsolescence_Data_PRE_SAFE_Lvl_4_5_Threshold_Green_to_Yellow
          Availability_Data_Read_Availability_Data_PRE_SAFE_haptic_warning: DcmDspDataSize=8, DcmDspDataType=UINT8, DcmDspDataInfoRef=Info_Availability_Data_Read_Availability_Data_PRE_SAFE_haptic_warning
          Obsolescence_Data_Read_Obsolescence_Data_haptic_Warning_Threshold_Green_to_Yellow: DcmDspDataSize=16, DcmDspDataType=UINT16, DcmDspDataInfoRef=Info_Obsolescence_Data_Read_Obsolescence_Data_haptic_Warning_Threshold_Green_to_Yellow
          Obsolescence_Data_Read_Obsolescence_Data_PRE_CRASH_Current_Value: DcmDspDataSize=16, DcmDspDataType=UINT16, DcmDspDataInfoRef=Info_Obsolescence_Data_Read_Obsolescence_Data_PRE_CRASH_Current_Value
          Last_Warm_Reset_Parameters_Read_Reset_Cause_Counter: DcmDspDataSize=32, DcmDspDataType=UINT8_N, DcmDspDataInfoRef=Info_Last_Warm_Reset_Parameters_Read_Reset_Cause_Counter
        DidInfo_Measurement_Frames_Configuration_Read (DcmDspDidInfo)
          DcmDspDidAccess
            DcmDspDidWrite: DcmDspDidWriteSessionRef=Development, DcmDspDidWriteRoleRef=Supplier, DcmDspDidWriteRoleRef=Development_ENHANCED, DcmDspDidWriteRoleRef=Production
            DcmDspDidRead: DcmDspDidReadSessionRef=Development  # COVERS: PLAIN_TEXT ARCH_SW_DIA_0168
        Info_Last_Warm_Reset_Parameters_Read_Reset_Cause_Counter (DcmDspDataInfo): DcmDspDataFixedLength=true
        DidInfo_Last_Warm_Reset_Parameters_Read (DcmDspDidInfo)
          DcmDspDidAccess
            DcmDspDidRead: DcmDspDidReadSessionRef=Development  # COVERS: PLAIN_TEXT ARCH_SW_DIA_0157
        DID_Last_Warm_Reset_Parameters_Read (DcmDspDid):
          DcmDspDidIdentifier = 64777
          DcmDspDidUsed = true
          DcmDspDidUsePort = USE_DATA_ELEMENT_SPECIFIC_INTERFACES
          DcmDspDidInfoRef = DidInfo_Last_Warm_Reset_Parameters_Read
          Reset_Cause_Counter (DcmDspDidSignal): DcmDspDidDataPos=32, DcmDspDidDataRef=Last_Warm_Reset_Parameters_Read_Reset_Cause_Counter
          Last_Detected_Warm_Reset_Cause (DcmDspDidSignal): DcmDspDidDataPos=0, DcmDspDidDataRef=Last_Warm_Reset_Parameters_Read_Last_Detected_Warm_Reset_Cause
        DID_Measurement_Frames_Configuration_Read (DcmDspDid):
          DcmDspDidIdentifier = 65279
          DcmDspDidUsed = true
          DcmDspDidUsePort = USE_DATA_ELEMENT_SPECIFIC_INTERFACES
          DcmDspDidInfoRef = DidInfo_Measurement_Frames_Configuration_Read
          CombinedSignal (DcmDspDidSignal): DcmDspDidDataPos=0, DcmDspDidDataRef=Measurement_Frames_Configuration_Read_CombinedSignal
        Last_Warm_Reset_Parameters_Read_Last_Detected_Warm_Reset_Cause (DcmDspData):
          DcmDspDataSize = 32
          DcmDspDataType = UINT8_N
          DcmDspDataUsePort = USE_DATA_ASYNCH_CLIENT_SERVER
          DcmDspDataInfoRef = Info_Last_Warm_Reset_Parameters_Read_Last_Detected_Warm_Reset_Cause
        Info_Last_Warm_Reset_Parameters_Read_Last_Detected_Warm_Reset_Cause (DcmDspDataInfo): DcmDspDataFixedLength=true
        Info_Measurement_Frames_Configuration_Read_CombinedSignal (DcmDspDataInfo): DcmDspDataFixedLength=true
        DID_Measurement_Frame_Block_12_Config_Read (DcmDspDid):
          DcmDspDidIdentifier = 65023
          DcmDspDidUsed = true
          DcmDspDidUsePort = USE_DATA_ELEMENT_SPECIFIC_INTERFACES
          DcmDspDidInfoRef = DidInfo_Measurement_Frame_Block_12_Config_Read
          CombinedSignal (DcmDspDidSignal): DcmDspDidDataPos=0, DcmDspDidDataRef=Measurement_Frame_Block_12_Config_Read_CombinedSignal
        HB_Calibration_Read_CombinedSignal (DcmDspData):
          DcmDspDataSize = 320
          DcmDspDataType = UINT8_N
          DcmDspDataUsePort = USE_DATA_ASYNCH_CLIENT_SERVER
          DcmDspDataInfoRef = Info_HB_Calibration_Read_CombinedSignal
        Reset_Cause_Management_Read_Reset_Cause (DcmDspData):
          DcmDspDataSize = 8
          DcmDspDataType = UINT8
          DcmDspDataUsePort = USE_DATA_ASYNCH_CLIENT_SERVER
          DcmDspDataInfoRef = Info_Reset_Cause_Management_Read_Reset_Cause
        DID_HB_Calibration_Read (DcmDspDid): DcmDspDidIdentifier=64817, DcmDspDidUsed=true, DcmDspDidUsePort=USE_DATA_ELEMENT_SPECIFIC_INTERFACES, DcmDspDidInfoRef=DidInfo_HB_Calibration_Read
          CombinedSignal (DcmDspDidSignal): DcmDspDidDataPos=0, DcmDspDidDataRef=HB_Calibration_Read_CombinedSignal
        DID_AEC_Status_Read (DcmDspDid): DcmDspDidIdentifier=65024, DcmDspDidUsed=true, DcmDspDidUsePort=USE_DATA_ELEMENT_SPECIFIC_INTERFACES, DcmDspDidInfoRef=DidInfo_AEC_Status_Read
          AEC_Status (DcmDspDidSignal): DcmDspDidDataPos=0, DcmDspDidDataRef=AEC_Status_Read_AEC_Status
        Measurement_Frames_Configuration_Read_CombinedSignal (DcmDspData):
          DcmDspDataSize = 32
          DcmDspDataType = UINT8_N
          DcmDspDataUsePort = USE_DATA_ASYNCH_CLIENT_SERVER
          DcmDspDataInfoRef = Info_Measurement_Frames_Configuration_Read_CombinedSignal
        Info_HB_Calibration_Read_CombinedSignal (DcmDspDataInfo): DcmDspDataFixedLength=true
        DidInfo_Reset_Cause_Management_Read (DcmDspDidInfo)
          DcmDspDidAccess
            DcmDspDidRead: DcmDspDidReadSessionRef=Development  # COVERS: PLAIN_TEXT ARCH_SW_DIA_0154
        Info_AEC_Status_Read_AEC_Status (DcmDspDataInfo): DcmDspDataFixedLength=false
        DID_Reset_Cause_Management_Read (DcmDspDid):
          DcmDspDidIdentifier = 64776
          DcmDspDidUsed = true
          DcmDspDidUsePort = USE_DATA_ELEMENT_SPECIFIC_INTERFACES
          DcmDspDidInfoRef = DidInfo_Reset_Cause_Management_Read
          Reset_Cause (DcmDspDidSignal): DcmDspDidDataPos=0, DcmDspDidDataRef=Reset_Cause_Management_Read_Reset_Cause
        DidInfo_AEC_Status_Read (DcmDspDidInfo)
          DcmDspDidAccess
            DcmDspDidRead: DcmDspDidReadSessionRef=Development  # COVERS: PLAIN_TEXT ARCH_SW_DIA_0165
        Info_Reset_Cause_Management_Read_Reset_Cause (DcmDspDataInfo): DcmDspDataFixedLength=true
        AEC_Status_Read_AEC_Status (DcmDspData): DcmDspDataSize=1920, DcmDspDataType=UINT8_N, DcmDspDataUsePort=USE_DATA_ASYNCH_CLIENT_SERVER, DcmDspDataInfoRef=Info_AEC_Status_Read_AEC_Status
        Measurement_Frame_Block_12_Config_Read_CombinedSignal (DcmDspData):
          DcmDspDataSize = 40
          DcmDspDataType = UINT8_N
          DcmDspDataUsePort = USE_DATA_ASYNCH_CLIENT_SERVER
          DcmDspDataInfoRef = Info_Measurement_Frame_Block_12_Config_Read_CombinedSignal
        DidInfo_HB_Calibration_Read (DcmDspDidInfo)
          DcmDspDidAccess
            DcmDspDidWrite:
              DcmDspDidWriteSessionRef = Development
              DcmDspDidWriteRoleRef = Supplier
              DcmDspDidWriteRoleRef = Development_ENHANCED
              DcmDspDidWriteRoleRef = Production
              DcmDspDidWriteRoleRef = After_Sales_ENHANCED
              DcmDspDidWriteRoleRef = After_Sales_STANDARD
            DcmDspDidRead: DcmDspDidReadSessionRef=Development  # COVERS: PLAIN_TEXT ARCH_SW_DIA_0162
        Info_Measurement_Frame_Block_12_Config_Read_CombinedSignal (DcmDspDataInfo): DcmDspDataFixedLength=true
        DidInfo_Measurement_Frame_Block_12_Config_Read (DcmDspDidInfo)
          DcmDspDidAccess
            DcmDspDidWrite:  # COVERS: PLAIN_TEXT ARCH_SW_DIA_0174
              DcmDspDidWriteSessionRef = Development
              DcmDspDidWriteRoleRef = Supplier
              DcmDspDidWriteRoleRef = Development_ENHANCED
              DcmDspDidWriteRoleRef = Production
              DcmDspDidWriteRoleRef = After_Sales_ENHANCED
              DcmDspDidWriteRoleRef = After_Sales_STANDARD
            DcmDspDidRead: DcmDspDidReadSessionRef=Development  # COVERS: PLAIN_TEXT ARCH_SW_DIA_0171
        RoutineInfo_Cycle_Execution_Start (DcmDspRoutineInfo)
          DcmDspRoutineRequestResOut
            routineInfo (DcmDspRoutineRequestResOutSignal): DcmDspRoutineSignalLength=8, DcmDspRoutineSignalType=UINT8, DcmDspRoutineSignalPos=0
            Executed_Cycle (DcmDspRoutineRequestResOutSignal): DcmDspRoutineSignalLength=8, DcmDspRoutineSignalType=UINT8, DcmDspRoutineSignalPos=8
          DcmDspStartRoutineIn
            Cycle (DcmDspStartRoutineInSignal): DcmDspRoutineSignalLength=8, DcmDspRoutineSignalType=UINT8, DcmDspRoutineSignalPos=0
          DcmDspRoutineAuthorization:
            DcmDspRoutineSessionRef = Development
            DcmDspRoutineRoleRef = Supplier
            DcmDspRoutineRoleRef = Development_ENHANCED
            DcmDspRoutineRoleRef = Production
            DcmDspRoutineRoleRef = After_Sales_ENHANCED
            DcmDspRoutineRoleRef = After_Sales_STANDARD
          DcmDspRoutineStopOut
            routineInfo (DcmDspRoutineStopOutSignal): DcmDspRoutineSignalLength=8, DcmDspRoutineSignalType=UINT8, DcmDspRoutineSignalPos=0
          DcmDspStartRoutineOut
            routineInfo (DcmDspStartRoutineOutSignal): DcmDspRoutineSignalLength=8, DcmDspRoutineSignalType=UINT8, DcmDspRoutineSignalPos=0
        Routine_Cycle_Execution_Start (DcmDspRoutine):
          DcmDspRequestResultsRoutineSupported = true
          DcmDspStopRoutineSupported = true
          DcmDspRoutineIdentifier = 63235
          DcmDspRoutineFixedLength = false
          DcmDspRoutineUsePort = true
          DcmDspRoutineUsed = true
          DcmDspRoutineInfoRef = RoutineInfo_Cycle_Execution_Start
        DcmDspMemory: DcmDspUseMemoryId=false
          DcmDspMemoryIdInfo
            DcmDspReadMemoryRangeInfo: DcmDspReadMemoryRangeHigh=1879146240, DcmDspReadMemoryRangeLow=1879048192
            DcmDspWriteMemoryRangeInfo: DcmDspWriteMemoryRangeHigh=1879146240, DcmDspWriteMemoryRangeLow=1879048192
            DcmDspWriteMemoryRangeInfoEEPROMAlias (DcmDspWriteMemoryRangeInfo): DcmDspWriteMemoryRangeHigh=4278190080, DcmDspWriteMemoryRangeLow=3992977408
        DID_Task_Response_Time_Read (DcmDspDid):
          DcmDspDidIdentifier = 480
          DcmDspDidUsed = true
          DcmDspDidUsePort = USE_DATA_ELEMENT_SPECIFIC_INTERFACES
          DcmDspDidInfoRef = DidInfo_Task_Response_Time_Read
          Task_histograms (DcmDspDidSignal): DcmDspDidDataPos=0, DcmDspDidDataRef=Task_Response_Time_Read_Task_histograms
        DidInfo_Task_Response_Time_Read (DcmDspDidInfo)
          DcmDspDidAccess
            DcmDspDidRead:
              DcmDspDidReadRoleRef = Supplier
              DcmDspDidReadRoleRef = Development_ENHANCED
              DcmDspDidReadRoleRef = Production
              DcmDspDidReadRoleRef = Internal_Diagnostic_Test_Tool
        Stack_Load_Read_Maximum (DcmDspData): DcmDspDataSize=4080, DcmDspDataType=UINT8_N, DcmDspDataUsePort=USE_DATA_ASYNCH_CLIENT_SERVER, DcmDspDataInfoRef=Info_Stack_Load_Read_Maximum
        DID_Stack_Load_Read (DcmDspDid): DcmDspDidIdentifier=483, DcmDspDidUsed=true, DcmDspDidUsePort=USE_DATA_ELEMENT_SPECIFIC_INTERFACES, DcmDspDidInfoRef=DidInfo_Stack_Load_Read
          Maximum (DcmDspDidSignal): DcmDspDidDataPos=0, DcmDspDidDataRef=Stack_Load_Read_Maximum
        Routine_Clear_Resource_Consumption_Data_Start (DcmDspRoutine):
          DcmDspRequestResultsRoutineSupported = false
          DcmDspStopRoutineSupported = false
          DcmDspRoutineIdentifier = 529
          DcmDspRoutineFixedLength = false
          DcmDspRoutineUsePort = true
          DcmDspRoutineUsed = true
          DcmDspRoutineInfoRef = RoutineInfo_Clear_Resource_Consumption_Data_Start
        CPU_Load_Read_CPU_load_histograms (DcmDspData):
          DcmDspDataSize = 24480
          DcmDspDataType = UINT8_N
          DcmDspDataUsePort = USE_DATA_ASYNCH_CLIENT_SERVER
          DcmDspDataInfoRef = Info_CPU_Load_Read_CPU_load_histograms
        DidInfo_CPU_Load_Read (DcmDspDidInfo)
          DcmDspDidAccess
            DcmDspDidRead:
              DcmDspDidReadRoleRef = Supplier
              DcmDspDidReadRoleRef = Development_ENHANCED
              DcmDspDidReadRoleRef = Production
              DcmDspDidReadRoleRef = Internal_Diagnostic_Test_Tool
        RoutineInfo_Clear_Resource_Consumption_Data_Start (DcmDspRoutineInfo)
          DcmDspRoutineAuthorization:
            DcmDspRoutineSessionRef = DcmDspSession/Extended
            DcmDspRoutineSessionRef = Development
            DcmDspRoutineRoleRef = Supplier
            DcmDspRoutineRoleRef = Development_ENHANCED
          DcmDspStartRoutineOut
            routineInfo (DcmDspStartRoutineOutSignal): DcmDspRoutineSignalLength=8, DcmDspRoutineSignalType=UINT8, DcmDspRoutineSignalPos=0
        Task_Response_Time_Read_Task_histograms (DcmDspData):
          DcmDspDataSize = 32640
          DcmDspDataType = UINT8_N
          DcmDspDataUsePort = USE_DATA_ASYNCH_CLIENT_SERVER
          DcmDspDataInfoRef = Info_Task_Response_Time_Read_Task_histograms
        3 x DcmDspDataInfo, all with DcmDspDataFixedLength=false:
          Info_Stack_Load_Read_Maximum
          Info_CPU_Load_Read_CPU_load_histograms
          Info_Task_Response_Time_Read_Task_histograms
        DID_CPU_Load_Read (DcmDspDid): DcmDspDidIdentifier=481, DcmDspDidUsed=true, DcmDspDidUsePort=USE_DATA_ELEMENT_SPECIFIC_INTERFACES, DcmDspDidInfoRef=DidInfo_CPU_Load_Read
          CPU_load_histograms (DcmDspDidSignal): DcmDspDidDataPos=0, DcmDspDidDataRef=CPU_Load_Read_CPU_load_histograms
        DidInfo_Stack_Load_Read (DcmDspDidInfo)
          DcmDspDidAccess
            DcmDspDidRead:
              DcmDspDidReadRoleRef = Supplier
              DcmDspDidReadRoleRef = Development_ENHANCED
              DcmDspDidReadRoleRef = Production
              DcmDspDidReadRoleRef = Internal_Diagnostic_Test_Tool
        Info_Vehicle_Equipment_Read_Reserved (DcmDspDataInfo): DcmDspDataFixedLength=true
        Info_PreSafe_Cycles_Level_1_8_Read_CombinedSignal (DcmDspDataInfo): DcmDspDataFixedLength=true
        Vehicle_Equipment_Read_Reserved (DcmDspData): DcmDspDataUsePort=USE_NO_DATA, DcmDspDataSize=8, DcmDspDataType=UINT8, DcmDspDataInfoRef=Info_Vehicle_Equipment_Read_Reserved
        Info_Release_Cycles_BSR_and_PreSafe_Read_CombinedSignal (DcmDspDataInfo): DcmDspDataFixedLength=true
        3 x DcmDspData, all with DcmDspDataSize=8, DcmDspDataType=UINT8, DcmDspDataUsePort=USE_DATA_ASYNCH_CLIENT_SERVER:
          Vehicle_Equipment_Read_Equipment_5: DcmDspDataInfoRef=Info_Vehicle_Equipment_Read_Equipment_5
          Vehicle_Equipment_Read_Equipment_6: DcmDspDataInfoRef=Info_Vehicle_Equipment_Read_Equipment_6
          Vehicle_Equipment_Read_Equipment_4: DcmDspDataInfoRef=Info_Vehicle_Equipment_Read_Equipment_4
        Info_Tensioning_Cycle_BSR_Read_CombinedSignal (DcmDspDataInfo): DcmDspDataFixedLength=true
        Release_Cycles_BSR_and_PreSafe_Read_CombinedSignal (DcmDspData):
          DcmDspDataSize = 1152
          DcmDspDataType = UINT8_N
          DcmDspDataUsePort = USE_DATA_ASYNCH_CLIENT_SERVER
          DcmDspDataInfoRef = Info_Release_Cycles_BSR_and_PreSafe_Read_CombinedSignal
        3 x DcmDspDataInfo, all with DcmDspDataFixedLength=true:
          Info_Vehicle_Equipment_Read_Equipment_6
          Info_Vehicle_Equipment_Read_Equipment_4
          Info_Vehicle_Equipment_Read_Equipment_5
        Tensioning_Cycle_BSR_Read_CombinedSignal (DcmDspData):
          DcmDspDataSize = 1864
          DcmDspDataType = UINT8_N
          DcmDspDataUsePort = USE_DATA_ASYNCH_CLIENT_SERVER
          DcmDspDataInfoRef = Info_Tensioning_Cycle_BSR_Read_CombinedSignal
        PreSafe_Cycles_Level_1_8_Read_CombinedSignal (DcmDspData):
          DcmDspDataSize = 8584
          DcmDspDataType = UINT8_N
          DcmDspDataUsePort = USE_DATA_ASYNCH_CLIENT_SERVER
          DcmDspDataInfoRef = Info_PreSafe_Cycles_Level_1_8_Read_CombinedSignal
        Info_Vehicle_Equipment_Read_Reserved_1 (DcmDspDataInfo): DcmDspDataFixedLength=true
        Vehicle_Equipment_Read_Reserved_1 (DcmDspData): DcmDspDataUsePort=USE_NO_DATA, DcmDspDataSize=8, DcmDspDataType=UINT8, DcmDspDataInfoRef=Info_Vehicle_Equipment_Read_Reserved_1
        DcmDspRoe: DcmDspRoeInitOnDSC=false, DcmDspRoeInterMessageTime=0.2, DcmDspRoeMaxNumberOfRetry=0, DcmDspRoeQueueEnabled=true, DcmDspRoeSchedulerRate=0.01
          DcmDspRoeEvent: DcmDspRoeEventId=0
            DcmDspRoeEventProperties
              DcmDspRoeOnDTCStatusChange
        DcmDspAuthentication: DcmDspAuthenticationRoleSize=2, DcmDspAuthenticationSetDeauthenticatedRoleApi=false, DcmDspAuthenticationDeauthenticatedRoleRef=Anybody
          9 x DcmDspAuthenticationRow:
            ePTI_Test_Tool: DcmDspAuthenticationRoleBitPosition=8
            Internal_Diagnostic_Test_Tool: DcmDspAuthenticationRoleBitPosition=7
            After_Sales_BASIC: DcmDspAuthenticationRoleBitPosition=6
            After_Sales_STANDARD: DcmDspAuthenticationRoleBitPosition=5
            After_Sales_ENHANCED: DcmDspAuthenticationRoleBitPosition=4
            Production: DcmDspAuthenticationRoleBitPosition=3
            Development_ENHANCED: DcmDspAuthenticationRoleBitPosition=2
            Supplier: DcmDspAuthenticationRoleBitPosition=1
            Anybody: DcmDspAuthenticationRoleBitPosition=0
        Info_Memory_Usage_Cycles_Read_Memory_Usage_Cycles (DcmDspDataInfo): DcmDspDataFixedLength=false
        Global_Time_Sync_Measured_Values_Read_GTSM (DcmDspData):
          DcmDspDataSize = 20904
          DcmDspDataType = UINT8_N
          DcmDspDataUsePort = USE_DATA_ASYNCH_CLIENT_SERVER
          DcmDspDataInfoRef = Info_Global_Time_Sync_Measured_Values_Read_GTSM
        DidInfo_Memory_Usage_Cycles_Read (DcmDspDidInfo)
          DcmDspDidAccess
            DcmDspDidRead:
              DcmDspDidReadRoleRef = Supplier
              DcmDspDidReadRoleRef = Development_ENHANCED
              DcmDspDidReadRoleRef = Production
              DcmDspDidReadRoleRef = Internal_Diagnostic_Test_Tool
        DID_Memory_Usage_Cycles_Read (DcmDspDid):
          DcmDspDidIdentifier = 484
          DcmDspDidUsed = true
          DcmDspDidUsePort = USE_DATA_ELEMENT_SPECIFIC_INTERFACES
          DcmDspDidInfoRef = DidInfo_Memory_Usage_Cycles_Read
          Memory_Usage_Cycles (DcmDspDidSignal): DcmDspDidDataPos=0, DcmDspDidDataRef=Memory_Usage_Cycles_Read_Memory_Usage_Cycles
        Info_Global_Time_Sync_Measured_Values_Read_GTSM (DcmDspDataInfo): DcmDspDataFixedLength=false
        Memory_Usage_Cycles_Read_Memory_Usage_Cycles (DcmDspData):
          DcmDspDataSize = 10200
          DcmDspDataType = UINT8_N
          DcmDspDataUsePort = USE_DATA_ASYNCH_CLIENT_SERVER
          DcmDspDataInfoRef = Info_Memory_Usage_Cycles_Read_Memory_Usage_Cycles
        HSM_Identification_Read_HSM_MB_Version_HW_patch_level (DcmDspData):
          DcmDspDataSize = 8
          DcmDspDataType = UINT8
          DcmDspDataUsePort = USE_DATA_ASYNCH_CLIENT_SERVER
          DcmDspDataInfoRef = Info_HSM_Identification_Read_HSM_MB_Version_HW_patch_level
        Info_CAN_input_Read_Neues_Bitfeld_8 (DcmDspDataInfo): DcmDspDataFixedLength=true
        Info_CAN_input_Read_Neues_Bitfeld_7 (DcmDspDataInfo): DcmDspDataFixedLength=true
        HSM_Identification_Read_HSM_MB_Supplier_Version_HW_week (DcmDspData):
          DcmDspDataSize = 8
          DcmDspDataType = UINT8
          DcmDspDataUsePort = USE_DATA_ASYNCH_CLIENT_SERVER
          DcmDspDataInfoRef = Info_HSM_Identification_Read_HSM_MB_Supplier_Version_HW_week
        Info_HSM_Identification_Read_HSM_MB_Supplier_Version_HW_patch_level (DcmDspDataInfo): DcmDspDataFixedLength=true
        HSM_Identification_Read_HSM_MB_Supplier_Version_HW_year (DcmDspData):
          DcmDspDataSize = 8
          DcmDspDataType = UINT8
          DcmDspDataUsePort = USE_DATA_ASYNCH_CLIENT_SERVER
          DcmDspDataInfoRef = Info_HSM_Identification_Read_HSM_MB_Supplier_Version_HW_year
        Info_HSM_Identification_Read_HSM_MB_Supplier_Version_HW_week (DcmDspDataInfo): DcmDspDataFixedLength=true
        Info_HSM_Identification_Read_HSM_MB_Partnumber (DcmDspDataInfo): DcmDspDataFixedLength=true
        HSM_Identification_Read_HSM_MB_Version_HW_year (DcmDspData):
          DcmDspDataSize = 8
          DcmDspDataType = UINT8
          DcmDspDataUsePort = USE_DATA_ASYNCH_CLIENT_SERVER
          DcmDspDataInfoRef = Info_HSM_Identification_Read_HSM_MB_Version_HW_year
        DID_HSM_Identification_Read (DcmDspDid):
          DcmDspDidIdentifier = 64772
          DcmDspDidUsed = true
          DcmDspDidUsePort = USE_DATA_ELEMENT_SPECIFIC_INTERFACES
          DcmDspDidInfoRef = DidInfo_HSM_Identification_Read
          7 x DcmDspDidSignal:
            HSM_MB_Version_HW_patch_level: DcmDspDidDataPos=80, DcmDspDidDataRef=HSM_Identification_Read_HSM_MB_Version_HW_patch_level
            HSM_MB_Supplier_Version_HW_week: DcmDspDidDataPos=112, DcmDspDidDataRef=HSM_Identification_Read_HSM_MB_Supplier_Version_HW_week
            HSM_MB_Supplier_Version_HW_patch_level: DcmDspDidDataPos=104, DcmDspDidDataRef=HSM_Identification_Read_HSM_MB_Supplier_Version_HW_patch_level
            HSM_MB_Version_HW_year: DcmDspDidDataPos=96, DcmDspDidDataRef=HSM_Identification_Read_HSM_MB_Version_HW_year
            HSM_MB_Partnumber: DcmDspDidDataPos=0, DcmDspDidDataRef=HSM_Identification_Read_HSM_MB_Partnumber
            HSM_MB_Supplier_Version_HW_year: DcmDspDidDataPos=120, DcmDspDidDataRef=HSM_Identification_Read_HSM_MB_Supplier_Version_HW_year
            HSM_MB_Version_HW_week: DcmDspDidDataPos=88, DcmDspDidDataRef=HSM_Identification_Read_HSM_MB_Version_HW_week
        HSM_Identification_Read_HSM_MB_Version_HW_week (DcmDspData):
          DcmDspDataSize = 8
          DcmDspDataType = UINT8
          DcmDspDataUsePort = USE_DATA_ASYNCH_CLIENT_SERVER
          DcmDspDataInfoRef = Info_HSM_Identification_Read_HSM_MB_Version_HW_week
        DID_SW_Version_Read (DcmDspDid): DcmDspDidIdentifier=64769, DcmDspDidUsed=true, DcmDspDidUsePort=USE_DATA_ELEMENT_SPECIFIC_INTERFACES, DcmDspDidInfoRef=DidInfo_SW_Version_Read
          SW_Version (DcmDspDidSignal): DcmDspDidDataPos=0, DcmDspDidDataRef=SW_Version_Read_SW_Version
        HSM_Identification_Read_HSM_MB_Supplier_Version_HW_patch_level (DcmDspData):
          DcmDspDataSize = 8
          DcmDspDataType = UINT8
          DcmDspDataUsePort = USE_DATA_ASYNCH_CLIENT_SERVER
          DcmDspDataInfoRef = Info_HSM_Identification_Read_HSM_MB_Supplier_Version_HW_patch_level
        DidInfo_SW_Version_Read (DcmDspDidInfo)
          DcmDspDidAccess
            DcmDspDidRead: DcmDspDidReadSessionRef=Development
        CAN_input_Read_Neues_Bitfeld_7 (DcmDspData): DcmDspDataSize=8, DcmDspDataType=UINT8, DcmDspDataUsePort=USE_DATA_ASYNCH_CLIENT_SERVER, DcmDspDataInfoRef=Info_CAN_input_Read_Neues_Bitfeld_7
        CAN_input_Read_Neues_Bitfeld_8 (DcmDspData): DcmDspDataSize=8, DcmDspDataType=UINT8, DcmDspDataUsePort=USE_DATA_ASYNCH_CLIENT_SERVER, DcmDspDataInfoRef=Info_CAN_input_Read_Neues_Bitfeld_8
        Info_HSM_Identification_Read_HSM_MB_Supplier_Version_HW_year (DcmDspDataInfo): DcmDspDataFixedLength=true
        SW_Version_Read_SW_Version (DcmDspData): DcmDspDataSize=96, DcmDspDataType=UINT8_N, DcmDspDataUsePort=USE_DATA_ASYNCH_CLIENT_SERVER, DcmDspDataInfoRef=Info_SW_Version_Read_SW_Version
        3 x DcmDspDataInfo, all with DcmDspDataFixedLength=true:
          Info_SW_Version_Read_SW_Version
          Info_HSM_Identification_Read_HSM_MB_Version_HW_year
          Info_HSM_Identification_Read_HSM_MB_Version_HW_week
        DidInfo_HSM_Identification_Read (DcmDspDidInfo)
          DcmDspDidAccess
            DcmDspDidWrite:
              DcmDspDidWriteSessionRef = DcmDspSession/Programming
              DcmDspDidWriteSessionRef = DcmDspSession/Extended
              DcmDspDidWriteSessionRef = Development
              DcmDspDidWriteRoleRef = Supplier
              DcmDspDidWriteRoleRef = Development_ENHANCED
              DcmDspDidWriteRoleRef = Production
              DcmDspDidWriteRoleRef = After_Sales_ENHANCED
              DcmDspDidWriteRoleRef = After_Sales_STANDARD
            DcmDspDidRead:
              DcmDspDidReadRoleRef = Supplier
              DcmDspDidReadRoleRef = Development_ENHANCED
              DcmDspDidReadRoleRef = Production
              DcmDspDidReadRoleRef = After_Sales_ENHANCED
              DcmDspDidReadRoleRef = After_Sales_STANDARD
              DcmDspDidReadRoleRef = After_Sales_BASIC
              DcmDspDidReadRoleRef = Internal_Diagnostic_Test_Tool
              DcmDspDidReadRoleRef = ePTI_Test_Tool
        Info_HSM_Identification_Read_HSM_MB_Version_HW_patch_level (DcmDspDataInfo): DcmDspDataFixedLength=true
        HSM_Identification_Read_HSM_MB_Partnumber (DcmDspData):
          DcmDspDataSize = 80
          DcmDspDataType = UINT8_N
          DcmDspDataUsePort = USE_DATA_ASYNCH_CLIENT_SERVER
          DcmDspDataInfoRef = Info_HSM_Identification_Read_HSM_MB_Partnumber
        Info_Hardware_Version_Information_Write_HW_year (DcmDspDataInfo): DcmDspDataFixedLength=true
        3 x DcmDspData, all with DcmDspDataSize=8, DcmDspDataType=UINT8, DcmDspDataUsePort=USE_DATA_ASYNCH_CLIENT_SERVER:
          Hardware_Version_Information_Write_HW_week: DcmDspDataInfoRef=Info_Hardware_Version_Information_Write_HW_week
          Hardware_Version_Information_Write_HW_year: DcmDspDataInfoRef=Info_Hardware_Version_Information_Write_HW_year
          Hardware_Version_Information_Write_HW_patch_level: DcmDspDataInfoRef=Info_Hardware_Version_Information_Write_HW_patch_level
        Info_Hardware_Version_Information_Write_HW_patch_level (DcmDspDataInfo): DcmDspDataFixedLength=true
        DidInfo_Hardware_Version_Information_Write (DcmDspDidInfo)
          DcmDspDidAccess
            DcmDspDidWrite:
              DcmDspDidWriteSessionRef = Development
              DcmDspDidWriteRoleRef = Supplier
              DcmDspDidWriteRoleRef = Development_ENHANCED
              DcmDspDidWriteRoleRef = Production
              DcmDspDidWriteRoleRef = After_Sales_ENHANCED
              DcmDspDidWriteRoleRef = After_Sales_STANDARD
        Info_Hardware_Version_Information_Write_HW_week (DcmDspDataInfo): DcmDspDataFixedLength=true
        DID_Hardware_Version_Information_Write (DcmDspDid):
          DcmDspDidIdentifier = 64848
          DcmDspDidUsed = true
          DcmDspDidUsePort = USE_DATA_ELEMENT_SPECIFIC_INTERFACES
          DcmDspDidInfoRef = DidInfo_Hardware_Version_Information_Write
          3 x DcmDspDidSignal:
            HW_year: DcmDspDidDataPos=0, DcmDspDidDataRef=Hardware_Version_Information_Write_HW_year
            HW_week: DcmDspDidDataPos=8, DcmDspDidDataRef=Hardware_Version_Information_Write_HW_week
            HW_patch_level: DcmDspDidDataPos=16, DcmDspDidDataRef=Hardware_Version_Information_Write_HW_patch_level
        ECU_serial_number_Read_ECU_traceability_number (DcmDspData):
          DcmDspDataSize = 96
          DcmDspDataType = UINT8_N
          DcmDspDataUsePort = USE_DATA_ASYNCH_CLIENT_SERVER
          DcmDspDataInfoRef = Info_ECU_serial_number_Read_ECU_traceability_number
        DID_Calibration_Identifications_CAL_ID_Write (DcmDspDid):
          DcmDspDidIdentifier = 63492
          DcmDspDidUsed = true
          DcmDspDidUsePort = USE_DATA_ELEMENT_SPECIFIC_INTERFACES
          DcmDspDidInfoRef = DidInfo_Calibration_Identifications_CAL_ID_Write
          Calibration_Identification (DcmDspDidSignal): DcmDspDidDataPos=8, DcmDspDidDataRef=Calibration_Identifications_CAL_ID_Write_Calibration_Identification
          Number_of_data_items (DcmDspDidSignal): DcmDspDidDataPos=0, DcmDspDidDataRef=Calibration_Identifications_CAL_ID_Write_Number_of_data_items
        DidInfo_ECU_serial_number_Read (DcmDspDidInfo)
          DcmDspDidAccess
            DcmDspDidWrite: DcmDspDidWriteSessionRef=Development, DcmDspDidWriteRoleRef=Supplier, DcmDspDidWriteRoleRef=Development_ENHANCED, DcmDspDidWriteRoleRef=Production
            DcmDspDidRead
        Info_ECU_serial_number_Read_PCBA_Programmed_Part_number (DcmDspDataInfo): DcmDspDataFixedLength=true
        Info_Standard_Application_SW_Package_Information_Read_C_P_Identification (DcmDspDataInfo): DcmDspDataFixedLength=true
        Standard_Application_SW_Package_Information_Read_C_P_Identification (DcmDspData):
          DcmDspDataSize = 160
          DcmDspDataType = UINT8_N
          DcmDspDataUsePort = USE_DATA_ASYNCH_CLIENT_SERVER
          DcmDspDataInfoRef = Info_Standard_Application_SW_Package_Information_Read_C_P_Identification
        Info_Calibration_Identifications_CAL_ID_Read_Calibration_Identification (DcmDspDataInfo): DcmDspDataFixedLength=false
        Calibration_Identifications_CAL_ID_Read_Calibration_Identification (DcmDspData):
          DcmDspDataSize = 2560
          DcmDspDataType = UINT8_N
          DcmDspDataUsePort = USE_DATA_ASYNCH_CLIENT_SERVER
          DcmDspDataInfoRef = Info_Calibration_Identifications_CAL_ID_Read_Calibration_Identification
        Info_ECU_serial_number_Read_ECU_traceability_number (DcmDspDataInfo): DcmDspDataFixedLength=true
        Calibration_Identifications_CAL_ID_Write_Number_of_data_items (DcmDspData):
          DcmDspDataSize = 8
          DcmDspDataType = UINT8
          DcmDspDataUsePort = USE_DATA_ASYNCH_CLIENT_SERVER
          DcmDspDataInfoRef = Info_Calibration_Identifications_CAL_ID_Write_Number_of_data_items
        Calibration_Identifications_CAL_ID_Write_Calibration_Identification (DcmDspData):
          DcmDspDataSize = 2560
          DcmDspDataType = UINT8_N
          DcmDspDataUsePort = USE_DATA_ASYNCH_CLIENT_SERVER
          DcmDspDataInfoRef = Info_Calibration_Identifications_CAL_ID_Write_Calibration_Identification
        Info_Calibration_Identifications_CAL_ID_Write_Calibration_Identification (DcmDspDataInfo): DcmDspDataFixedLength=false
        ECU_serial_number_Read_PCBA_Programmed_Part_number (DcmDspData):
          DcmDspDataSize = 80
          DcmDspDataType = UINT8_N
          DcmDspDataUsePort = USE_DATA_ASYNCH_CLIENT_SERVER
          DcmDspDataInfoRef = Info_ECU_serial_number_Read_PCBA_Programmed_Part_number
        DidInfo_Calibration_Identifications_CAL_ID_Write (DcmDspDidInfo)
          DcmDspDidAccess
            DcmDspDidWrite:
              DcmDspDidWriteSessionRef = DcmDspSession/Programming
              DcmDspDidWriteSessionRef = DcmDspSession/Extended
              DcmDspDidWriteSessionRef = Development
              DcmDspDidWriteRoleRef = Supplier
              DcmDspDidWriteRoleRef = Development_ENHANCED
              DcmDspDidWriteRoleRef = Production
              DcmDspDidWriteRoleRef = After_Sales_ENHANCED
              DcmDspDidWriteRoleRef = After_Sales_STANDARD
        DID_ECU_serial_number_Read (DcmDspDid):
          DcmDspDidIdentifier = 64771
          DcmDspDidUsed = true
          DcmDspDidUsePort = USE_DATA_ELEMENT_SPECIFIC_INTERFACES
          DcmDspDidInfoRef = DidInfo_ECU_serial_number_Read
          PCBA_Programmed_Part_number (DcmDspDidSignal): DcmDspDidDataPos=96, DcmDspDidDataRef=ECU_serial_number_Read_PCBA_Programmed_Part_number
          ECU_traceability_number (DcmDspDidSignal): DcmDspDidDataPos=0, DcmDspDidDataRef=ECU_serial_number_Read_ECU_traceability_number
        Info_Calibration_Identifications_CAL_ID_Write_Number_of_data_items (DcmDspDataInfo): DcmDspDataFixedLength=true
        Routine_Force_External_WDG_Start (DcmDspRoutine):
          DcmDspRequestResultsRoutineSupported = false
          DcmDspStopRoutineSupported = false
          DcmDspRoutineIdentifier = 63377
          DcmDspRoutineFixedLength = false
          DcmDspRoutineUsePort = true
          DcmDspRoutineUsed = true
          DcmDspRoutineInfoRef = RoutineInfo_Force_External_WDG_Start
        Info_Customer_Settings_Read_PS_Curve_Stat (DcmDspDataInfo): DcmDspDataFixedLength=true
        Info_Velocity_PI_Regulation_Coefficient_Read_Input_Velocity_Coefficient (DcmDspDataInfo): DcmDspDataFixedLength=true
        RoutineInfo_Force_External_WDG_Start (DcmDspRoutineInfo)
          DcmDspRoutineAuthorization:
            DcmDspRoutineSessionRef = Development
            DcmDspRoutineRoleRef = Supplier
            DcmDspRoutineRoleRef = Development_ENHANCED
            DcmDspRoutineRoleRef = Production
            DcmDspRoutineRoleRef = After_Sales_ENHANCED
            DcmDspRoutineRoleRef = After_Sales_STANDARD
          DcmDspStartRoutineOut
            routineInfo (DcmDspStartRoutineOutSignal): DcmDspRoutineSignalLength=8, DcmDspRoutineSignalType=UINT8, DcmDspRoutineSignalPos=0
            Status (DcmDspStartRoutineOutSignal): DcmDspRoutineSignalLength=8, DcmDspRoutineSignalType=UINT8, DcmDspRoutineSignalPos=8
        Customer_Settings_Read_PS_Curve_Stat (DcmDspData):
          DcmDspDataSize = 8
          DcmDspDataType = UINT8
          DcmDspDataUsePort = USE_DATA_ASYNCH_CLIENT_SERVER
          DcmDspDataInfoRef = Info_Customer_Settings_Read_PS_Curve_Stat
        Info_Trust_Model_CSR_Supplier_Signature_Read_Trust_Model_CSR_Supplier_Signature (DcmDspDataInfo): DcmDspDataFixedLength=false
        RoutineInfo_Erase_All_Start (DcmDspRoutineInfo)
          DcmDspRoutineAuthorization:
            DcmDspRoutineSessionRef = Development
            DcmDspRoutineRoleRef = Supplier
            DcmDspRoutineRoleRef = Development_ENHANCED
            DcmDspRoutineRoleRef = Production
            DcmDspRoutineRoleRef = After_Sales_ENHANCED
            DcmDspRoutineRoleRef = After_Sales_STANDARD
          DcmDspStartRoutineOut
            routineInfo (DcmDspStartRoutineOutSignal): DcmDspRoutineSignalLength=8, DcmDspRoutineSignalType=UINT8, DcmDspRoutineSignalPos=0
            Status (DcmDspStartRoutineOutSignal): DcmDspRoutineSignalLength=8, DcmDspRoutineSignalType=UINT8, DcmDspRoutineSignalPos=8
        Routine_Erase_All_Start (DcmDspRoutine):
          DcmDspRequestResultsRoutineSupported = false
          DcmDspStopRoutineSupported = false
          DcmDspRoutineIdentifier = 63362
          DcmDspRoutineFixedLength = false
          DcmDspRoutineUsePort = true
          DcmDspRoutineUsed = true
          DcmDspRoutineInfoRef = RoutineInfo_Erase_All_Start
        DID_Trust_Model_CSR_Supplier_Signature_Read (DcmDspDid):
          DcmDspDidIdentifier = 418
          DcmDspDidUsed = true
          DcmDspDidUsePort = USE_DATA_ELEMENT_SPECIFIC_INTERFACES
          DcmDspDidInfoRef = DidInfo_Trust_Model_CSR_Supplier_Signature_Read
          Trust_Model_CSR_Supplier_Signature (DcmDspDidSignal): DcmDspDidDataPos=0, DcmDspDidDataRef=Trust_Model_CSR_Supplier_Signature_Read_Trust_Model_CSR_Supplier_Signature
        Velocity_PI_Regulation_Coefficient_Read_Input_Velocity_Coefficient (DcmDspData):
          DcmDspDataSize = 240
          DcmDspDataType = UINT8_N
          DcmDspDataUsePort = USE_DATA_ASYNCH_CLIENT_SERVER
          DcmDspDataInfoRef = Info_Velocity_PI_Regulation_Coefficient_Read_Input_Velocity_Coefficient
        DID_Velocity_PI_Regulation_Coefficient_Read (DcmDspDid):
          DcmDspDidIdentifier = 64991
          DcmDspDidUsed = true
          DcmDspDidUsePort = USE_DATA_ELEMENT_SPECIFIC_INTERFACES
          DcmDspDidInfoRef = DidInfo_Velocity_PI_Regulation_Coefficient_Read
          Input_Velocity_Coefficient (DcmDspDidSignal): DcmDspDidDataPos=0, DcmDspDidDataRef=Velocity_PI_Regulation_Coefficient_Read_Input_Velocity_Coefficient
        Customer_Settings_Read_BltSlckDec_Md_Stat (DcmDspData):
          DcmDspDataSize = 8
          DcmDspDataType = UINT8
          DcmDspDataUsePort = USE_DATA_ASYNCH_CLIENT_SERVER
          DcmDspDataInfoRef = Info_Customer_Settings_Read_BltSlckDec_Md_Stat
        DID_Temperature_Sensor_Calibration_Point_Read (DcmDspDid):
          DcmDspDidIdentifier = 64816
          DcmDspDidUsed = true
          DcmDspDidUsePort = USE_DATA_ELEMENT_SPECIFIC_INTERFACES
          DcmDspDidInfoRef = DidInfo_Temperature_Sensor_Calibration_Point_Read
          Offset_Point (DcmDspDidSignal): DcmDspDidDataPos=0, DcmDspDidDataRef=Temperature_Sensor_Calibration_Point_Read_Offset_Point
        Trust_Model_CSR_Supplier_Signature_Read_Trust_Model_CSR_Supplier_Signature (DcmDspData):
          DcmDspDataSize = 2064
          DcmDspDataType = UINT8_N
          DcmDspDataUsePort = USE_DATA_ASYNCH_CLIENT_SERVER
          DcmDspDataInfoRef = Info_Trust_Model_CSR_Supplier_Signature_Read_Trust_Model_CSR_Supplier_Signature
        3 x DcmDspDidInfo:
          DidInfo_Trust_Model_CSR_Supplier_Signature_Read
            DcmDspDidAccess
              DcmDspDidWrite:
                DcmDspDidWriteSessionRef = DcmDspSession/Default
                DcmDspDidWriteSessionRef = DcmDspSession/Extended
                DcmDspDidWriteSessionRef = Development
                DcmDspDidWriteRoleRef = Supplier
              DcmDspDidRead:
                DcmDspDidReadSessionRef = DcmDspSession/Default
                DcmDspDidReadSessionRef = DcmDspSession/Extended
                DcmDspDidReadSessionRef = Development
                DcmDspDidReadRoleRef = Supplier
                DcmDspDidReadRoleRef = Development_ENHANCED
                DcmDspDidReadRoleRef = Production
                DcmDspDidReadRoleRef = After_Sales_ENHANCED
          DidInfo_Velocity_PI_Regulation_Coefficient_Read
            DcmDspDidAccess
              DcmDspDidWrite:
                DcmDspDidWriteSessionRef = Development
                DcmDspDidWriteRoleRef = Supplier
                DcmDspDidWriteRoleRef = Development_ENHANCED
                DcmDspDidWriteRoleRef = Production
                DcmDspDidWriteRoleRef = After_Sales_ENHANCED
                DcmDspDidWriteRoleRef = After_Sales_STANDARD
              DcmDspDidRead:
                DcmDspDidReadSessionRef = DcmDspSession/Default
                DcmDspDidReadSessionRef = DcmDspSession/Extended
                DcmDspDidReadSessionRef = Development
                DcmDspDidReadRoleRef = Supplier
                DcmDspDidReadRoleRef = Development_ENHANCED
                DcmDspDidReadRoleRef = Production
                DcmDspDidReadRoleRef = After_Sales_ENHANCED
                DcmDspDidReadRoleRef = After_Sales_STANDARD
                DcmDspDidReadRoleRef = After_Sales_BASIC
                DcmDspDidReadRoleRef = Internal_Diagnostic_Test_Tool
                DcmDspDidReadRoleRef = ePTI_Test_Tool
          DidInfo_Temperature_Sensor_Calibration_Point_Read
            DcmDspDidAccess
              DcmDspDidWrite:
                DcmDspDidWriteSessionRef = Development
                DcmDspDidWriteRoleRef = Supplier
                DcmDspDidWriteRoleRef = Development_ENHANCED
                DcmDspDidWriteRoleRef = Production
                DcmDspDidWriteRoleRef = After_Sales_ENHANCED
                DcmDspDidWriteRoleRef = After_Sales_STANDARD
              DcmDspDidRead:
                DcmDspDidReadSessionRef = DcmDspSession/Default
                DcmDspDidReadSessionRef = DcmDspSession/Extended
                DcmDspDidReadSessionRef = Development
                DcmDspDidReadRoleRef = Supplier
                DcmDspDidReadRoleRef = Development_ENHANCED
                DcmDspDidReadRoleRef = Production
                DcmDspDidReadRoleRef = After_Sales_ENHANCED
                DcmDspDidReadRoleRef = After_Sales_STANDARD
                DcmDspDidReadRoleRef = After_Sales_BASIC
                DcmDspDidReadRoleRef = Internal_Diagnostic_Test_Tool
                DcmDspDidReadRoleRef = ePTI_Test_Tool
        Info_Temperature_Sensor_Calibration_Point_Read_Offset_Point (DcmDspDataInfo): DcmDspDataFixedLength=true
        Temperature_Sensor_Calibration_Point_Read_Offset_Point (DcmDspData):
          DcmDspDataSize = 8
          DcmDspDataType = SINT8
          DcmDspDataUsePort = USE_DATA_ASYNCH_CLIENT_SERVER
          DcmDspDataInfoRef = Info_Temperature_Sensor_Calibration_Point_Read_Offset_Point
        Info_Customer_Settings_Read_BltSlckDec_Md_Stat (DcmDspDataInfo): DcmDspDataFixedLength=true
      DcmPageBufferCfg: DcmPagedBufferEnabled=true
