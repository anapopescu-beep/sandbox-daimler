[part 1 of 2: package /ActiveEcuC]
AUTOSAR XML (schema 00049)
package /ActiveEcuC
  module config Dcm: implementation-config-variant=VARIANT-POST-BUILD-SELECTABLE, module-description=Dcm_Impl
    DcmConfigSet
      DcmDsl
        3 x DcmDslServiceRequestManufacturerNotification, all with DcmDslServiceRequestManufacturerNotificationUsePort=true:
          DcmDslServiceRequestManufacturerNotification_ResetPreconditionCheck
          DcmDslServiceRequestManufacturerNotification_RightsM
          DcmDslServiceRequestManufacturerNotification_Coding
        DcmDslProtocol
          DcmDslProtocolRow_29812fbf (DcmDslProtocolRow):
            DcmDslProtocolEndiannessConvEnabled = false
            DcmDslProtocolID = DCM_UDS_ON_CAN
            DcmDslProtocolPreemptTimeout = 0
            DcmDslProtocolPriority = 0
            DcmSendRespPendOnTransToBoot = true
            DcmTimStrP2ServerAdjust = 0
            DcmTimStrP2StarServerAdjust = 0
            DcmSendRespPendOnRestart = true
            DcmDslProtocolMaximumResponseSize = 4095
            DcmDslProtocolRxBufferID = DcmDslBuffer
            DcmDslProtocolSIDTable = DcmDsdServiceTable
            DcmDslProtocolTxBufferID = DcmDslBuffer
            DcmDemClientRef = DemClient
            6 x DcmDslConnection:
              DIAG_RBTM_FL_03_ExtCAN_RQ_BODY3_ST3_DIAG_RBTM_FL_03_ExtCAN_RS_BODY3_ST3_2f852a42: variation-point=post-build-variant-condition{matching-criterion=SideAllocation, value=0}
                DIAG_RBTM_FL_03_ExtCAN_RQ_BODY3_ST3_DIAG_RBTM_FL_03_ExtCAN_RS_BODY3_ST3_2f852a42 (DcmDslMainConnection): DcmDslProtocolRxTesterSourceAddr=3833, DcmDslProtocolRxConnectionId=0
                  SDU_DIAG_GLOBAL_ExtCAN_RQ_BODY3_ST3_18e7f235_Rx_2b322367 (DcmDslProtocolRx):
                    DcmDslProtocolRxAddrType = DCM_FUNCTIONAL_TYPE
                    DcmDslProtocolRxPduId = 0
                    DcmDslProtocolRxChannelId = 0
                    DcmDslProtocolRxComMChannelRef = RBTM_FL_BODY3_8uqv9blm85ehm0msat385m76v_03d5f5f6
                    DcmDslProtocolRxPduRef = SDU_DIAG_GLOBAL_ExtCAN_RQ_BODY3_ST3_18e7f235_Rx
                  SDU_DIAG_RBTM_FL_03_ExtCAN_RQ_BODY3_ST3_ec0e6e12_Rx_2873db84 (DcmDslProtocolRx):
                    DcmDslProtocolRxAddrType = DCM_PHYSICAL_TYPE
                    DcmDslProtocolRxPduId = 1
                    DcmDslProtocolRxChannelId = 0
                    DcmDslProtocolRxComMChannelRef = RBTM_FL_BODY3_8uqv9blm85ehm0msat385m76v_03d5f5f6
                    DcmDslProtocolRxPduRef = SDU_DIAG_RBTM_FL_03_ExtCAN_RQ_BODY3_ST3_ec0e6e12_Rx
                  SDU_DIAG_RBTM_FL_03_ExtCAN_RS_BODY3_ST3_b462d7d3_Tx_70f6d2b0 (DcmDslProtocolTx): DcmDslTxConfirmationPduId=0, DcmDslProtocolTxPduRef=SDU_DIAG_RBTM_FL_03_ExtCAN_RS_BODY3_ST3_b462d7d3_Tx
              DIAG_RBTM_FL_03_ExtEth_RQ_BODY3_ST3_DIAG_RBTM_FL_03_ExtEth_RS_BODY3_ST3_816f6eb3: variation-point=post-build-variant-condition{matching-criterion=SideAllocation, value=0}
                DIAG_RBTM_FL_03_ExtEth_RQ_BODY3_ST3_DIAG_RBTM_FL_03_ExtEth_RS_BODY3_ST3_816f6eb3 (DcmDslMainConnection): DcmDslProtocolRxTesterSourceAddr=3832, DcmDslProtocolRxConnectionId=1
                  SDU_DIAG_GLOBAL_ExtEth_RQ_BODY3_ST3_81f0b7e5_Rx_d414628a (DcmDslProtocolRx):
                    DcmDslProtocolRxAddrType = DCM_FUNCTIONAL_TYPE
                    DcmDslProtocolRxPduId = 2
                    DcmDslProtocolRxChannelId = 0
                    DcmDslProtocolRxComMChannelRef = RBTM_FL_BODY3_8uqv9blm85ehm0msat385m76v_03d5f5f6
                    DcmDslProtocolRxPduRef = SDU_DIAG_GLOBAL_ExtEth_RQ_BODY3_ST3_81f0b7e5_Rx
                  SDU_DIAG_RBTM_FL_03_ExtEth_RQ_BODY3_ST3_75192bc2_Rx_5a27dd11 (DcmDslProtocolRx):
                    DcmDslProtocolRxAddrType = DCM_PHYSICAL_TYPE
                    DcmDslProtocolRxPduId = 3
                    DcmDslProtocolRxChannelId = 0
                    DcmDslProtocolRxComMChannelRef = RBTM_FL_BODY3_8uqv9blm85ehm0msat385m76v_03d5f5f6
                    DcmDslProtocolRxPduRef = SDU_DIAG_RBTM_FL_03_ExtEth_RQ_BODY3_ST3_75192bc2_Rx
                  SDU_DIAG_RBTM_FL_03_ExtEth_RS_BODY3_ST3_2d759203_Tx_2b590afc (DcmDslProtocolTx): DcmDslTxConfirmationPduId=1, DcmDslProtocolTxPduRef=SDU_DIAG_RBTM_FL_03_ExtEth_RS_BODY3_ST3_2d759203_Tx
              DIAG_RBTM_FL_03_IntEth_RQ_BODY3_ST3_DIAG_RBTM_FL_03_IntEth_RS_BODY3_ST3_1d9ca21c: variation-point=post-build-variant-condition{matching-criterion=SideAllocation, value=0}
                DIAG_RBTM_FL_03_IntEth_RQ_BODY3_ST3_DIAG_RBTM_FL_03_IntEth_RS_BODY3_ST3_1d9ca21c (DcmDslMainConnection): DcmDslProtocolRxTesterSourceAddr=3853, DcmDslProtocolRxConnectionId=2
                  SDU_DIAG_GLOBAL_IntEth_RQ_BODY3_ST3_41e6471f_Rx_c0cc433b (DcmDslProtocolRx):
                    DcmDslProtocolRxAddrType = DCM_FUNCTIONAL_TYPE
                    DcmDslProtocolRxPduId = 4
                    DcmDslProtocolRxChannelId = 0
                    DcmDslProtocolRxComMChannelRef = RBTM_FL_BODY3_8uqv9blm85ehm0msat385m76v_03d5f5f6
                    DcmDslProtocolRxPduRef = SDU_DIAG_GLOBAL_IntEth_RQ_BODY3_ST3_41e6471f_Rx
                  SDU_DIAG_RBTM_FL_03_IntEth_RQ_BODY3_ST3_b50fdb38_Rx_6a163982 (DcmDslProtocolRx):
                    DcmDslProtocolRxAddrType = DCM_PHYSICAL_TYPE
                    DcmDslProtocolRxPduId = 5
                    DcmDslProtocolRxChannelId = 0
                    DcmDslProtocolRxComMChannelRef = RBTM_FL_BODY3_8uqv9blm85ehm0msat385m76v_03d5f5f6
                    DcmDslProtocolRxPduRef = SDU_DIAG_RBTM_FL_03_IntEth_RQ_BODY3_ST3_b50fdb38_Rx
                  SDU_DIAG_RBTM_FL_03_IntEth_RS_BODY3_ST3_ed6362f9_Tx_3060e687 (DcmDslProtocolTx): DcmDslTxConfirmationPduId=2, DcmDslProtocolTxPduRef=SDU_DIAG_RBTM_FL_03_IntEth_RS_BODY3_ST3_ed6362f9_Tx
              DIAG_RBTM_FR_03_ExtEth_RQ_BODY3_ST3_DIAG_RBTM_FR_03_ExtEth_RS_BODY3_ST3_b444e987: variation-point=post-build-variant-condition{matching-criterion=SideAllocation, value=1}
                DIAG_RBTM_FR_03_ExtEth_RQ_BODY3_ST3_DIAG_RBTM_FR_03_ExtEth_RS_BODY3_ST3_b444e987 (DcmDslMainConnection): DcmDslProtocolRxTesterSourceAddr=3832, DcmDslProtocolRxConnectionId=1
                  SDU_DIAG_RBTM_FR_03_ExtEth_RQ_BODY3_ST3_68423a11_Rx_510ebea9 (DcmDslProtocolRx):
                    DcmDslProtocolRxAddrType = DCM_PHYSICAL_TYPE
                    DcmDslProtocolRxPduId = 3
                    DcmDslProtocolRxChannelId = 0
                    DcmDslProtocolRxComMChannelRef = RBTM_FR_BODY3_4xwwtd59665s787n6ctawh7k8_23a94727
                    DcmDslProtocolRxPduRef = SDU_DIAG_RBTM_FR_03_ExtEth_RQ_BODY3_ST3_68423a11_Rx
                  SDU_DIAG_RBTM_FR_03_ExtEth_RS_BODY3_ST3_302e83d0_Tx_afb57ffd (DcmDslProtocolTx): DcmDslTxConfirmationPduId=1, DcmDslProtocolTxPduRef=SDU_DIAG_RBTM_FR_03_ExtEth_RS_BODY3_ST3_302e83d0_Tx
                  SDU_DIAG_GLOBAL_ExtEth_RQ_BODY3_ST3_81f0b7e5_Rx_d414628a (DcmDslProtocolRx):
                    DcmDslProtocolRxAddrType = DCM_FUNCTIONAL_TYPE
                    DcmDslProtocolRxPduId = 2
                    DcmDslProtocolRxChannelId = 0
                    DcmDslProtocolRxComMChannelRef = RBTM_FR_BODY3_4xwwtd59665s787n6ctawh7k8_23a94727
                    DcmDslProtocolRxPduRef = SDU_DIAG_GLOBAL_ExtEth_RQ_BODY3_ST3_81f0b7e5_Rx
              DIAG_RBTM_FR_03_IntEth_RQ_BODY3_ST3_DIAG_RBTM_FR_03_IntEth_RS_BODY3_ST3_28b72528: variation-point=post-build-variant-condition{matching-criterion=SideAllocation, value=1}
                DIAG_RBTM_FR_03_IntEth_RQ_BODY3_ST3_DIAG_RBTM_FR_03_IntEth_RS_BODY3_ST3_28b72528 (DcmDslMainConnection): DcmDslProtocolRxTesterSourceAddr=3853, DcmDslProtocolRxConnectionId=2
                  SDU_DIAG_GLOBAL_IntEth_RQ_BODY3_ST3_41e6471f_Rx_c0cc433b (DcmDslProtocolRx):
                    DcmDslProtocolRxAddrType = DCM_FUNCTIONAL_TYPE
                    DcmDslProtocolRxPduId = 4
                    DcmDslProtocolRxChannelId = 0
                    DcmDslProtocolRxComMChannelRef = RBTM_FR_BODY3_4xwwtd59665s787n6ctawh7k8_23a94727
                    DcmDslProtocolRxPduRef = SDU_DIAG_GLOBAL_IntEth_RQ_BODY3_ST3_41e6471f_Rx
                  SDU_DIAG_RBTM_FR_03_IntEth_RQ_BODY3_ST3_a854caeb_Rx_536fd8c4 (DcmDslProtocolRx):
                    DcmDslProtocolRxAddrType = DCM_PHYSICAL_TYPE
                    DcmDslProtocolRxPduId = 5
                    DcmDslProtocolRxChannelId = 0
                    DcmDslProtocolRxComMChannelRef = RBTM_FR_BODY3_4xwwtd59665s787n6ctawh7k8_23a94727
                    DcmDslProtocolRxPduRef = SDU_DIAG_RBTM_FR_03_IntEth_RQ_BODY3_ST3_a854caeb_Rx
                  SDU_DIAG_RBTM_FR_03_IntEth_RS_BODY3_ST3_f038732a_Tx_f8a04d74 (DcmDslProtocolTx): DcmDslTxConfirmationPduId=2, DcmDslProtocolTxPduRef=SDU_DIAG_RBTM_FR_03_IntEth_RS_BODY3_ST3_f038732a_Tx
              DIAG_RBTM_FR_03_ExtCAN_RQ_BODY3_ST3_DIAG_RBTM_FR_03_ExtCAN_RS_BODY3_ST3_1aaead76: variation-point=post-build-variant-condition{matching-criterion=SideAllocation, value=1}
                DIAG_RBTM_FR_03_ExtCAN_RQ_BODY3_ST3_DIAG_RBTM_FR_03_ExtCAN_RS_BODY3_ST3_1aaead76 (DcmDslMainConnection): DcmDslProtocolRxTesterSourceAddr=3833, DcmDslProtocolRxConnectionId=0
                  SDU_DIAG_GLOBAL_ExtCAN_RQ_BODY3_ST3_18e7f235_Rx_2b322367 (DcmDslProtocolRx):
                    DcmDslProtocolRxAddrType = DCM_FUNCTIONAL_TYPE
                    DcmDslProtocolRxPduId = 0
                    DcmDslProtocolRxChannelId = 0
                    DcmDslProtocolRxComMChannelRef = RBTM_FR_BODY3_4xwwtd59665s787n6ctawh7k8_23a94727
                    DcmDslProtocolRxPduRef = SDU_DIAG_GLOBAL_ExtCAN_RQ_BODY3_ST3_18e7f235_Rx
                  SDU_DIAG_RBTM_FR_03_ExtCAN_RQ_BODY3_ST3_f1557fc1_Rx_3b6533a8 (DcmDslProtocolRx):
                    DcmDslProtocolRxAddrType = DCM_PHYSICAL_TYPE
                    DcmDslProtocolRxPduId = 1
                    DcmDslProtocolRxChannelId = 0
                    DcmDslProtocolRxComMChannelRef = RBTM_FR_BODY3_4xwwtd59665s787n6ctawh7k8_23a94727
                    DcmDslProtocolRxPduRef = SDU_DIAG_RBTM_FR_03_ExtCAN_RQ_BODY3_ST3_f1557fc1_Rx
                  SDU_DIAG_RBTM_FR_03_ExtCAN_RS_BODY3_ST3_a939c600_Tx_82eb6958 (DcmDslProtocolTx): DcmDslTxConfirmationPduId=0, DcmDslProtocolTxPduRef=SDU_DIAG_RBTM_FR_03_ExtCAN_RS_BODY3_ST3_a939c600_Tx
        DcmDslDiagResp: DcmDslDiagRespMaxNumRespPend=30, DcmDslDiagRespOnSecondDeclinedRequest=true, DcmDslDiagRespMaxNumOfDeclinedRequests=3
        DcmDslBuffer: DcmDslBufferSize=4095
      DcmGeneral:
        DcmResetToFblAfterSessionFinalResponseEnabled = true
        DcmDevErrorDetect = false
        DcmRequestManufacturerNotificationEnabled = true
        DcmRequestSupplierNotificationEnabled = false
        DcmRespondAllRequest = true
        DcmTaskTime = 0.01
        DcmVersionInfoApi = false
        DcmDspDataDefaultEndianness = LITTLE_ENDIAN
        DcmSafeBswChecks = false
        DcmSupportedIDCalculationSuppressionEnabled = false
        DcmDtrDataProvisionViaDemEnabled = true
        DcmForeignDiagnosticRequestDetectionEnabled = false
        DcmSuppressResponseOnCanTpFuncMixedAddrRequests = false
        DcmSenderReceiverPRPortsEnabled = false
        DcmAutosarVersion = AUTOSAR_4_02_02
        DcmUserConfigFile = $(DpaProjectFolder)/Config/userconfig.cfg
      DcmDsd
        DcmDsdServiceTable
          13 x DcmDsdService:
            DiagSessionControl: DcmDsdSidTabServiceId=16, DcmDsdSidTabSubfuncAvail=true
              4 x DcmDsdSubService:
                Default: DcmDsdSubServiceId=1
                Extended: DcmDsdSubServiceId=3, DcmDsdSubServiceRoleRef=Supplier, DcmDsdSubServiceRoleRef=Development_ENHANCED, DcmDsdSubServiceRoleRef=Production, DcmDsdSubServiceRoleRef=After_Sales_ENHANCED, DcmDsdSubServiceRoleRef=After_Sales_STANDARD, DcmDsdSubServiceRoleRef=After_Sales_BASIC, DcmDsdSubServiceRoleRef=Internal_Diagnostic_Test_Tool, DcmDsdSubServiceRoleRef=ePTI_Test_Tool
                Programming: DcmDsdSubServiceId=2, DcmDsdSubServiceRoleRef=Supplier, DcmDsdSubServiceRoleRef=Development_ENHANCED, DcmDsdSubServiceRoleRef=Production, DcmDsdSubServiceRoleRef=After_Sales_ENHANCED
                Development_Start: DcmDsdSubServiceId=126, DcmDsdSubServiceSessionLevelRef=DcmDspSession/Default, DcmDsdSubServiceSessionLevelRef=DcmDspSession/Extended, DcmDsdSubServiceSessionLevelRef=Development, DcmDsdSubServiceRoleRef=Supplier, DcmDsdSubServiceRoleRef=Development_ENHANCED, DcmDsdSubServiceRoleRef=Production  # COVERS: PLAIN_TEXT ARCH_SW_DIA_0044
            TesterPresent: DcmDsdSidTabServiceId=62, DcmDsdSidTabSubfuncAvail=true
              TesterPresent (DcmDsdSubService): DcmDsdSubServiceId=0
            ReadDataById: DcmDsdSidTabServiceId=34, DcmDsdSidTabSubfuncAvail=false
            WriteDataById: DcmDsdSidTabServiceId=46, DcmDsdSidTabSubfuncAvail=false, DcmDsdServiceRoleRef=Supplier, DcmDsdServiceRoleRef=Development_ENHANCED, DcmDsdServiceRoleRef=Production, DcmDsdServiceRoleRef=After_Sales_ENHANCED, DcmDsdServiceRoleRef=After_Sales_STANDARD, DcmDsdServiceRoleRef=Internal_Diagnostic_Test_Tool
            ClearDiagInfo: DcmDsdSidTabServiceId=20, DcmDsdSidTabSubfuncAvail=false, DcmDsdSidTabSessionLevelRef=DcmDspSession/Default, DcmDsdSidTabSessionLevelRef=DcmDspSession/Extended, DcmDsdSidTabSessionLevelRef=Development
            ReadDtcInfo: DcmDsdSidTabServiceId=25, DcmDsdSidTabSubfuncAvail=true, DcmDsdSidTabSessionLevelRef=DcmDspSession/Default, DcmDsdSidTabSessionLevelRef=DcmDspSession/Extended, DcmDsdSidTabSessionLevelRef=Development
              6 x DcmDsdSubService, all with DcmDsdSubServiceSessionLevelRef=DcmDspSession/Default, DcmDsdSubServiceSessionLevelRef=DcmDspSession/Extended, DcmDsdSubServiceSessionLevelRef=Development:
                RDTCBSM: DcmDsdSubServiceId=2  # COVERS: PLAIN_TEXT ARCH_SW_DIA_0010
                RDTCEDRBDN: DcmDsdSubServiceId=6
                RNODTCBSM: DcmDsdSubServiceId=1
                RSUPDTC: DcmDsdSubServiceId=10, DcmDsdSubServiceRoleRef=Supplier, DcmDsdSubServiceRoleRef=Development_ENHANCED, DcmDsdSubServiceRoleRef=Production, DcmDsdSubServiceRoleRef=After_Sales_ENHANCED, DcmDsdSubServiceRoleRef=After_Sales_STANDARD, DcmDsdSubServiceRoleRef=Internal_Diagnostic_Test_Tool, DcmDsdSubServiceRoleRef=ePTI_Test_Tool
                RDTCSSBDTC: DcmDsdSubServiceId=4
                RDTCFDC: DcmDsdSubServiceId=20, DcmDsdSubServiceRoleRef=Supplier, DcmDsdSubServiceRoleRef=Development_ENHANCED, DcmDsdSubServiceRoleRef=Production, DcmDsdSubServiceRoleRef=After_Sales_ENHANCED, DcmDsdSubServiceRoleRef=After_Sales_STANDARD, DcmDsdSubServiceRoleRef=Internal_Diagnostic_Test_Tool, DcmDsdSubServiceRoleRef=ePTI_Test_Tool
            EcuReset: DcmDsdSidTabServiceId=17, DcmDsdSidTabSubfuncAvail=true, DcmDsdServiceRoleRef=Supplier, DcmDsdServiceRoleRef=Development_ENHANCED, DcmDsdServiceRoleRef=Production, DcmDsdServiceRoleRef=After_Sales_ENHANCED, DcmDsdServiceRoleRef=After_Sales_STANDARD
              4 x DcmDsdSubService:
                DisableRapidShutDown: DcmDsdSubServiceId=5
                EnableRapidShutDown: DcmDsdSubServiceId=4
                Hard: DcmDsdSubServiceId=1, DcmDsdSubServiceRoleRef=Supplier, DcmDsdSubServiceRoleRef=Development_ENHANCED, DcmDsdSubServiceRoleRef=Production, DcmDsdSubServiceRoleRef=After_Sales_ENHANCED, DcmDsdSubServiceRoleRef=After_Sales_STANDARD
                Soft: DcmDsdSubServiceId=3, DcmDsdSubServiceRoleRef=Supplier, DcmDsdSubServiceRoleRef=Development_ENHANCED, DcmDsdSubServiceRoleRef=Production, DcmDsdSubServiceRoleRef=After_Sales_ENHANCED, DcmDsdSubServiceRoleRef=After_Sales_STANDARD
            CommunicationControl: DcmDsdSidTabServiceId=40, DcmDsdSidTabSubfuncAvail=true, DcmDsdSidTabSessionLevelRef=DcmDspSession/Extended, DcmDsdSidTabSessionLevelRef=Development, DcmDsdServiceRoleRef=Supplier, DcmDsdServiceRoleRef=Development_ENHANCED, DcmDsdServiceRoleRef=Production, DcmDsdServiceRoleRef=After_Sales_ENHANCED
              EnableRxAndDisableTx (DcmDsdSubService):
                DcmDsdSubServiceId = 1
                DcmDsdSubServiceSessionLevelRef = DcmDspSession/Extended
                DcmDsdSubServiceSessionLevelRef = Development
                DcmDsdSubServiceRoleRef = Supplier
                DcmDsdSubServiceRoleRef = Development_ENHANCED
                DcmDsdSubServiceRoleRef = Production
                DcmDsdSubServiceRoleRef = After_Sales_ENHANCED
              EnableRxAndTx (DcmDsdSubService):
                DcmDsdSubServiceId = 0
                DcmDsdSubServiceSessionLevelRef = DcmDspSession/Extended
                DcmDsdSubServiceSessionLevelRef = Development
                DcmDsdSubServiceRoleRef = Supplier
                DcmDsdSubServiceRoleRef = Development_ENHANCED
                DcmDsdSubServiceRoleRef = Production
                DcmDsdSubServiceRoleRef = After_Sales_ENHANCED
            ControlDtcSetting: DcmDsdSidTabServiceId=133, DcmDsdSidTabSubfuncAvail=true, DcmDsdSidTabSessionLevelRef=DcmDspSession/Extended, DcmDsdSidTabSessionLevelRef=Development, DcmDsdServiceRoleRef=Supplier, DcmDsdServiceRoleRef=Development_ENHANCED, DcmDsdServiceRoleRef=Production, DcmDsdServiceRoleRef=After_Sales_ENHANCED
              Disable (DcmDsdSubService):
                DcmDsdSubServiceId = 2
                DcmDsdSubServiceSessionLevelRef = DcmDspSession/Extended
                DcmDsdSubServiceSessionLevelRef = Development
                DcmDsdSubServiceRoleRef = Supplier
                DcmDsdSubServiceRoleRef = Development_ENHANCED
                DcmDsdSubServiceRoleRef = Production
                DcmDsdSubServiceRoleRef = After_Sales_ENHANCED
              Enable (DcmDsdSubService):
                DcmDsdSubServiceId = 1
                DcmDsdSubServiceSessionLevelRef = DcmDspSession/Extended
                DcmDsdSubServiceSessionLevelRef = Development
                DcmDsdSubServiceRoleRef = Supplier
                DcmDsdSubServiceRoleRef = Development_ENHANCED
                DcmDsdSubServiceRoleRef = Production
                DcmDsdSubServiceRoleRef = After_Sales_ENHANCED
            RoutineControl: DcmDsdSidTabServiceId=49, DcmDsdSidTabSubfuncAvail=true
            Authentication_Deauthenticate: DcmDsdSidTabServiceId=41, DcmDsdSidTabSubfuncAvail=true, DcmDsdSidTabFnc=Ssa_Cdd_DiagnosticService_Authentication_0x29
            ReadMemoryByAddress: DcmDsdSidTabServiceId=35, DcmDsdSidTabSubfuncAvail=false, DcmDsdServiceRoleRef=Supplier, DcmDsdServiceRoleRef=Development_ENHANCED
            WriteMemoryByAddress: DcmDsdSidTabServiceId=61, DcmDsdSidTabSubfuncAvail=false, DcmDsdSidTabSessionLevelRef=DcmDspSession/Extended, DcmDsdSidTabSessionLevelRef=Development, DcmDsdServiceRoleRef=Supplier, DcmDsdServiceRoleRef=Development_ENHANCED
      DcmDsp: DcmDspMaxDidToRead=1, DcmDspReadDIDReportsNODIByte=false, DcmDspPowerDownTime=255, DcmDspDDDidCheckPerSourceDid=false
        4 x DcmDspDataInfo:
          DID_F804_DataInfo_CombinedDataElement: DcmDspDataFixedLength=false  # CombinedDataElement
          DID_0136_DataInfo_Trigger_Event_Activation_Status_Byte_2: DcmDspDataFixedLength=true  # Trigger_Event_Activation_Status_Byte_2
          DID_0136_DataInfo_Trigger_Event_Activation_Status_Byte_1: DcmDspDataFixedLength=true  # Trigger_Event_Activation_Status_Byte_1
          DID_0131_DataInfo_SAR_Data_Storage_Status: DcmDspDataFixedLength=true  # SAR_Data_Storage_Status
        DidInfo_Activate_SAR_Data_Storage (DcmDspDidInfo): DcmDspDidDynamicallyDefined=false  # Activate_SAR_Data_Storage
          DcmDspDidAccess
            DcmDspDidWrite: DcmDspDidWriteSessionRef=DcmDspSession/Extended
            DcmDspDidRead: DcmDspDidReadSessionRef=DcmDspSession/Default, DcmDspDidReadSessionRef=DcmDspSession/Extended
        DID_0131_SAR_Data_Storage_Status (DcmDspData):  # SAR_Data_Storage_Status
          DcmDspDataEndianness = opaque
          DcmDspDataSize = 8
          DcmDspDataType = UINT8
          DcmDspDataUsePort = USE_DATA_ASYNCH_CLIENT_SERVER
          DcmDspDataInfoRef = DID_0131_DataInfo_SAR_Data_Storage_Status
        DID_F804_CombinedDataElement (DcmDspData):  # CombinedDataElement
          DcmDspDataEndianness = opaque
          DcmDspDataSize = 2568
          DcmDspDataType = UINT8_N
          DcmDspDataUsePort = USE_DATA_ASYNCH_CLIENT_SERVER
          DcmDspDataInfoRef = DID_F804_DataInfo_CombinedDataElement
        DidInfo_Configure_SAR_Trigger_Events (DcmDspDidInfo): DcmDspDidDynamicallyDefined=false  # Configure_SAR_Trigger_Events
          DcmDspDidAccess
            DcmDspDidWrite: DcmDspDidWriteSessionRef=DcmDspSession/Extended
            DcmDspDidRead: DcmDspDidReadSessionRef=DcmDspSession/Default, DcmDspDidReadSessionRef=DcmDspSession/Extended
        DID_0136_Trigger_Event_Activation_Status_Byte_2 (DcmDspData):  # Trigger_Event_Activation_Status_Byte_2
          DcmDspDataEndianness = opaque
          DcmDspDataSize = 8
          DcmDspDataType = UINT8
          DcmDspDataUsePort = USE_DATA_ASYNCH_CLIENT_SERVER
          DcmDspDataInfoRef = DID_0136_DataInfo_Trigger_Event_Activation_Status_Byte_2
        DID_0136_Trigger_Event_Activation_Status_Byte_1 (DcmDspData):  # Trigger_Event_Activation_Status_Byte_1
          DcmDspDataEndianness = opaque
          DcmDspDataSize = 8
          DcmDspDataType = UINT8
          DcmDspDataUsePort = USE_DATA_ASYNCH_CLIENT_SERVER
          DcmDspDataInfoRef = DID_0136_DataInfo_Trigger_Event_Activation_Status_Byte_1
        Activate_SAR_Data_Storage (DcmDspDid):
          DcmDspDidIdentifier = 305
          DcmDspDidUsed = true
          DcmDspDidUsePort = USE_DATA_ELEMENT_SPECIFIC_INTERFACES
          DcmDspDidInfoRef = DidInfo_Activate_SAR_Data_Storage
          SAR_Data_Storage_Status (DcmDspDidSignal): DcmDspDidDataPos=0, DcmDspDidDataRef=DID_0131_SAR_Data_Storage_Status
        Configure_SAR_Trigger_Events (DcmDspDid):
          DcmDspDidIdentifier = 310
          DcmDspDidUsed = true
          DcmDspDidUsePort = USE_DATA_ELEMENT_SPECIFIC_INTERFACES
          DcmDspDidInfoRef = DidInfo_Configure_SAR_Trigger_Events
          Trigger_Event_Activation_Status_Byte_2 (DcmDspDidSignal): DcmDspDidDataPos=8, DcmDspDidDataRef=DID_0136_Trigger_Event_Activation_Status_Byte_2
          Trigger_Event_Activation_Status_Byte_1 (DcmDspDidSignal): DcmDspDidDataPos=0, DcmDspDidDataRef=DID_0136_Trigger_Event_Activation_Status_Byte_1
        DidInfo_Calibration_Identifications_CAL_ID (DcmDspDidInfo): DcmDspDidDynamicallyDefined=false  # Calibration_Identifications_CAL_ID
          DcmDspDidAccess
            DcmDspDidWrite: DcmDspDidWriteSessionRef=DcmDspSession/Extended, DcmDspDidWriteSessionRef=DcmDspSession/Programming
            DcmDspDidRead
        DcmDspControlDTCSetting: DcmSupportDTCSettingControlOptionRecord=false
        DcmDspSession
          4 x DcmDspSessionRow, all with DcmDspSessionP2ServerMax=0.02, DcmDspSessionP2StarServerMax=2:
            Default: DcmDspSessionLevel=1, DcmDspSessionForBoot=DCM_NO_BOOT
            Programming: DcmDspSessionLevel=2, DcmDspSessionForBoot=DCM_OEM_BOOT
            Extended: DcmDspSessionLevel=3, DcmDspSessionForBoot=DCM_NO_BOOT
            Development: DcmDspSessionLevel=126, DcmDspSessionForBoot=DCM_NO_BOOT
          DcmDspSessionCallback: DcmDspSessionCallbackFnc=DiagSessionChangeCallback
        DcmDspSecurity
          4 x DcmDspSecurityRow, all with DcmDspSecurityDelayTime=10, DcmDspSecurityNumAttDelay=1, DcmDspSecurityAttemptCounterEnabled=false, DcmDspSecurityDelayTimeOnBoot=10, DcmDspSecurityUsePort=USE_ASYNCH_CLIENT_SERVER:
            SAR_Read: DcmDspSecurityKeySize=64, DcmDspSecurityLevel=26, DcmDspSecuritySeedSize=32
            SAR_Remove: DcmDspSecurityKeySize=64, DcmDspSecurityLevel=27, DcmDspSecuritySeedSize=32
            Level_3: DcmDspSecurityKeySize=64, DcmDspSecurityLevel=2, DcmDspSecuritySeedSize=32
            Level_5F: DcmDspSecurityKeySize=2, DcmDspSecurityLevel=48, DcmDspSecuritySeedSize=2
        Info_Real_Time_Offset_Read_TickCount (DcmDspDataInfo): DcmDspDataFixedLength=true
        DidInfo_HW_input_Read (DcmDspDidInfo)
          DcmDspDidAccess
            DcmDspDidRead:
              DcmDspDidReadSessionRef = DcmDspSession/Default
              DcmDspDidReadSessionRef = DcmDspSession/Extended
              DcmDspDidReadSessionRef = Development
              DcmDspDidReadRoleRef = Supplier
              DcmDspDidReadRoleRef = Development_ENHANCED
              DcmDspDidReadRoleRef = Production
              DcmDspDidReadRoleRef = After_Sales_ENHANCED
              DcmDspDidReadRoleRef = After_Sales_STANDARD
              DcmDspDidReadRoleRef = After_Sales_BASIC
              DcmDspDidReadRoleRef = Internal_Diagnostic_Test_Tool
              DcmDspDidReadRoleRef = ePTI_Test_Tool
        DDS_Package_Release_Read_DDS_Package_Release_of_Application_Software_Month_Appl (DcmDspData):
          DcmDspDataSize = 8
          DcmDspDataType = UINT8
          DcmDspDataUsePort = USE_DATA_ASYNCH_CLIENT_SERVER
          DcmDspDataInfoRef = Info_DDS_Package_Release_Read_DDS_Package_Release_of_Application_Software_Month_Appl
        DID_Diagnostic_Extract_Version_Read (DcmDspDid):
          DcmDspDidIdentifier = 61185
          DcmDspDidUsed = true
          DcmDspDidUsePort = USE_DATA_ELEMENT_SPECIFIC_INTERFACES
          DcmDspDidInfoRef = DidInfo_Diagnostic_Extract_Version_Read
          6 x DcmDspDidSignal:
            Diagnostic_Extract_Minor_Version: DcmDspDidDataPos=8, DcmDspDidDataRef=Diagnostic_Extract_Version_Read_Diagnostic_Extract_Minor_Version
            CANdela_Version: DcmDspDidDataPos=24, DcmDspDidDataRef=Diagnostic_Extract_Version_Read_CANdela_Version
            Diagnostic_Extract_Major_Version: DcmDspDidDataPos=0, DcmDspDidDataRef=Diagnostic_Extract_Version_Read_Diagnostic_Extract_Major_Version
            DDM_Version: DcmDspDidDataPos=104, DcmDspDidDataRef=Diagnostic_Extract_Version_Read_DDM_Version
            Exported_Diagnostic_Variant: DcmDspDidDataPos=184, DcmDspDidDataRef=Diagnostic_Extract_Version_Read_Exported_Diagnostic_Variant
            Diagnostic_Extract_Patch_Version: DcmDspDidDataPos=16, DcmDspDidDataRef=Diagnostic_Extract_Version_Read_Diagnostic_Extract_Patch_Version
        Diagnostic_Authentication_Certificate_Identification_Read_Diagnostic_Authentication_Certificate_Serial_Number (DcmDspData):
          DcmDspDataSize = 128
          DcmDspDataType = UINT8_N
          DcmDspDataUsePort = USE_DATA_ASYNCH_CLIENT_SERVER
          DcmDspDataInfoRef = Info_Diagnostic_Authentication_Certificate_Identification_Read_Diagnostic_Authentication_Certificate_Serial_Number
        DID_Vehicle_Equipment_Read (DcmDspDid):
          DcmDspDidIdentifier = 784
          DcmDspDidUsed = true
          DcmDspDidUsePort = USE_DATA_ELEMENT_SPECIFIC_INTERFACES
          DcmDspDidInfoRef = DidInfo_Vehicle_Equipment_Read
          12 x DcmDspDidSignal:
            Equipment_1: DcmDspDidDataPos=0, DcmDspDidDataRef=Vehicle_Equipment_Read_Equipment_1
            Unterspannungsbereichsschwelle: DcmDspDidDataPos=80, DcmDspDidDataRef=Vehicle_Equipment_Read_Unterspannungsbereichsschwelle
            Unterspannungsabbruchschwelle: DcmDspDidDataPos=64, DcmDspDidDataRef=Vehicle_Equipment_Read_Unterspannungsabbruchschwelle
            Ueberspannungsbereichsschwelle: DcmDspDidDataPos=96, DcmDspDidDataRef=Vehicle_Equipment_Read_Ueberspannungsbereichsschwelle
            Equipment_3: DcmDspDidDataPos=16, DcmDspDidDataRef=Vehicle_Equipment_Read_Equipment_3
            Equipment_2: DcmDspDidDataPos=8, DcmDspDidDataRef=Vehicle_Equipment_Read_Equipment_2
            Ueberspannungsabbruchschwelle: DcmDspDidDataPos=112, DcmDspDidDataRef=Vehicle_Equipment_Read_Ueberspannungsabbruchschwelle
            Reserved: DcmDspDidDataPos=48, DcmDspDidDataRef=Vehicle_Equipment_Read_Reserved
            Equipment_6: DcmDspDidDataPos=40, DcmDspDidDataRef=Vehicle_Equipment_Read_Equipment_6
            Reserved_1: DcmDspDidDataPos=56, DcmDspDidDataRef=Vehicle_Equipment_Read_Reserved_1
            Equipment_5: DcmDspDidDataPos=32, DcmDspDidDataRef=Vehicle_Equipment_Read_Equipment_5
            Equipment_4: DcmDspDidDataPos=24, DcmDspDidDataRef=Vehicle_Equipment_Read_Equipment_4
        Info_CAN_output_Read_CANoutput1 (DcmDspDataInfo): DcmDspDataFixedLength=true
        Info_ECU_Extract_Version_Read_ECU_Extract_Major_Version (DcmDspDataInfo): DcmDspDataFixedLength=true
        DID_Backend_CA_Certificate_Identification_Read (DcmDspDid):
          DcmDspDidIdentifier = 386
          DcmDspDidUsed = true
          DcmDspDidUsePort = USE_DATA_ELEMENT_SPECIFIC_INTERFACES
          DcmDspDidInfoRef = DidInfo_Backend_CA_Certificate_Identification_Read
          Backend_CA_SubjectKeyIdentifier (DcmDspDidSignal): DcmDspDidDataPos=0, DcmDspDidDataRef=Backend_CA_Certificate_Identification_Read_Backend_CA_SubjectKeyIdentifier
        ECU_Extract_Version_Read_ECU_Extract_Information_Identification_Type (DcmDspData):
          DcmDspDataSize = 8
          DcmDspDataType = UINT8
          DcmDspDataUsePort = USE_DATA_ASYNCH_CLIENT_SERVER
          DcmDspDataConstantValue = 00
          DcmDspDataConstantValueType = HEX
          DcmDspDataInfoRef = Info_ECU_Extract_Version_Read_ECU_Extract_Information_Identification_Type
        3 x DcmDspDataInfo:
          Info_HW_input_Read_Voltage_KL30t: DcmDspDataFixedLength=true
          Info_Security_Event_Log_Read_Security_Event_Log: DcmDspDataFixedLength=false
          Info_DDS_Package_Release_Read_DDS_Package_Release_of_Application_Software_Year_Appl: DcmDspDataFixedLength=true
        Trust_model_Root_CA_certificate_Read_Trust_model_Root_CA_certificate (DcmDspData):
          DcmDspDataSize = 8016
          DcmDspDataType = UINT8_N
          DcmDspDataUsePort = USE_DATA_ASYNCH_CLIENT_SERVER
          DcmDspDataInfoRef = Info_Trust_model_Root_CA_certificate_Read_Trust_model_Root_CA_certificate
        RoutineInfo_PreCheckProgrammingDependencies_Start (DcmDspRoutineInfo)
          DcmDspStartRoutineIn
            Pre_Check_Informations (DcmDspStartRoutineInSignal): DcmDspRoutineSignalLength=32512, DcmDspRoutineSignalType=VARIABLE_LENGTH, DcmDspRoutineSignalEndianness=opaque, DcmDspRoutineSignalPos=0
          DcmDspRoutineAuthorization:
            DcmDspRoutineSessionRef = DcmDspSession/Programming
            DcmDspRoutineSessionRef = DcmDspSession/Extended
            DcmDspRoutineSessionRef = Development
            DcmDspRoutineRoleRef = Supplier
            DcmDspRoutineRoleRef = Development_ENHANCED
            DcmDspRoutineRoleRef = Production
            DcmDspRoutineRoleRef = After_Sales_ENHANCED
          DcmDspStartRoutineOut
            routineInfo (DcmDspStartRoutineOutSignal): DcmDspRoutineSignalLength=8, DcmDspRoutineSignalType=UINT8, DcmDspRoutineSignalPos=0
            Dependencies_Verification_Check_Result (DcmDspStartRoutineOutSignal): DcmDspRoutineSignalLength=8, DcmDspRoutineSignalType=UINT8, DcmDspRoutineSignalPos=8
        Info_Standard_Application_SW_Package_Information_Read_Standard_Application_SW_Package_Build_Version (DcmDspDataInfo): DcmDspDataFixedLength=true
        Vehicle_Equipment_Read_Ueberspannungsbereichsschwelle (DcmDspData):
          DcmDspDataSize = 16
          DcmDspDataType = UINT16
          DcmDspDataUsePort = USE_DATA_ASYNCH_CLIENT_SERVER
          DcmDspDataInfoRef = Info_Vehicle_Equipment_Read_Ueberspannungsbereichsschwelle
        Routine_PreCheckProgrammingDependencies_Start (DcmDspRoutine):
          DcmDspRequestResultsRoutineSupported = false
          DcmDspStopRoutineSupported = false
          DcmDspRoutineIdentifier = 519
          DcmDspRoutineFixedLength = false
          DcmDspRoutineUsePort = true
          DcmDspRoutineUsed = true
          DcmDspRoutineInfoRef = RoutineInfo_PreCheckProgrammingDependencies_Start
        Info_Trust_Model_Request_ephemeral_public_key_Read_Certificates (DcmDspDataInfo): DcmDspDataFixedLength=false
        ECUSerialNumberDataIdentifier_Read_ECU_Serial_Number (DcmDspData):
          DcmDspDataSize = 264
          DcmDspDataType = UINT8_N
          DcmDspDataUsePort = USE_DATA_ASYNCH_CLIENT_SERVER
          DcmDspDataInfoRef = Info_ECUSerialNumberDataIdentifier_Read_ECU_Serial_Number
        Info_PRE_SAFE_Recorder_1_read_Read_CombinedDataElement (DcmDspDataInfo): DcmDspDataFixedLength=false
        MercedesCarGroupHardware_Read_Hardware_Part_Number (DcmDspData):
          DcmDspDataSize = 80
          DcmDspDataType = UINT8_N
          DcmDspDataUsePort = USE_DATA_ASYNCH_CLIENT_SERVER
          DcmDspDataInfoRef = Info_MercedesCarGroupHardware_Read_Hardware_Part_Number
        VIN_Status_Read_VIN_Status (DcmDspData): DcmDspDataSize=8, DcmDspDataType=UINT8, DcmDspDataUsePort=USE_DATA_ASYNCH_CLIENT_SERVER, DcmDspDataInfoRef=Info_VIN_Status_Read_VIN_Status
        DID_Trust_model_ECU_certificate_Read (DcmDspDid):
          DcmDspDidIdentifier = 411
          DcmDspDidUsed = true
          DcmDspDidUsePort = USE_DATA_ELEMENT_SPECIFIC_INTERFACES
          DcmDspDidInfoRef = DidInfo_Trust_model_ECU_certificate_Read
          Trust_model_ECU_Certificate (DcmDspDidSignal): DcmDspDidDataPos=0, DcmDspDidDataRef=Trust_model_ECU_certificate_Read_Trust_model_ECU_Certificate
        DidInfo_ECUSerialNumberDataIdentifier_Read (DcmDspDidInfo)
          DcmDspDidAccess
            DcmDspDidRead:  # COVERS: PLAIN_TEXT ARCH_SW_DIA_0051
              DcmDspDidReadRoleRef = Supplier
              DcmDspDidReadRoleRef = Development_ENHANCED
              DcmDspDidReadRoleRef = Production
              DcmDspDidReadRoleRef = After_Sales_ENHANCED
              DcmDspDidReadRoleRef = After_Sales_STANDARD
              DcmDspDidReadRoleRef = After_Sales_BASIC
              DcmDspDidReadRoleRef = Internal_Diagnostic_Test_Tool
              DcmDspDidReadRoleRef = ePTI_Test_Tool
        DidInfo_ECU_Extract_Version_Read (DcmDspDidInfo)
          DcmDspDidAccess
            DcmDspDidRead
        Info_Vehicle_Equipment_Read_Unterspannungsabbruchschwelle (DcmDspDataInfo): DcmDspDataFixedLength=true
        SoftwareSupplier_Read_Software_Logical_Block_Supplier_Identification (DcmDspData):
          DcmDspDataSize = 2032
          DcmDspDataType = UINT8_N
          DcmDspDataUsePort = USE_DATA_ASYNCH_CLIENT_SERVER
          DcmDspDataInfoRef = Info_SoftwareSupplier_Read_Software_Logical_Block_Supplier_Identification
        Info_ECU_Extract_Version_Read_ECU_Extract_Information_Export_Date (DcmDspDataInfo): DcmDspDataFixedLength=true
        Info_SoftwareSupplier_Read_Software_Logical_Block_Supplier_Identification (DcmDspDataInfo): DcmDspDataFixedLength=false
        DidInfo_SSA_Version_Information_Read (DcmDspDidInfo)
          DcmDspDidAccess
            DcmDspDidRead:
              DcmDspDidReadRoleRef = Supplier
              DcmDspDidReadRoleRef = Development_ENHANCED
              DcmDspDidReadRoleRef = Production
              DcmDspDidReadRoleRef = Internal_Diagnostic_Test_Tool
        SecOC_Vehicle_Shared_Secret_Hash_Read_SecOC_Vehicle_Shared_Secret_Hash (DcmDspData):
          DcmDspDataSize = 32
          DcmDspDataType = UINT8_N
          DcmDspDataUsePort = USE_DATA_ASYNCH_CLIENT_SERVER
          DcmDspDataInfoRef = Info_SecOC_Vehicle_Shared_Secret_Hash_Read_SecOC_Vehicle_Shared_Secret_Hash
        Info_Standard_Application_SW_Package_Information_Read_Standard_Application_SW_Package_Patch_Level (DcmDspDataInfo): DcmDspDataFixedLength=true
        DidInfo_CAN_input_Read (DcmDspDidInfo)
          DcmDspDidAccess
            DcmDspDidRead:
              DcmDspDidReadSessionRef = DcmDspSession/Default
              DcmDspDidReadSessionRef = DcmDspSession/Extended
              DcmDspDidReadSessionRef = Development
              DcmDspDidReadRoleRef = Supplier
              DcmDspDidReadRoleRef = Development_ENHANCED
              DcmDspDidReadRoleRef = Production
              DcmDspDidReadRoleRef = After_Sales_ENHANCED
              DcmDspDidReadRoleRef = After_Sales_STANDARD
              DcmDspDidReadRoleRef = After_Sales_BASIC
              DcmDspDidReadRoleRef = Internal_Diagnostic_Test_Tool
              DcmDspDidReadRoleRef = ePTI_Test_Tool
        Info_Trust_model_full_chain_of_trust_certificates_Read_Trust_model_certificates (DcmDspDataInfo): DcmDspDataFixedLength=false
        Access_Control_List_Version_Read_Basic_ACL_Version_Candela_File_Version_Patch (DcmDspData):
          DcmDspDataSize = 8
          DcmDspDataType = UINT8
          DcmDspDataUsePort = USE_DATA_ASYNCH_CLIENT_SERVER
          DcmDspDataInfoRef = Info_Access_Control_List_Version_Read_Basic_ACL_Version_Candela_File_Version_Patch
        DidInfo_Root_CA_Certificate_Read (DcmDspDidInfo)
          DcmDspDidAccess
            DcmDspDidRead:
              DcmDspDidReadRoleRef = Supplier
              DcmDspDidReadRoleRef = Development_ENHANCED
              DcmDspDidReadRoleRef = Production
              DcmDspDidReadRoleRef = After_Sales_ENHANCED
              DcmDspDidReadRoleRef = After_Sales_STANDARD
              DcmDspDidReadRoleRef = After_Sales_BASIC
              DcmDspDidReadRoleRef = Internal_Diagnostic_Test_Tool
              DcmDspDidReadRoleRef = ePTI_Test_Tool
        DidInfo_Access_Control_List_Version_Read (DcmDspDidInfo)
          DcmDspDidAccess
            DcmDspDidRead:
              DcmDspDidReadRoleRef = Supplier
              DcmDspDidReadRoleRef = Development_ENHANCED
              DcmDspDidReadRoleRef = Production
              DcmDspDidReadRoleRef = After_Sales_ENHANCED
              DcmDspDidReadRoleRef = After_Sales_STANDARD
              DcmDspDidReadRoleRef = After_Sales_BASIC
              DcmDspDidReadRoleRef = Internal_Diagnostic_Test_Tool
              DcmDspDidReadRoleRef = ePTI_Test_Tool
        Info_Access_Control_List_Version_Read_ECU_indvidual_ACL_Version_Generation_Time_GTC (DcmDspDataInfo): DcmDspDataFixedLength=true
        Minimum_Software_Version_Read_Minimum_Software_Version (DcmDspData):
          DcmDspDataSize = 3048
          DcmDspDataType = UINT8_N
          DcmDspDataUsePort = USE_DATA_ASYNCH_CLIENT_SERVER
          DcmDspDataInfoRef = Info_Minimum_Software_Version_Read_Minimum_Software_Version
        SecOC_PDU_Data_IDs_and_Key_CMACs_Read_Secured_PDU_Data_IDs_and_Key_CMACs (DcmDspData):
          DcmDspDataSize = 32736
          DcmDspDataType = UINT8_N
          DcmDspDataUsePort = USE_DATA_ASYNCH_CLIENT_SERVER
          DcmDspDataInfoRef = Info_SecOC_PDU_Data_IDs_and_Key_CMACs_Read_Secured_PDU_Data_IDs_and_Key_CMACs
        DidInfo_SecOC_Local_TickCount_Read (DcmDspDidInfo)
          DcmDspDidAccess
            DcmDspDidRead
        Routine_Authenticate_Diagnostic_User_or_Tester_Start (DcmDspRoutine):
          DcmDspRequestResultsRoutineSupported = false
          DcmDspStopRoutineSupported = false
          DcmDspRoutineIdentifier = 608
          DcmDspRoutineFixedLength = false
          DcmDspRoutineUsePort = true
          DcmDspRoutineUsed = true
          DcmDspRoutineInfoRef = RoutineInfo_Authenticate_Diagnostic_User_or_Tester_Start
        Routine_Certificate_Self_Check_Start (DcmDspRoutine):
          DcmDspRequestResultsRoutineSupported = false
          DcmDspStopRoutineSupported = false
          DcmDspRoutineIdentifier = 615
          DcmDspRoutineFixedLength = false
          DcmDspRoutineUsePort = true
          DcmDspRoutineUsed = true
          DcmDspRoutineInfoRef = RoutineInfo_Certificate_Self_Check_Start
        Internal_ECU_information_Read_MOTOR_Current (DcmDspData):
          DcmDspDataSize = 16
          DcmDspDataType = UINT16
          DcmDspDataUsePort = USE_DATA_ASYNCH_CLIENT_SERVER
          DcmDspDataInfoRef = Info_Internal_ECU_information_Read_MOTOR_Current
        DidInfo_Internal_ECU_information_Read (DcmDspDidInfo)
          DcmDspDidAccess
            DcmDspDidRead:
              DcmDspDidReadSessionRef = DcmDspSession/Default
              DcmDspDidReadSessionRef = DcmDspSession/Extended
              DcmDspDidReadSessionRef = Development
              DcmDspDidReadRoleRef = Supplier
              DcmDspDidReadRoleRef = Development_ENHANCED
              DcmDspDidReadRoleRef = Production
              DcmDspDidReadRoleRef = After_Sales_ENHANCED
              DcmDspDidReadRoleRef = After_Sales_STANDARD
              DcmDspDidReadRoleRef = After_Sales_BASIC
              DcmDspDidReadRoleRef = Internal_Diagnostic_Test_Tool
              DcmDspDidReadRoleRef = ePTI_Test_Tool
        DidInfo_Trust_model_ECU_CSR_Read (DcmDspDidInfo)
          DcmDspDidAccess
            DcmDspDidRead: DcmDspDidReadSessionRef=DcmDspSession/Default, DcmDspDidReadSessionRef=DcmDspSession/Extended, DcmDspDidReadSessionRef=Development
        Info_CAN_input_Read_Neues_Bitfeld_6 (DcmDspDataInfo): DcmDspDataFixedLength=true
        Diagnostic_Extract_Version_Read_Exported_Diagnostic_Variant (DcmDspData):
          DcmDspDataSize = 240
          DcmDspDataType = UINT8_N
          DcmDspDataUsePort = USE_DATA_ASYNCH_CLIENT_SERVER
          DcmDspDataInfoRef = Info_Diagnostic_Extract_Version_Read_Exported_Diagnostic_Variant
        5 x DcmDspDataInfo, all with DcmDspDataFixedLength=true:
          Info_CAN_input_Read_Neues_Bitfeld_5
          Info_CAN_input_Read_Neues_Bitfeld_2
          Info_CAN_input_Read_Neues_Bitfeld_1
          Info_CAN_input_Read_Neues_Bitfeld_4
          Info_CAN_input_Read_Neues_Bitfeld_3
        RandomNumber_Read_Generated_Random_Number_Result (DcmDspData):
          DcmDspDataSize = 8
          DcmDspDataType = UINT8
          DcmDspDataUsePort = USE_DATA_ASYNCH_CLIENT_SERVER
          DcmDspDataInfoRef = Info_RandomNumber_Read_Generated_Random_Number_Result
        Trust_Model_Request_ephemeral_public_key_Read_Nonce (DcmDspData):
          DcmDspDataSize = 256
          DcmDspDataType = UINT8_N
          DcmDspDataUsePort = USE_DATA_ASYNCH_CLIENT_SERVER
          DcmDspDataInfoRef = Info_Trust_Model_Request_ephemeral_public_key_Read_Nonce
        Routine_Evaluate_Data_Verification_Certificate_Start (DcmDspRoutine):
          DcmDspRequestResultsRoutineSupported = false
          DcmDspStopRoutineSupported = false
          DcmDspRoutineIdentifier = 610
          DcmDspRoutineFixedLength = false
          DcmDspRoutineUsePort = true
          DcmDspRoutineUsed = true
          DcmDspRoutineInfoRef = RoutineInfo_Evaluate_Data_Verification_Certificate_Start
        Access_Control_List_Version_Read_ECU_indvidual_ACL_Version_Candela_File_Version_Major (DcmDspData):
          DcmDspDataSize = 8
          DcmDspDataType = UINT8
          DcmDspDataUsePort = USE_DATA_ASYNCH_CLIENT_SERVER
          DcmDspDataInfoRef = Info_Access_Control_List_Version_Read_ECU_indvidual_ACL_Version_Candela_File_Version_Major
        Info_Secured_System_Date_and_Time_Read_GeneralizedTime (DcmDspDataInfo): DcmDspDataFixedLength=true
        Info_SSA_Version_Information_Read_SSA_Minor_Version (DcmDspDataInfo): DcmDspDataFixedLength=true
        DID_Seatbelt_Serial_Number_Read (DcmDspDid):
          DcmDspDidIdentifier = 832
          DcmDspDidUsed = true
          DcmDspDidUsePort = USE_DATA_ELEMENT_SPECIFIC_INTERFACES
          DcmDspDidInfoRef = DidInfo_Seatbelt_Serial_Number_Read
          Unique_Seatbelt_Serialnumber (DcmDspDidSignal): DcmDspDidDataPos=0, DcmDspDidDataRef=Seatbelt_Serial_Number_Read_Unique_Seatbelt_Serialnumber
        DID_Obsolescence_Data_Read (DcmDspDid):
          DcmDspDidIdentifier = 320
          DcmDspDidUsed = true
          DcmDspDidUsePort = USE_DATA_ELEMENT_SPECIFIC_INTERFACES
          DcmDspDidInfoRef = DidInfo_Obsolescence_Data_Read
          12 x DcmDspDidSignal:
            Obsolescence_Data_haptic_Warning_Threshold_Yellow_to_Red: DcmDspDidDataPos=80, DcmDspDidDataRef=Obsolescence_Data_Read_Obsolescence_Data_haptic_Warning_Threshold_Yellow_to_Red
            Obsolescence_Data_PRE_SAFE_Lvl_4_5_Threshold_Green_to_Yellow: DcmDspDidDataPos=112, DcmDspDidDataRef=Obsolescence_Data_Read_Obsolescence_Data_PRE_SAFE_Lvl_4_5_Threshold_Green_to_Yellow
            Obsolescence_Data_BSR_Threshold_Yellow_to_Red: DcmDspDidDataPos=32, DcmDspDidDataRef=Obsolescence_Data_Read_Obsolescence_Data_BSR_Threshold_Yellow_to_Red
            Obsolescence_Data_haptic_Warning_Threshold_Green_to_Yellow: DcmDspDidDataPos=64, DcmDspDidDataRef=Obsolescence_Data_Read_Obsolescence_Data_haptic_Warning_Threshold_Green_to_Yellow
            Obsolescence_Data_BSR_Current_Value: DcmDspDidDataPos=0, DcmDspDidDataRef=Obsolescence_Data_Read_Obsolescence_Data_BSR_Current_Value
            Obsolescence_Data_PRE_CRASH_Threshold_Yellow_to_Red: DcmDspDidDataPos=176, DcmDspDidDataRef=Obsolescence_Data_Read_Obsolescence_Data_PRE_CRASH_Threshold_Yellow_to_Red
            Obsolescence_Data_PRE_SAFE_Lvl_4_5_Threshold_Yellow_to_Red: DcmDspDidDataPos=128, DcmDspDidDataRef=Obsolescence_Data_Read_Obsolescence_Data_PRE_SAFE_Lvl_4_5_Threshold_Yellow_to_Red
            Obsolescence_Data_PRE_CRASH_Threshold_Green_to_Yellow: DcmDspDidDataPos=160, DcmDspDidDataRef=Obsolescence_Data_Read_Obsolescence_Data_PRE_CRASH_Threshold_Green_to_Yellow
            Obsolescence_Data_PRE_SAFE_Lvl_4_5_Current_Value: DcmDspDidDataPos=96, DcmDspDidDataRef=Obsolescence_Data_Read_Obsolescence_Data_PRE_SAFE_Lvl_4_5_Current_Value
            Obsolescence_Data_haptic_Warning_Current_Value: DcmDspDidDataPos=48, DcmDspDidDataRef=Obsolescence_Data_Read_Obsolescence_Data_haptic_Warning_Current_Value
            Obsolescence_Data_BSR_Threshold_Green_to_Yellow: DcmDspDidDataPos=16, DcmDspDidDataRef=Obsolescence_Data_Read_Obsolescence_Data_BSR_Threshold_Green_to_Yellow
            Obsolescence_Data_PRE_CRASH_Current_Value: DcmDspDidDataPos=144, DcmDspDidDataRef=Obsolescence_Data_Read_Obsolescence_Data_PRE_CRASH_Current_Value
        Info_PRE_SAFE_Recorder_2_read_Read_CombinedDataElement (DcmDspDataInfo): DcmDspDataFixedLength=false
        DidInfo_Calibration_Identifications_CAL_ID_Read (DcmDspDidInfo)
          DcmDspDidAccess
            DcmDspDidRead
        DidInfo_SecOC_PDU_Data_IDs_and_Key_Checksum_Read (DcmDspDidInfo)
          DcmDspDidAccess
            DcmDspDidRead
        3 x DcmDspData, all with DcmDspDataType=UINT8_N, DcmDspDataUsePort=USE_DATA_ASYNCH_CLIENT_SERVER:
          Secured_System_Date_and_Time_Read_GeneralizedTime: DcmDspDataSize=120, DcmDspDataInfoRef=Info_Secured_System_Date_and_Time_Read_GeneralizedTime
          Trust_Model_Request_ephemeral_public_key_Read_Ephemeral_ECU_Public_Key: DcmDspDataSize=256, DcmDspDataInfoRef=Info_Trust_Model_Request_ephemeral_public_key_Read_Ephemeral_ECU_Public_Key
          Security_Event_Log_Current_Counter_Values_Read_Security_Event_Log_Current_Counter_Values: DcmDspDataSize=8192, DcmDspDataInfoRef=Info_Security_Event_Log_Current_Counter_Values_Read_Security_Event_Log_Current_Counter_Values
        DidInfo_PreSafe_Cycles_Level_1_8_Read (DcmDspDidInfo)
          DcmDspDidAccess
            DcmDspDidWrite:  # COVERS: PLAIN_TEXT ARCH_SW_DIA_0088
              DcmDspDidWriteRoleRef = Supplier
              DcmDspDidWriteRoleRef = Development_ENHANCED
              DcmDspDidWriteRoleRef = Production
              DcmDspDidWriteRoleRef = After_Sales_ENHANCED
            DcmDspDidRead:  # COVERS: PLAIN_TEXT ARCH_SW_DIA_0086
              DcmDspDidReadSessionRef = DcmDspSession/Default
              DcmDspDidReadSessionRef = DcmDspSession/Extended
              DcmDspDidReadSessionRef = Development
              DcmDspDidReadRoleRef = Supplier
              DcmDspDidReadRoleRef = Development_ENHANCED
              DcmDspDidReadRoleRef = Production
              DcmDspDidReadRoleRef = After_Sales_ENHANCED
              DcmDspDidReadRoleRef = After_Sales_STANDARD
              DcmDspDidReadRoleRef = After_Sales_BASIC
              DcmDspDidReadRoleRef = Internal_Diagnostic_Test_Tool
              DcmDspDidReadRoleRef = ePTI_Test_Tool
        Info_Supported_configuration_mechanisms_Read_Config_mechanisms (DcmDspDataInfo): DcmDspDataFixedLength=true
        BSR_Counter_read_Read_BSR_Counter (DcmDspData):
          DcmDspDataSize = 24
          DcmDspDataType = UINT8_N
          DcmDspDataUsePort = USE_DATA_ASYNCH_CLIENT_SERVER
          DcmDspDataInfoRef = Info_BSR_Counter_read_Read_BSR_Counter
        DidInfo_MercedesCarGroupHardware_Read (DcmDspDidInfo)
          DcmDspDidAccess
            DcmDspDidRead
        DidInfo_HardwareSupplier_Read (DcmDspDidInfo)
          DcmDspDidAccess
            DcmDspDidRead
        3 x DcmDspDataInfo, all with DcmDspDataFixedLength=true:
          Info_CAN_input_Read_Supply_battery_voltage
          Info_Access_Control_List_Version_Read_Basic_ACL_Version_Candela_File_Version_Major
          Info_SecOC_Local_TickCount_Read_TickCount
        DID_Availability_Data_Read (DcmDspDid):
          DcmDspDidIdentifier = 322
          DcmDspDidUsed = true
          DcmDspDidUsePort = USE_DATA_ELEMENT_SPECIFIC_INTERFACES
          DcmDspDidInfoRef = DidInfo_Availability_Data_Read
          Availability_Data_PRE_SAFE_haptic_warning (DcmDspDidSignal): DcmDspDidDataPos=0, DcmDspDidDataRef=Availability_Data_Read_Availability_Data_PRE_SAFE_haptic_warning
        Info_DDS_Package_Release_Read_DDS_Package_Release_of_Boot_Software_Month_Boot (DcmDspDataInfo): DcmDspDataFixedLength=true
        Trust_model_ECU_certificate_Read_Trust_model_ECU_Certificate (DcmDspData):
          DcmDspDataSize = 8016
          DcmDspDataType = UINT8_N
          DcmDspDataUsePort = USE_DATA_ASYNCH_CLIENT_SERVER
          DcmDspDataInfoRef = Info_Trust_model_ECU_certificate_Read_Trust_model_ECU_Certificate
        ECU_Extract_Version_Read_ECU_Extract_Information_XDIS_Version (DcmDspData):
          DcmDspDataSize = 80
          DcmDspDataType = UINT8_N
          DcmDspDataUsePort = USE_DATA_ASYNCH_CLIENT_SERVER
          DcmDspDataConstantValue = 23.2.2
          DcmDspDataConstantValueType = ASCII
          DcmDspDataInfoRef = Info_ECU_Extract_Version_Read_ECU_Extract_Information_XDIS_Version
        Info_SecOC_PDU_Data_IDs_and_Key_Checksum_Read_Secured_PDU_Data_IDs_and_Key_Checksum (DcmDspDataInfo): DcmDspDataFixedLength=false
        PRE_SAFE_Recorder_2_read_Read_CombinedDataElement (DcmDspData):
          DcmDspDataSize = 176
          DcmDspDataType = UINT8_N
          DcmDspDataUsePort = USE_DATA_ASYNCH_CLIENT_SERVER
          DcmDspDataInfoRef = Info_PRE_SAFE_Recorder_2_read_Read_CombinedDataElement
        Reprogramming_Attempt_Counter_Read_Reprogramming_Attempts (DcmDspData):
          DcmDspDataSize = 4064
          DcmDspDataType = UINT8_N
          DcmDspDataUsePort = USE_DATA_ASYNCH_CLIENT_SERVER
          DcmDspDataInfoRef = Info_Reprogramming_Attempt_Counter_Read_Reprogramming_Attempts
        Info_BSR_Counter_read_Read_BSR_Counter (DcmDspDataInfo): DcmDspDataFixedLength=true
        Info_Diagnostic_Extract_Version_Read_Diagnostic_Extract_Major_Version (DcmDspDataInfo): DcmDspDataFixedLength=true
        3 x DcmDspDidInfo:
          DidInfo_HardwareVersion_Read
            DcmDspDidAccess
              DcmDspDidRead
          DidInfo_ZZZ_Vehicle_Equipment_Development_Read
            DcmDspDidAccess
              DcmDspDidWrite:  # COVERS: PLAIN_TEXT ARCH_SW_DIA_0147
                DcmDspDidWriteSessionRef = DcmDspSession/Default
                DcmDspDidWriteSessionRef = DcmDspSession/Extended
                DcmDspDidWriteSessionRef = Development
                DcmDspDidWriteRoleRef = Supplier
                DcmDspDidWriteRoleRef = Development_ENHANCED
                DcmDspDidWriteRoleRef = Production
                DcmDspDidWriteRoleRef = After_Sales_ENHANCED
              DcmDspDidRead:  # COVERS: PLAIN_TEXT ARCH_SW_DIA_0144
                DcmDspDidReadSessionRef = DcmDspSession/Default
                DcmDspDidReadSessionRef = DcmDspSession/Extended
                DcmDspDidReadSessionRef = Development
                DcmDspDidReadRoleRef = Supplier
                DcmDspDidReadRoleRef = Development_ENHANCED
                DcmDspDidReadRoleRef = Production
                DcmDspDidReadRoleRef = After_Sales_ENHANCED
                DcmDspDidReadRoleRef = After_Sales_STANDARD
                DcmDspDidReadRoleRef = After_Sales_BASIC
                DcmDspDidReadRoleRef = Internal_Diagnostic_Test_Tool
                DcmDspDidReadRoleRef = ePTI_Test_Tool
          DidInfo_BootSoftwareVersion_Read
            DcmDspDidAccess
              DcmDspDidRead:
                DcmDspDidReadRoleRef = Supplier
                DcmDspDidReadRoleRef = Development_ENHANCED
                DcmDspDidReadRoleRef = Production
                DcmDspDidReadRoleRef = After_Sales_ENHANCED
                DcmDspDidReadRoleRef = After_Sales_STANDARD
                DcmDspDidReadRoleRef = After_Sales_BASIC
                DcmDspDidReadRoleRef = Internal_Diagnostic_Test_Tool
                DcmDspDidReadRoleRef = ePTI_Test_Tool
        Info_Minimum_Software_Version_Read_Minimum_Software_Version (DcmDspDataInfo): DcmDspDataFixedLength=false
        DidInfo_Diagnostic_Trace_Memory_Read (DcmDspDidInfo)
          DcmDspDidAccess
            DcmDspDidWrite:
              DcmDspDidWriteSessionRef = DcmDspSession/Extended
              DcmDspDidWriteSessionRef = Development
              DcmDspDidWriteRoleRef = Supplier
              DcmDspDidWriteRoleRef = Development_ENHANCED
              DcmDspDidWriteRoleRef = Production
              DcmDspDidWriteRoleRef = After_Sales_ENHANCED
              DcmDspDidWriteRoleRef = After_Sales_STANDARD
            DcmDspDidRead:
              DcmDspDidReadSessionRef = DcmDspSession/Default
              DcmDspDidReadSessionRef = DcmDspSession/Extended
              DcmDspDidReadSessionRef = Development
              DcmDspDidReadRoleRef = Supplier
              DcmDspDidReadRoleRef = Development_ENHANCED
              DcmDspDidReadRoleRef = Production
              DcmDspDidReadRoleRef = After_Sales_ENHANCED
              DcmDspDidReadRoleRef = After_Sales_STANDARD
              DcmDspDidReadRoleRef = After_Sales_BASIC
              DcmDspDidReadRoleRef = Internal_Diagnostic_Test_Tool
              DcmDspDidReadRoleRef = ePTI_Test_Tool
        Info_Internal_ECU_information_Read_MOTOR_Current (DcmDspDataInfo): DcmDspDataFixedLength=true
        Info_Access_Control_List_Version_Read_ECU_indvidual_ACL_Version_Candela_File_Version_Major (DcmDspDataInfo): DcmDspDataFixedLength=true
        DidInfo_DDS_Package_Release_Read (DcmDspDidInfo)
          DcmDspDidAccess
            DcmDspDidRead: DcmDspDidReadRoleRef=Supplier, DcmDspDidReadRoleRef=Development_ENHANCED, DcmDspDidReadRoleRef=Internal_Diagnostic_Test_Tool
        Info_Diagnostic_Authentication_Certificate_Identification_Read_Diagnostic_Authentication_Certificate_Issuer (DcmDspDataInfo): DcmDspDataFixedLength=true
        Info_Adjust_ISO_15765_2_Block_Size_and_STmin_Parameter_Read_STmin_Value_as_defined_in_ISO_15765_2 (DcmDspDataInfo): DcmDspDataFixedLength=true
        Routine_Trust_Model_Generate_Key_Pair_Start (DcmDspRoutine):
          DcmDspRequestResultsRoutineSupported = false
          DcmDspStopRoutineSupported = false
          DcmDspRoutineIdentifier = 635
          DcmDspRoutineFixedLength = false
          DcmDspRoutineUsePort = true
          DcmDspRoutineUsed = true
          DcmDspRoutineInfoRef = RoutineInfo_Trust_Model_Generate_Key_Pair_Start
        DID_PRE_SAFE_Recorder_1_read_Read (DcmDspDid):
          DcmDspDidIdentifier = 577
          DcmDspDidUsed = true
          DcmDspDidUsePort = USE_DATA_ELEMENT_SPECIFIC_INTERFACES
          DcmDspDidInfoRef = DidInfo_PRE_SAFE_Recorder_1_read_Read
          CombinedDataElement (DcmDspDidSignal): DcmDspDidDataPos=0, DcmDspDidDataRef=PRE_SAFE_Recorder_1_read_Read_CombinedDataElement
        DID_Minimum_Software_Version_Read (DcmDspDid):
          DcmDspDidIdentifier = 61189
          DcmDspDidUsed = true
          DcmDspDidUsePort = USE_DATA_ELEMENT_SPECIFIC_INTERFACES
          DcmDspDidInfoRef = DidInfo_Minimum_Software_Version_Read
          Minimum_Software_Version (DcmDspDidSignal): DcmDspDidDataPos=0, DcmDspDidDataRef=Minimum_Software_Version_Read_Minimum_Software_Version
        Access_Control_List_Version_Read_Basic_ACL_Version_Generation_Time_GTC (DcmDspData):
          DcmDspDataSize = 120
          DcmDspDataType = UINT8_N
          DcmDspDataUsePort = USE_DATA_ASYNCH_CLIENT_SERVER
          DcmDspDataInfoRef = Info_Access_Control_List_Version_Read_Basic_ACL_Version_Generation_Time_GTC
        DidInfo_Current_Operating_Time_Read (DcmDspDidInfo)
          DcmDspDidAccess
            DcmDspDidRead:
              DcmDspDidReadRoleRef = Supplier
              DcmDspDidReadRoleRef = Development_ENHANCED
              DcmDspDidReadRoleRef = Production
              DcmDspDidReadRoleRef = After_Sales_ENHANCED
              DcmDspDidReadRoleRef = After_Sales_STANDARD
              DcmDspDidReadRoleRef = Internal_Diagnostic_Test_Tool
        3 x DcmDspDataInfo, all with DcmDspDataFixedLength=true:
          Info_ECU_Extract_Version_Read_ECU_Extract_Information_Identification_Type
          Info_ActiveDiagnosticInformation_Read_Session
          Info_Diagnostic_Extract_Version_Read_Diagnostic_Extract_Patch_Version
        SSA_Version_Information_Read_SSA_Minor_Version (DcmDspData):
          DcmDspDataSize = 8
          DcmDspDataType = UINT8
          DcmDspDataUsePort = USE_DATA_ASYNCH_CLIENT_SERVER
          DcmDspDataInfoRef = Info_SSA_Version_Information_Read_SSA_Minor_Version
        4 x DcmDspDid, all with DcmDspDidUsed=true, DcmDspDidUsePort=USE_DATA_ELEMENT_SPECIFIC_INTERFACES:
          DID_Tensioning_Cycle_BSR_Read: DcmDspDidIdentifier=770, DcmDspDidInfoRef=DidInfo_Tensioning_Cycle_BSR_Read
            CombinedSignal (DcmDspDidSignal): DcmDspDidDataPos=0, DcmDspDidDataRef=Tensioning_Cycle_BSR_Read_CombinedSignal
          DID_VINDataIdentifier_Read: DcmDspDidIdentifier=61840, DcmDspDidInfoRef=DidInfo_VINDataIdentifier_Read
            VINDataIdentifier (DcmDspDidSignal): DcmDspDidDataPos=0, DcmDspDidDataRef=VINDataIdentifier_Read_VINDataIdentifier
          DID_Diagnostic_User_Role_Read: DcmDspDidIdentifier=396, DcmDspDidInfoRef=DidInfo_Diagnostic_User_Role_Read
            Cebas_UserRole (DcmDspDidSignal): DcmDspDidDataPos=0, DcmDspDidDataRef=Diagnostic_User_Role_Read_Cebas_UserRole
          DID_Secured_System_Date_and_Time_Read: DcmDspDidIdentifier=390, DcmDspDidInfoRef=DidInfo_Secured_System_Date_and_Time_Read
            GeneralizedTime (DcmDspDidSignal): DcmDspDidDataPos=0, DcmDspDidDataRef=Secured_System_Date_and_Time_Read_GeneralizedTime
        BootSoftwareVersion_Read_Boot_SW_patch_level (DcmDspData):
          DcmDspDataSize = 8
          DcmDspDataType = UINT8
          DcmDspDataUsePort = USE_DATA_ASYNCH_CLIENT_SERVER
          DcmDspDataInfoRef = Info_BootSoftwareVersion_Read_Boot_SW_patch_level
        Info_ECUSerialNumberDataIdentifier_Read_ECU_Serial_Number (DcmDspDataInfo): DcmDspDataFixedLength=false
        Diagnostic_Extract_Version_Read_Diagnostic_Extract_Major_Version (DcmDspData):
          DcmDspDataSize = 8
          DcmDspDataType = UINT8
          DcmDspDataUsePort = USE_DATA_ASYNCH_CLIENT_SERVER
          DcmDspDataInfoRef = Info_Diagnostic_Extract_Version_Read_Diagnostic_Extract_Major_Version
        ZZZ_Vehicle_Equipment_Development_Read_Bitfield (DcmDspData):
          DcmDspDataSize = 16
          DcmDspDataType = UINT8_N
          DcmDspDataUsePort = USE_DATA_ASYNCH_CLIENT_SERVER
          DcmDspDataInfoRef = Info_ZZZ_Vehicle_Equipment_Development_Read_Bitfield
        Info_Diagnostic_Extract_Version_Read_CANdela_Version (DcmDspDataInfo): DcmDspDataFixedLength=true
        Routine_Replace_Certificates_Start (DcmDspRoutine):
          DcmDspRequestResultsRoutineSupported = false
          DcmDspStopRoutineSupported = false
          DcmDspRoutineIdentifier = 612
          DcmDspRoutineFixedLength = false
          DcmDspRoutineUsePort = true
          DcmDspRoutineUsed = true
          DcmDspRoutineInfoRef = RoutineInfo_Replace_Certificates_Start
        Info_Trust_model_Backend_CA_certificate_Read_Trust_model_Backend_CA_certificate (DcmDspDataInfo): DcmDspDataFixedLength=false
        DID_BootSoftwareVersion_Read (DcmDspDid):
          DcmDspDidIdentifier = 61779
          DcmDspDidUsed = true
          DcmDspDidUsePort = USE_DATA_ELEMENT_SPECIFIC_INTERFACES
          DcmDspDidInfoRef = DidInfo_BootSoftwareVersion_Read
          3 x DcmDspDidSignal:
            Boot_SW_year: DcmDspDidDataPos=0, DcmDspDidDataRef=BootSoftwareVersion_Read_Boot_SW_year
            Boot_SW_patch_level: DcmDspDidDataPos=16, DcmDspDidDataRef=BootSoftwareVersion_Read_Boot_SW_patch_level
            Boot_SW_week: DcmDspDidDataPos=8, DcmDspDidDataRef=BootSoftwareVersion_Read_Boot_SW_week
        Info_Backend_CA_Certificate_Read_Backend_CA_Certificate (DcmDspDataInfo): DcmDspDataFixedLength=false
        Routine_Get_Certificate_Entry_Start (DcmDspRoutine):
          DcmDspRequestResultsRoutineSupported = false
          DcmDspStopRoutineSupported = false
          DcmDspRoutineIdentifier = 637
          DcmDspRoutineFixedLength = false
          DcmDspRoutineUsePort = true
          DcmDspRoutineUsed = true
          DcmDspRoutineInfoRef = RoutineInfo_Get_Certificate_Entry_Start
        RoutineInfo_Synchronize_Secured_System_Date_and_Time_Start (DcmDspRoutineInfo)
          DcmDspRoutineAuthorization
          DcmDspStartRoutineOut
            routineInfo (DcmDspStartRoutineOutSignal): DcmDspRoutineSignalLength=8, DcmDspRoutineSignalType=UINT8, DcmDspRoutineSignalPos=0
            Nonce (DcmDspStartRoutineOutSignal): DcmDspRoutineSignalLength=256, DcmDspRoutineSignalType=UINT8_N, DcmDspRoutineSignalEndianness=opaque, DcmDspRoutineSignalPos=8
        Info_Internal_ECU_information_Read_ECU_Temperature (DcmDspDataInfo): DcmDspDataFixedLength=true
        RoutineInfo_Replace_Certificates_Start (DcmDspRoutineInfo)
          DcmDspStartRoutineIn
            Certificates (DcmDspStartRoutineInSignal): DcmDspRoutineSignalLength=32064, DcmDspRoutineSignalType=VARIABLE_LENGTH, DcmDspRoutineSignalEndianness=opaque, DcmDspRoutineSignalPos=0
          DcmDspRoutineAuthorization:
            DcmDspRoutineSessionRef = DcmDspSession/Programming
            DcmDspRoutineSessionRef = DcmDspSession/Extended
            DcmDspRoutineSessionRef = Development
            DcmDspRoutineRoleRef = Production
          DcmDspStartRoutineOut
            Verification_Result (DcmDspStartRoutineOutSignal): DcmDspRoutineSignalLength=8, DcmDspRoutineSignalType=UINT8, DcmDspRoutineSignalPos=8
            routineInfo (DcmDspStartRoutineOutSignal): DcmDspRoutineSignalLength=8, DcmDspRoutineSignalType=UINT8, DcmDspRoutineSignalPos=0
        Info_ZZZ_Vehicle_Equipment_Development_Read_Bitfield (DcmDspDataInfo): DcmDspDataFixedLength=true
        Real_Time_Offset_Read_Real_Time_Offset (DcmDspData):
          DcmDspDataSize = 120
          DcmDspDataType = UINT8_N
          DcmDspDataUsePort = USE_DATA_ASYNCH_CLIENT_SERVER
          DcmDspDataInfoRef = Info_Real_Time_Offset_Read_Real_Time_Offset
        DidInfo_Minimum_Software_Version_Read (DcmDspDidInfo)
          DcmDspDidAccess
            DcmDspDidRead:
              DcmDspDidReadRoleRef = Supplier
              DcmDspDidReadRoleRef = Development_ENHANCED
              DcmDspDidReadRoleRef = Production
              DcmDspDidReadRoleRef = After_Sales_ENHANCED
              DcmDspDidReadRoleRef = Internal_Diagnostic_Test_Tool
        BootSoftwareVersion_Read_Boot_SW_week (DcmDspData):
          DcmDspDataSize = 8
          DcmDspDataType = UINT8
          DcmDspDataUsePort = USE_DATA_ASYNCH_CLIENT_SERVER
          DcmDspDataInfoRef = Info_BootSoftwareVersion_Read_Boot_SW_week
        Info_Security_Event_Log_Current_Counter_Values_Read_Security_Event_Log_Current_Counter_Values (DcmDspDataInfo): DcmDspDataFixedLength=false
        DidInfo_Release_Cycles_BSR_and_PreSafe_Read (DcmDspDidInfo)
          DcmDspDidAccess
            DcmDspDidWrite:  # COVERS: PLAIN_TEXT ARCH_SW_DIA_0093
              DcmDspDidWriteRoleRef = Supplier
              DcmDspDidWriteRoleRef = Development_ENHANCED
              DcmDspDidWriteRoleRef = Production
              DcmDspDidWriteRoleRef = After_Sales_ENHANCED
            DcmDspDidRead:  # COVERS: PLAIN_TEXT ARCH_SW_DIA_0090
              DcmDspDidReadSessionRef = DcmDspSession/Default
              DcmDspDidReadSessionRef = DcmDspSession/Extended
              DcmDspDidReadSessionRef = Development
              DcmDspDidReadRoleRef = Supplier
              DcmDspDidReadRoleRef = Development_ENHANCED
              DcmDspDidReadRoleRef = Production
              DcmDspDidReadRoleRef = After_Sales_ENHANCED
              DcmDspDidReadRoleRef = After_Sales_STANDARD
              DcmDspDidReadRoleRef = After_Sales_BASIC
              DcmDspDidReadRoleRef = Internal_Diagnostic_Test_Tool
              DcmDspDidReadRoleRef = ePTI_Test_Tool
        DidInfo_Trust_model_ECU_certificate_Read (DcmDspDidInfo)
          DcmDspDidAccess
            DcmDspDidRead
        3 x DcmDspData, all with DcmDspDataUsePort=USE_DATA_ASYNCH_CLIENT_SERVER:
          HardwareVersion_Read_HW_year: DcmDspDataSize=8, DcmDspDataType=UINT8, DcmDspDataInfoRef=Info_HardwareVersion_Read_HW_year
          Standard_Application_SW_Package_Information_Read_Standard_Application_SW_Package_Minor_Version: DcmDspDataSize=8, DcmDspDataType=UINT8, DcmDspDataInfoRef=Info_Standard_Application_SW_Package_Information_Read_Standard_Application_SW_Package_Minor_Version
          RandomNumber_Read_Generated_Random_Number: DcmDspDataSize=256, DcmDspDataType=UINT8_N, DcmDspDataInfoRef=Info_RandomNumber_Read_Generated_Random_Number
        Routine_Check_Reprogramming_Preconditions_Start (DcmDspRoutine):
          DcmDspRequestResultsRoutineSupported = false
          DcmDspStopRoutineSupported = false
          DcmDspRoutineIdentifier = 515
          DcmDspRoutineFixedLength = false
          DcmDspRoutineUsePort = true
          DcmDspRoutineUsed = true
          DcmDspRoutineInfoRef = RoutineInfo_Check_Reprogramming_Preconditions_Start
        DID_Reprogramming_Attempt_Counter_Read (DcmDspDid):
          DcmDspDidIdentifier = 256
          DcmDspDidUsed = true
          DcmDspDidUsePort = USE_DATA_ELEMENT_SPECIFIC_INTERFACES
          DcmDspDidInfoRef = DidInfo_Reprogramming_Attempt_Counter_Read
          Reprogramming_Attempts (DcmDspDidSignal): DcmDspDidDataPos=0, DcmDspDidDataRef=Reprogramming_Attempt_Counter_Read_Reprogramming_Attempts
        Diagnostic_Authentication_Certificate_Identification_Read_Diagnostic_Authentication_Certificate_Issuer (DcmDspData):
          DcmDspDataSize = 120
          DcmDspDataType = UINT8_N
          DcmDspDataUsePort = USE_DATA_ASYNCH_CLIENT_SERVER
          DcmDspDataInfoRef = Info_Diagnostic_Authentication_Certificate_Identification_Read_Diagnostic_Authentication_Certificate_Issuer
        HW_input_Read_Voltage_KL30t (DcmDspData): DcmDspDataSize=8, DcmDspDataType=UINT8, DcmDspDataUsePort=USE_DATA_ASYNCH_CLIENT_SERVER, DcmDspDataInfoRef=Info_HW_input_Read_Voltage_KL30t
        DID_Standard_Application_SW_Package_Information_Read (DcmDspDid):
          DcmDspDidIdentifier = 61187
          DcmDspDidUsed = true
          DcmDspDidUsePort = USE_DATA_ELEMENT_SPECIFIC_INTERFACES
          DcmDspDidInfoRef = DidInfo_Standard_Application_SW_Package_Information_Read
          7 x DcmDspDidSignal:
            Standard_Application_SW_Package_Major_Version: DcmDspDidDataPos=0, DcmDspDidDataRef=Standard_Application_SW_Package_Information_Read_Standard_Application_SW_Package_Major_Version
            Standard_Application_SW_Package_Patch_Level: DcmDspDidDataPos=16, DcmDspDidDataRef=Standard_Application_SW_Package_Information_Read_Standard_Application_SW_Package_Patch_Level
            Standard_Application_SW_Package_Minor_Version: DcmDspDidDataPos=8, DcmDspDidDataRef=Standard_Application_SW_Package_Information_Read_Standard_Application_SW_Package_Minor_Version
            Supplier_Identification: DcmDspDidDataPos=192, DcmDspDidDataRef=Standard_Application_SW_Package_Information_Read_Supplier_Identification
            Standard_Application_SW_Package_Build_Version: DcmDspDidDataPos=24, DcmDspDidDataRef=Standard_Application_SW_Package_Information_Read_Standard_Application_SW_Package_Build_Version
            AUTOSAR_Platform: DcmDspDidDataPos=208, DcmDspDidDataRef=Standard_Application_SW_Package_Information_Read_AUTOSAR_Platform
            INVALID_SHORTNAME_C_P_Identification: DcmDspDidDataPos=32, DcmDspDidDataRef=Standard_Application_SW_Package_Information_Read_C_P_Identification
        Supported_configuration_mechanisms_Read_Config_mechanisms (DcmDspData):
          DcmDspDataSize = 8
          DcmDspDataType = UINT8
          DcmDspDataUsePort = USE_DATA_ASYNCH_CLIENT_SERVER
          DcmDspDataInfoRef = Info_Supported_configuration_mechanisms_Read_Config_mechanisms
        DID_Dump_of_Vedoc_Relevant_Information_Read (DcmDspDid):
          DcmDspDidIdentifier = 61699
          DcmDspDidUsed = true
          DcmDspDidUsePort = USE_DATA_ELEMENT_SPECIFIC_INTERFACES
          DcmDspDidInfoRef = DidInfo_Dump_of_Vedoc_Relevant_Information_Read
          PatchedObject (DcmDspDidSignal): DcmDspDidDataPos=0, DcmDspDidDataRef=Dump_of_Vedoc_Relevant_Information_Read_PatchedObject
        Info_Diagnostic_User_Role_Read_Cebas_UserRole (DcmDspDataInfo): DcmDspDataFixedLength=true
        Info_Vehicle_Equipment_Read_Ueberspannungsabbruchschwelle (DcmDspDataInfo): DcmDspDataFixedLength=true
        RoutineInfo_Check_Reprogramming_Preconditions_Start (DcmDspRoutineInfo)
          DcmDspRoutineAuthorization:
            DcmDspRoutineSessionRef = DcmDspSession/Programming
            DcmDspRoutineSessionRef = DcmDspSession/Extended
            DcmDspRoutineSessionRef = Development
            DcmDspRoutineRoleRef = Supplier
            DcmDspRoutineRoleRef = Development_ENHANCED
            DcmDspRoutineRoleRef = Production
            DcmDspRoutineRoleRef = After_Sales_ENHANCED
          DcmDspStartRoutineOut
            3 x DcmDspStartRoutineOutSignal:
              routineInfo: DcmDspRoutineSignalLength=8, DcmDspRoutineSignalType=UINT8, DcmDspRoutineSignalPos=0
              List_of_Preconditions: DcmDspRoutineSignalLength=800, DcmDspRoutineSignalType=VARIABLE_LENGTH, DcmDspRoutineSignalEndianness=opaque, DcmDspRoutineSignalPos=16
              Number_of_Unfulfilled_Preconditions: DcmDspRoutineSignalLength=8, DcmDspRoutineSignalType=UINT8, DcmDspRoutineSignalPos=8
        DidInfo_VINDataIdentifier_Read (DcmDspDidInfo)
          DcmDspDidAccess
            DcmDspDidWrite:
              DcmDspDidWriteSessionRef = DcmDspSession/Programming
              DcmDspDidWriteSessionRef = DcmDspSession/Extended
              DcmDspDidWriteSessionRef = Development
              DcmDspDidWriteRoleRef = Supplier
              DcmDspDidWriteRoleRef = Development_ENHANCED
              DcmDspDidWriteRoleRef = Production
            DcmDspDidRead
        DidInfo_RandomNumber_Read (DcmDspDidInfo)
          DcmDspDidAccess
            DcmDspDidRead:
              DcmDspDidReadSessionRef = DcmDspSession/Default
              DcmDspDidReadSessionRef = DcmDspSession/Extended
              DcmDspDidReadSessionRef = Development
              DcmDspDidReadRoleRef = Supplier
              DcmDspDidReadRoleRef = Development_ENHANCED
              DcmDspDidReadRoleRef = Production
        DID_ECU_Name_Read (DcmDspDid): DcmDspDidIdentifier=61700, DcmDspDidUsed=true, DcmDspDidUsePort=USE_DATA_ELEMENT_SPECIFIC_INTERFACES, DcmDspDidInfoRef=DidInfo_ECU_Name_Read
          Diagnostic_ECU_Name (DcmDspDidSignal): DcmDspDidDataPos=0, DcmDspDidDataRef=ECU_Name_Read_Diagnostic_ECU_Name
        DID_Security_Event_Log_Read (DcmDspDid):
          DcmDspDidIdentifier = 391
          DcmDspDidUsed = true
          DcmDspDidUsePort = USE_DATA_ELEMENT_SPECIFIC_INTERFACES
          DcmDspDidInfoRef = DidInfo_Security_Event_Log_Read
          Security_Event_Log (DcmDspDidSignal): DcmDspDidDataPos=0, DcmDspDidDataRef=Security_Event_Log_Read_Security_Event_Log
        Vehicle_Equipment_Read_Unterspannungsabbruchschwelle (DcmDspData):
          DcmDspDataSize = 16
          DcmDspDataType = UINT16
          DcmDspDataUsePort = USE_DATA_ASYNCH_CLIENT_SERVER
          DcmDspDataInfoRef = Info_Vehicle_Equipment_Read_Unterspannungsabbruchschwelle
        RoutineInfo_Get_Certificate_Entry_Start (DcmDspRoutineInfo)
          DcmDspStartRoutineIn
            In_Certificate_Entry (DcmDspStartRoutineInSignal): DcmDspRoutineSignalLength=8, DcmDspRoutineSignalType=UINT8, DcmDspRoutineSignalPos=8
            In_Certificate_Identification (DcmDspStartRoutineInSignal): DcmDspRoutineSignalLength=8, DcmDspRoutineSignalType=UINT8, DcmDspRoutineSignalPos=0
          DcmDspRoutineAuthorization:
            DcmDspRoutineSessionRef = DcmDspSession/Extended
            DcmDspRoutineSessionRef = Development
            DcmDspRoutineRoleRef = Supplier
            DcmDspRoutineRoleRef = Development_ENHANCED
            DcmDspRoutineRoleRef = Production
            DcmDspRoutineRoleRef = After_Sales_ENHANCED
            DcmDspRoutineRoleRef = After_Sales_STANDARD
            DcmDspRoutineRoleRef = After_Sales_BASIC
            DcmDspRoutineRoleRef = Internal_Diagnostic_Test_Tool
            DcmDspRoutineRoleRef = ePTI_Test_Tool
          DcmDspStartRoutineOut
            5 x DcmDspStartRoutineOutSignal:
              Verification_Result: DcmDspRoutineSignalLength=8, DcmDspRoutineSignalType=UINT8, DcmDspRoutineSignalPos=8
              routineInfo: DcmDspRoutineSignalLength=8, DcmDspRoutineSignalType=UINT8, DcmDspRoutineSignalPos=0
              Out_Certificate_Entry: DcmDspRoutineSignalLength=8, DcmDspRoutineSignalType=UINT8, DcmDspRoutineSignalPos=24
              Certificate_Content: DcmDspRoutineSignalLength=512, DcmDspRoutineSignalType=VARIABLE_LENGTH, DcmDspRoutineSignalEndianness=opaque, DcmDspRoutineSignalPos=32
              Out_Certificate_Identification: DcmDspRoutineSignalLength=8, DcmDspRoutineSignalType=UINT8, DcmDspRoutineSignalPos=16
        Info_ReadFingerprint_Read_Software_Fingerprint_s (DcmDspDataInfo): DcmDspDataFixedLength=false
        HardwareVersion_Read_HW_week (DcmDspData): DcmDspDataSize=8, DcmDspDataType=UINT8, DcmDspDataUsePort=USE_DATA_ASYNCH_CLIENT_SERVER, DcmDspDataInfoRef=Info_HardwareVersion_Read_HW_week
        DidInfo_PRE_SAFE_Recorder_2_read_Read (DcmDspDidInfo)
          DcmDspDidAccess
            DcmDspDidWrite:
              DcmDspDidWriteSessionRef = DcmDspSession/Extended
              DcmDspDidWriteSessionRef = Development
              DcmDspDidWriteRoleRef = Supplier
              DcmDspDidWriteRoleRef = Development_ENHANCED
              DcmDspDidWriteRoleRef = Production
              DcmDspDidWriteRoleRef = After_Sales_ENHANCED
              DcmDspDidWriteRoleRef = After_Sales_STANDARD
            DcmDspDidRead:
              DcmDspDidReadSessionRef = DcmDspSession/Default
              DcmDspDidReadSessionRef = DcmDspSession/Extended
              DcmDspDidReadSessionRef = Development
              DcmDspDidReadRoleRef = Supplier
              DcmDspDidReadRoleRef = Development_ENHANCED
              DcmDspDidReadRoleRef = Production
              DcmDspDidReadRoleRef = After_Sales_ENHANCED
              DcmDspDidReadRoleRef = After_Sales_STANDARD
              DcmDspDidReadRoleRef = After_Sales_BASIC
              DcmDspDidReadRoleRef = Internal_Diagnostic_Test_Tool
              DcmDspDidReadRoleRef = ePTI_Test_Tool
        Info_HW_input_Read_Voltage_Motor (DcmDspDataInfo): DcmDspDataFixedLength=true
        RoutineInfo_Certificate_Self_Check_Start (DcmDspRoutineInfo)
          DcmDspRoutineAuthorization
          DcmDspStartRoutineOut
            Verification_Result (DcmDspStartRoutineOutSignal): DcmDspRoutineSignalLength=144, DcmDspRoutineSignalType=VARIABLE_LENGTH, DcmDspRoutineSignalEndianness=opaque, DcmDspRoutineSignalPos=8
            routineInfo (DcmDspStartRoutineOutSignal): DcmDspRoutineSignalLength=8, DcmDspRoutineSignalType=UINT8, DcmDspRoutineSignalPos=0
        ECU_Name_Read_Diagnostic_ECU_Name (DcmDspData):
          DcmDspDataSize = 8000
          DcmDspDataType = UINT8_N
          DcmDspDataUsePort = USE_DATA_ASYNCH_CLIENT_SERVER
          DcmDspDataInfoRef = Info_ECU_Name_Read_Diagnostic_ECU_Name
        Real_Time_Offset_Read_TickCount (DcmDspData): DcmDspDataSize=40, DcmDspDataType=UINT8_N, DcmDspDataUsePort=USE_DATA_ASYNCH_CLIENT_SERVER, DcmDspDataInfoRef=Info_Real_Time_Offset_Read_TickCount
        DidInfo_System_Time_read_Read (DcmDspDidInfo)
          DcmDspDidAccess
            DcmDspDidRead:
              DcmDspDidReadSessionRef = DcmDspSession/Default
              DcmDspDidReadSessionRef = DcmDspSession/Extended
              DcmDspDidReadSessionRef = Development
              DcmDspDidReadRoleRef = Supplier
              DcmDspDidReadRoleRef = Development_ENHANCED
              DcmDspDidReadRoleRef = Production
              DcmDspDidReadRoleRef = After_Sales_ENHANCED
              DcmDspDidReadRoleRef = After_Sales_STANDARD
              DcmDspDidReadRoleRef = After_Sales_BASIC
              DcmDspDidReadRoleRef = Internal_Diagnostic_Test_Tool
              DcmDspDidReadRoleRef = ePTI_Test_Tool
        Adjust_ISO_15765_2_Block_Size_and_STmin_Parameter_Read_STmin_Value_as_defined_in_ISO_15765_2 (DcmDspData):
          DcmDspDataSize = 8
          DcmDspDataType = UINT8
          DcmDspDataUsePort = USE_DATA_ASYNCH_CLIENT_SERVER
          DcmDspDataInfoRef = Info_Adjust_ISO_15765_2_Block_Size_and_STmin_Parameter_Read_STmin_Value_as_defined_in_ISO_15765_2
        Vehicle_Equipment_Read_Unterspannungsbereichsschwelle (DcmDspData):
          DcmDspDataSize = 16
          DcmDspDataType = UINT16
          DcmDspDataUsePort = USE_DATA_ASYNCH_CLIENT_SERVER
          DcmDspDataInfoRef = Info_Vehicle_Equipment_Read_Unterspannungsbereichsschwelle
        Info_Vehicle_Equipment_Read_Unterspannungsbereichsschwelle (DcmDspDataInfo): DcmDspDataFixedLength=true
        Vehicle_Equipment_Read_Equipment_3 (DcmDspData): DcmDspDataSize=8, DcmDspDataType=UINT8, DcmDspDataUsePort=USE_DATA_ASYNCH_CLIENT_SERVER, DcmDspDataInfoRef=Info_Vehicle_Equipment_Read_Equipment_3
        CAN_input_Read_Supply_battery_voltage (DcmDspData):
          DcmDspDataSize = 8
          DcmDspDataType = UINT8
          DcmDspDataUsePort = USE_DATA_ASYNCH_CLIENT_SERVER
          DcmDspDataInfoRef = Info_CAN_input_Read_Supply_battery_voltage
        Info_Backend_CA_Certificate_Identification_Read_Backend_CA_SubjectKeyIdentifier (DcmDspDataInfo): DcmDspDataFixedLength=true
        4 x DcmDspData, all with DcmDspDataUsePort=USE_DATA_ASYNCH_CLIENT_SERVER:
          Vehicle_Equipment_Read_Equipment_1: DcmDspDataSize=8, DcmDspDataType=UINT8, DcmDspDataInfoRef=Info_Vehicle_Equipment_Read_Equipment_1
          Vehicle_Equipment_Read_Equipment_2: DcmDspDataSize=8, DcmDspDataType=UINT8, DcmDspDataInfoRef=Info_Vehicle_Equipment_Read_Equipment_2
          Trust_Model_Request_ephemeral_public_key_Read_Certificates: DcmDspDataSize=24048, DcmDspDataType=UINT8_N, DcmDspDataInfoRef=Info_Trust_Model_Request_ephemeral_public_key_Read_Certificates
          HW_input_Read_Voltage_Motor: DcmDspDataSize=8, DcmDspDataType=UINT8, DcmDspDataInfoRef=Info_HW_input_Read_Voltage_Motor
        DidInfo_Reprogramming_Attempt_Counter_Read (DcmDspDidInfo)
          DcmDspDidAccess
            DcmDspDidRead:
              DcmDspDidReadRoleRef = Supplier
              DcmDspDidReadRoleRef = Development_ENHANCED
              DcmDspDidReadRoleRef = Production
              DcmDspDidReadRoleRef = After_Sales_ENHANCED
              DcmDspDidReadRoleRef = After_Sales_STANDARD
              DcmDspDidReadRoleRef = After_Sales_BASIC
              DcmDspDidReadRoleRef = Internal_Diagnostic_Test_Tool
              DcmDspDidReadRoleRef = ePTI_Test_Tool
        Info_Real_Time_Offset_Read_Real_Time_Offset (DcmDspDataInfo): DcmDspDataFixedLength=true
        DID_ECU_Extract_Version_Read (DcmDspDid):
          DcmDspDidIdentifier = 61184
          DcmDspDidUsed = true
          DcmDspDidUsePort = USE_DATA_ELEMENT_SPECIFIC_INTERFACES
          DcmDspDidInfoRef = DidInfo_ECU_Extract_Version_Read
          8 x DcmDspDidSignal:
            ECU_Extract_Information_Checksum: DcmDspDidDataPos=432, DcmDspDidDataRef=ECU_Extract_Version_Read_ECU_Extract_Information_Checksum
            ECU_Extract_Information_Identification_Type: DcmDspDidDataPos=24, DcmDspDidDataRef=ECU_Extract_Version_Read_ECU_Extract_Information_Identification_Type
            ECU_Extract_Minor_Version: DcmDspDidDataPos=8, DcmDspDidDataRef=ECU_Extract_Version_Read_ECU_Extract_Minor_Version
            ECU_Extract_Patch_Version: DcmDspDidDataPos=16, DcmDspDidDataRef=ECU_Extract_Version_Read_ECU_Extract_Patch_Version
            ECU_Extract_Information_ECU_Name: DcmDspDidDataPos=192, DcmDspDidDataRef=ECU_Extract_Version_Read_ECU_Extract_Information_ECU_Name
            ECU_Extract_Information_Export_Date: DcmDspDidDataPos=112, DcmDspDidDataRef=ECU_Extract_Version_Read_ECU_Extract_Information_Export_Date
            ECU_Extract_Major_Version: DcmDspDidDataPos=0, DcmDspDidDataRef=ECU_Extract_Version_Read_ECU_Extract_Major_Version
            ECU_Extract_Information_XDIS_Version: DcmDspDidDataPos=32, DcmDspDidDataRef=ECU_Extract_Version_Read_ECU_Extract_Information_XDIS_Version
        DidInfo_Real_Time_Offset_Read (DcmDspDidInfo)
          DcmDspDidAccess
            DcmDspDidRead
        DidInfo_Trust_model_Backend_CA_certificate_Read (DcmDspDidInfo)
          DcmDspDidAccess
            DcmDspDidRead:
              DcmDspDidReadSessionRef = DcmDspSession/Default
              DcmDspDidReadSessionRef = DcmDspSession/Extended
              DcmDspDidReadSessionRef = Development
              DcmDspDidReadRoleRef = Supplier
              DcmDspDidReadRoleRef = Development_ENHANCED
              DcmDspDidReadRoleRef = Production
              DcmDspDidReadRoleRef = After_Sales_ENHANCED
              DcmDspDidReadRoleRef = After_Sales_STANDARD
              DcmDspDidReadRoleRef = After_Sales_BASIC
              DcmDspDidReadRoleRef = Internal_Diagnostic_Test_Tool
              DcmDspDidReadRoleRef = ePTI_Test_Tool
        DID_Adjust_ISO_15765_2_Block_Size_and_STmin_Parameter_Read (DcmDspDid):
          DcmDspDidIdentifier = 267
          DcmDspDidUsed = true
          DcmDspDidUsePort = USE_DATA_ELEMENT_SPECIFIC_INTERFACES
          DcmDspDidInfoRef = DidInfo_Adjust_ISO_15765_2_Block_Size_and_STmin_Parameter_Read
          STmin_Value_as_defined_in_ISO_15765_2 (DcmDspDidSignal): DcmDspDidDataPos=8, DcmDspDidDataRef=Adjust_ISO_15765_2_Block_Size_and_STmin_Parameter_Read_STmin_Value_as_defined_in_ISO_15765_2
          Block_Size_Value_as_defined_in_ISO_15765_2 (DcmDspDidSignal): DcmDspDidDataPos=0, DcmDspDidDataRef=Adjust_ISO_15765_2_Block_Size_and_STmin_Parameter_Read_Block_Size_Value_as_defined_in_ISO_15765_2
        Access_Control_List_Version_Read_Basic_ACL_Version_Candela_File_Version_Major (DcmDspData):
          DcmDspDataSize = 8
          DcmDspDataType = UINT8
          DcmDspDataUsePort = USE_DATA_ASYNCH_CLIENT_SERVER
          DcmDspDataInfoRef = Info_Access_Control_List_Version_Read_Basic_ACL_Version_Candela_File_Version_Major
        DID_SSA_Version_Information_Read (DcmDspDid):
          DcmDspDidIdentifier = 61188
          DcmDspDidUsed = true
          DcmDspDidUsePort = USE_DATA_ELEMENT_SPECIFIC_INTERFACES
          DcmDspDidInfoRef = DidInfo_SSA_Version_Information_Read
          3 x DcmDspDidSignal:
            SSA_Patch_Level: DcmDspDidDataPos=16, DcmDspDidDataRef=SSA_Version_Information_Read_SSA_Patch_Level
            SSA_Major_Version: DcmDspDidDataPos=0, DcmDspDidDataRef=SSA_Version_Information_Read_SSA_Major_Version
            SSA_Minor_Version: DcmDspDidDataPos=8, DcmDspDidDataRef=SSA_Version_Information_Read_SSA_Minor_Version
        Info_SSA_Version_Information_Read_SSA_Patch_Level (DcmDspDataInfo): DcmDspDataFixedLength=true
        RoutineInfo_Trust_Model_SecOC_ECU_Shared_Secret_Distribution_Start (DcmDspRoutineInfo)
          DcmDspStartRoutineIn
            7 x DcmDspStartRoutineInSignal, all with DcmDspRoutineSignalEndianness=opaque:
              Certificates: DcmDspRoutineSignalLength=24048, DcmDspRoutineSignalType=VARIABLE_LENGTH, DcmDspRoutineSignalPos=1544
              Tick_Count_Offset: DcmDspRoutineSignalLength=40, DcmDspRoutineSignalType=UINT8_N, DcmDspRoutineSignalPos=96
              Encrypted_Nonce_and_Shared_Secret: DcmDspRoutineSignalLength=640, DcmDspRoutineSignalType=UINT8_N, DcmDspRoutineSignalPos=136
              Date_and_Time: DcmDspRoutineSignalLength=56, DcmDspRoutineSignalType=UINT8_N, DcmDspRoutineSignalPos=0
              Ephemeral_VSM_Public_Key: DcmDspRoutineSignalLength=256, DcmDspRoutineSignalType=UINT8_N, DcmDspRoutineSignalPos=776
              Tick_Count: DcmDspRoutineSignalLength=40, DcmDspRoutineSignalType=UINT8_N, DcmDspRoutineSignalPos=56
              Data_Signature: DcmDspRoutineSignalLength=512, DcmDspRoutineSignalType=UINT8_N, DcmDspRoutineSignalPos=1032
          DcmDspRoutineAuthorization:
            DcmDspRoutineSessionRef = DcmDspSession/Default
            DcmDspRoutineSessionRef = DcmDspSession/Extended
            DcmDspRoutineSessionRef = Development
            DcmDspRoutineRoleRef = Production
          DcmDspStartRoutineOut
            Verification_Result (DcmDspStartRoutineOutSignal): DcmDspRoutineSignalLength=8, DcmDspRoutineSignalType=UINT8, DcmDspRoutineSignalPos=8
            routineInfo (DcmDspStartRoutineOutSignal): DcmDspRoutineSignalLength=8, DcmDspRoutineSignalType=UINT8, DcmDspRoutineSignalPos=0
        Info_ECU_Name_Read_Diagnostic_ECU_Name (DcmDspDataInfo): DcmDspDataFixedLength=false
        DidInfo_Tensioning_Cycle_BSR_Read (DcmDspDidInfo)
          DcmDspDidAccess
            DcmDspDidWrite:  # COVERS: PLAIN_TEXT ARCH_SW_DIA_0099
              DcmDspDidWriteRoleRef = Supplier
              DcmDspDidWriteRoleRef = Development_ENHANCED
              DcmDspDidWriteRoleRef = Production
              DcmDspDidWriteRoleRef = After_Sales_ENHANCED
            DcmDspDidRead:  # COVERS: PLAIN_TEXT ARCH_SW_DIA_0096
              DcmDspDidReadSessionRef = DcmDspSession/Default
              DcmDspDidReadSessionRef = DcmDspSession/Extended
              DcmDspDidReadSessionRef = Development
              DcmDspDidReadRoleRef = Supplier
              DcmDspDidReadRoleRef = Development_ENHANCED
              DcmDspDidReadRoleRef = Production
              DcmDspDidReadRoleRef = After_Sales_ENHANCED
              DcmDspDidReadRoleRef = After_Sales_STANDARD
              DcmDspDidReadRoleRef = After_Sales_BASIC
              DcmDspDidReadRoleRef = Internal_Diagnostic_Test_Tool
              DcmDspDidReadRoleRef = ePTI_Test_Tool
        Trust_model_Intermediate_CA_certificate_Read_Trust_model_Intermediate_CA_Certificate (DcmDspData):
          DcmDspDataSize = 8016
          DcmDspDataType = UINT8_N
          DcmDspDataUsePort = USE_DATA_ASYNCH_CLIENT_SERVER
          DcmDspDataInfoRef = Info_Trust_model_Intermediate_CA_certificate_Read_Trust_model_Intermediate_CA_Certificate
        DID_SoftwareSupplier_Read (DcmDspDid):
          DcmDspDidIdentifier = 61781
          DcmDspDidUsed = true
          DcmDspDidUsePort = USE_DATA_ELEMENT_SPECIFIC_INTERFACES
          DcmDspDidInfoRef = DidInfo_SoftwareSupplier_Read
          Software_Logical_Block_Supplier_Identification (DcmDspDidSignal): DcmDspDidDataPos=0, DcmDspDidDataRef=SoftwareSupplier_Read_Software_Logical_Block_Supplier_Identification
        Info_BootSoftwareVersion_Read_Boot_SW_patch_level (DcmDspDataInfo): DcmDspDataFixedLength=true
        Backend_CA_Certificate_Read_Backend_CA_Certificate (DcmDspData):
          DcmDspDataSize = 8016
          DcmDspDataType = UINT8_N
          DcmDspDataUsePort = USE_DATA_ASYNCH_CLIENT_SERVER
          DcmDspDataInfoRef = Info_Backend_CA_Certificate_Read_Backend_CA_Certificate
        RoutineInfo_Replace_Trust_model_Certificates_Start (DcmDspRoutineInfo)
          DcmDspStartRoutineIn
            Trust_Certificates (DcmDspStartRoutineInSignal): DcmDspRoutineSignalLength=24048, DcmDspRoutineSignalType=VARIABLE_LENGTH, DcmDspRoutineSignalEndianness=opaque, DcmDspRoutineSignalPos=0
          DcmDspRoutineAuthorization:
            DcmDspRoutineSessionRef = DcmDspSession/Programming
            DcmDspRoutineSessionRef = DcmDspSession/Extended
            DcmDspRoutineSessionRef = Development
            DcmDspRoutineRoleRef = Supplier
            DcmDspRoutineRoleRef = Development_ENHANCED
            DcmDspRoutineRoleRef = Production
            DcmDspRoutineRoleRef = After_Sales_ENHANCED
          DcmDspStartRoutineOut
            Verification_Result (DcmDspStartRoutineOutSignal): DcmDspRoutineSignalLength=8, DcmDspRoutineSignalType=UINT8, DcmDspRoutineSignalPos=8
            routineInfo (DcmDspStartRoutineOutSignal): DcmDspRoutineSignalLength=8, DcmDspRoutineSignalType=UINT8, DcmDspRoutineSignalPos=0
        DID_Customer_Settings_Read (DcmDspDid):
          DcmDspDidIdentifier = 312
          DcmDspDidUsed = true
          DcmDspDidUsePort = USE_DATA_ELEMENT_SPECIFIC_INTERFACES
          DcmDspDidInfoRef = DidInfo_Customer_Settings_Read
          BltSlckDec_Md_Stat (DcmDspDidSignal): DcmDspDidDataPos=0, DcmDspDidDataRef=Customer_Settings_Read_BltSlckDec_Md_Stat
          PS_Curve_Stat (DcmDspDidSignal): DcmDspDidDataPos=8, DcmDspDidDataRef=Customer_Settings_Read_PS_Curve_Stat
        Diagnostic_Trace_Memory_Read_Diagnostic_Trace_Memory (DcmDspData):
          DcmDspDataSize = 96
          DcmDspDataType = UINT8_N
          DcmDspDataUsePort = USE_DATA_ASYNCH_CLIENT_SERVER
          DcmDspDataInfoRef = Info_Diagnostic_Trace_Memory_Read_Diagnostic_Trace_Memory
        DID_DDS_Package_Release_Read (DcmDspDid):
          DcmDspDidIdentifier = 61709
          DcmDspDidUsed = true
          DcmDspDidUsePort = USE_DATA_ELEMENT_SPECIFIC_INTERFACES
          DcmDspDidInfoRef = DidInfo_DDS_Package_Release_Read
          4 x DcmDspDidSignal:
            DDS_Package_Release_of_Boot_Software_Month_Boot: DcmDspDidDataPos=24, DcmDspDidDataRef=DDS_Package_Release_Read_DDS_Package_Release_of_Boot_Software_Month_Boot
            DDS_Package_Release_of_Application_Software_Year_Appl: DcmDspDidDataPos=0, DcmDspDidDataRef=DDS_Package_Release_Read_DDS_Package_Release_of_Application_Software_Year_Appl
            DDS_Package_Release_of_Application_Software_Month_Appl: DcmDspDidDataPos=8, DcmDspDidDataRef=DDS_Package_Release_Read_DDS_Package_Release_of_Application_Software_Month_Appl
            DDS_Package_Release_of_Boot_Software_Year_Boot: DcmDspDidDataPos=16, DcmDspDidDataRef=DDS_Package_Release_Read_DDS_Package_Release_of_Boot_Software_Year_Boot
        DID_Security_Event_Log_Current_Counter_Values_Read (DcmDspDid):
          DcmDspDidIdentifier = 400
          DcmDspDidUsed = true
          DcmDspDidUsePort = USE_DATA_ELEMENT_SPECIFIC_INTERFACES
          DcmDspDidInfoRef = DidInfo_Security_Event_Log_Current_Counter_Values_Read
          Security_Event_Log_Current_Counter_Values (DcmDspDidSignal): DcmDspDidDataPos=0, DcmDspDidDataRef=Security_Event_Log_Current_Counter_Values_Read_Security_Event_Log_Current_Counter_Values
        ECU_Extract_Version_Read_ECU_Extract_Major_Version (DcmDspData):
          DcmDspDataSize = 8
          DcmDspDataType = UINT8
          DcmDspDataUsePort = USE_DATA_ASYNCH_CLIENT_SERVER
          DcmDspDataConstantValue = 23
          DcmDspDataConstantValueType = HEX
          DcmDspDataInfoRef = Info_ECU_Extract_Version_Read_ECU_Extract_Major_Version
        Info_HardwareVersion_Read_HW_year (DcmDspDataInfo): DcmDspDataFixedLength=true
        RoutineInfo_Reset_VINDataIdentifier_Start (DcmDspRoutineInfo)
          DcmDspRoutineAuthorization:
            DcmDspRoutineSessionRef = DcmDspSession/Extended
            DcmDspRoutineSessionRef = Development
            DcmDspRoutineRoleRef = Supplier
            DcmDspRoutineRoleRef = Development_ENHANCED
          DcmDspStartRoutineOut
            routineInfo (DcmDspStartRoutineOutSignal): DcmDspRoutineSignalLength=8, DcmDspRoutineSignalType=UINT8, DcmDspRoutineSignalPos=0
        Info_Root_CA_Certificate_Read_Root_CA_Certificate (DcmDspDataInfo): DcmDspDataFixedLength=false
        RoutineInfo_Authenticate_Diagnostic_User_or_Tester_Start (DcmDspRoutineInfo)
          DcmDspStartRoutineIn
            3 x DcmDspStartRoutineInSignal:
              Tester_Authentication: DcmDspRoutineSignalLength=32032, DcmDspRoutineSignalType=VARIABLE_LENGTH, DcmDspRoutineSignalEndianness=opaque, DcmDspRoutineSignalPos=16
              Configuration: DcmDspRoutineSignalLength=8, DcmDspRoutineSignalType=UINT8, DcmDspRoutineSignalPos=0
              Task: DcmDspRoutineSignalLength=8, DcmDspRoutineSignalType=UINT8, DcmDspRoutineSignalPos=8
          DcmDspRoutineAuthorization
          DcmDspStartRoutineOut
            3 x DcmDspStartRoutineOutSignal:
              Verification_Result: DcmDspRoutineSignalLength=8, DcmDspRoutineSignalType=UINT8, DcmDspRoutineSignalPos=8
              routineInfo: DcmDspRoutineSignalLength=8, DcmDspRoutineSignalType=UINT8, DcmDspRoutineSignalPos=0
              Authentication_Result: DcmDspRoutineSignalLength=24048, DcmDspRoutineSignalType=VARIABLE_LENGTH, DcmDspRoutineSignalEndianness=opaque, DcmDspRoutineSignalPos=16
        SoftwareVersion_Read_Software_Logical_Block_Version_Information (DcmDspData):
          DcmDspDataSize = 3048
          DcmDspDataType = UINT8_N
          DcmDspDataUsePort = USE_DATA_ASYNCH_CLIENT_SERVER
          DcmDspDataInfoRef = Info_SoftwareVersion_Read_Software_Logical_Block_Version_Information
        Info_Current_Operating_Time_Read_Operating_Time_Status (DcmDspDataInfo): DcmDspDataFixedLength=true
        Info_Vehicle_Equipment_Read_Ueberspannungsbereichsschwelle (DcmDspDataInfo): DcmDspDataFixedLength=true
        DID_Supported_configuration_mechanisms_Read (DcmDspDid):
          DcmDspDidIdentifier = 61745
          DcmDspDidUsed = true
          DcmDspDidUsePort = USE_DATA_ELEMENT_SPECIFIC_INTERFACES
          DcmDspDidInfoRef = DidInfo_Supported_configuration_mechanisms_Read
          Config_mechanisms (DcmDspDidSignal): DcmDspDidDataPos=0, DcmDspDidDataRef=Supported_configuration_mechanisms_Read_Config_mechanisms
        Standard_Application_SW_Package_Information_Read_Supplier_Identification (DcmDspData):
          DcmDspDataSize = 16
          DcmDspDataType = UINT16
          DcmDspDataUsePort = USE_DATA_ASYNCH_CLIENT_SERVER
          DcmDspDataInfoRef = Info_Standard_Application_SW_Package_Information_Read_Supplier_Identification
        3 x DcmDspDataInfo:
          Info_Vehicle_Odometer_in_Low_Resolution_Read_Vehicle_Odometer_in_Low_Resolution: DcmDspDataFixedLength=true
          Info_Trust_Model_Request_ephemeral_public_key_Read_Data_Signature: DcmDspDataFixedLength=true
          Info_Trust_model_Intermediate_CA_certificate_Read_Trust_model_Intermediate_CA_Certificate: DcmDspDataFixedLength=false
        DidInfo_PRE_SAFE_Recorder_1_read_Read (DcmDspDidInfo)
          DcmDspDidAccess
            DcmDspDidWrite:
              DcmDspDidWriteSessionRef = DcmDspSession/Extended
              DcmDspDidWriteSessionRef = Development
              DcmDspDidWriteRoleRef = Supplier
              DcmDspDidWriteRoleRef = Development_ENHANCED
              DcmDspDidWriteRoleRef = Production
              DcmDspDidWriteRoleRef = After_Sales_ENHANCED
              DcmDspDidWriteRoleRef = After_Sales_STANDARD
            DcmDspDidRead:
              DcmDspDidReadSessionRef = DcmDspSession/Default
              DcmDspDidReadSessionRef = DcmDspSession/Extended
              DcmDspDidReadSessionRef = Development
              DcmDspDidReadRoleRef = Supplier
              DcmDspDidReadRoleRef = Development_ENHANCED
              DcmDspDidReadRoleRef = Production
              DcmDspDidReadRoleRef = After_Sales_ENHANCED
              DcmDspDidReadRoleRef = After_Sales_STANDARD
              DcmDspDidReadRoleRef = After_Sales_BASIC
              DcmDspDidReadRoleRef = Internal_Diagnostic_Test_Tool
              DcmDspDidReadRoleRef = ePTI_Test_Tool
        Info_HardwareVersion_Read_HW_week (DcmDspDataInfo): DcmDspDataFixedLength=true
        DID_Calibration_Identifications_CAL_ID_Read (DcmDspDid):
          DcmDspDidIdentifier = 57604
          DcmDspDidUsed = true
          DcmDspDidUsePort = USE_DATA_ELEMENT_SPECIFIC_INTERFACES
          DcmDspDidInfoRef = DidInfo_Calibration_Identifications_CAL_ID_Read
          Calibration_Identification (DcmDspDidSignal): DcmDspDidDataPos=0, DcmDspDidDataRef=Calibration_Identifications_CAL_ID_Read_Calibration_Identification
        SSA_Version_Information_Read_SSA_Major_Version (DcmDspData):
          DcmDspDataSize = 8
          DcmDspDataType = UINT8
          DcmDspDataUsePort = USE_DATA_ASYNCH_CLIENT_SERVER
          DcmDspDataInfoRef = Info_SSA_Version_Information_Read_SSA_Major_Version
        Current_Operating_Time_Read_Operating_Time_Status (DcmDspData):
          DcmDspDataSize = 8
          DcmDspDataType = UINT8
          DcmDspDataUsePort = USE_DATA_ASYNCH_CLIENT_SERVER
          DcmDspDataInfoRef = Info_Current_Operating_Time_Read_Operating_Time_Status
        DID_CAN_input_Read (DcmDspDid): DcmDspDidIdentifier=512, DcmDspDidUsed=true, DcmDspDidUsePort=USE_DATA_ELEMENT_SPECIFIC_INTERFACES, DcmDspDidInfoRef=DidInfo_CAN_input_Read
          9 x DcmDspDidSignal:
            Neues_Bitfeld_6: DcmDspDidDataPos=48, DcmDspDidDataRef=CAN_input_Read_Neues_Bitfeld_6
            Neues_Bitfeld_5: DcmDspDidDataPos=40, DcmDspDidDataRef=CAN_input_Read_Neues_Bitfeld_5
            Neues_Bitfeld_4: DcmDspDidDataPos=24, DcmDspDidDataRef=CAN_input_Read_Neues_Bitfeld_4
            Neues_Bitfeld_3: DcmDspDidDataPos=16, DcmDspDidDataRef=CAN_input_Read_Neues_Bitfeld_3
            Supply_battery_voltage: DcmDspDidDataPos=32, DcmDspDidDataRef=CAN_input_Read_Supply_battery_voltage
            Neues_Bitfeld_2: DcmDspDidDataPos=8, DcmDspDidDataRef=CAN_input_Read_Neues_Bitfeld_2
            Neues_Bitfeld_1: DcmDspDidDataPos=0, DcmDspDidDataRef=CAN_input_Read_Neues_Bitfeld_1
            Neues_Bitfeld_8: DcmDspDidDataPos=64, DcmDspDidDataRef=CAN_input_Read_Neues_Bitfeld_8
            Neues_Bitfeld_7: DcmDspDidDataPos=56, DcmDspDidDataRef=CAN_input_Read_Neues_Bitfeld_7
        Diagnostic_Extract_Version_Read_Diagnostic_Extract_Minor_Version (DcmDspData):
          DcmDspDataSize = 8
          DcmDspDataType = UINT8
          DcmDspDataUsePort = USE_DATA_ASYNCH_CLIENT_SERVER
          DcmDspDataInfoRef = Info_Diagnostic_Extract_Version_Read_Diagnostic_Extract_Minor_Version
        Info_Access_Control_List_Version_Read_ECU_indvidual_ACL_Hash (DcmDspDataInfo): DcmDspDataFixedLength=true
        Root_CA_Certificate_Read_Root_CA_Certificate (DcmDspData):
          DcmDspDataSize = 8016
          DcmDspDataType = UINT8_N
          DcmDspDataUsePort = USE_DATA_ASYNCH_CLIENT_SERVER
          DcmDspDataInfoRef = Info_Root_CA_Certificate_Read_Root_CA_Certificate
        DID_SecOC_Vehicle_Shared_Secret_Hash_Read (DcmDspDid):
          DcmDspDidIdentifier = 393
          DcmDspDidUsed = true
          DcmDspDidUsePort = USE_DATA_ELEMENT_SPECIFIC_INTERFACES
          DcmDspDidInfoRef = DidInfo_SecOC_Vehicle_Shared_Secret_Hash_Read
          SecOC_Vehicle_Shared_Secret_Hash (DcmDspDidSignal): DcmDspDidDataPos=0, DcmDspDidDataRef=SecOC_Vehicle_Shared_Secret_Hash_Read_SecOC_Vehicle_Shared_Secret_Hash
        Diagnostic_Extract_Version_Read_DDM_Version (DcmDspData):
          DcmDspDataSize = 80
          DcmDspDataType = UINT8_N
          DcmDspDataUsePort = USE_DATA_ASYNCH_CLIENT_SERVER
          DcmDspDataInfoRef = Info_Diagnostic_Extract_Version_Read_DDM_Version
        Info_Access_Control_List_Version_Read_Basic_ACL_Version_Candela_File_Version_Patch (DcmDspDataInfo): DcmDspDataFixedLength=true
        DID_Trust_model_ECU_CSR_Read (DcmDspDid):
          DcmDspDidIdentifier = 410
          DcmDspDidUsed = true
          DcmDspDidUsePort = USE_DATA_ELEMENT_SPECIFIC_INTERFACES
          DcmDspDidInfoRef = DidInfo_Trust_model_ECU_CSR_Read
          Trust_model_ECU_CSR (DcmDspDidSignal): DcmDspDidDataPos=0, DcmDspDidDataRef=Trust_model_ECU_CSR_Read_Trust_model_ECU_CSR
        ReadFingerprint_Read_Software_Fingerprint_s (DcmDspData):
          DcmDspDataSize = 20320
          DcmDspDataType = UINT8_N
          DcmDspDataUsePort = USE_DATA_ASYNCH_CLIENT_SERVER
          DcmDspDataInfoRef = Info_ReadFingerprint_Read_Software_Fingerprint_s
        DID_Root_CA_Certificate_Read (DcmDspDid):
          DcmDspDidIdentifier = 384
          DcmDspDidUsed = true
          DcmDspDidUsePort = USE_DATA_ELEMENT_SPECIFIC_INTERFACES
          DcmDspDidInfoRef = DidInfo_Root_CA_Certificate_Read
          Root_CA_Certificate (DcmDspDidSignal): DcmDspDidDataPos=0, DcmDspDidDataRef=Root_CA_Certificate_Read_Root_CA_Certificate
        SSA_Version_Information_Read_SSA_Patch_Level (DcmDspData):
          DcmDspDataSize = 8
          DcmDspDataType = UINT8
          DcmDspDataUsePort = USE_DATA_ASYNCH_CLIENT_SERVER
          DcmDspDataInfoRef = Info_SSA_Version_Information_Read_SSA_Patch_Level
        Standard_Application_SW_Package_Information_Read_Standard_Application_SW_Package_Major_Version (DcmDspData):
          DcmDspDataSize = 8
          DcmDspDataType = UINT8
          DcmDspDataUsePort = USE_DATA_ASYNCH_CLIENT_SERVER
          DcmDspDataInfoRef = Info_Standard_Application_SW_Package_Information_Read_Standard_Application_SW_Package_Major_Version
        Routine_Reset_VINDataIdentifier_Start (DcmDspRoutine):
          DcmDspRequestResultsRoutineSupported = false
          DcmDspStopRoutineSupported = false
          DcmDspRoutineIdentifier = 530
          DcmDspRoutineFixedLength = false
          DcmDspRoutineUsePort = true
          DcmDspRoutineUsed = true
          DcmDspRoutineInfoRef = RoutineInfo_Reset_VINDataIdentifier_Start
        Security_Event_Log_Read_Security_Event_Log (DcmDspData):
          DcmDspDataSize = 32736
          DcmDspDataType = UINT8_N
          DcmDspDataUsePort = USE_DATA_ASYNCH_CLIENT_SERVER
          DcmDspDataInfoRef = Info_Security_Event_Log_Read_Security_Event_Log
        DID_ECUSerialNumberDataIdentifier_Read (DcmDspDid):
          DcmDspDidIdentifier = 61836
          DcmDspDidUsed = true
          DcmDspDidUsePort = USE_DATA_ELEMENT_SPECIFIC_INTERFACES
          DcmDspDidInfoRef = DidInfo_ECUSerialNumberDataIdentifier_Read
          ECU_Serial_Number (DcmDspDidSignal): DcmDspDidDataPos=0, DcmDspDidDataRef=ECUSerialNumberDataIdentifier_Read_ECU_Serial_Number
        CAN_output_Read_CANoutput1 (DcmDspData): DcmDspDataSize=8, DcmDspDataType=UINT8, DcmDspDataUsePort=USE_DATA_ASYNCH_CLIENT_SERVER, DcmDspDataInfoRef=Info_CAN_output_Read_CANoutput1
        DID_VIN_Status_Read (DcmDspDid): DcmDspDidIdentifier=398, DcmDspDidUsed=true, DcmDspDidUsePort=USE_DATA_ELEMENT_SPECIFIC_INTERFACES, DcmDspDidInfoRef=DidInfo_VIN_Status_Read
          VIN_Lock_Status (DcmDspDidSignal): DcmDspDidDataPos=8, DcmDspDidDataRef=VIN_Status_Read_VIN_Lock_Status
          VIN_Status (DcmDspDidSignal): DcmDspDidDataPos=0, DcmDspDidDataRef=VIN_Status_Read_VIN_Status
        DidInfo_PRE_SAFE_Counter_read_Read (DcmDspDidInfo)
          DcmDspDidAccess
            DcmDspDidWrite:
              DcmDspDidWriteSessionRef = DcmDspSession/Extended
              DcmDspDidWriteSessionRef = Development
              DcmDspDidWriteRoleRef = Supplier
              DcmDspDidWriteRoleRef = Development_ENHANCED
              DcmDspDidWriteRoleRef = Production
              DcmDspDidWriteRoleRef = After_Sales_ENHANCED
              DcmDspDidWriteRoleRef = After_Sales_STANDARD
            DcmDspDidRead:  # COVERS: PLAIN_TEXT ARCH_SW_DIA_0076
              DcmDspDidReadSessionRef = DcmDspSession/Default
              DcmDspDidReadSessionRef = DcmDspSession/Extended
              DcmDspDidReadSessionRef = Development
              DcmDspDidReadRoleRef = Supplier
              DcmDspDidReadRoleRef = Development_ENHANCED
              DcmDspDidReadRoleRef = Production
              DcmDspDidReadRoleRef = After_Sales_ENHANCED
              DcmDspDidReadRoleRef = After_Sales_STANDARD
              DcmDspDidReadRoleRef = After_Sales_BASIC
              DcmDspDidReadRoleRef = Internal_Diagnostic_Test_Tool
              DcmDspDidReadRoleRef = ePTI_Test_Tool
        RoutineInfo_Enhance_Access_Rights_Start (DcmDspRoutineInfo)
          DcmDspStartRoutineIn
            Enhanced_Rights_Certificate (DcmDspStartRoutineInSignal): DcmDspRoutineSignalLength=16016, DcmDspRoutineSignalType=VARIABLE_LENGTH, DcmDspRoutineSignalEndianness=opaque, DcmDspRoutineSignalPos=0
          DcmDspRoutineAuthorization:
            DcmDspRoutineRoleRef = Supplier
            DcmDspRoutineRoleRef = Development_ENHANCED
            DcmDspRoutineRoleRef = Production
            DcmDspRoutineRoleRef = After_Sales_ENHANCED
            DcmDspRoutineRoleRef = After_Sales_STANDARD
            DcmDspRoutineRoleRef = After_Sales_BASIC
            DcmDspRoutineRoleRef = Internal_Diagnostic_Test_Tool
            DcmDspRoutineRoleRef = ePTI_Test_Tool
          DcmDspStartRoutineOut
            Verification_Result (DcmDspStartRoutineOutSignal): DcmDspRoutineSignalLength=8, DcmDspRoutineSignalType=UINT8, DcmDspRoutineSignalPos=8
            routineInfo (DcmDspStartRoutineOutSignal): DcmDspRoutineSignalLength=8, DcmDspRoutineSignalType=UINT8, DcmDspRoutineSignalPos=0
        ECU_Extract_Version_Read_ECU_Extract_Information_Checksum (DcmDspData):
          DcmDspDataSize = 320
          DcmDspDataType = UINT8_N
          DcmDspDataUsePort = USE_DATA_ASYNCH_CLIENT_SERVER
          DcmDspDataConstantValue = F060001286ACD0F8241614C6F50B33BF52CCF849
          DcmDspDataConstantValueType = HEX
          DcmDspDataInfoRef = Info_ECU_Extract_Version_Read_ECU_Extract_Information_Checksum
        4 x DcmDspDataInfo, all with DcmDspDataFixedLength=true:
          Info_ECU_Extract_Version_Read_ECU_Extract_Information_ECU_Name
          Info_DDS_Package_Release_Read_DDS_Package_Release_of_Application_Software_Month_Appl
          Info_VIN_Status_Read_VIN_Status
          Info_BootSoftwareVersion_Read_Boot_SW_week
        DID_Release_Cycles_BSR_and_PreSafe_Read (DcmDspDid):
          DcmDspDidIdentifier = 769
          DcmDspDidUsed = true
          DcmDspDidUsePort = USE_DATA_ELEMENT_SPECIFIC_INTERFACES
          DcmDspDidInfoRef = DidInfo_Release_Cycles_BSR_and_PreSafe_Read
          CombinedSignal (DcmDspDidSignal): DcmDspDidDataPos=0, DcmDspDidDataRef=Release_Cycles_BSR_and_PreSafe_Read_CombinedSignal
        Info_PRE_SAFE_Counter_read_Read_CombinedDataElement (DcmDspDataInfo): DcmDspDataFixedLength=false
        DDS_Package_Release_Read_DDS_Package_Release_of_Boot_Software_Month_Boot (DcmDspData):
          DcmDspDataSize = 8
          DcmDspDataType = UINT8
          DcmDspDataUsePort = USE_DATA_ASYNCH_CLIENT_SERVER
          DcmDspDataInfoRef = Info_DDS_Package_Release_Read_DDS_Package_Release_of_Boot_Software_Month_Boot
        DID_Status_SSA_Pre_Compile_Switches_Read (DcmDspDid):
          DcmDspDidIdentifier = 407
          DcmDspDidUsed = true
          DcmDspDidUsePort = USE_DATA_ELEMENT_SPECIFIC_INTERFACES
          DcmDspDidInfoRef = DidInfo_Status_SSA_Pre_Compile_Switches_Read
          Precompile_switch (DcmDspDidSignal): DcmDspDidDataPos=0, DcmDspDidDataRef=Status_SSA_Pre_Compile_Switches_Read_Precompile_switch
        Diagnostic_Extract_Version_Read_Diagnostic_Extract_Patch_Version (DcmDspData):
          DcmDspDataSize = 8
          DcmDspDataType = UINT8
          DcmDspDataUsePort = USE_DATA_ASYNCH_CLIENT_SERVER
          DcmDspDataInfoRef = Info_Diagnostic_Extract_Version_Read_Diagnostic_Extract_Patch_Version
        RoutineInfo_Synchronize_to_Non_volatile_Memory_Start (DcmDspRoutineInfo)
          DcmDspRoutineRequestResOut
            routineInfo (DcmDspRoutineRequestResOutSignal): DcmDspRoutineSignalLength=8, DcmDspRoutineSignalType=UINT8, DcmDspRoutineSignalPos=0
          DcmDspRoutineAuthorization:
            DcmDspRoutineSessionRef = DcmDspSession/Extended
            DcmDspRoutineSessionRef = Development
            DcmDspRoutineRoleRef = Supplier
            DcmDspRoutineRoleRef = Development_ENHANCED
            DcmDspRoutineRoleRef = Production
            DcmDspRoutineRoleRef = After_Sales_ENHANCED
            DcmDspRoutineRoleRef = After_Sales_STANDARD
          DcmDspRoutineStopOut
            routineInfo (DcmDspRoutineStopOutSignal): DcmDspRoutineSignalLength=8, DcmDspRoutineSignalType=UINT8, DcmDspRoutineSignalPos=0
          DcmDspStartRoutineOut
            routineInfo (DcmDspStartRoutineOutSignal): DcmDspRoutineSignalLength=8, DcmDspRoutineSignalType=UINT8, DcmDspRoutineSignalPos=0
        MercedesCarGroupSoftware_Read_Software_Logical_Block_Numbers (DcmDspData):
          DcmDspDataSize = 10160
          DcmDspDataType = UINT8_N
          DcmDspDataUsePort = USE_DATA_ASYNCH_CLIENT_SERVER
          DcmDspDataInfoRef = Info_MercedesCarGroupSoftware_Read_Software_Logical_Block_Numbers
        Info_ECU_Extract_Version_Read_ECU_Extract_Information_XDIS_Version (DcmDspDataInfo): DcmDspDataFixedLength=true
        DID_PRE_SAFE_Recorder_2_read_Read (DcmDspDid):
          DcmDspDidIdentifier = 578
          DcmDspDidUsed = true
          DcmDspDidUsePort = USE_DATA_ELEMENT_SPECIFIC_INTERFACES
          DcmDspDidInfoRef = DidInfo_PRE_SAFE_Recorder_2_read_Read
          CombinedDataElement (DcmDspDidSignal): DcmDspDidDataPos=0, DcmDspDidDataRef=PRE_SAFE_Recorder_2_read_Read_CombinedDataElement
        Info_ZZZ_Vehicle_Equipment_Development_Read_Zykluszeit_Messtechnik (DcmDspDataInfo): DcmDspDataFixedLength=true
        DidInfo_Seatbelt_Serial_Number_Read (DcmDspDidInfo)
          DcmDspDidAccess
            DcmDspDidRead:  # COVERS: PLAIN_TEXT ARCH_SW_DIA_0054
              DcmDspDidReadRoleRef = Supplier
              DcmDspDidReadRoleRef = Development_ENHANCED
              DcmDspDidReadRoleRef = Production
              DcmDspDidReadRoleRef = After_Sales_ENHANCED
              DcmDspDidReadRoleRef = After_Sales_STANDARD
              DcmDspDidReadRoleRef = After_Sales_BASIC
              DcmDspDidReadRoleRef = Internal_Diagnostic_Test_Tool
              DcmDspDidReadRoleRef = ePTI_Test_Tool
            DcmDspDidWrite: DcmDspDidWriteSessionRef=Development, DcmDspDidWriteRoleRef=Supplier, DcmDspDidWriteRoleRef=Development_ENHANCED, DcmDspDidWriteRoleRef=Production  # COVERS: PLAIN_TEXT ARCH_SW_DIA_0056
        Routine_Enhance_Access_Rights_Start (DcmDspRoutine):
          DcmDspRequestResultsRoutineSupported = false
          DcmDspStopRoutineSupported = false
          DcmDspRoutineIdentifier = 609
          DcmDspRoutineFixedLength = false
          DcmDspRoutineUsePort = true
          DcmDspRoutineUsed = true
          DcmDspRoutineInfoRef = RoutineInfo_Enhance_Access_Rights_Start
        Info_MercedesCarGroupSoftware_Read_Software_Logical_Block_Numbers (DcmDspDataInfo): DcmDspDataFixedLength=false
        DID_BSR_Counter_read_Read (DcmDspDid): DcmDspDidIdentifier=579, DcmDspDidUsed=true, DcmDspDidUsePort=USE_DATA_ELEMENT_SPECIFIC_INTERFACES, DcmDspDidInfoRef=DidInfo_BSR_Counter_read_Read
          BSR_Counter (DcmDspDidSignal): DcmDspDidDataPos=0, DcmDspDidDataRef=BSR_Counter_read_Read_BSR_Counter
        Info_Internal_ECU_information_Read_Autosar_System_State_EcuM_State (DcmDspDataInfo): DcmDspDataFixedLength=true
        Access_Control_List_Version_Read_ECU_indvidual_ACL_Version_Candela_File_Version_Patch (DcmDspData):
          DcmDspDataSize = 8
          DcmDspDataType = UINT8
          DcmDspDataUsePort = USE_DATA_ASYNCH_CLIENT_SERVER
          DcmDspDataInfoRef = Info_Access_Control_List_Version_Read_ECU_indvidual_ACL_Version_Candela_File_Version_Patch
        Info_HardwareSupplier_Read_Hardware_Supplier_Identification (DcmDspDataInfo): DcmDspDataFixedLength=true
        Info_BootSoftwareVersion_Read_Boot_SW_year (DcmDspDataInfo): DcmDspDataFixedLength=true
        Routine_Trust_Model_SecOC_ECU_Shared_Secret_Distribution_Start (DcmDspRoutine):
          DcmDspRequestResultsRoutineSupported = false
          DcmDspStopRoutineSupported = false
          DcmDspRoutineIdentifier = 633
          DcmDspRoutineFixedLength = false
          DcmDspRoutineUsePort = true
          DcmDspRoutineUsed = true
          DcmDspRoutineInfoRef = RoutineInfo_Trust_Model_SecOC_ECU_Shared_Secret_Distribution_Start
