AUTOSAR XML (schema 00049)
package /Icu
  module config Icu: implementation-config-variant=VARIANT-POST-BUILD, module-description=Icu_Impl
    CommonPublishedInformation:
      ArMajorVersion = 4
      ArMinorVersion = 4
      ArPatchVersion = 0
      ModuleId = 122
      Release = _TRICORE_TC332
      SwMajorVersion = 20
      SwMinorVersion = 0
      SwPatchVersion = 1
      VendorApiInfix = TimerIp
      VendorId = 17
    IcuConfigSet: IcuMaxChannel=1
      SignalMeas (IcuChannel):
        IcuAssignedHwUnit = CCU6
        IcuChannelId = 0
        IcuDefaultStartEdge = ICU_RISING_EDGE
        IcuMeasurementMode = ICU_MODE_SIGNAL_MEASUREMENT
        IcuTimeoutFeature = TIMEOUT_DISABLED
        IcuWakeupCapability = false
        CCU6CC6Configuration_0 (CCU6CC6Configuration): CCChannelInputSelection=CCINB_PORT2_PIN0, Cc6xChannel=Cc60, CCU6KernelUsed=McuCcu6ModuleAllocationConf_1
          CCU6xParameters: CCU6InterruptNode=NODE_SR0, T12ClkSelection=7, T12PrescalerEnabled=false
        IcuSignalMeasurement_0 (IcuSignalMeasurement): IcuSignalMeasurementProperty=ICU_DUTY_CYCLE
    IcuGeneral:
      IcuDevErrorDetect = false
      IcuInitDeInitApiMode = ICU_MCAL_SUPERVISOR
      IcuMultiCoreErrorDetect = false
      IcuReportWakeupSource = false
      IcuRunTimeErrorDetect = false
      IcuRuntimeApiMode = ICU_MCAL_SUPERVISOR
      IcuSafetyEnable = false
    IcuOptionalApis:
      IcuDeInitApi = false
      IcuDisableWakeupApi = false
      IcuEdgeCountApi = false
      IcuEdgeDetectApi = false
      IcuEnableWakeupApi = false
      IcuGetDutyCycleValuesApi = true
      IcuGetInputStateApi = false
      IcuGetTimeElapsedApi = false
      IcuGetVersionInfoApi = false
      IcuIncrementalInterfaceApi = false
      IcuInitCheckApi = false
      IcuSetModeApi = false
      IcuSignalMeasurementApi = true
      IcuTimeoutDetectionApi = false
      IcuTimestampApi = false
      IcuWakeupFunctionalityApi = false
