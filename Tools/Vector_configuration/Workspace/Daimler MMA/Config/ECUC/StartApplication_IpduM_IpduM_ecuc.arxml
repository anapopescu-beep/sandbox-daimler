AUTOSAR XML (schema 00049)
package /ActiveEcuC
  module config IpduM: implementation-config-variant=VARIANT-PRE-COMPILE, module-description=IpduM_Impl
    IpduMPublishedInformation: IpduMRxDirectComInvocation=false
    IpduMGeneral:
      IpduMHeaderByteOrder = IPDUM_BIG_ENDIAN
      IpduMStaticPartExists = false
      IpduMConfigurationTimeBase = 0.005
      IpduMRxTimeBase = 0.005
      IpduMTxTimeBase = 0.005
      IpduMDevErrorDetect = false
      IpduMVersionInfoApi = false
      IpduMSafeBswChecks = true
    IpduMConfig
      ADAS_PREDICTION_ST3_549e2a63_Rx (IpduMRxPathway)
        IpduMRxIndication_33e88c66 (IpduMRxIndication): IpduMByteOrder=LITTLE_ENDIAN, IpduMRxHandleId=0, IpduMRxIndicationPduRef=ADAS_PREDICTION_ST3_549e2a63_Rx
          ADAS_PREDICTION_ST3_aeaf2bf1 (IpduMRxDynamicPart): IpduMRxSelectorValue=6, IpduMOutgoingDynamicPduRef=ADAS_PREDICTION_ST3_6_262b63d1_Rx
            IpduMSegment_0 (IpduMSegment): IpduMSegmentLength=64, IpduMSegmentPosition=0
          IpduMSelectorFieldPosition: IpduMSelectorFieldLength=3, IpduMSelectorFieldPosition=0
          ADAS_PREDICTION_ST3_d9a81b67 (IpduMRxDynamicPart): IpduMRxSelectorValue=7, IpduMOutgoingDynamicPduRef=ADAS_PREDICTION_ST3_7_512c5347_Rx
            IpduMSegment_0 (IpduMSegment): IpduMSegmentLength=64, IpduMSegmentPosition=0
      ADAS_PROFILE_SHORT_ST3_2225c4a7_Rx (IpduMRxPathway)
        IpduMRxIndication_17ccd7a3 (IpduMRxIndication): IpduMByteOrder=LITTLE_ENDIAN, IpduMRxHandleId=1, IpduMRxIndicationPduRef=ADAS_PROFILE_SHORT_ST3_2225c4a7_Rx
          ADAS_PROFILE_SHORT_ST3_42520299 (IpduMRxDynamicPart): IpduMRxSelectorValue=31, IpduMOutgoingDynamicPduRef=ADAS_PROFILE_SHORT_ST3_31_05b1585f_Rx
            IpduMSegment_0 (IpduMSegment): IpduMSegmentLength=64, IpduMSegmentPosition=0
          ADAS_PROFILE_SHORT_ST3_01fee412 (IpduMRxDynamicPart): IpduMRxSelectorValue=1, IpduMOutgoingDynamicPduRef=ADAS_PROFILE_SHORT_ST3_1_506b5dfc_Rx
            IpduMSegment_0 (IpduMSegment): IpduMSegmentLength=64, IpduMSegmentPosition=0
          IpduMSelectorFieldPosition: IpduMSelectorFieldLength=5, IpduMSelectorFieldPosition=27
    IpduMGeneration:
      IpduMOutOfBoundsWriteProtectionStrategy = NONE
      IpduMOutOfBoundsWriteSanitizer = false
      IpduMOutOfBoundsReadSanitizer = false
      IpduMReduceConstantData2Define = false
      IpduMBoolDataInArrayOfStructStrategy = BITMASKING
      IpduMDeduplicateIndirectedData = true
      IpduMDataDeduplicationStrategy = WITH_CAST
      IpduMReduceBoolDataByNegationThreshold = 2
      IpduMReduceBoolDataByNumericalComparisonThreshold = 2
      IpduMReduceBoolDataByNumericalRelationThreshold = 2
      IpduMReduceBoolDataByNumericalOperandStrategy = WITH_ANY_VALUE
      IpduMReduceNumericalDataByOffsetThreshold = 2
      IpduMReduceNumericalDataByArraySubtractionThreshold = 2
      IpduMReduceDataByStreaming = false
      IpduMShortSymbols = false
      IpduMInterfacesForDeactivatedData = false
      IpduMReferringKeysInComments = false
