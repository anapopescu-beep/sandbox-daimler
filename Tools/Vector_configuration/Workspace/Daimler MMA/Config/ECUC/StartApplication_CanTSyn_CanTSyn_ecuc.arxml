AUTOSAR XML (schema 00049)
package /ActiveEcuC
  module config CanTSyn: implementation-config-variant=VARIANT-PRE-COMPILE, module-description=CanTSyn_Impl
    CanTSynGeneral:
      CanTSynDevErrorDetect = false
      CanTSynMainFunctionPeriod = 0.005
      CanTSynVersionInfoApi = false
      CanTSynMessageCompatibility = AR_4_3_X
      CanTSynSafeBswChecks = true
    GTD_BODY3_0_14e64f11 (CanTSynGlobalTimeDomain):
      CanTSynGlobalTimeDomainId = 0
      CanTSynUseExtendedMsgFormat = false
      CanTSynSynchronizedTimeBaseRef = GTD_BODY3_0_14e64f11 if post-build-variant-condition{matching-criterion=SideAllocation, value=0}
      CanTSynSynchronizedTimeBaseRef = GTD_BODY3_0_14e64f11 if post-build-variant-condition{matching-criterion=SideAllocation, value=1}
      CanTSynGlobalTimeFupDataIDList
        16 x CanTSynGlobalTimeFupDataIDListElement:
          CanTSynGlobalTimeFupDataIDListElement_0: CanTSynGlobalTimeFupDataIDListIndex=0, CanTSynGlobalTimeFupDataIDListValue=143
          CanTSynGlobalTimeFupDataIDListElement_1: CanTSynGlobalTimeFupDataIDListIndex=1, CanTSynGlobalTimeFupDataIDListValue=78
          CanTSynGlobalTimeFupDataIDListElement_10: CanTSynGlobalTimeFupDataIDListIndex=10, CanTSynGlobalTimeFupDataIDListValue=246
          CanTSynGlobalTimeFupDataIDListElement_11: CanTSynGlobalTimeFupDataIDListIndex=11, CanTSynGlobalTimeFupDataIDListValue=181
          CanTSynGlobalTimeFupDataIDListElement_12: CanTSynGlobalTimeFupDataIDListIndex=12, CanTSynGlobalTimeFupDataIDListValue=116
          CanTSynGlobalTimeFupDataIDListElement_13: CanTSynGlobalTimeFupDataIDListIndex=13, CanTSynGlobalTimeFupDataIDListValue=51
          CanTSynGlobalTimeFupDataIDListElement_14: CanTSynGlobalTimeFupDataIDListIndex=14, CanTSynGlobalTimeFupDataIDListValue=237
          CanTSynGlobalTimeFupDataIDListElement_15: CanTSynGlobalTimeFupDataIDListIndex=15, CanTSynGlobalTimeFupDataIDListValue=172
          CanTSynGlobalTimeFupDataIDListElement_2: CanTSynGlobalTimeFupDataIDListIndex=2, CanTSynGlobalTimeFupDataIDListValue=13
          CanTSynGlobalTimeFupDataIDListElement_3: CanTSynGlobalTimeFupDataIDListIndex=3, CanTSynGlobalTimeFupDataIDListValue=199
          CanTSynGlobalTimeFupDataIDListElement_4: CanTSynGlobalTimeFupDataIDListIndex=4, CanTSynGlobalTimeFupDataIDListValue=134
          CanTSynGlobalTimeFupDataIDListElement_5: CanTSynGlobalTimeFupDataIDListIndex=5, CanTSynGlobalTimeFupDataIDListValue=69
          CanTSynGlobalTimeFupDataIDListElement_6: CanTSynGlobalTimeFupDataIDListIndex=6, CanTSynGlobalTimeFupDataIDListValue=4
          CanTSynGlobalTimeFupDataIDListElement_7: CanTSynGlobalTimeFupDataIDListIndex=7, CanTSynGlobalTimeFupDataIDListValue=190
          CanTSynGlobalTimeFupDataIDListElement_8: CanTSynGlobalTimeFupDataIDListIndex=8, CanTSynGlobalTimeFupDataIDListValue=125
          CanTSynGlobalTimeFupDataIDListElement_9: CanTSynGlobalTimeFupDataIDListIndex=9, CanTSynGlobalTimeFupDataIDListValue=60
      GTS_RBTM_FL_0_f14a8f52 (CanTSynGlobalTimeSlave):
        CanTSynGlobalTimeFollowUpTimeout = 0.25
        CanTSynGlobalTimeSequenceCounterJumpWidth = 3
        CanTSynRxCrcValidated = CRC_VALIDATED if post-build-variant-condition{matching-criterion=SideAllocation, value=0}
        CanTSynRxCrcValidated = CRC_VALIDATED if post-build-variant-condition{matching-criterion=SideAllocation, value=1}
        GTS_Main_CAN_ST3_dd88dcd5_Rx (CanTSynGlobalTimeSlavePdu):
          CanTSynGlobalTimeSlaveHandleId = 0
          CanTSynGlobalTimePduRef = GTS_Main_CAN_ST3_dd88dcd5_Rx if post-build-variant-condition{matching-criterion=SideAllocation, value=0}
          CanTSynGlobalTimePduRef = GTS_Main_CAN_ST3_dd88dcd5_Rx if post-build-variant-condition{matching-criterion=SideAllocation, value=1}
      CanTSynGlobalTimeSyncDataIDList
        16 x CanTSynGlobalTimeSyncDataIDListElement:
          CanTSynGlobalTimeSyncDataIDListElement_0: CanTSynGlobalTimeSyncDataIDListIndex=0, CanTSynGlobalTimeSyncDataIDListValue=225
          CanTSynGlobalTimeSyncDataIDListElement_1: CanTSynGlobalTimeSyncDataIDListIndex=1, CanTSynGlobalTimeSyncDataIDListValue=102
          CanTSynGlobalTimeSyncDataIDListElement_10: CanTSynGlobalTimeSyncDataIDListIndex=10, CanTSynGlobalTimeSyncDataIDListValue=250
          CanTSynGlobalTimeSyncDataIDListElement_11: CanTSynGlobalTimeSyncDataIDListIndex=11, CanTSynGlobalTimeSyncDataIDListValue=127
          CanTSynGlobalTimeSyncDataIDListElement_12: CanTSynGlobalTimeSyncDataIDListIndex=12, CanTSynGlobalTimeSyncDataIDListValue=4
          CanTSynGlobalTimeSyncDataIDListElement_13: CanTSynGlobalTimeSyncDataIDListIndex=13, CanTSynGlobalTimeSyncDataIDListValue=132
          CanTSynGlobalTimeSyncDataIDListElement_14: CanTSynGlobalTimeSyncDataIDListIndex=14, CanTSynGlobalTimeSyncDataIDListValue=9
          CanTSynGlobalTimeSyncDataIDListElement_15: CanTSynGlobalTimeSyncDataIDListIndex=15, CanTSynGlobalTimeSyncDataIDListValue=137
          CanTSynGlobalTimeSyncDataIDListElement_2: CanTSynGlobalTimeSyncDataIDListIndex=2, CanTSynGlobalTimeSyncDataIDListValue=230
          CanTSynGlobalTimeSyncDataIDListElement_3: CanTSynGlobalTimeSyncDataIDListIndex=3, CanTSynGlobalTimeSyncDataIDListValue=107
          CanTSynGlobalTimeSyncDataIDListElement_4: CanTSynGlobalTimeSyncDataIDListIndex=4, CanTSynGlobalTimeSyncDataIDListValue=235
          CanTSynGlobalTimeSyncDataIDListElement_5: CanTSynGlobalTimeSyncDataIDListIndex=5, CanTSynGlobalTimeSyncDataIDListValue=112
          CanTSynGlobalTimeSyncDataIDListElement_6: CanTSynGlobalTimeSyncDataIDListIndex=6, CanTSynGlobalTimeSyncDataIDListValue=240
          CanTSynGlobalTimeSyncDataIDListElement_7: CanTSynGlobalTimeSyncDataIDListIndex=7, CanTSynGlobalTimeSyncDataIDListValue=117
          CanTSynGlobalTimeSyncDataIDListElement_8: CanTSynGlobalTimeSyncDataIDListIndex=8, CanTSynGlobalTimeSyncDataIDListValue=245
          CanTSynGlobalTimeSyncDataIDListElement_9: CanTSynGlobalTimeSyncDataIDListIndex=9, CanTSynGlobalTimeSyncDataIDListValue=122
