AUTOSAR XML (schema 00049)
package /ActiveEcuC
  module config WdgM: implementation-config-variant=VARIANT-PRE-COMPILE, module-description=WdgM_Impl
    WdgMGeneral:
      WdgMDefensiveBehavior = true
      WdgMDevErrorDetect = false
      WdgMOffModeEnabled = false
      WdgMVersionInfoApi = true
      WdgMDemReport = true
      WdgMImmediateReset = true
      WdgMUseRte = true
      WdgMDemSupervisionReport = true
      WdgMFirstCycleAliveCounterReset = false
      WdgMAutosarDebugging = false
      WdgMUseOsSuspendInterrupt = true
      WdgMTimebaseSource = WDGM_INTERNAL_SOFTWARE_TICK
      WdgMSecondResetPath = true
      WdgMTickOverrunCorrection = false
      WdgMEntityDeactivationEnabled = false
      WdgMGenerateCPIdAsPortDefinedArgument = false
      WdgMStatusReportingMechanism = WDGM_USE_MODE_SWITCH_PORTS
      WdgMCallerIds: WdgMCallerId=0
      WdgMWatchdog: WdgMWatchdogName=, WdgMWatchdogDeviceRef=WdgIfDevice
      WdgMSupervisedEntity: WdgMSupervisedEntityId=0, WdgMEnableEntityDeactivation=false, WdgMReportStatusViaRte=true, WdgMInternalCheckpointInitialRef=WdgMCheckpoint
        WdgMCheckpoint: WdgMCheckpointId=0
    WdgMConfigSet: WdgMInitialMode=WdgMMode
      WdgMMode:
        WdgMExpiredSupervisionCycleTol = 0
        WdgMModeId = 0
        WdgMSupervisionCycle = 0.003
        WdgMInitialTriggerModeId = 0
        WdgMModeCoreAssignment = 0
        WdgMTicksPerSecond = 334
        WdgMReportStatusViaRte = true
        WdgMTrigger: WdgMWatchdogMode=WDGIF_SLOW_MODE, WdgMTriggerConditionValue=3, WdgMTriggerModeId=0, WdgMTriggerWatchdogRef=WdgMWatchdog
        WdgMLocalStatusParams:
          WdgMFailedAliveSupervisionRefCycleTol = 0
          WdgMSupervisedEntityInitialMode = WDGM_LOCAL_STATUS_OK
          WdgMFailedDeadlineRefCycleTol = 0
          WdgMDeadlineReferenceCycle = 0
          WdgMFailedProgramFlowRefCycleTol = 0
          WdgMProgramFlowReferenceCycle = 0
          WdgMLocalStatusSupervisedEntityRef = WdgMSupervisedEntity
      WdgMDemEventParameterRefs: WDGM_E_IMPROPER_CALLER=WDGM_E_IMPROPER_CALLER, WDGM_E_MONITORING=WDGM_E_MONITORING
