AUTOSAR XML (schema 00049)
package /Dio
  module config Dio: implementation-config-variant=VARIANT-LINK-TIME, module-description=Dio_Impl
    CommonPublishedInformation:
      ArMajorVersion = 4
      ArMinorVersion = 4
      ArPatchVersion = 0
      ModuleId = 120
      Release = _TRICORE_TC332
      SwMajorVersion = 20
      SwMinorVersion = 0
      SwPatchVersion = 1
      VendorId = 17
    DioConfig
      5 x DioPort:
        DioPort_33: DioPortId=33
          4 x DioChannel:
            HB_P_EN_RD: DioChannelId=5
            HB_N_EN_RD: DioChannelId=7
            DioChannel_LED: DioChannelId=4
            STB2: DioChannelId=10
          DioChannelGroup_LED (DioChannelGroup): DioChannelGroupIdentification=DioChGrpId_P33_0, DioPortMask=224, DioPortOffset=5
        DioPort_20: DioPortId=20
          TRB_LED (DioChannel): DioChannelId=11
          KL30_SW_EN (DioChannel): DioChannelId=14
        DioPort_2: DioPortId=2
          7 x DioChannel:
            OCU_CHANNEL_PIN: DioChannelId=5
            HB_N_EN_mcu: DioChannelId=2
            HB_P_EN_mcu: DioChannelId=0
            PWM_N: DioChannelId=8
            PWM_P: DioChannelId=4
            HES_A: DioChannelId=6
            HES_B: DioChannelId=7
        DioPort_10: DioPortId=10
          STB (DioChannel): DioChannelId=6
        DioPort_11: DioPortId=11
          SBC_CS (DioChannel): DioChannelId=11
    DioGeneral: DioDevErrorDetect=true, DioFlipChannelApi=true, DioMaskedWritePortApi=false, DioSafetyEnable=true, DioVersionInfoApi=false
