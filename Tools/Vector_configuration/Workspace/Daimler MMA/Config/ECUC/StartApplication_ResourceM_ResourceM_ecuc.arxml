AUTOSAR XML (schema 00049)
package /ResourceM
  module config ResourceM: implementation-config-variant=VARIANT-PRE-COMPILE
    ResourceMMcalConfig_0 (ResourceMMcalConfig): ResourceMMasterCore=CORE0
      ResourceMMcalCore_0 (ResourceMMcalCore): ResourceMCoreID=CORE0
        6 x ResourceMAllocation:
          ResourceMAllocation_11: ResourceMModuleName=SPI, ResourceMResourceRef=SpiHwConfigurationQspi_0
          ResourceMAllocation_4: ResourceMModuleName=ICU, ResourceMResourceRef=SignalMeas
          ResourceMAllocation_6: ResourceMModuleName=DMA, ResourceMResourceRef=DmaChannelConfig_2
          ResourceMAllocation_7: ResourceMModuleName=DMA, ResourceMResourceRef=DmaChannelConfig_0
          ResourceMAllocation_8: ResourceMModuleName=DMA, ResourceMResourceRef=DmaChannelConfig_1
          ResourceMAllocation_9: ResourceMModuleName=STM, ResourceMResourceRef=McuStmAllocationConf_0
