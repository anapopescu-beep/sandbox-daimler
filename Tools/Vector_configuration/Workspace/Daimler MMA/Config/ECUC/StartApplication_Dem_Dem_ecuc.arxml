AUTOSAR XML (schema 00049)
package /ActiveEcuC
  module config Dem: implementation-config-variant=VARIANT-PRE-COMPILE, module-description=Dem_Impl
    DemGeneral:
      DemAgingCycleCounterProcessing = DEM_PROCESS_AGINGCTR_INTERN
      DemDebounceCounterBasedSupport = true
      DemDebounceTimeBasedSupport = true
      DemEnableConditionSupport = true
      DemPTOSupport = false
      DemDtcStatusAvailabilityMask = 57
      DemGeneralInterfaceSupport = false
      DemDataElementDefaultEndianness = LITTLE_ENDIAN
      DemAgingRequieresTestedCycle = false
      DemMaxNumberEventEntryMirror = 0
      DemTriggerMonitorInitBeforeClearOk = true
      DemExtendedDataCapture = DEM_TRIGGER_EVENT_MEMORY_STORAGE
      DemFreezeFrameCapture = DEM_TRIGGER_EVENT_MEMORY_STORAGE
      DemOperationCycleProcessing = DEM_PROCESS_OPCYC_STATE
      DemMaxNumberTimeSeriesSnapshots = 0
      DemAvailabilitySupport = DEM_NO_AVAILABILITY
      DemAvailabilityStorage = false
      DemBswErrorBufferSize = 5
      DemClearDTCBehavior = DEM_CLRRESP_NONVOLATILE_FINISH
      DemClearDTCLimitation = DEM_ALL_SUPPORTED_DTCS
      DemDevErrorDetect = false
      DemEventCombinationSupport = DEM_EVCOMB_DISABLED
      DemEventDisplacementStrategy = DEM_DISPLACEMENT_FULL
      DemEventMemoryEntryStorageTrigger = DEM_STORAGE_ON_TEST_FAILED
      DemMaxNumberEventEntryOBDFreezeFrame = 0
      DemMaxNumberEventEntryPermanent = 0
      DemMaxNumberPrestoredFF = 0
      DemOBDSupport = DEM_OBD_NO_OBD_SUPPORT
      DemOccurrenceCounterProcessing = DEM_PROCESS_OCCCTR_TF
      DemOperationCycleStatusStorage = false
      DemResetConfirmedBitOnOverflow = true
      DemStatusBitHandlingTestFailedSinceLastClear = DEM_STATUS_BIT_NORMAL
      DemStatusBitStorageTestFailed = false
      DemStorageConditionSupport = true
      DemSuppressionSupport = DEM_DTC_SUPPRESSION
      DemTaskTime = 0.01
      DemTriggerDcmReports = false
      DemTriggerDltReports = false
      DemTriggerFiMReports = false
      DemTriggerFiMReportsExtended = false
      DemTriggerMonitorInitForEnableConditions = false
      DemTypeOfDTCSupported = DEM_DTC_TRANSLATION_ISO15031_6
      DemVersionInfoApi = false
      DemBswApiVersion = DEM_BSW_API_4_XX_XX
      DemBswApiVersionNvM = DEM_BSW_API_4_XX_XX
      DemBswApiVersionFiM = DEM_BSW_API_4_XX_XX
      DemAgingAfterHealing = DEM_AGING_WHILE_HEALING
      DemAgingBehavior = DEM_AGING_TYPE_1
      DemAgingCounterBehavior = DEM_AGING_COUNT_ALWAYS
      DemAgingCounterReporting = DEM_AGING_NORMAL_REPORTING
      DemAgingRetainEnvironmentalData = false
      DemCompiledPostbuildCrc = 2046761461
      DemCompiledPostbuildCrcMode = DEM_POSTBUILD_CRC_AUTOMATIC
      DemEventDisplacementFallbackStrategy = DEM_FALLBACK_DISCARD_NEW_EVENT
      DemGeneralDiagnosticInfoSupport = true
      DemJ1939Support = false
      DemNvSynchronizeSupport = false
      DemPendingDtcProcessing = DEM_PROCESS_PDTC_STOREDONLY
      DemResetDebounceBehavior = DEM_RESET_DEBOUNCE_ON_DISABLE_ENABLE_CONDITIONS
      DemResetTestFailedOnOperationCycleStart = false
      DemRetryStorageSupport = false
      DemSafeBswChecks = true
      DemUseMemcopyMacros = false
      DemUseRte = true
      DemUserControlledWirBehavior = DEM_ENABLED_DURING_CONTROLDTCSETTING
      DemUserDefinedCompareAndSwap = false
      DemWarningIndicatorRequestedProcessing = DEM_PROCESS_WIR_STOREDONLY
      DemUseMultiPartitionFiM = false
      DemReportSuppressedDTCsInService19x0A = false
      DemSupportAgingForAllDTCs = false
      DemLatchTestFailedBehavior = DEM_LATCH_TF_CONFIRMED_AND_THIS_CYCLE
      DemUseNvm = true
      DemHeaderFileInclusion = RCM_Callout_Stubs.h
      DemHeaderFileInclusion = Dem_Callout_Stubs.h
      DemHeaderFileInclusion = SBC.h
      DemImmediateNvStorageSupport = true
      DemRestartCycleOnInitRef = PowerCycle
      DemClearEventsWithoutDTCEventMemoryRef = PrimaryMemory
      DemEventMemorySet
        DemClearDTCNotification: DemClearDtcNotificationTime=FINISH, DemClearDtcNotificationFnc=Dem_ClearDTC_Callback_Notification_StartClear
        PrimaryMemory (DemPrimaryMemory): DemTypeOfFreezeFrameRecordNumeration=DEM_FF_RECNUM_CONFIGURED, DemMaxNumberEventEntryPrimary=10
      DemPostbuild:
        DemEventAvailableDefaultSupport = true
        DemMaxSizeFreezeFrame = 10
        DemMaxNumberDtr = 0
        DemMaxSizeGlobalFreezeFrame = 0
        DemMaxSizeOBDonUDSFreezeFrame = 0
        DemMaxNumberEventsWithMonitorActivityData = 0
      DemClient: DemClientId=0
      Data_StandardEnvironmentData_Operation_Cycle_Counter (DemDataClass):
        DemDataElementDataSize = 1
        DemDataElementInternalData = DEM_AGINGCTR_UPCNT
        DemDataElementUsePort = USE_DATA_INTERNAL
        DemDataElementStoreNonVolatile = true
      Data_DID_0x133_Current_Operating_Time (DemDataClass):
        DemDataElementDataSize = 4
        DemDataElementDataType = UINT32
        DemDataElementEndianness = BIG_ENDIAN
        DemDataElementUsePort = USE_DATA_CLIENT_SERVER_PORT
        DemDataElementStoreNonVolatile = true
      DID_0x18b (DemDidClass): DemDidIdentifier=395, DemDidDataClassRef=Data_DID_0x18b_SecOcDataID
      DID_Current_Operating_Time_Read_0x133 (DemDidClass): DemDidIdentifier=307, DemDidDataClassRef=Data_DID_0x133_Current_Operating_Time, DemDidDataClassRef=Data_DID_0x133_Operating_Time_Status
      Data_StandardEnvironmentData_Occurrence_Flag (DemDataClass):
        DemDataElementDataSize = 1
        DemDataElementInternalData = DEM_SIGNIFICANCE
        DemDataElementUsePort = USE_DATA_INTERNAL
        DemDataElementStoreNonVolatile = true
      ExtendedDataClass_dda5abf3 (DemExtendedDataClass): DemExtendedDataRecordClassRef=ExtendedDataRecord_StandardEnvironmentData
      IgnitionCycle (DemOperationCycle): DemOperationCycleType=DEM_OPCYC_IGNITION, DemOperationCycleAutomaticEnd=false, DemOperationCycleAutostart=false
      Data_DID_0x10a_Vehicle_Odometer_in_Low_Resolution (DemDataClass):
        DemDataElementDataSize = 2
        DemDataElementDataType = UINT16
        DemDataElementEndianness = BIG_ENDIAN
        DemDataElementUsePort = USE_DATA_CLIENT_SERVER_PORT
        DemDataElementStoreNonVolatile = true
      RoELight (DemCallbackDTCStatusChanged)
      FreezeFrameRecNum_bc8f2da9 (DemFreezeFrameRecNumClass):
        DemFreezeFrameRecordNumber = 16
        DemFreezeFrameRecordTrigger = DEM_RECORD_TRIGGER_CONFIRMED
        DemFreezeFrameRecordNumber = 32
        DemFreezeFrameRecordTrigger = DEM_RECORD_TRIGGER_TESTFAILED
        DemFreezeFrameRecordUpdate = DEM_UPDATE_RECORD_NO
        DemFreezeFrameRecordUpdate = DEM_UPDATE_RECORD_YES
      DID_Vehicle_Odometer_in_Low_Resolution_Read_0x10a (DemDidClass): DemDidIdentifier=266, DemDidDataClassRef=Data_DID_0x10a_Vehicle_Odometer_in_Low_Resolution
      Data_DID_0x18b_SecOcDataID (DemDataClass):
        DemDataElementDataSize = 2
        DemDataElementDataType = UINT8_N
        DemDataElementEndianness = opaque
        DemDataElementUsePort = USE_DATA_CLIENT_SERVER_PORT
        DemDataElementStoreNonVolatile = true
      PowerCycle (DemOperationCycle): DemOperationCycleType=DEM_OPCYC_POWER, DemOperationCycleAutomaticEnd=false, DemOperationCycleAutostart=false
      ExtendedDataRecord_StandardEnvironmentData (DemExtendedDataRecordClass):
        DemExtendedDataRecordNumber = 1
        DemExtendedDataRecordTrigger = DEM_RECORD_TRIGGER_CONFIRMED
        DemExtendedDataRecordUpdate = DEM_UPDATE_RECORD_YES
        DemDataClassRef = Data_StandardEnvironmentData_Occurrence_Flag
        DemDataClassRef = Data_StandardEnvironmentData_External_Tester_Present_Flag
        DemDataClassRef = Data_StandardEnvironmentData_Frequency_Counter
        DemDataClassRef = Data_StandardEnvironmentData_Operation_Cycle_Counter
      3 x DemDataClass, all with DemDataElementDataSize=1, DemDataElementStoreNonVolatile=true:
        Data_StandardEnvironmentData_External_Tester_Present_Flag: DemDataElementDataType=UINT8, DemDataElementUsePort=USE_DATA_INTERNAL, DemDataElementInternalData=DEM_SIGNIFICANCE
        Data_DID_0x133_Operating_Time_Status: DemDataElementDataType=UINT8, DemDataElementUsePort=USE_DATA_CLIENT_SERVER_PORT
        Data_StandardEnvironmentData_Frequency_Counter: DemDataElementInternalData=DEM_OCCCTR, DemDataElementUsePort=USE_DATA_INTERNAL
      WarningIndicator (DemIndicator): DemIndicatorID=0
      12 x DemNvRamBlockId:
        DemNvRamBlock_Admin: DemNvRamBlockIdType=DEM_NVBLOCK_ADMIN, DemNvRamBlockIdRef=NvMBlock_Dem_Admin_Data
        DemNvRamBlock_Primary_{0..9}: DemNvRamBlockIdType=DEM_NVBLOCK_PRIMARY, DemNvRamBlockIdIndex={0..9}, DemNvRamBlockIdRef=NvMBlock_Dem_Primary_{0..9}
        DemNvRamBlock_Status: DemNvRamBlockIdType=DEM_NVBLOCK_STATUS, DemNvRamBlockIdRef=NvMBlock_Dem_Status
      FreezeFrame_b430d746 (DemFreezeFrameClass):
        DemDidClassRef = DID_Vehicle_Odometer_in_Low_Resolution_Read_0x10a
        DemDidClassRef = DID_Current_Operating_Time_Read_0x133
        DemDidClassRef = DID_0x18b
        DemDidClassRef = DID_0xfd05
      FreezeFrame_8035c374 (DemFreezeFrameClass):
        DemDidClassRef = DID_Vehicle_Odometer_in_Low_Resolution_Read_0x10a
        DemDidClassRef = DID_Current_Operating_Time_Read_0x133
        DemDidClassRef = DID_0xfd05
      DemStorageConditionGroup_ECU_LEVEL (DemStorageConditionGroup):
        DemStorageConditionRef = DemStorageCondition_SC1_ControlDTC
        DemStorageConditionRef = DemStorageCondition_SC3_LocalVoltage
        DemStorageConditionRef = DemStorageCondition_SC11_VehicleStartup
      9 x DemStorageCondition:
        DemStorageCondition_SC1_ControlDTC: DemStorageConditionId=0, DemStorageConditionStatus=true
        DemStorageCondition_SC2_IgnitonStatus: DemStorageConditionId=1, DemStorageConditionStatus=false  # Annotation PLAIN_TEXT COVERS: ARCH_SW_BSW_0010; ARCH_SW_BSW_0012;
        DemStorageCondition_SC3_LocalVoltage: DemStorageConditionId=2, DemStorageConditionStatus=false  # Annotation PLAIN_TEXT COVERS: ARCH_SW_BSW_0009;
        DemStorageCondition_SC4_SystemVoltage: DemStorageConditionId=3, DemStorageConditionStatus=false  # Annotation PLAIN_TEXT COVERS: ARCH_SW_BSW_0010; ARCH_SW_BSW_0011;
        DemStorageCondition_SC5_TransportationMode: DemStorageConditionId=4, DemStorageConditionStatus=true  # Annotation PLAIN_TEXT COVERS: ARCH_SW_BSW_0010; ARCH_SW_BSW_0011; ARCH_SW_BSW_0012;
        DemStorageCondition_SC8_CommunicationStatus: DemStorageConditionId=5, DemStorageConditionStatus=true  # Annotation PLAIN_TEXT COVERS: ARCH_SW_BSW_0010; ARCH_SW_BSW_0011;
        DemStorageCondition_SC10_debounceTimerPD: DemStorageConditionId=6, DemStorageConditionStatus=false  # Annotation PLAIN_TEXT COVERS: ARCH_SW_BSW_0010; ARCH_SW_BSW_0011; ARCH_SW_BSW_0012;
        DemStorageCondition_SC11_VehicleStartup: DemStorageConditionId=9, DemStorageConditionStatus=false
        DemStorageCondition_SC12_ProductionMode: DemStorageConditionId=10, DemStorageConditionStatus=true  # Annotation PLAIN_TEXT COVERS: ARCH_SW_BSW_0010; ARCH_SW_BSW_0011; ARCH_SW_BSW_0012;
      DemStorageConditionGroup_NetworkCommunication (DemStorageConditionGroup):
        DemStorageConditionRef = DemStorageCondition_SC1_ControlDTC
        DemStorageConditionRef = DemStorageCondition_SC2_IgnitonStatus
        DemStorageConditionRef = DemStorageCondition_SC4_SystemVoltage
        DemStorageConditionRef = DemStorageCondition_SC5_TransportationMode
        DemStorageConditionRef = DemStorageCondition_SC8_CommunicationStatus
        DemStorageConditionRef = DemStorageCondition_SC11_VehicleStartup
        DemStorageConditionRef = DemStorageCondition_SC12_ProductionMode
        DemStorageConditionRef = DemStorageCondition_SC10_debounceTimerNC
      DemStorageConditionGroup_PowerDistribution (DemStorageConditionGroup):
        DemStorageConditionRef = DemStorageCondition_SC1_ControlDTC
        DemStorageConditionRef = DemStorageCondition_SC2_IgnitonStatus
        DemStorageConditionRef = DemStorageCondition_SC5_TransportationMode
        DemStorageConditionRef = DemStorageCondition_SC10_debounceTimerPD
        DemStorageConditionRef = DemStorageCondition_SC11_VehicleStartup
        DemStorageConditionRef = DemStorageCondition_SC12_ProductionMode
      4 x DemEnableCondition, all with DemEnableConditionStatus=true:
        DemEnableCondition_IgnitionON: DemEnableConditionId=5  # Annotation PLAIN_TEXT COVERS: ARCH_SW_BSW_0020; ARCH_SW_BSW_0021;
        DemEnableCondition_CodingRBTMFR: DemEnableConditionId=4  # Annotation PLAIN_TEXT COVERS: ARCH_SW_BSW_0020; ARCH_SW_BSW_0021;
        DemEnableCondition_CodingRBTMFL: DemEnableConditionId=3  # Annotation PLAIN_TEXT COVERS: ARCH_SW_BSW_0020; ARCH_SW_BSW_0021;
        DemEnableCondition_CodingAPI: DemEnableConditionId=2  # Annotation PLAIN_TEXT COVERS: ARCH_SW_BSW_0020; ARCH_SW_BSW_0021;
      5 x DemEnableConditionGroup:
        DemEnableConditionGroup_CodingAPI_IgnON: DemEnableConditionRef=DemEnableCondition_CodingAPI, DemEnableConditionRef=DemEnableCondition_IgnitionON  # Annotation PLAIN_TEXT COVERS: ARCH_SW_BSW_0020; ARCH_SW_BSW_0021;
        DemEnableConditionGroup_CodingRBTMFL: DemEnableConditionRef=DemEnableCondition_CodingRBTMFL  # Annotation PLAIN_TEXT COVERS: ARCH_SW_BSW_0020; ARCH_SW_BSW_0021;
        DemEnableConditionGroup_CodingRBTMFR: DemEnableConditionRef=DemEnableCondition_CodingRBTMFR  # Annotation PLAIN_TEXT COVERS: ARCH_SW_BSW_0020; ARCH_SW_BSW_0021;
        DemEnableConditionGroup_IgnitionON: DemEnableConditionRef=DemEnableCondition_IgnitionON  # Annotation PLAIN_TEXT COVERS: ARCH_SW_BSW_0020; ARCH_SW_BSW_0021;
        DemEnableConditionGroup_ECUPowerUp: DemEnableConditionRef=DemEnableCondition_ECUPowerUp  # Annotation PLAIN_TEXT COVERS: ARCH_SW_BSW_0020; ARCH_SW_BSW_0021;
      DemEnableCondition_ECUPowerUp (DemEnableCondition): DemEnableConditionId=1, DemEnableConditionStatus=true  # Annotation PLAIN_TEXT COVERS: ARCH_SW_BSW_0020; ARCH_SW_BSW_0021;
      DemStorageConditionGroup_NetworkCommunication_WithoutClamp15 (DemStorageConditionGroup):
        DemStorageConditionRef = DemStorageCondition_SC1_ControlDTC
        DemStorageConditionRef = DemStorageCondition_SC4_SystemVoltage
        DemStorageConditionRef = DemStorageCondition_SC5_TransportationMode
        DemStorageConditionRef = DemStorageCondition_SC8_CommunicationStatus
        DemStorageConditionRef = DemStorageCondition_SC11_VehicleStartup
        DemStorageConditionRef = DemStorageCondition_SC12_ProductionMode
        DemStorageConditionRef = DemStorageCondition_SC10_debounceTimerNC15
      DemStorageCondition_SC10_debounceTimerNC (DemStorageCondition): DemStorageConditionId=7, DemStorageConditionStatus=false  # Annotation PLAIN_TEXT COVERS: ARCH_SW_BSW_0010; ARCH_SW_BSW_0011; ARCH_SW_BSW_0012;
      DemStorageCondition_SC10_debounceTimerNC15 (DemStorageCondition): DemStorageConditionId=8, DemStorageConditionStatus=false  # Annotation PLAIN_TEXT COVERS: ARCH_SW_BSW_0010; ARCH_SW_BSW_0011; ARCH_SW_BSW_0012;
      DID_0xfd05 (DemDidClass): DemDidIdentifier=64773, DemDidDataClassRef=Data_DID_0xfd05_Root_Causes
      Data_DID_0xfd05_Root_Causes (DemDataClass): DemDataElementDataSize=1, DemDataElementDataType=UINT8, DemDataElementUsePort=USE_DATA_CLIENT_SERVER_PORT, DemDataElementStoreNonVolatile=true
    DemConfigSet
      3 x DemEventParameter, all with DemEventTimeSeries=DEM_TIMESERIES_SNAPSHOT_NONE, DemEventAvailable=true, DemEventKind=DEM_EVENT_KIND_BSW, DemEventAvailableInVariant=true, DemEventLatchTestFailed=false, DemEventCreateInfoPort=true:
        SPI_E_HARDWARE_ERROR: DemEventId=36
          DemEventClass:
            DemFFPrestorageSupported = false
            DemEventPriority = 2
            DemEventSignificance = DEM_EVENT_SIGNIFICANCE_FAULT
            DemAgingAllowed = false
            DemConsiderPtoStatus = false
            DemOperationCycleRef = PowerCycle
            DemDebounceAlgorithmClass
              DemDebounceCounterBased:
                DemDebounceBehavior = DEM_DEBOUNCE_FREEZE
                DemDebounceCounterDecrementStepSize = 1
                DemDebounceCounterFailedThreshold = 127
                DemDebounceCounterIncrementStepSize = 1
                DemDebounceCounterJumpDown = true
                DemDebounceCounterJumpDownValue = 0
                DemDebounceCounterJumpUp = true
                DemDebounceCounterJumpUpValue = 0
                DemDebounceCounterPassedThreshold = -128
                DemDebounceCounterStorage = false
                DemDebounceContinuous = false
          DemCallbackEventStatusChanged: DemCallbackEventStatusChangedFnc=SBC_SpiConfigurationHwError_Notification
        WDGM_E_MONITORING: DemEventId=37
          DemEventClass:
            DemFFPrestorageSupported = false
            DemEventPriority = 2
            DemEventSignificance = DEM_EVENT_SIGNIFICANCE_FAULT
            DemAgingAllowed = false
            DemConsiderPtoStatus = false
            DemOperationCycleRef = PowerCycle
            DemDebounceAlgorithmClass
              DemDebounceCounterBased:
                DemDebounceBehavior = DEM_DEBOUNCE_FREEZE
                DemDebounceCounterDecrementStepSize = 1
                DemDebounceCounterFailedThreshold = 127
                DemDebounceCounterIncrementStepSize = 1
                DemDebounceCounterJumpDown = true
                DemDebounceCounterJumpDownValue = 0
                DemDebounceCounterJumpUp = true
                DemDebounceCounterJumpUpValue = 0
                DemDebounceCounterPassedThreshold = -128
                DemDebounceCounterStorage = false
                DemDebounceContinuous = false
        WDGM_E_IMPROPER_CALLER: DemEventId=38
          DemEventClass:
            DemFFPrestorageSupported = false
            DemEventPriority = 2
            DemEventSignificance = DEM_EVENT_SIGNIFICANCE_FAULT
            DemAgingAllowed = false
            DemConsiderPtoStatus = false
            DemOperationCycleRef = PowerCycle
            DemDebounceAlgorithmClass
              DemDebounceCounterBased:
                DemDebounceBehavior = DEM_DEBOUNCE_FREEZE
                DemDebounceCounterDecrementStepSize = 1
                DemDebounceCounterFailedThreshold = 127
                DemDebounceCounterIncrementStepSize = 1
                DemDebounceCounterJumpDown = true
                DemDebounceCounterJumpDownValue = 0
                DemDebounceCounterJumpUp = true
                DemDebounceCounterJumpUpValue = 0
                DemDebounceCounterPassedThreshold = -128
                DemDebounceCounterStorage = false
                DemDebounceContinuous = false
      DtcClass_DTC_0xa28b4b (DemDTCClass): DemDTCSeverity=DEM_DTC_SEV_NO_SEVERITY, DemUdsDTC=10652491, DemImmediateNvStorage=true, DemDTCAttributesRef=DtcAttributes_41914fb7
      DTC_0x1ca000 (DemEventParameter):  # Annotation PLAIN_TEXT COVERS: ARCH_SW_BSW_0013;
        DemEventKind = DEM_EVENT_KIND_SWC
        DemEventTimeSeries = DEM_TIMESERIES_SNAPSHOT_NONE
        DemEventAvailable = true
        DemEventId = 1
        DemEventAvailableInVariant = true
        DemEventLatchTestFailed = false
        DemEventCreateInfoPort = true
        DemDTCClassRef = DtcClass_DTC_0x1ca000
        DemExtendedDataClassRef = ExtendedDataClass_dda5abf3
        DemFreezeFrameClassRef = FreezeFrame_8035c374
        DemFreezeFrameRecNumClassRef = FreezeFrameRecNum_bc8f2da9
        DemEventClass:
          DemAgingAllowed = true
          DemAgingCycleCounterThreshold = 1
          DemEventPriority = 2
          DemEventSignificance = DEM_EVENT_SIGNIFICANCE_FAULT
          DemEventFailureCycleCounterThreshold = 0
          DemConsiderPtoStatus = false
          DemFFPrestorageSupported = false
          DemAgingCycleRef = IgnitionCycle
          DemEnableConditionGroupRef = DemEnableConditionGroup_ECUPowerUp
          DemOperationCycleRef = PowerCycle
          DemStorageConditionGroupRef = DemStorageConditionGroup_ECU_LEVEL
          DemDebounceAlgorithmClass
            DemDebounceCounterBased:
              DemDebounceCounterDecrementStepSize = 1
              DemDebounceCounterIncrementStepSize = 1
              DemDebounceCounterJumpDown = true
              DemDebounceCounterJumpUp = false
              DemDebounceCounterFailedThreshold = 127
              DemDebounceCounterPassedThreshold = -128
              DemDebounceBehavior = DEM_DEBOUNCE_FREEZE
              DemDebounceCounterJumpDownValue = 0
              DemDebounceCounterJumpUpValue = 0
              DemDebounceCounterStorage = false
              DemDebounceContinuous = false
      DtcClass_DTC_0xc20287 (DemDTCClass): DemDTCSeverity=DEM_DTC_SEV_NO_SEVERITY, DemUdsDTC=12714631, DemImmediateNvStorage=true, DemDTCAttributesRef=DtcAttributes_41914fb7
      3 x DemEventParameter, all with DemEventKind=DEM_EVENT_KIND_SWC, DemEventTimeSeries=DEM_TIMESERIES_SNAPSHOT_NONE, DemEventAvailable=true, DemEventAvailableInVariant=true, DemEventLatchTestFailed=false, DemEventCreateInfoPort=true, DemExtendedDataClassRef=ExtendedDataClass_dda5abf3, DemFreezeFrameClassRef=FreezeFrame_8035c374, DemFreezeFrameRecNumClassRef=FreezeFrameRecNum_bc8f2da9:
        DTC_0xa10b00: DemEventId=5, DemDTCClassRef=DtcClass_DTC_0xa10b00  # Annotation PLAIN_TEXT COVERS: ARCH_SW_BSW_0016;
          DemEventClass:
            DemAgingAllowed = true
            DemAgingCycleCounterThreshold = 100
            DemEventPriority = 2
            DemEventSignificance = DEM_EVENT_SIGNIFICANCE_OCCURRENCE
            DemEventFailureCycleCounterThreshold = 0
            DemConsiderPtoStatus = false
            DemFFPrestorageSupported = false
            DemAgingCycleRef = IgnitionCycle
            DemEnableConditionGroupRef = DemEnableConditionGroup_ECUPowerUp
            DemOperationCycleRef = PowerCycle
            DemStorageConditionGroupRef = DemStorageConditionGroup_PowerDistribution
            DemDebounceAlgorithmClass
              DemDebounceCounterBased:
                DemDebounceCounterDecrementStepSize = 1
                DemDebounceCounterIncrementStepSize = 1
                DemDebounceCounterJumpDown = true
                DemDebounceCounterJumpUp = false
                DemDebounceCounterFailedThreshold = 127
                DemDebounceCounterPassedThreshold = -128
                DemDebounceBehavior = DEM_DEBOUNCE_FREEZE
                DemDebounceCounterJumpDownValue = 0
                DemDebounceCounterJumpUpValue = 0
                DemDebounceCounterStorage = false
                DemDebounceContinuous = false
        DTC_0xc44286: DemEventId=28, DemDTCClassRef=DtcClass_DTC_0xc44286  # Annotation PLAIN_TEXT COVERS: ARCH_SW_BSW_0021; ARCH_SW_BSW_0014;
          DemEventClass:
            DemAgingAllowed = true
            DemAgingCycleCounterThreshold = 10
            DemEventPriority = 2
            DemEventSignificance = DEM_EVENT_SIGNIFICANCE_OCCURRENCE
            DemEventFailureCycleCounterThreshold = 0
            DemConsiderPtoStatus = false
            DemFFPrestorageSupported = false
            DemAgingCycleRef = IgnitionCycle
            DemEnableConditionGroupRef = DemEnableConditionGroup_IgnitionON
            DemOperationCycleRef = PowerCycle
            DemStorageConditionGroupRef = DemStorageConditionGroup_NetworkCommunication
            DemDebounceAlgorithmClass
              DemDebounceCounterBased:
                DemDebounceCounterDecrementStepSize = 1
                DemDebounceCounterIncrementStepSize = 1
                DemDebounceCounterJumpDown = true
                DemDebounceCounterJumpUp = false
                DemDebounceCounterFailedThreshold = 127
                DemDebounceCounterPassedThreshold = -128
                DemDebounceBehavior = DEM_DEBOUNCE_FREEZE
                DemDebounceCounterJumpDownValue = 0
                DemDebounceCounterJumpUpValue = 0
                DemDebounceCounterStorage = false
                DemDebounceContinuous = false
        DTC_0xa10d00: DemEventId=6, DemDTCClassRef=DtcClass_DTC_0xa10d00  # Annotation PLAIN_TEXT COVERS: ARCH_SW_BSW_0016;
          DemEventClass:
            DemAgingAllowed = true
            DemAgingCycleCounterThreshold = 100
            DemEventPriority = 2
            DemEventSignificance = DEM_EVENT_SIGNIFICANCE_OCCURRENCE
            DemEventFailureCycleCounterThreshold = 0
            DemConsiderPtoStatus = false
            DemFFPrestorageSupported = false
            DemAgingCycleRef = IgnitionCycle
            DemEnableConditionGroupRef = DemEnableConditionGroup_ECUPowerUp
            DemOperationCycleRef = PowerCycle
            DemStorageConditionGroupRef = DemStorageConditionGroup_PowerDistribution
            DemDebounceAlgorithmClass
              DemDebounceCounterBased:
                DemDebounceCounterDecrementStepSize = 1
                DemDebounceCounterIncrementStepSize = 1
                DemDebounceCounterJumpDown = true
                DemDebounceCounterJumpUp = false
                DemDebounceCounterFailedThreshold = 127
                DemDebounceCounterPassedThreshold = -128
                DemDebounceBehavior = DEM_DEBOUNCE_FREEZE
                DemDebounceCounterJumpDownValue = 0
                DemDebounceCounterJumpUpValue = 0
                DemDebounceCounterStorage = false
                DemDebounceContinuous = false
      3 x DemDTCClass, all with DemDTCSeverity=DEM_DTC_SEV_NO_SEVERITY, DemImmediateNvStorage=true, DemDTCAttributesRef=DtcAttributes_41914fb7:
        DtcClass_DTC_0xa28b96: DemUdsDTC=10652566
        DtcClass_DTC_0x9a6857: DemUdsDTC=10119255
        DtcClass_DTC_0xa28b97: DemUdsDTC=10652567
      3 x DemEventParameter, all with DemEventKind=DEM_EVENT_KIND_SWC, DemEventTimeSeries=DEM_TIMESERIES_SNAPSHOT_NONE, DemEventAvailable=true, DemEventAvailableInVariant=true, DemEventLatchTestFailed=false, DemEventCreateInfoPort=true, DemExtendedDataClassRef=ExtendedDataClass_dda5abf3, DemFreezeFrameClassRef=FreezeFrame_8035c374, DemFreezeFrameRecNumClassRef=FreezeFrameRecNum_bc8f2da9:
        DTC_0xa28b45: DemEventId=11, DemDTCClassRef=DtcClass_DTC_0xa28b45
          DemEventClass:
            DemAgingAllowed = false
            DemAgingCycleCounterThreshold = 255
            DemEventPriority = 1
            DemEventSignificance = DEM_EVENT_SIGNIFICANCE_FAULT
            DemEventFailureCycleCounterThreshold = 0
            DemConsiderPtoStatus = false
            DemFFPrestorageSupported = false
            DemAgingCycleRef = IgnitionCycle
            DemEnableConditionGroupRef = DemEnableConditionGroup_ECUPowerUp
            DemOperationCycleRef = PowerCycle
            DemDebounceAlgorithmClass
              DemDebounceCounterBased:
                DemDebounceCounterDecrementStepSize = 127
                DemDebounceCounterIncrementStepSize = 127
                DemDebounceCounterJumpDown = true
                DemDebounceCounterJumpUp = false
                DemDebounceCounterFailedThreshold = 10
                DemDebounceCounterPassedThreshold = -128
                DemDebounceBehavior = DEM_DEBOUNCE_FREEZE
                DemDebounceCounterJumpDownValue = 0
                DemDebounceCounterJumpUpValue = 0
                DemDebounceCounterStorage = false
                DemDebounceContinuous = false
            WarningIndicator (DemIndicatorAttribute):
              DemIndicatorFailureCycleSource = DEM_FAILURE_CYCLE_EVENT
              DemIndicatorHealingCycleCounterThreshold = 0
              DemIndicatorBehaviour = DEM_INDICATOR_CONTINUOUS
              DemIndicatorHealingCycleRef = PowerCycle
              DemIndicatorRef = DemGeneral/WarningIndicator
        DTC_0xc45208: DemEventId=29, DemDTCClassRef=DtcClass_DTC_0xc45208  # Annotation PLAIN_TEXT COVERS: ARCH_SW_BSW_0021; ARCH_SW_BSW_0014;
          DemEventClass:
            DemAgingAllowed = true
            DemAgingCycleCounterThreshold = 10
            DemEventPriority = 2
            DemEventSignificance = DEM_EVENT_SIGNIFICANCE_OCCURRENCE
            DemEventFailureCycleCounterThreshold = 0
            DemConsiderPtoStatus = false
            DemFFPrestorageSupported = false
            DemAgingCycleRef = IgnitionCycle
            DemEnableConditionGroupRef = DemEnableConditionGroup_IgnitionON
            DemOperationCycleRef = PowerCycle
            DemStorageConditionGroupRef = DemStorageConditionGroup_NetworkCommunication
            DemDebounceAlgorithmClass
              DemDebounceCounterBased:
                DemDebounceCounterDecrementStepSize = 1
                DemDebounceCounterIncrementStepSize = 1
                DemDebounceCounterJumpDown = true
                DemDebounceCounterJumpUp = false
                DemDebounceCounterFailedThreshold = 127
                DemDebounceCounterPassedThreshold = -128
                DemDebounceBehavior = DEM_DEBOUNCE_FREEZE
                DemDebounceCounterJumpDownValue = 0
                DemDebounceCounterJumpUpValue = 0
                DemDebounceCounterStorage = false
                DemDebounceContinuous = false
            WarningIndicator (DemIndicatorAttribute):
              DemIndicatorFailureCycleSource = DEM_FAILURE_CYCLE_EVENT
              DemIndicatorHealingCycleCounterThreshold = 100
              DemIndicatorBehaviour = DEM_INDICATOR_CONTINUOUS
              DemIndicatorHealingCycleRef = PowerCycle
              DemIndicatorRef = DemGeneral/WarningIndicator
        DTC_0xa28b49: DemEventId=13, DemDTCClassRef=DtcClass_DTC_0xa28b49  # Annotation PLAIN_TEXT COVERS: ARCH_SW_BSW_0013;
          DemEventClass:
            DemAgingAllowed = false
            DemAgingCycleCounterThreshold = 255
            DemEventPriority = 1
            DemEventSignificance = DEM_EVENT_SIGNIFICANCE_FAULT
            DemEventFailureCycleCounterThreshold = 0
            DemConsiderPtoStatus = false
            DemFFPrestorageSupported = false
            DemAgingCycleRef = IgnitionCycle
            DemEnableConditionGroupRef = DemEnableConditionGroup_ECUPowerUp
            DemOperationCycleRef = PowerCycle
            DemStorageConditionGroupRef = DemStorageConditionGroup_ECU_LEVEL
            DemDebounceAlgorithmClass
              DemDebounceCounterBased:
                DemDebounceCounterDecrementStepSize = 127
                DemDebounceCounterIncrementStepSize = 127
                DemDebounceCounterJumpDown = true
                DemDebounceCounterJumpUp = false
                DemDebounceCounterFailedThreshold = 10
                DemDebounceCounterPassedThreshold = -128
                DemDebounceBehavior = DEM_DEBOUNCE_FREEZE
                DemDebounceCounterJumpDownValue = 0
                DemDebounceCounterJumpUpValue = 0
                DemDebounceCounterStorage = false
                DemDebounceContinuous = false
            WarningIndicator (DemIndicatorAttribute):
              DemIndicatorFailureCycleSource = DEM_FAILURE_CYCLE_EVENT
              DemIndicatorHealingCycleCounterThreshold = 0
              DemIndicatorBehaviour = DEM_INDICATOR_CONTINUOUS
              DemIndicatorHealingCycleRef = PowerCycle
              DemIndicatorRef = DemGeneral/WarningIndicator
      DtcClass_DTC_0xa28b16 (DemDTCClass): DemDTCSeverity=DEM_DTC_SEV_NO_SEVERITY, DemUdsDTC=10652438, DemImmediateNvStorage=true, DemDTCAttributesRef=DtcAttributes_41914fb7
      DTC_0xa28b47 (DemEventParameter):
        DemEventKind = DEM_EVENT_KIND_SWC
        DemEventTimeSeries = DEM_TIMESERIES_SNAPSHOT_NONE
        DemEventAvailable = true
        DemEventId = 12
        DemEventAvailableInVariant = true
        DemEventLatchTestFailed = false
        DemEventCreateInfoPort = true
        DemDTCClassRef = DtcClass_DTC_0xa28b47
        DemExtendedDataClassRef = ExtendedDataClass_dda5abf3
        DemFreezeFrameClassRef = FreezeFrame_8035c374
        DemFreezeFrameRecNumClassRef = FreezeFrameRecNum_bc8f2da9
        DemEventClass:
          DemAgingAllowed = false
          DemAgingCycleCounterThreshold = 255
          DemEventPriority = 1
          DemEventSignificance = DEM_EVENT_SIGNIFICANCE_OCCURRENCE
          DemEventFailureCycleCounterThreshold = 0
          DemConsiderPtoStatus = false
          DemFFPrestorageSupported = false
          DemAgingCycleRef = IgnitionCycle
          DemEnableConditionGroupRef = DemEnableConditionGroup_ECUPowerUp
          DemOperationCycleRef = PowerCycle
          DemDebounceAlgorithmClass
            DemDebounceCounterBased:
              DemDebounceCounterDecrementStepSize = 127
              DemDebounceCounterIncrementStepSize = 127
              DemDebounceCounterJumpDown = true
              DemDebounceCounterJumpUp = false
              DemDebounceCounterFailedThreshold = 10
              DemDebounceCounterPassedThreshold = -128
              DemDebounceBehavior = DEM_DEBOUNCE_FREEZE
              DemDebounceCounterJumpDownValue = 0
              DemDebounceCounterJumpUpValue = 0
              DemDebounceCounterStorage = false
              DemDebounceContinuous = false
      DtcClass_DTC_0xa28b17 (DemDTCClass): DemDTCSeverity=DEM_DTC_SEV_NO_SEVERITY, DemUdsDTC=10652439, DemImmediateNvStorage=true, DemDTCAttributesRef=DtcAttributes_41914fb7
      DtcClass_DTC_0xc42708 (DemDTCClass): DemDTCSeverity=DEM_DTC_SEV_NO_SEVERITY, DemUdsDTC=12855048, DemImmediateNvStorage=true, DemDTCAttributesRef=DtcAttributes_41914fb7
      DTC_0xc41608 (DemEventParameter):  # Annotation PLAIN_TEXT COVERS: ARCH_SW_BSW_0021; ARCH_SW_BSW_0014;
        DemEventKind = DEM_EVENT_KIND_SWC
        DemEventTimeSeries = DEM_TIMESERIES_SNAPSHOT_NONE
        DemEventAvailable = true
        DemEventId = 26
        DemEventAvailableInVariant = true
        DemEventLatchTestFailed = false
        DemEventCreateInfoPort = true
        DemDTCClassRef = DtcClass_DTC_0xc41608
        DemExtendedDataClassRef = ExtendedDataClass_dda5abf3
        DemFreezeFrameClassRef = FreezeFrame_8035c374
        DemFreezeFrameRecNumClassRef = FreezeFrameRecNum_bc8f2da9
        DemEventClass:
          DemAgingAllowed = true
          DemAgingCycleCounterThreshold = 10
          DemEventPriority = 2
          DemEventSignificance = DEM_EVENT_SIGNIFICANCE_OCCURRENCE
          DemEventFailureCycleCounterThreshold = 0
          DemConsiderPtoStatus = false
          DemFFPrestorageSupported = false
          DemAgingCycleRef = IgnitionCycle
          DemEnableConditionGroupRef = DemEnableConditionGroup_IgnitionON
          DemOperationCycleRef = PowerCycle
          DemStorageConditionGroupRef = DemStorageConditionGroup_NetworkCommunication
          DemDebounceAlgorithmClass
            DemDebounceCounterBased:
              DemDebounceCounterDecrementStepSize = 1
              DemDebounceCounterIncrementStepSize = 1
              DemDebounceCounterJumpDown = true
              DemDebounceCounterJumpUp = false
              DemDebounceCounterFailedThreshold = 127
              DemDebounceCounterPassedThreshold = -128
              DemDebounceBehavior = DEM_DEBOUNCE_FREEZE
              DemDebounceCounterJumpDownValue = 0
              DemDebounceCounterJumpUpValue = 0
              DemDebounceCounterStorage = false
              DemDebounceContinuous = false
          WarningIndicator (DemIndicatorAttribute):
            DemIndicatorFailureCycleSource = DEM_FAILURE_CYCLE_EVENT
            DemIndicatorHealingCycleCounterThreshold = 100
            DemIndicatorBehaviour = DEM_INDICATOR_CONTINUOUS
            DemIndicatorHealingCycleRef = PowerCycle
            DemIndicatorRef = DemGeneral/WarningIndicator
      DtcClass_DTC_0xc44286 (DemDTCClass): DemDTCSeverity=DEM_DTC_SEV_NO_SEVERITY, DemUdsDTC=12862086, DemImmediateNvStorage=true, DemDTCAttributesRef=DtcAttributes_41914fb7
      DTC_0xc20287 (DemEventParameter):  # Annotation PLAIN_TEXT COVERS: ARCH_SW_BSW_0021; ARCH_SW_BSW_0014;
        DemEventKind = DEM_EVENT_KIND_SWC
        DemEventTimeSeries = DEM_TIMESERIES_SNAPSHOT_NONE
        DemEventAvailable = true
        DemEventId = 25
        DemEventAvailableInVariant = true
        DemEventLatchTestFailed = false
        DemEventCreateInfoPort = true
        DemDTCClassRef = DtcClass_DTC_0xc20287
        DemExtendedDataClassRef = ExtendedDataClass_dda5abf3
        DemFreezeFrameClassRef = FreezeFrame_8035c374
        DemFreezeFrameRecNumClassRef = FreezeFrameRecNum_bc8f2da9
        DemEventClass:
          DemAgingAllowed = true
          DemAgingCycleCounterThreshold = 10
          DemEventPriority = 2
          DemEventSignificance = DEM_EVENT_SIGNIFICANCE_OCCURRENCE
          DemEventFailureCycleCounterThreshold = 0
          DemConsiderPtoStatus = false
          DemFFPrestorageSupported = false
          DemAgingCycleRef = IgnitionCycle
          DemEnableConditionGroupRef = DemEnableConditionGroup_CodingRBTMFR
          DemOperationCycleRef = PowerCycle
          DemStorageConditionGroupRef = DemStorageConditionGroup_NetworkCommunication
          DemDebounceAlgorithmClass
            DemDebounceCounterBased:
              DemDebounceCounterDecrementStepSize = 1
              DemDebounceCounterIncrementStepSize = 1
              DemDebounceCounterJumpDown = true
              DemDebounceCounterJumpUp = false
              DemDebounceCounterFailedThreshold = 127
              DemDebounceCounterPassedThreshold = -128
              DemDebounceBehavior = DEM_DEBOUNCE_FREEZE
              DemDebounceCounterJumpDownValue = 0
              DemDebounceCounterJumpUpValue = 0
              DemDebounceCounterStorage = false
              DemDebounceContinuous = false
      DtcClass_DTC_0xa10b00 (DemDTCClass): DemDTCSeverity=DEM_DTC_SEV_NO_SEVERITY, DemUdsDTC=10554112, DemImmediateNvStorage=true, DemDTCAttributesRef=DtcAttributes_41914fb7
      DtcClass_DTC_0xd22488 (DemDTCClass): DemDTCSeverity=DEM_DTC_SEV_NO_SEVERITY, DemUdsDTC=13771912, DemImmediateNvStorage=true, DemDTCAttributesRef=DtcAttributes_41914fb7
      DTC_0xa20400 (DemEventParameter):  # Annotation PLAIN_TEXT COVERS: ARCH_SW_BSW_0013;
        DemEventKind = DEM_EVENT_KIND_SWC
        DemEventTimeSeries = DEM_TIMESERIES_SNAPSHOT_NONE
        DemEventAvailable = true
        DemEventId = 18
        DemEventAvailableInVariant = true
        DemEventLatchTestFailed = false
        DemEventCreateInfoPort = true
        DemDTCClassRef = DtcClass_DTC_0xa20400
        DemExtendedDataClassRef = ExtendedDataClass_dda5abf3
        DemFreezeFrameClassRef = FreezeFrame_8035c374
        DemFreezeFrameRecNumClassRef = FreezeFrameRecNum_bc8f2da9
        DemEventClass:
          DemAgingAllowed = false
          DemAgingCycleCounterThreshold = 255
          DemEventPriority = 1
          DemEventSignificance = DEM_EVENT_SIGNIFICANCE_FAULT
          DemEventFailureCycleCounterThreshold = 0
          DemConsiderPtoStatus = false
          DemFFPrestorageSupported = false
          DemAgingCycleRef = IgnitionCycle
          DemEnableConditionGroupRef = DemEnableConditionGroup_ECUPowerUp
          DemOperationCycleRef = PowerCycle
          DemStorageConditionGroupRef = DemStorageConditionGroup_ECU_LEVEL
          DemDebounceAlgorithmClass
            DemDebounceCounterBased:
              DemDebounceCounterDecrementStepSize = 127
              DemDebounceCounterIncrementStepSize = 127
              DemDebounceCounterJumpDown = true
              DemDebounceCounterJumpUp = false
              DemDebounceCounterFailedThreshold = 10
              DemDebounceCounterPassedThreshold = -128
              DemDebounceBehavior = DEM_DEBOUNCE_FREEZE
              DemDebounceCounterJumpDownValue = 0
              DemDebounceCounterJumpUpValue = 0
              DemDebounceCounterStorage = false
              DemDebounceContinuous = false
          WarningIndicator (DemIndicatorAttribute):
            DemIndicatorFailureCycleSource = DEM_FAILURE_CYCLE_EVENT
            DemIndicatorHealingCycleCounterThreshold = 0
            DemIndicatorBehaviour = DEM_INDICATOR_CONTINUOUS
            DemIndicatorHealingCycleRef = PowerCycle
            DemIndicatorRef = DemGeneral/WarningIndicator
      DtcClass_DTC_0xd12083 (DemDTCClass): DemDTCSeverity=DEM_DTC_SEV_NO_SEVERITY, DemUdsDTC=13705347, DemImmediateNvStorage=true, DemDTCAttributesRef=DtcAttributes_41914fb7
      DTC_0x9a6857 (DemEventParameter):
        DemEventKind = DEM_EVENT_KIND_SWC
        DemEventTimeSeries = DEM_TIMESERIES_SNAPSHOT_NONE
        DemEventAvailable = true
        DemEventId = 2
        DemEventAvailableInVariant = true
        DemEventLatchTestFailed = false
        DemEventCreateInfoPort = true
        DemDTCClassRef = DtcClass_DTC_0x9a6857
        DemExtendedDataClassRef = ExtendedDataClass_dda5abf3
        DemFreezeFrameClassRef = FreezeFrame_8035c374
        DemFreezeFrameRecNumClassRef = FreezeFrameRecNum_bc8f2da9
        DemEventClass:
          DemAgingAllowed = true
          DemAgingCycleCounterThreshold = 100
          DemEventPriority = 2
          DemEventSignificance = DEM_EVENT_SIGNIFICANCE_FAULT
          DemEventFailureCycleCounterThreshold = 0
          DemConsiderPtoStatus = false
          DemFFPrestorageSupported = false
          DemAgingCycleRef = IgnitionCycle
          DemEnableConditionGroupRef = DemEnableConditionGroup_ECUPowerUp
          DemOperationCycleRef = PowerCycle
          DemDebounceAlgorithmClass
            DemDebounceCounterBased:
              DemDebounceCounterDecrementStepSize = 1
              DemDebounceCounterIncrementStepSize = 1
              DemDebounceCounterJumpDown = true
              DemDebounceCounterJumpUp = false
              DemDebounceCounterFailedThreshold = 127
              DemDebounceCounterPassedThreshold = -128
              DemDebounceBehavior = DEM_DEBOUNCE_FREEZE
              DemDebounceCounterJumpDownValue = 0
              DemDebounceCounterJumpUpValue = 0
              DemDebounceCounterStorage = false
              DemDebounceContinuous = false
      4 x DemDTCClass, all with DemDTCSeverity=DEM_DTC_SEV_NO_SEVERITY, DemImmediateNvStorage=true, DemDTCAttributesRef=DtcAttributes_41914fb7:
        DtcClass_DTC_0x164456: DemUdsDTC=1459286
        DtcClass_DTC_0xc11587: DemUdsDTC=12653959
        DtcClass_DTC_0xa10d00: DemUdsDTC=10554624
        DtcClass_DTC_0xd12081: DemUdsDTC=13705345
      DTC_0xa28b71 (DemEventParameter):  # Annotation PLAIN_TEXT COVERS: ARCH_SW_BSW_0013;
        DemEventKind = DEM_EVENT_KIND_SWC
        DemEventTimeSeries = DEM_TIMESERIES_SNAPSHOT_NONE
        DemEventAvailable = true
        DemEventId = 14
        DemEventAvailableInVariant = true
        DemEventLatchTestFailed = false
        DemEventCreateInfoPort = true
        DemDTCClassRef = DtcClass_DTC_0xa28b71
        DemExtendedDataClassRef = ExtendedDataClass_dda5abf3
        DemFreezeFrameClassRef = FreezeFrame_8035c374
        DemFreezeFrameRecNumClassRef = FreezeFrameRecNum_bc8f2da9
        DemEventClass:
          DemAgingAllowed = false
          DemAgingCycleCounterThreshold = 255
          DemEventPriority = 1
          DemEventSignificance = DEM_EVENT_SIGNIFICANCE_FAULT
          DemEventFailureCycleCounterThreshold = 0
          DemConsiderPtoStatus = false
          DemFFPrestorageSupported = false
          DemAgingCycleRef = IgnitionCycle
          DemEnableConditionGroupRef = DemEnableConditionGroup_ECUPowerUp
          DemOperationCycleRef = PowerCycle
          DemStorageConditionGroupRef = DemStorageConditionGroup_ECU_LEVEL
          DemDebounceAlgorithmClass
            DemDebounceCounterBased:
              DemDebounceCounterDecrementStepSize = 127
              DemDebounceCounterIncrementStepSize = 127
              DemDebounceCounterJumpDown = true
              DemDebounceCounterJumpUp = false
              DemDebounceCounterFailedThreshold = 10
              DemDebounceCounterPassedThreshold = -128
              DemDebounceBehavior = DEM_DEBOUNCE_FREEZE
              DemDebounceCounterJumpDownValue = 0
              DemDebounceCounterJumpUpValue = 0
              DemDebounceCounterStorage = false
              DemDebounceContinuous = false
          WarningIndicator (DemIndicatorAttribute):
            DemIndicatorFailureCycleSource = DEM_FAILURE_CYCLE_EVENT
            DemIndicatorHealingCycleCounterThreshold = 0
            DemIndicatorBehaviour = DEM_INDICATOR_CONTINUOUS
            DemIndicatorHealingCycleRef = PowerCycle
            DemIndicatorRef = DemGeneral/WarningIndicator
      9 x DemDTCClass, all with DemDTCSeverity=DEM_DTC_SEV_NO_SEVERITY, DemImmediateNvStorage=true, DemDTCAttributesRef=DtcAttributes_41914fb7:
        DtcClass_DTC_0xc15587: DemUdsDTC=12670343
        DtcClass_DTC_0xd12087: DemUdsDTC=13705351  # COVERS: PLAIN_TEXT ARCH_SW_ATM_0005;
        DtcClass_DTC_0xc15187: DemUdsDTC=12669319
        DtcClass_DTC_0xa28b49: DemUdsDTC=10652489
        DtcClass_DTC_0xc45208: DemUdsDTC=12866056
        DtcClass_DTC_0xc41608: DemUdsDTC=12850696
        DtcClass_DTC_0xa28b45: DemUdsDTC=10652485
        DtcClass_DTC_0xa28b47: DemUdsDTC=10652487
        DtcClass_DTC_0xc20187: DemUdsDTC=12714375
      6 x DemEventParameter, all with DemEventKind=DEM_EVENT_KIND_SWC, DemEventTimeSeries=DEM_TIMESERIES_SNAPSHOT_NONE, DemEventAvailable=true, DemEventAvailableInVariant=true, DemEventLatchTestFailed=false, DemEventCreateInfoPort=true, DemExtendedDataClassRef=ExtendedDataClass_dda5abf3, DemFreezeFrameRecNumClassRef=FreezeFrameRecNum_bc8f2da9:
        DTC_0xa10a00: DemEventId=4, DemDTCClassRef=DtcClass_DTC_0xa10a00, DemFreezeFrameClassRef=FreezeFrame_8035c374  # Annotation PLAIN_TEXT COVERS: ARCH_SW_BSW_0016;
          DemEventClass:
            DemAgingAllowed = true
            DemAgingCycleCounterThreshold = 100
            DemEventPriority = 2
            DemEventSignificance = DEM_EVENT_SIGNIFICANCE_OCCURRENCE
            DemEventFailureCycleCounterThreshold = 0
            DemConsiderPtoStatus = false
            DemFFPrestorageSupported = false
            DemAgingCycleRef = IgnitionCycle
            DemEnableConditionGroupRef = DemEnableConditionGroup_ECUPowerUp
            DemOperationCycleRef = PowerCycle
            DemStorageConditionGroupRef = DemStorageConditionGroup_PowerDistribution
            DemDebounceAlgorithmClass
              DemDebounceCounterBased:
                DemDebounceCounterDecrementStepSize = 1
                DemDebounceCounterIncrementStepSize = 1
                DemDebounceCounterJumpDown = true
                DemDebounceCounterJumpUp = false
                DemDebounceCounterFailedThreshold = 127
                DemDebounceCounterPassedThreshold = -128
                DemDebounceBehavior = DEM_DEBOUNCE_FREEZE
                DemDebounceCounterJumpDownValue = 0
                DemDebounceCounterJumpUpValue = 0
                DemDebounceCounterStorage = false
                DemDebounceContinuous = false
        DTC_0xd12081: DemEventId=30, DemDTCClassRef=DtcClass_DTC_0xd12081, DemFreezeFrameClassRef=FreezeFrame_8035c374  # Annotation PLAIN_TEXT COVERS: ARCH_SW_BSW_0013;
          DemEventClass:
            DemAgingAllowed = true
            DemAgingCycleCounterThreshold = 10
            DemEventPriority = 2
            DemEventSignificance = DEM_EVENT_SIGNIFICANCE_OCCURRENCE
            DemEventFailureCycleCounterThreshold = 0
            DemConsiderPtoStatus = false
            DemFFPrestorageSupported = false
            DemAgingCycleRef = IgnitionCycle
            DemEnableConditionGroupRef = DemEnableConditionGroup_ECUPowerUp
            DemOperationCycleRef = PowerCycle
            DemStorageConditionGroupRef = DemStorageConditionGroup_ECU_LEVEL
            DemDebounceAlgorithmClass
              DemDebounceCounterBased:
                DemDebounceCounterDecrementStepSize = 1
                DemDebounceCounterIncrementStepSize = 1
                DemDebounceCounterJumpDown = true
                DemDebounceCounterJumpUp = false
                DemDebounceCounterFailedThreshold = 127
                DemDebounceCounterPassedThreshold = -128
                DemDebounceBehavior = DEM_DEBOUNCE_FREEZE
                DemDebounceCounterJumpDownValue = 0
                DemDebounceCounterJumpUpValue = 0
                DemDebounceCounterStorage = false
                DemDebounceContinuous = false
          DemCallbackInitMForE
        DTC_0xd12083: DemEventId=31, DemDTCClassRef=DtcClass_DTC_0xd12083, DemFreezeFrameClassRef=FreezeFrame_b430d746  # Annotation PLAIN_TEXT COVERS: ARCH_SW_BSW_0013;
          DemEventClass:
            DemAgingAllowed = true
            DemAgingCycleCounterThreshold = 10
            DemEventPriority = 2
            DemEventSignificance = DEM_EVENT_SIGNIFICANCE_OCCURRENCE
            DemEventFailureCycleCounterThreshold = 0
            DemConsiderPtoStatus = false
            DemFFPrestorageSupported = false
            DemAgingCycleRef = IgnitionCycle
            DemEnableConditionGroupRef = DemEnableConditionGroup_ECUPowerUp
            DemOperationCycleRef = PowerCycle
            DemStorageConditionGroupRef = DemStorageConditionGroup_ECU_LEVEL
            DemDebounceAlgorithmClass
              DemDebounceCounterBased:
                DemDebounceCounterDecrementStepSize = 1
                DemDebounceCounterIncrementStepSize = 1
                DemDebounceCounterJumpDown = true
                DemDebounceCounterJumpUp = false
                DemDebounceCounterFailedThreshold = 127
                DemDebounceCounterPassedThreshold = -128
                DemDebounceBehavior = DEM_DEBOUNCE_FREEZE
                DemDebounceCounterJumpDownValue = 0
                DemDebounceCounterJumpUpValue = 0
                DemDebounceCounterStorage = false
                DemDebounceContinuous = false
          DemCallbackInitMForE
        DTC_0xa10e00: DemEventId=7, DemDTCClassRef=DtcClass_DTC_0xa10e00, DemFreezeFrameClassRef=FreezeFrame_8035c374  # Annotation PLAIN_TEXT COVERS: ARCH_SW_BSW_0016;
          DemEventClass:
            DemAgingAllowed = true
            DemAgingCycleCounterThreshold = 100
            DemEventPriority = 2
            DemEventSignificance = DEM_EVENT_SIGNIFICANCE_OCCURRENCE
            DemEventFailureCycleCounterThreshold = 0
            DemConsiderPtoStatus = false
            DemFFPrestorageSupported = false
            DemAgingCycleRef = IgnitionCycle
            DemEnableConditionGroupRef = DemEnableConditionGroup_ECUPowerUp
            DemOperationCycleRef = PowerCycle
            DemStorageConditionGroupRef = DemStorageConditionGroup_PowerDistribution
            DemDebounceAlgorithmClass
              DemDebounceCounterBased:
                DemDebounceCounterDecrementStepSize = 1
                DemDebounceCounterIncrementStepSize = 1
                DemDebounceCounterJumpDown = true
                DemDebounceCounterJumpUp = false
                DemDebounceCounterFailedThreshold = 127
                DemDebounceCounterPassedThreshold = -128
                DemDebounceBehavior = DEM_DEBOUNCE_FREEZE
                DemDebounceCounterJumpDownValue = 0
                DemDebounceCounterJumpUpValue = 0
                DemDebounceCounterStorage = false
                DemDebounceContinuous = false
        DTC_0x164456: DemEventId=3, DemDTCClassRef=DtcClass_DTC_0x164456, DemFreezeFrameClassRef=FreezeFrame_8035c374  # Annotation PLAIN_TEXT COVERS: ARCH_SW_BSW_0015;
          DemEventClass:
            DemAgingAllowed = true
            DemAgingCycleCounterThreshold = 100
            DemEventPriority = 2
            DemEventSignificance = DEM_EVENT_SIGNIFICANCE_FAULT
            DemEventFailureCycleCounterThreshold = 0
            DemConsiderPtoStatus = false
            DemFFPrestorageSupported = false
            DemAgingCycleRef = IgnitionCycle
            DemEnableConditionGroupRef = DemEnableConditionGroup_ECUPowerUp
            DemOperationCycleRef = PowerCycle
            DemStorageConditionGroupRef = DemStorageConditionGroup_NetworkCommunication_WithoutClamp15
            DemDebounceAlgorithmClass
              DemDebounceCounterBased:
                DemDebounceCounterDecrementStepSize = 1
                DemDebounceCounterIncrementStepSize = 1
                DemDebounceCounterJumpDown = true
                DemDebounceCounterJumpUp = false
                DemDebounceCounterFailedThreshold = 127
                DemDebounceCounterPassedThreshold = -128
                DemDebounceBehavior = DEM_DEBOUNCE_FREEZE
                DemDebounceCounterJumpDownValue = 0
                DemDebounceCounterJumpUpValue = 0
                DemDebounceCounterStorage = false
                DemDebounceContinuous = false
          DemCallbackInitMForE
        DTC_0xa28bfa: DemEventId=17, DemDTCClassRef=DtcClass_DTC_0xa28bfa, DemFreezeFrameClassRef=FreezeFrame_8035c374  # Annotation PLAIN_TEXT COVERS: ARCH_SW_BSW_0013;
          DemEventClass:
            DemAgingAllowed = false
            DemAgingCycleCounterThreshold = 255
            DemEventPriority = 1
            DemEventSignificance = DEM_EVENT_SIGNIFICANCE_OCCURRENCE
            DemEventFailureCycleCounterThreshold = 0
            DemConsiderPtoStatus = false
            DemFFPrestorageSupported = false
            DemAgingCycleRef = IgnitionCycle
            DemEnableConditionGroupRef = DemEnableConditionGroup_ECUPowerUp
            DemOperationCycleRef = PowerCycle
            DemStorageConditionGroupRef = DemStorageConditionGroup_ECU_LEVEL
            DemDebounceAlgorithmClass
              DemDebounceCounterBased:
                DemDebounceCounterDecrementStepSize = 127
                DemDebounceCounterIncrementStepSize = 127
                DemDebounceCounterJumpDown = true
                DemDebounceCounterJumpUp = false
                DemDebounceCounterFailedThreshold = 10
                DemDebounceCounterPassedThreshold = -128
                DemDebounceBehavior = DEM_DEBOUNCE_FREEZE
                DemDebounceCounterJumpDownValue = 0
                DemDebounceCounterJumpUpValue = 0
                DemDebounceCounterStorage = false
                DemDebounceContinuous = false
      DtcClass_DTC_0xa20400 (DemDTCClass): DemDTCSeverity=DEM_DTC_SEV_NO_SEVERITY, DemUdsDTC=10617856, DemImmediateNvStorage=true, DemDTCAttributesRef=DtcAttributes_41914fb7
      DtcClass_DTC_0xc16887 (DemDTCClass): DemDTCSeverity=DEM_DTC_SEV_NO_SEVERITY, DemUdsDTC=12675207, DemImmediateNvStorage=true, DemDTCAttributesRef=DtcAttributes_41914fb7
      3 x DemEventParameter, all with DemEventKind=DEM_EVENT_KIND_SWC, DemEventTimeSeries=DEM_TIMESERIES_SNAPSHOT_NONE, DemEventAvailable=true, DemEventAvailableInVariant=true, DemEventLatchTestFailed=false, DemEventCreateInfoPort=true, DemExtendedDataClassRef=ExtendedDataClass_dda5abf3, DemFreezeFrameClassRef=FreezeFrame_8035c374, DemFreezeFrameRecNumClassRef=FreezeFrameRecNum_bc8f2da9:
        DTC_0xc15587: DemEventId=22, DemDTCClassRef=DtcClass_DTC_0xc15587  # Annotation PLAIN_TEXT COVERS: ARCH_SW_BSW_0014;
          DemEventClass:
            DemAgingAllowed = true
            DemAgingCycleCounterThreshold = 10
            DemEventPriority = 2
            DemEventSignificance = DEM_EVENT_SIGNIFICANCE_OCCURRENCE
            DemEventFailureCycleCounterThreshold = 0
            DemConsiderPtoStatus = false
            DemFFPrestorageSupported = false
            DemAgingCycleRef = IgnitionCycle
            DemEnableConditionGroupRef = DemEnableConditionGroup_ECUPowerUp
            DemOperationCycleRef = PowerCycle
            DemStorageConditionGroupRef = DemStorageConditionGroup_NetworkCommunication
            DemDebounceAlgorithmClass
              DemDebounceCounterBased:
                DemDebounceCounterDecrementStepSize = 1
                DemDebounceCounterIncrementStepSize = 1
                DemDebounceCounterJumpDown = true
                DemDebounceCounterJumpUp = false
                DemDebounceCounterFailedThreshold = 127
                DemDebounceCounterPassedThreshold = -128
                DemDebounceBehavior = DEM_DEBOUNCE_FREEZE
                DemDebounceCounterJumpDownValue = 0
                DemDebounceCounterJumpUpValue = 0
                DemDebounceCounterStorage = false
                DemDebounceContinuous = false
        DTC_0xd22488: DemEventId=33, DemDTCClassRef=DtcClass_DTC_0xd22488  # Annotation PLAIN_TEXT COVERS: ARCH_SW_BSW_0016;
          DemEventClass:
            DemAgingAllowed = true
            DemAgingCycleCounterThreshold = 100
            DemEventPriority = 2
            DemEventSignificance = DEM_EVENT_SIGNIFICANCE_FAULT
            DemEventFailureCycleCounterThreshold = 0
            DemConsiderPtoStatus = false
            DemFFPrestorageSupported = false
            DemAgingCycleRef = IgnitionCycle
            DemEnableConditionGroupRef = DemEnableConditionGroup_ECUPowerUp
            DemOperationCycleRef = PowerCycle
            DemStorageConditionGroupRef = DemStorageConditionGroup_PowerDistribution
            DemDebounceAlgorithmClass
              DemDebounceCounterBased:
                DemDebounceCounterDecrementStepSize = 1
                DemDebounceCounterIncrementStepSize = 1
                DemDebounceCounterJumpDown = true
                DemDebounceCounterJumpUp = false
                DemDebounceCounterFailedThreshold = 127
                DemDebounceCounterPassedThreshold = -128
                DemDebounceBehavior = DEM_DEBOUNCE_FREEZE
                DemDebounceCounterJumpDownValue = 0
                DemDebounceCounterJumpUpValue = 0
                DemDebounceCounterStorage = false
                DemDebounceContinuous = false
        DTC_0xd12087: DemEventId=32, DemDTCClassRef=DtcClass_DTC_0xd12087  # Annotation PLAIN_TEXT COVERS: ARCH_SW_BSW_0013;
          DemEventClass:
            DemAgingAllowed = true
            DemAgingCycleCounterThreshold = 10
            DemEventPriority = 2
            DemEventSignificance = DEM_EVENT_SIGNIFICANCE_OCCURRENCE
            DemEventFailureCycleCounterThreshold = 0
            DemConsiderPtoStatus = false
            DemFFPrestorageSupported = false
            DemAgingCycleRef = IgnitionCycle
            DemEnableConditionGroupRef = DemEnableConditionGroup_ECUPowerUp
            DemOperationCycleRef = PowerCycle
            DemStorageConditionGroupRef = DemStorageConditionGroup_ECU_LEVEL
            DemDebounceAlgorithmClass
              DemDebounceTimeBase: DemDebounceTimeFailedThreshold=3, DemDebounceTimePassedThreshold=0.01, DemDebounceBehavior=DEM_DEBOUNCE_FREEZE, DemDebounceContinuous=false
          DemCallbackInitMForE
      DtcClass_DTC_0xc12287 (DemDTCClass): DemDTCSeverity=DEM_DTC_SEV_NO_SEVERITY, DemUdsDTC=12657287, DemImmediateNvStorage=true, DemDTCAttributesRef=DtcAttributes_41914fb7
      DTC_0xc11587 (DemEventParameter):  # Annotation PLAIN_TEXT COVERS: ARCH_SW_BSW_0014;
        DemEventKind = DEM_EVENT_KIND_SWC
        DemEventTimeSeries = DEM_TIMESERIES_SNAPSHOT_NONE
        DemEventAvailable = true
        DemEventId = 19
        DemEventAvailableInVariant = true
        DemEventLatchTestFailed = false
        DemEventCreateInfoPort = true
        DemDTCClassRef = DtcClass_DTC_0xc11587
        DemExtendedDataClassRef = ExtendedDataClass_dda5abf3
        DemFreezeFrameClassRef = FreezeFrame_8035c374
        DemFreezeFrameRecNumClassRef = FreezeFrameRecNum_bc8f2da9
        DemEventClass:
          DemAgingAllowed = true
          DemAgingCycleCounterThreshold = 10
          DemEventPriority = 2
          DemEventSignificance = DEM_EVENT_SIGNIFICANCE_OCCURRENCE
          DemEventFailureCycleCounterThreshold = 0
          DemConsiderPtoStatus = false
          DemFFPrestorageSupported = false
          DemAgingCycleRef = IgnitionCycle
          DemEnableConditionGroupRef = DemEnableConditionGroup_ECUPowerUp
          DemOperationCycleRef = PowerCycle
          DemStorageConditionGroupRef = DemStorageConditionGroup_NetworkCommunication
          DemDebounceAlgorithmClass
            DemDebounceCounterBased:
              DemDebounceCounterDecrementStepSize = 1
              DemDebounceCounterIncrementStepSize = 1
              DemDebounceCounterJumpDown = true
              DemDebounceCounterJumpUp = false
              DemDebounceCounterFailedThreshold = 127
              DemDebounceCounterPassedThreshold = -128
              DemDebounceBehavior = DEM_DEBOUNCE_FREEZE
              DemDebounceCounterJumpDownValue = 0
              DemDebounceCounterJumpUpValue = 0
              DemDebounceCounterStorage = false
              DemDebounceContinuous = false
      DtcClass_DTC_0xa28b71 (DemDTCClass): DemDTCSeverity=DEM_DTC_SEV_NO_SEVERITY, DemUdsDTC=10652529, DemImmediateNvStorage=true, DemDTCAttributesRef=DtcAttributes_41914fb7
      3 x DemEventParameter, all with DemEventKind=DEM_EVENT_KIND_SWC, DemEventTimeSeries=DEM_TIMESERIES_SNAPSHOT_NONE, DemEventAvailable=true, DemEventAvailableInVariant=true, DemEventLatchTestFailed=false, DemEventCreateInfoPort=true, DemExtendedDataClassRef=ExtendedDataClass_dda5abf3, DemFreezeFrameClassRef=FreezeFrame_8035c374, DemFreezeFrameRecNumClassRef=FreezeFrameRecNum_bc8f2da9:
        DTC_0xc15187: DemEventId=21, DemDTCClassRef=DtcClass_DTC_0xc15187  # Annotation PLAIN_TEXT COVERS: ARCH_SW_BSW_0021; ARCH_SW_BSW_0014;
          DemEventClass:
            DemAgingAllowed = true
            DemAgingCycleCounterThreshold = 10
            DemEventPriority = 2
            DemEventSignificance = DEM_EVENT_SIGNIFICANCE_OCCURRENCE
            DemEventFailureCycleCounterThreshold = 0
            DemConsiderPtoStatus = false
            DemFFPrestorageSupported = false
            DemAgingCycleRef = IgnitionCycle
            DemEnableConditionGroupRef = DemEnableConditionGroup_IgnitionON
            DemOperationCycleRef = PowerCycle
            DemStorageConditionGroupRef = DemStorageConditionGroup_NetworkCommunication
            DemDebounceAlgorithmClass
              DemDebounceCounterBased:
                DemDebounceCounterDecrementStepSize = 1
                DemDebounceCounterIncrementStepSize = 1
                DemDebounceCounterJumpDown = true
                DemDebounceCounterJumpUp = false
                DemDebounceCounterFailedThreshold = 10
                DemDebounceCounterPassedThreshold = -128
                DemDebounceBehavior = DEM_DEBOUNCE_FREEZE
                DemDebounceCounterJumpDownValue = 0
                DemDebounceCounterJumpUpValue = 0
                DemDebounceCounterStorage = false
                DemDebounceContinuous = false
            WarningIndicator (DemIndicatorAttribute):
              DemIndicatorFailureCycleSource = DEM_FAILURE_CYCLE_EVENT
              DemIndicatorHealingCycleCounterThreshold = 100
              DemIndicatorBehaviour = DEM_INDICATOR_CONTINUOUS
              DemIndicatorHealingCycleRef = PowerCycle
              DemIndicatorRef = DemGeneral/WarningIndicator
        DTC_0xc20187: DemEventId=24, DemDTCClassRef=DtcClass_DTC_0xc20187  # Annotation PLAIN_TEXT COVERS: ARCH_SW_BSW_0021; ARCH_SW_BSW_0014;
          DemEventClass:
            DemAgingAllowed = true
            DemAgingCycleCounterThreshold = 10
            DemEventPriority = 2
            DemEventSignificance = DEM_EVENT_SIGNIFICANCE_OCCURRENCE
            DemEventFailureCycleCounterThreshold = 0
            DemConsiderPtoStatus = false
            DemFFPrestorageSupported = false
            DemAgingCycleRef = IgnitionCycle
            DemEnableConditionGroupRef = DemEnableConditionGroup_CodingRBTMFL
            DemOperationCycleRef = PowerCycle
            DemStorageConditionGroupRef = DemStorageConditionGroup_NetworkCommunication
            DemDebounceAlgorithmClass
              DemDebounceCounterBased:
                DemDebounceCounterDecrementStepSize = 1
                DemDebounceCounterIncrementStepSize = 1
                DemDebounceCounterJumpDown = true
                DemDebounceCounterJumpUp = false
                DemDebounceCounterFailedThreshold = 127
                DemDebounceCounterPassedThreshold = -128
                DemDebounceBehavior = DEM_DEBOUNCE_FREEZE
                DemDebounceCounterJumpDownValue = 0
                DemDebounceCounterJumpUpValue = 0
                DemDebounceCounterStorage = false
                DemDebounceContinuous = false
        DTC_0xa28b4b: DemEventId=8, DemDTCClassRef=DtcClass_DTC_0xa28b4b  # Annotation PLAIN_TEXT COVERS: ARCH_SW_BSW_0013;
          DemEventClass:
            DemAgingAllowed = true
            DemAgingCycleCounterThreshold = 100
            DemEventPriority = 2
            DemEventSignificance = DEM_EVENT_SIGNIFICANCE_OCCURRENCE
            DemEventFailureCycleCounterThreshold = 0
            DemConsiderPtoStatus = false
            DemFFPrestorageSupported = false
            DemAgingCycleRef = IgnitionCycle
            DemEnableConditionGroupRef = DemEnableConditionGroup_ECUPowerUp
            DemOperationCycleRef = PowerCycle
            DemStorageConditionGroupRef = DemStorageConditionGroup_ECU_LEVEL
            DemDebounceAlgorithmClass
              DemDebounceCounterBased:
                DemDebounceCounterDecrementStepSize = 127
                DemDebounceCounterIncrementStepSize = 127
                DemDebounceCounterJumpDown = true
                DemDebounceCounterJumpUp = false
                DemDebounceCounterFailedThreshold = 10
                DemDebounceCounterPassedThreshold = -128
                DemDebounceBehavior = DEM_DEBOUNCE_FREEZE
                DemDebounceCounterJumpDownValue = 0
                DemDebounceCounterJumpUpValue = 0
                DemDebounceCounterStorage = false
                DemDebounceContinuous = false
            WarningIndicator (DemIndicatorAttribute):
              DemIndicatorFailureCycleSource = DEM_FAILURE_CYCLE_EVENT
              DemIndicatorHealingCycleCounterThreshold = 0
              DemIndicatorBehaviour = DEM_INDICATOR_CONTINUOUS
              DemIndicatorHealingCycleRef = PowerCycle
              DemIndicatorRef = DemGeneral/WarningIndicator
      DtcClass_DTC_0xa10a00 (DemDTCClass): DemDTCSeverity=DEM_DTC_SEV_NO_SEVERITY, DemUdsDTC=10553856, DemImmediateNvStorage=true, DemDTCAttributesRef=DtcAttributes_41914fb7
      DTC_0xa28b96 (DemEventParameter):  # Annotation PLAIN_TEXT COVERS: ARCH_SW_BSW_0013;
        DemEventKind = DEM_EVENT_KIND_SWC
        DemEventTimeSeries = DEM_TIMESERIES_SNAPSHOT_NONE
        DemEventAvailable = true
        DemEventId = 15
        DemEventAvailableInVariant = true
        DemEventLatchTestFailed = false
        DemEventCreateInfoPort = true
        DemDTCClassRef = DtcClass_DTC_0xa28b96
        DemExtendedDataClassRef = ExtendedDataClass_dda5abf3
        DemFreezeFrameClassRef = FreezeFrame_8035c374
        DemFreezeFrameRecNumClassRef = FreezeFrameRecNum_bc8f2da9
        DemEventClass:
          DemAgingAllowed = false
          DemAgingCycleCounterThreshold = 255
          DemEventPriority = 1
          DemEventSignificance = DEM_EVENT_SIGNIFICANCE_FAULT
          DemEventFailureCycleCounterThreshold = 0
          DemConsiderPtoStatus = false
          DemFFPrestorageSupported = false
          DemAgingCycleRef = IgnitionCycle
          DemEnableConditionGroupRef = DemEnableConditionGroup_ECUPowerUp
          DemOperationCycleRef = PowerCycle
          DemStorageConditionGroupRef = DemStorageConditionGroup_ECU_LEVEL
          DemDebounceAlgorithmClass
            DemDebounceCounterBased:
              DemDebounceCounterDecrementStepSize = 127
              DemDebounceCounterIncrementStepSize = 127
              DemDebounceCounterJumpDown = true
              DemDebounceCounterJumpUp = false
              DemDebounceCounterFailedThreshold = 10
              DemDebounceCounterPassedThreshold = -128
              DemDebounceBehavior = DEM_DEBOUNCE_FREEZE
              DemDebounceCounterJumpDownValue = 0
              DemDebounceCounterJumpUpValue = 0
              DemDebounceCounterStorage = false
              DemDebounceContinuous = false
          WarningIndicator (DemIndicatorAttribute):
            DemIndicatorFailureCycleSource = DEM_FAILURE_CYCLE_EVENT
            DemIndicatorHealingCycleCounterThreshold = 0
            DemIndicatorBehaviour = DEM_INDICATOR_CONTINUOUS
            DemIndicatorHealingCycleRef = PowerCycle
            DemIndicatorRef = DemGeneral/WarningIndicator
      DtcClass_DTC_0xa10e00 (DemDTCClass): DemDTCSeverity=DEM_DTC_SEV_NO_SEVERITY, DemUdsDTC=10554880, DemImmediateNvStorage=true, DemDTCAttributesRef=DtcAttributes_41914fb7
      DTC_0xc12287 (DemEventParameter):  # Annotation PLAIN_TEXT COVERS: ARCH_SW_BSW_0014;
        DemEventKind = DEM_EVENT_KIND_SWC
        DemEventTimeSeries = DEM_TIMESERIES_SNAPSHOT_NONE
        DemEventAvailable = true
        DemEventId = 20
        DemEventAvailableInVariant = true
        DemEventLatchTestFailed = false
        DemEventCreateInfoPort = true
        DemDTCClassRef = DtcClass_DTC_0xc12287
        DemExtendedDataClassRef = ExtendedDataClass_dda5abf3
        DemFreezeFrameClassRef = FreezeFrame_8035c374
        DemFreezeFrameRecNumClassRef = FreezeFrameRecNum_bc8f2da9
        DemEventClass:
          DemAgingAllowed = true
          DemAgingCycleCounterThreshold = 10
          DemEventPriority = 2
          DemEventSignificance = DEM_EVENT_SIGNIFICANCE_OCCURRENCE
          DemEventFailureCycleCounterThreshold = 0
          DemConsiderPtoStatus = false
          DemFFPrestorageSupported = false
          DemAgingCycleRef = IgnitionCycle
          DemEnableConditionGroupRef = DemEnableConditionGroup_ECUPowerUp
          DemOperationCycleRef = PowerCycle
          DemStorageConditionGroupRef = DemStorageConditionGroup_NetworkCommunication
          DemDebounceAlgorithmClass
            DemDebounceCounterBased:
              DemDebounceCounterDecrementStepSize = 1
              DemDebounceCounterIncrementStepSize = 1
              DemDebounceCounterJumpDown = true
              DemDebounceCounterJumpUp = false
              DemDebounceCounterFailedThreshold = 10
              DemDebounceCounterPassedThreshold = -128
              DemDebounceBehavior = DEM_DEBOUNCE_FREEZE
              DemDebounceCounterJumpDownValue = 0
              DemDebounceCounterJumpUpValue = 0
              DemDebounceCounterStorage = false
              DemDebounceContinuous = false
          WarningIndicator (DemIndicatorAttribute):
            DemIndicatorFailureCycleSource = DEM_FAILURE_CYCLE_EVENT
            DemIndicatorHealingCycleCounterThreshold = 100
            DemIndicatorBehaviour = DEM_INDICATOR_CONTINUOUS
            DemIndicatorHealingCycleRef = PowerCycle
            DemIndicatorRef = DemGeneral/WarningIndicator
      DtcClass_DTC_0xa28bfa (DemDTCClass): DemDTCSeverity=DEM_DTC_SEV_NO_SEVERITY, DemUdsDTC=10652666, DemImmediateNvStorage=true, DemDTCAttributesRef=DtcAttributes_41914fb7
      4 x DemEventParameter, all with DemEventKind=DEM_EVENT_KIND_SWC, DemEventTimeSeries=DEM_TIMESERIES_SNAPSHOT_NONE, DemEventAvailable=true, DemEventAvailableInVariant=true, DemEventLatchTestFailed=false, DemEventCreateInfoPort=true, DemExtendedDataClassRef=ExtendedDataClass_dda5abf3, DemFreezeFrameClassRef=FreezeFrame_8035c374, DemFreezeFrameRecNumClassRef=FreezeFrameRecNum_bc8f2da9:
        DTC_0xc16887: DemEventId=23, DemDTCClassRef=DtcClass_DTC_0xc16887  # Annotation PLAIN_TEXT COVERS: ARCH_SW_BSW_0015;
          DemEventClass:
            DemAgingAllowed = true
            DemAgingCycleCounterThreshold = 10
            DemEventPriority = 2
            DemEventSignificance = DEM_EVENT_SIGNIFICANCE_OCCURRENCE
            DemEventFailureCycleCounterThreshold = 0
            DemConsiderPtoStatus = false
            DemFFPrestorageSupported = false
            DemAgingCycleRef = IgnitionCycle
            DemEnableConditionGroupRef = DemEnableConditionGroup_ECUPowerUp
            DemOperationCycleRef = PowerCycle
            DemStorageConditionGroupRef = DemStorageConditionGroup_NetworkCommunication_WithoutClamp15
            DemDebounceAlgorithmClass
              DemDebounceCounterBased:
                DemDebounceCounterDecrementStepSize = 1
                DemDebounceCounterIncrementStepSize = 1
                DemDebounceCounterJumpDown = true
                DemDebounceCounterJumpUp = false
                DemDebounceCounterFailedThreshold = 127
                DemDebounceCounterPassedThreshold = -128
                DemDebounceBehavior = DEM_DEBOUNCE_FREEZE
                DemDebounceCounterJumpDownValue = 0
                DemDebounceCounterJumpUpValue = 0
                DemDebounceCounterStorage = false
                DemDebounceContinuous = false
        DTC_0xa28b97: DemEventId=16, DemDTCClassRef=DtcClass_DTC_0xa28b97  # Annotation PLAIN_TEXT COVERS: ARCH_SW_BSW_0013;
          DemEventClass:
            DemAgingAllowed = false
            DemAgingCycleCounterThreshold = 255
            DemEventPriority = 1
            DemEventSignificance = DEM_EVENT_SIGNIFICANCE_FAULT
            DemEventFailureCycleCounterThreshold = 0
            DemConsiderPtoStatus = false
            DemFFPrestorageSupported = false
            DemAgingCycleRef = IgnitionCycle
            DemEnableConditionGroupRef = DemEnableConditionGroup_ECUPowerUp
            DemOperationCycleRef = PowerCycle
            DemStorageConditionGroupRef = DemStorageConditionGroup_ECU_LEVEL
            DemDebounceAlgorithmClass
              DemDebounceCounterBased:
                DemDebounceCounterDecrementStepSize = 127
                DemDebounceCounterIncrementStepSize = 127
                DemDebounceCounterJumpDown = true
                DemDebounceCounterJumpUp = false
                DemDebounceCounterFailedThreshold = 10
                DemDebounceCounterPassedThreshold = -128
                DemDebounceBehavior = DEM_DEBOUNCE_FREEZE
                DemDebounceCounterJumpDownValue = 0
                DemDebounceCounterJumpUpValue = 0
                DemDebounceCounterStorage = false
                DemDebounceContinuous = false
        DTC_0xa28b16: DemEventId=9, DemDTCClassRef=DtcClass_DTC_0xa28b16  # Annotation PLAIN_TEXT COVERS: ARCH_SW_BSW_0016;
          DemEventClass:
            DemAgingAllowed = true
            DemAgingCycleCounterThreshold = 100
            DemEventPriority = 2
            DemEventSignificance = DEM_EVENT_SIGNIFICANCE_OCCURRENCE
            DemEventFailureCycleCounterThreshold = 0
            DemConsiderPtoStatus = false
            DemFFPrestorageSupported = false
            DemAgingCycleRef = IgnitionCycle
            DemEnableConditionGroupRef = DemEnableConditionGroup_ECUPowerUp
            DemOperationCycleRef = PowerCycle
            DemStorageConditionGroupRef = DemStorageConditionGroup_PowerDistribution
            DemDebounceAlgorithmClass
              DemDebounceCounterBased:
                DemDebounceCounterDecrementStepSize = 127
                DemDebounceCounterIncrementStepSize = 43
                DemDebounceCounterJumpDown = true
                DemDebounceCounterJumpUp = false
                DemDebounceCounterFailedThreshold = 10
                DemDebounceCounterPassedThreshold = -128
                DemDebounceBehavior = DEM_DEBOUNCE_FREEZE
                DemDebounceCounterJumpDownValue = 0
                DemDebounceCounterJumpUpValue = 0
                DemDebounceCounterStorage = false
                DemDebounceContinuous = false
        DTC_0xc42708: DemEventId=27, DemDTCClassRef=DtcClass_DTC_0xc42708  # Annotation PLAIN_TEXT COVERS: ARCH_SW_BSW_0021; ARCH_SW_BSW_0014;
          DemEventClass:
            DemAgingAllowed = true
            DemAgingCycleCounterThreshold = 10
            DemEventPriority = 2
            DemEventSignificance = DEM_EVENT_SIGNIFICANCE_OCCURRENCE
            DemEventFailureCycleCounterThreshold = 0
            DemConsiderPtoStatus = false
            DemFFPrestorageSupported = false
            DemAgingCycleRef = IgnitionCycle
            DemEnableConditionGroupRef = DemEnableConditionGroup_IgnitionON
            DemOperationCycleRef = PowerCycle
            DemStorageConditionGroupRef = DemStorageConditionGroup_NetworkCommunication
            DemDebounceAlgorithmClass
              DemDebounceCounterBased:
                DemDebounceCounterDecrementStepSize = 1
                DemDebounceCounterIncrementStepSize = 1
                DemDebounceCounterJumpDown = true
                DemDebounceCounterJumpUp = false
                DemDebounceCounterFailedThreshold = 127
                DemDebounceCounterPassedThreshold = -128
                DemDebounceBehavior = DEM_DEBOUNCE_FREEZE
                DemDebounceCounterJumpDownValue = 0
                DemDebounceCounterJumpUpValue = 0
                DemDebounceCounterStorage = false
                DemDebounceContinuous = false
            WarningIndicator (DemIndicatorAttribute):
              DemIndicatorFailureCycleSource = DEM_FAILURE_CYCLE_EVENT
              DemIndicatorHealingCycleCounterThreshold = 100
              DemIndicatorBehaviour = DEM_INDICATOR_CONTINUOUS
              DemIndicatorHealingCycleRef = PowerCycle
              DemIndicatorRef = DemGeneral/WarningIndicator
      DtcClass_DTC_0x1ca000 (DemDTCClass): DemDTCSeverity=DEM_DTC_SEV_NO_SEVERITY, DemUdsDTC=1875968, DemImmediateNvStorage=true, DemDTCAttributesRef=DtcAttributes_41914fb7
      5 x DemEventParameter, all with DemEventTimeSeries=DEM_TIMESERIES_SNAPSHOT_NONE, DemEventAvailable=true, DemEventAvailableInVariant=true, DemEventLatchTestFailed=false, DemEventCreateInfoPort=true:
        DTC_0xa28b17: DemEventKind=DEM_EVENT_KIND_SWC, DemEventId=10, DemDTCClassRef=DtcClass_DTC_0xa28b17, DemExtendedDataClassRef=ExtendedDataClass_dda5abf3, DemFreezeFrameClassRef=FreezeFrame_8035c374, DemFreezeFrameRecNumClassRef=FreezeFrameRecNum_bc8f2da9  # Annotation PLAIN_TEXT COVERS: ARCH_SW_BSW_0016;
          DemEventClass:
            DemAgingAllowed = true
            DemAgingCycleCounterThreshold = 100
            DemEventPriority = 2
            DemEventSignificance = DEM_EVENT_SIGNIFICANCE_OCCURRENCE
            DemEventFailureCycleCounterThreshold = 0
            DemConsiderPtoStatus = false
            DemFFPrestorageSupported = false
            DemAgingCycleRef = IgnitionCycle
            DemEnableConditionGroupRef = DemEnableConditionGroup_ECUPowerUp
            DemOperationCycleRef = PowerCycle
            DemStorageConditionGroupRef = DemStorageConditionGroup_PowerDistribution
            DemDebounceAlgorithmClass
              DemDebounceCounterBased:
                DemDebounceCounterDecrementStepSize = 127
                DemDebounceCounterIncrementStepSize = 43
                DemDebounceCounterJumpDown = true
                DemDebounceCounterJumpUp = false
                DemDebounceCounterFailedThreshold = 10
                DemDebounceCounterPassedThreshold = -128
                DemDebounceBehavior = DEM_DEBOUNCE_FREEZE
                DemDebounceCounterJumpDownValue = 0
                DemDebounceCounterJumpUpValue = 0
                DemDebounceCounterStorage = false
                DemDebounceContinuous = false
        ADC_ERROR_Dummy: DemEventId=39, DemEventKind=DEM_EVENT_KIND_SWC
          DemEventClass:
            DemAgingCycleCounterThreshold = 100
            DemFFPrestorageSupported = false
            DemEventPriority = 2
            DemEventSignificance = DEM_EVENT_SIGNIFICANCE_FAULT
            DemAgingAllowed = false
            DemConsiderPtoStatus = false
            DemOperationCycleRef = PowerCycle
            DemDebounceAlgorithmClass
              DemDebounceTimeBase: DemDebounceBehavior=DEM_DEBOUNCE_FREEZE, DemDebounceTimeFailedThreshold=0.01, DemDebounceTimePassedThreshold=0.01, DemDebounceContinuous=false
        MCU_E_OSC_FAILURE: DemEventId=40, DemEventKind=DEM_EVENT_KIND_BSW
          DemEventClass:
            DemAgingCycleCounterThreshold = 100
            DemFFPrestorageSupported = false
            DemEventPriority = 2
            DemEventSignificance = DEM_EVENT_SIGNIFICANCE_FAULT
            DemAgingAllowed = false
            DemConsiderPtoStatus = false
            DemOperationCycleRef = PowerCycle
            DemDebounceAlgorithmClass
              DemDebounceCounterBased:
                DemDebounceBehavior = DEM_DEBOUNCE_FREEZE
                DemDebounceCounterDecrementStepSize = 1
                DemDebounceCounterFailedThreshold = 127
                DemDebounceCounterIncrementStepSize = 1
                DemDebounceCounterJumpDown = true
                DemDebounceCounterJumpDownValue = 0
                DemDebounceCounterJumpUp = true
                DemDebounceCounterJumpUpValue = 0
                DemDebounceCounterPassedThreshold = -128
                DemDebounceCounterStorage = false
                DemDebounceContinuous = false
          DemCallbackEventStatusChanged: DemCallbackEventStatusChangedFnc=RCM_ClockFailure_Notification
        MCU_E_SYSTEM_PLL_LOCK_LOSS: DemEventId=41, DemEventKind=DEM_EVENT_KIND_BSW
          DemEventClass:
            DemAgingCycleCounterThreshold = 100
            DemFFPrestorageSupported = false
            DemEventPriority = 2
            DemEventSignificance = DEM_EVENT_SIGNIFICANCE_FAULT
            DemAgingAllowed = false
            DemConsiderPtoStatus = false
            DemOperationCycleRef = PowerCycle
            DemDebounceAlgorithmClass
              DemDebounceCounterBased:
                DemDebounceBehavior = DEM_DEBOUNCE_FREEZE
                DemDebounceCounterDecrementStepSize = 1
                DemDebounceCounterFailedThreshold = 127
                DemDebounceCounterIncrementStepSize = 1
                DemDebounceCounterJumpDown = true
                DemDebounceCounterJumpDownValue = 0
                DemDebounceCounterJumpUp = true
                DemDebounceCounterJumpUpValue = 0
                DemDebounceCounterPassedThreshold = -128
                DemDebounceCounterStorage = false
                DemDebounceContinuous = false
          DemCallbackEventStatusChanged: DemCallbackEventStatusChangedFnc=RCM_PllFailure_Notification
        FEE_E_READ: DemEventId=42, DemEventKind=DEM_EVENT_KIND_BSW
          DemEventClass:
            DemAgingCycleCounterThreshold = 100
            DemFFPrestorageSupported = false
            DemEventPriority = 2
            DemEventSignificance = DEM_EVENT_SIGNIFICANCE_FAULT
            DemAgingAllowed = false
            DemConsiderPtoStatus = false
            DemOperationCycleRef = PowerCycle
            DemDebounceAlgorithmClass
              DemDebounceCounterBased:
                DemDebounceBehavior = DEM_DEBOUNCE_FREEZE
                DemDebounceCounterDecrementStepSize = 1
                DemDebounceCounterFailedThreshold = 127
                DemDebounceCounterIncrementStepSize = 1
                DemDebounceCounterJumpDown = true
                DemDebounceCounterJumpDownValue = 0
                DemDebounceCounterJumpUp = true
                DemDebounceCounterJumpUpValue = 0
                DemDebounceCounterPassedThreshold = -128
                DemDebounceCounterStorage = false
                DemDebounceContinuous = false
          DemCallbackEventStatusChanged: DemCallbackEventStatusChangedFnc=RCM_DFlashEccFailure_Notification
      DemDTCAttributesPrimary (DemDTCAttributes): DemMemoryDestinationRef=PrimaryMemory
      DtcAttributes_41914fb7 (DemDTCAttributes): DemMemoryDestinationRef=PrimaryMemory
      DtcClass_DTC_0xd88987 (DemDTCClass): DemDTCSeverity=DEM_DTC_SEV_NO_SEVERITY, DemUdsDTC=14190983, DemImmediateNvStorage=true, DemDTCAttributesRef=DtcAttributes_41914fb7
      DTC_0xd88987 (DemEventParameter):  # Annotation PLAIN_TEXT COVERS: ARCH_SW_BSW_0021; ARCH_SW_BSW_0014;
        DemEventKind = DEM_EVENT_KIND_SWC
        DemEventTimeSeries = DEM_TIMESERIES_SNAPSHOT_NONE
        DemEventAvailable = true
        DemEventId = 34
        DemEventAvailableInVariant = true
        DemEventLatchTestFailed = false
        DemEventCreateInfoPort = true
        DemDTCClassRef = DtcClass_DTC_0xd88987
        DemExtendedDataClassRef = ExtendedDataClass_dda5abf3
        DemFreezeFrameClassRef = FreezeFrame_8035c374
        DemFreezeFrameRecNumClassRef = FreezeFrameRecNum_bc8f2da9
        DemEventClass:
          DemAgingAllowed = true
          DemAgingCycleCounterThreshold = 10
          DemEventPriority = 2
          DemEventSignificance = DEM_EVENT_SIGNIFICANCE_OCCURRENCE
          DemEventFailureCycleCounterThreshold = 0
          DemConsiderPtoStatus = false
          DemFFPrestorageSupported = false
          DemAgingCycleRef = IgnitionCycle
          DemEnableConditionGroupRef = DemEnableConditionGroup_CodingAPI_IgnON
          DemOperationCycleRef = PowerCycle
          DemStorageConditionGroupRef = DemStorageConditionGroup_NetworkCommunication
          DemDebounceAlgorithmClass
            DemDebounceCounterBased:
              DemDebounceCounterDecrementStepSize = 1
              DemDebounceCounterIncrementStepSize = 1
              DemDebounceCounterJumpDown = true
              DemDebounceCounterJumpUp = false
              DemDebounceCounterFailedThreshold = 127
              DemDebounceCounterPassedThreshold = -128
              DemDebounceBehavior = DEM_DEBOUNCE_FREEZE
              DemDebounceCounterJumpDownValue = 0
              DemDebounceCounterJumpUpValue = 0
              DemDebounceCounterStorage = false
              DemDebounceContinuous = false
      DtcClass_DTC_0xd88a08 (DemDTCClass): DemDTCSeverity=DEM_DTC_SEV_NO_SEVERITY, DemUdsDTC=14191112, DemImmediateNvStorage=true, DemDTCAttributesRef=DtcAttributes_41914fb7
      DTC_0xd88a08 (DemEventParameter):  # Annotation PLAIN_TEXT COVERS: ARCH_SW_BSW_0021; ARCH_SW_BSW_0014;
        DemEventKind = DEM_EVENT_KIND_SWC
        DemEventTimeSeries = DEM_TIMESERIES_SNAPSHOT_NONE
        DemEventAvailable = true
        DemEventId = 35
        DemEventAvailableInVariant = true
        DemEventLatchTestFailed = false
        DemEventCreateInfoPort = true
        DemDTCClassRef = DtcClass_DTC_0xd88a08
        DemExtendedDataClassRef = ExtendedDataClass_dda5abf3
        DemFreezeFrameClassRef = FreezeFrame_8035c374
        DemFreezeFrameRecNumClassRef = FreezeFrameRecNum_bc8f2da9
        DemEventClass:
          DemAgingAllowed = true
          DemAgingCycleCounterThreshold = 10
          DemEventPriority = 2
          DemEventSignificance = DEM_EVENT_SIGNIFICANCE_OCCURRENCE
          DemEventFailureCycleCounterThreshold = 0
          DemConsiderPtoStatus = false
          DemFFPrestorageSupported = false
          DemAgingCycleRef = IgnitionCycle
          DemEnableConditionGroupRef = DemEnableConditionGroup_CodingAPI_IgnON
          DemOperationCycleRef = PowerCycle
          DemStorageConditionGroupRef = DemStorageConditionGroup_NetworkCommunication
          DemDebounceAlgorithmClass
            DemDebounceCounterBased:
              DemDebounceCounterDecrementStepSize = 1
              DemDebounceCounterIncrementStepSize = 1
              DemDebounceCounterJumpDown = true
              DemDebounceCounterJumpUp = false
              DemDebounceCounterFailedThreshold = 127
              DemDebounceCounterPassedThreshold = -128
              DemDebounceBehavior = DEM_DEBOUNCE_FREEZE
              DemDebounceCounterJumpDownValue = 0
              DemDebounceCounterJumpUpValue = 0
              DemDebounceCounterStorage = false
              DemDebounceContinuous = false
