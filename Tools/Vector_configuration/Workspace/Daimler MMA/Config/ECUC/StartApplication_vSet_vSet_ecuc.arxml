AUTOSAR XML (schema 00049)
package /ActiveEcuC
  module config vSet: implementation-config-variant=VARIANT-PRE-COMPILE, module-description=vSet_Impl
    vSetCalibration
    vSetGeneral: vSetDummyStatementKind=None
    vSetPlatform:
      vSetBitOrder = LSB_to_MSB
      vSetByteOrder = LITTLE_ENDIAN
      vSetCPUType = CPU32Bit
      vSetSizeOfEnum = Size32Bit
      vSetSizeOfInt = Size32Bit
      vSetSizeOfRAMPointer = Size32Bit
      vSetSizeOfROMPointer = Size32Bit
    vSetBswInitialization
      87 x vSetInitFunction:
        Adc_Init: vSetHeader=Adc.h, vSetConfigType=Adc_ConfigType, vSetConfigPtrClass=AUTOMATIC, vSetModuleRef=Adc  # /ActiveEcuC/Adc PLAIN_TEXT Created Adc_Init by Extended Init XML Service
          vSetInitFunctionInstance: vSetInitPhase=INIT_ONE_LATE, vSetConfigPtrName=&Adc_Config
        BswM_Init: vSetHeader=BswM.h, vSetConfigType=BswM_ConfigType, vSetConfigPtrClass=BSWM_INIT_DATA, vSetModuleRef=BswM  # /ActiveEcuC/BswM PLAIN_TEXT Init function description of BswM in PostBuildPredefinedVariantView (Left) .
          vSetInitFunctionInstance:
            vSetInitPhase = NO_INIT
            vSetConfigPtrName = BswM_Config_Left_Ptr if post-build-variant-condition{matching-criterion=SideAllocation, value=0}
            vSetConfigPtrName = BswM_Config_Right_Ptr if post-build-variant-condition{matching-criterion=SideAllocation, value=1}
        BswM_PreInit: vSetHeader=BswM.h, vSetConfigType=BswM_ConfigType, vSetConfigPtrClass=BSWM_INIT_DATA, vSetModuleRef=BswM  # /ActiveEcuC/BswM PLAIN_TEXT PreInit function description of BswM in PostBuildPredefinedVariantView (Left) .
          vSetInitFunctionInstance:
            vSetInitPhase = INIT_ONE
            vSetConfigPtrName = BswM_Config_Left_Ptr if post-build-variant-condition{matching-criterion=SideAllocation, value=0}
            vSetConfigPtrName = BswM_Config_Right_Ptr if post-build-variant-condition{matching-criterion=SideAllocation, value=1}
        BswM_InitMemory: vSetHeader=BswM.h, vSetModuleRef=BswM  # /ActiveEcuC/BswM PLAIN_TEXT InitMemory function description of BswM in PostBuildPredefinedVariantView (Left) .
          vSetInitFunctionInstance: vSetInitPhase=INIT_MEMORY
        CanIf_InitMemory: vSetHeader=CanIf.h, vSetModuleRef=CanIf  # /ActiveEcuC/CanIf PLAIN_TEXT InitMemory function description of CanIf in PostBuildPredefinedVariantView (Left) .
          vSetInitFunctionInstance: vSetInitPhase=INIT_MEMORY
        CanIf_Init: vSetHeader=CanIf.h, vSetConfigType=CanIf_ConfigType, vSetConfigPtrClass=CANIF_INIT_DATA, vSetModuleRef=CanIf  # /ActiveEcuC/CanIf PLAIN_TEXT Init function description of CanIf in PostBuildPredefinedVariantView (Left) .
          vSetInitFunctionInstance:
            vSetInitPhase = INIT_TWO_IF
            vSetConfigPtrName = CanIf_Config_Left_Ptr if post-build-variant-condition{matching-criterion=SideAllocation, value=0}
            vSetConfigPtrName = CanIf_Config_Right_Ptr if post-build-variant-condition{matching-criterion=SideAllocation, value=1}
        CanNm_Init: vSetHeader=CanNm.h, vSetConfigType=CanNm_ConfigType, vSetConfigPtrClass=CANNM_INIT_DATA, vSetModuleRef=CanNm  # /ActiveEcuC/CanNm PLAIN_TEXT Init function description of CanNm in PostBuildPredefinedVariantView (Left) .
          vSetInitFunctionInstance:
            vSetInitPhase = INIT_TWO_NM
            vSetConfigPtrName = CanNm_Config_Left_Ptr if post-build-variant-condition{matching-criterion=SideAllocation, value=0}
            vSetConfigPtrName = CanNm_Config_Right_Ptr if post-build-variant-condition{matching-criterion=SideAllocation, value=1}
        CanNm_InitMemory: vSetHeader=CanNm.h, vSetModuleRef=CanNm  # /ActiveEcuC/CanNm PLAIN_TEXT InitMemory function description of CanNm in PostBuildPredefinedVariantView (Left) .
          vSetInitFunctionInstance: vSetInitPhase=INIT_MEMORY
        CanSM_InitMemory: vSetHeader=CanSM_EcuM.h, vSetModuleRef=CanSM  # /ActiveEcuC/CanSM PLAIN_TEXT InitMemory function description of CanSM in PostBuildPredefinedVariantView (Left) .
          vSetInitFunctionInstance: vSetInitPhase=INIT_MEMORY
        CanSM_Init: vSetHeader=CanSM_EcuM.h, vSetConfigType=CanSM_ConfigType, vSetConfigPtrClass=CANSM_INIT_DATA, vSetModuleRef=CanSM  # /ActiveEcuC/CanSM PLAIN_TEXT Init function description of CanSM in PostBuildPredefinedVariantView (Left) .
          vSetInitFunctionInstance:
            vSetInitPhase = INIT_TWO_SM
            vSetConfigPtrName = CanSM_Config_Left_Ptr if post-build-variant-condition{matching-criterion=SideAllocation, value=0}
            vSetConfigPtrName = CanSM_Config_Right_Ptr if post-build-variant-condition{matching-criterion=SideAllocation, value=1}
        CanTSyn_InitMemory: vSetHeader=CanTSyn.h, vSetModuleRef=CanTSyn  # /ActiveEcuC/CanTSyn PLAIN_TEXT InitMemory function description of CanTSyn in PostBuildPredefinedVariantView (Left) .
          vSetInitFunctionInstance: vSetInitPhase=INIT_MEMORY
        CanTSyn_Init: vSetHeader=CanTSyn.h, vSetConfigType=CanTSyn_ConfigType, vSetConfigPtrClass=CANTSYN_INIT_DATA, vSetModuleRef=CanTSyn  # /ActiveEcuC/CanTSyn PLAIN_TEXT Init function description of CanTSyn in PostBuildPredefinedVariantView (Left) .
          vSetInitFunctionInstance: vSetInitPhase=INIT_TWO_SYS, vSetConfigPtrName=CanTSyn_Config_Ptr
        CanTp_InitMemory: vSetHeader=CanTp.h, vSetModuleRef=CanTp  # /ActiveEcuC/CanTp PLAIN_TEXT InitMemory function description of CanTp in PostBuildPredefinedVariantView (Left) .
          vSetInitFunctionInstance: vSetInitPhase=INIT_MEMORY
        CanTp_Init: vSetHeader=CanTp.h, vSetConfigType=CanTp_ConfigType, vSetConfigPtrClass=CANTP_INIT_DATA, vSetModuleRef=CanTp  # /ActiveEcuC/CanTp PLAIN_TEXT Init function description of CanTp in PostBuildPredefinedVariantView (Left) .
          vSetInitFunctionInstance:
            vSetInitPhase = INIT_TWO_TP
            vSetConfigPtrName = CanTp_Config_Left_Ptr if post-build-variant-condition{matching-criterion=SideAllocation, value=0}
            vSetConfigPtrName = CanTp_Config_Right_Ptr if post-build-variant-condition{matching-criterion=SideAllocation, value=1}
        Can_InitMemory: vSetHeader=Can.h, vSetModuleRef=Can  # /ActiveEcuC/Can PLAIN_TEXT InitMemory function description of Can in PostBuildPredefinedVariantView (Left) .
          vSetInitFunctionInstance: vSetInitPhase=INIT_MEMORY
        Can_Init: vSetHeader=Can.h, vSetConfigType=Can_ConfigType, vSetConfigPtrClass=CAN_INIT_DATA, vSetModuleRef=Can  # /ActiveEcuC/Can PLAIN_TEXT Init function description of Can in PostBuildPredefinedVariantView (Left) .
          vSetInitFunctionInstance:
            vSetInitPhase = INIT_TWO_DRV
            vSetConfigPtrName = Can_Config_Left_Ptr if post-build-variant-condition{matching-criterion=SideAllocation, value=0}
            vSetConfigPtrName = Can_Config_Right_Ptr if post-build-variant-condition{matching-criterion=SideAllocation, value=1}
        ComM_PreInit: vSetHeader=ComM.h, vSetConfigType=ComM_ConfigType, vSetConfigPtrClass=COMM_INIT_DATA, vSetModuleRef=ComM  # /ActiveEcuC/ComM PLAIN_TEXT PreInit function description of ComM in PostBuildPredefinedVariantView (Left) .
          vSetInitFunctionInstance:
            vSetInitPhase = INIT_ONE
            vSetConfigPtrName = ComM_Config_Left_Ptr if post-build-variant-condition{matching-criterion=SideAllocation, value=0}
            vSetConfigPtrName = ComM_Config_Right_Ptr if post-build-variant-condition{matching-criterion=SideAllocation, value=1}
        ComM_PostInit: vSetHeader=ComM.h, vSetModuleRef=ComM  # /ActiveEcuC/ComM PLAIN_TEXT Post-Initialization of the ComM and its internal state machine
          vSetInitFunctionInstance: vSetInitPhase=INIT_THREE
        ComM_Init: vSetHeader=ComM.h, vSetConfigType=ComM_ConfigType, vSetConfigPtrClass=COMM_INIT_DATA, vSetModuleRef=ComM  # /ActiveEcuC/ComM PLAIN_TEXT Init function description of ComM in PostBuildPredefinedVariantView (Left) .
          vSetInitFunctionInstance:
            vSetInitPhase = INIT_TWO_POST_NVMREADALL
            vSetConfigPtrName = ComM_Config_Left_Ptr if post-build-variant-condition{matching-criterion=SideAllocation, value=0}
            vSetConfigPtrName = ComM_Config_Right_Ptr if post-build-variant-condition{matching-criterion=SideAllocation, value=1}
        ComM_InitMemory: vSetHeader=ComM.h, vSetModuleRef=ComM  # /ActiveEcuC/ComM PLAIN_TEXT InitMemory function description of ComM in PostBuildPredefinedVariantView (Left) .
          vSetInitFunctionInstance: vSetInitPhase=INIT_MEMORY
        ComXf_Init: vSetHeader=ComXf.h, vSetModuleRef=ComXf  # /ActiveEcuC/ComXf PLAIN_TEXT Automatically generated by BswInitFctConfigurationService.
          vSetInitFunctionInstance: vSetInitPhase=NO_INIT
        Com_InitMemory: vSetHeader=Com.h, vSetModuleRef=Com  # /ActiveEcuC/Com PLAIN_TEXT InitMemory function description of Com in PostBuildPredefinedVariantView (Left) .
          vSetInitFunctionInstance: vSetInitPhase=INIT_MEMORY
        Com_Init: vSetHeader=Com.h, vSetConfigType=Com_ConfigType, vSetConfigPtrClass=COM_INIT_DATA, vSetModuleRef=Com  # /ActiveEcuC/Com PLAIN_TEXT Init function description of Com in PostBuildPredefinedVariantView (Left) .
          vSetInitFunctionInstance:
            vSetInitPhase = INIT_TWO_COM
            vSetConfigPtrName = Com_Config_Left_Ptr if post-build-variant-condition{matching-criterion=SideAllocation, value=0}
            vSetConfigPtrName = Com_Config_Right_Ptr if post-build-variant-condition{matching-criterion=SideAllocation, value=1}
        CryIf_InitMemory: vSetHeader=CryIf.h, vSetModuleRef=CryIf  # /ActiveEcuC/CryIf PLAIN_TEXT Initializes variables of the Crypto Interface
          vSetInitFunctionInstance: vSetInitPhase=INIT_MEMORY
        CryIf_Init: vSetHeader=CryIf.h, vSetModuleRef=CryIf  # /ActiveEcuC/CryIf PLAIN_TEXT Initializes the Crypto Interface
          vSetInitFunctionInstance: vSetInitPhase=INIT_TWO_IF
        Crypto_30_LibCv_InitMemory: vSetHeader=Crypto_30_LibCv.h, vSetModuleRef=Crypto  # /ActiveEcuC/Crypto PLAIN_TEXT Initializes variables of the Crypto Driver
          vSetInitFunctionInstance: vSetInitPhase=INIT_MEMORY
        Crypto_30_LibCv_Init: vSetHeader=Crypto_30_LibCv.h, vSetModuleRef=Crypto  # /ActiveEcuC/Crypto PLAIN_TEXT Initializes the Crypto Driver
          vSetInitFunctionInstance: vSetInitPhase=INIT_TWO_DRV
        Crypto_30_vHsm_Init: vSetHeader=Crypto_30_vHsm.h, vSetModuleRef=Crypto_30_vHsm  # /ActiveEcuC/Crypto_30_vHsm PLAIN_TEXT Initializes the Crypto Driver
          vSetInitFunctionInstance: vSetInitPhase=INIT_TWO_DRV
        Crypto_30_vHsm_InitMemory: vSetHeader=Crypto_30_vHsm.h, vSetModuleRef=Crypto_30_vHsm  # /ActiveEcuC/Crypto_30_vHsm PLAIN_TEXT Initializes variables of the Crypto Interface
          vSetInitFunctionInstance: vSetInitPhase=INIT_MEMORY
        Csm_InitMemory: vSetHeader=Csm.h, vSetModuleRef=Csm  # /ActiveEcuC/Csm PLAIN_TEXT Initializes variables of the Crypto Service Manager
          vSetInitFunctionInstance: vSetInitPhase=INIT_MEMORY
        Csm_Init: vSetHeader=Csm.h, vSetModuleRef=Csm  # /ActiveEcuC/Csm PLAIN_TEXT Initializes the Crypto Service Manager
          vSetInitFunctionInstance: vSetInitPhase=INIT_TWO_SYS
        Dcm_Init: vSetHeader=Dcm.h, vSetConfigType=Dcm_ConfigType, vSetConfigPtrClass=DCM_CONST, vSetModuleRef=Dcm  # /ActiveEcuC/Dcm PLAIN_TEXT Dcm_Init function description
          vSetInitFunctionInstance:
            vSetInitPhase = INIT_TWO_POST_NVMREADALL
            vSetConfigPtrName = &Dcm_CfgConfig_Left if post-build-variant-condition{matching-criterion=SideAllocation, value=0}
            vSetConfigPtrName = &Dcm_CfgConfig_Right if post-build-variant-condition{matching-criterion=SideAllocation, value=1}
        Dcm_InitMemory: vSetHeader=Dcm.h, vSetModuleRef=Dcm  # /ActiveEcuC/Dcm PLAIN_TEXT Dcm_InitMemory function description
          vSetInitFunctionInstance: vSetInitPhase=INIT_MEMORY
        Dem_Init: vSetHeader=Dem.h, vSetConfigType=Dem_ConfigType, vSetConfigPtrClass=DEM_INIT_DATA, vSetModuleRef=Dem  # /ActiveEcuC/Dem PLAIN_TEXT Init function description of Dem in PostBuildPredefinedVariantView (Left) .
          vSetInitFunctionInstance: vSetInitPhase=INIT_TWO_POST_NVMREADALL, vSetConfigPtrName=Dem_Config_Ptr
        Dem_InitMemory: vSetHeader=Dem.h, vSetModuleRef=Dem  # /ActiveEcuC/Dem PLAIN_TEXT InitMemory function description of Dem in PostBuildPredefinedVariantView (Left) .
          vSetInitFunctionInstance: vSetInitPhase=INIT_MEMORY
        Dem_PreInit: vSetHeader=Dem.h, vSetConfigType=Dem_ConfigType, vSetConfigPtrClass=DEM_INIT_DATA, vSetModuleRef=Dem  # /ActiveEcuC/Dem PLAIN_TEXT PreInit function description of Dem in PostBuildPredefinedVariantView (Left) .
          vSetInitFunctionInstance: vSetInitPhase=INIT_ZERO, vSetConfigPtrName=Dem_Config_Ptr
        Det_Init: vSetHeader=Det.h, vSetConfigType=Det_ConfigType, vSetConfigPtrClass=DET_INIT_DATA, vSetModuleRef=Det  # /ActiveEcuC/Det PLAIN_TEXT Init function description of Det in PostBuildInvariantValuesModelView (PostBuildInvariantValuesModelView) .
          vSetInitFunctionInstance: vSetInitPhase=INIT_ZERO, vSetConfigPtrName=Det_Config_Ptr
        Det_InitMemory: vSetHeader=Det.h, vSetModuleRef=Det  # /ActiveEcuC/Det PLAIN_TEXT InitMemory function description of Det in PostBuildInvariantValuesModelView (PostBuildInvariantValuesModelView) .
          vSetInitFunctionInstance: vSetInitPhase=INIT_MEMORY
        Dio_Init: vSetHeader=Dio.h, vSetModuleRef=Dio  # /Dio/Dio PLAIN_TEXT Created Dio_Init by Extended Init XML Service
          vSetInitFunctionInstance: vSetInitPhase=NO_INIT
        Dma_Init: vSetHeader=Dma.h, vSetConfigType=Dma_ConfigType, vSetConfigPtrClass=AUTOMATIC, vSetModuleRef=Dma  # /Dma/Dma PLAIN_TEXT Created Dma_Init by Extended Init XML Service
          vSetInitFunctionInstance: vSetInitPhase=INIT_ONE, vSetConfigPtrName=&Dma_Config
        E2EXf_Init: vSetHeader=E2EXf.h, vSetConfigType=E2EXf_ConfigType, vSetConfigPtrClass=E2EXF_PBCFG, vSetModuleRef=E2EXf  # /ActiveEcuC/E2EXf PLAIN_TEXT Automatically generated by BswInitFctConfigurationService.
          vSetInitFunctionInstance: vSetInitPhase=INIT_ONE, vSetConfigPtrName=NULL_PTR
        E2EXf_InitMemory: vSetHeader=E2EXf.h, vSetModuleRef=E2EXf  # /ActiveEcuC/E2EXf PLAIN_TEXT Automatically generated by BswInitFctConfigurationService.
          vSetInitFunctionInstance: vSetInitPhase=INIT_MEMORY
        EcuM_Init: vSetHeader=EcuM.h, vSetConfigType=EcuM_PbConfigType, vSetConfigPtrClass=ECUM_INIT_DATA, vSetModuleRef=EcuM  # /ActiveEcuC/EcuM PLAIN_TEXT Init function description of EcuM in PostBuildPredefinedVariantView (Left) .
          vSetInitFunctionInstance:
            vSetInitPhase = NO_INIT
            vSetConfigPtrName = EcuM_Config_Left_Ptr if post-build-variant-condition{matching-criterion=SideAllocation, value=0}
            vSetConfigPtrName = EcuM_Config_Right_Ptr if post-build-variant-condition{matching-criterion=SideAllocation, value=1}
        Fee_Init: vSetHeader=Fee.h, vSetConfigType=Fee_ConfigType, vSetConfigPtrClass=AUTOMATIC, vSetModuleRef=Fee  # /ActiveEcuC/Fee PLAIN_TEXT Created Fee_Init by Extended Init XML Service
          vSetInitFunctionInstance: vSetInitPhase=INIT_ONE_LATE, vSetConfigPtrName=&Fee_Config
        Fls_17_Dmu_Init: vSetHeader=Fls_17_Dmu.h, vSetConfigType=Fls_17_Dmu_ConfigType, vSetConfigPtrClass=AUTOMATIC, vSetModuleRef=Fls  # /Fls/Fls PLAIN_TEXT Created Fls_17_Dmu_Init by Extended Init XML Service
          vSetInitFunctionInstance: vSetInitPhase=INIT_ONE, vSetConfigPtrName=&Fls_17_Dmu_Config
        Gpt_Init: vSetHeader=Gpt.h, vSetConfigType=Gpt_ConfigType, vSetConfigPtrClass=AUTOMATIC, vSetModuleRef=Gpt  # /ActiveEcuC/Gpt PLAIN_TEXT Created Gpt_Init by Extended Init XML Service
          vSetInitFunctionInstance: vSetInitPhase=INIT_ONE, vSetConfigPtrName=&Gpt_Config
        Icu_17_TimerIp_Init: vSetHeader=Icu_17_TimerIp.h, vSetConfigType=Icu_17_TimerIp_ConfigType, vSetConfigPtrClass=AUTOMATIC, vSetModuleRef=Icu  # /Icu/Icu PLAIN_TEXT Created Icu_17_TimerIp_Init by Extended Init XML Service
          vSetInitFunctionInstance: vSetInitPhase=INIT_ONE_LATE, vSetConfigPtrName=&Icu_17_TimerIp_Config
        IpduM_InitMemory: vSetHeader=IpduM.h, vSetModuleRef=IpduM  # /ActiveEcuC/IpduM PLAIN_TEXT InitMemory function description of IpduM in PostBuildPredefinedVariantView (Left) .
          vSetInitFunctionInstance: vSetInitPhase=INIT_MEMORY
        IpduM_Init: vSetHeader=IpduM.h, vSetConfigType=IpduM_ConfigType, vSetConfigPtrClass=IPDUM_INIT_DATA, vSetModuleRef=IpduM  # /ActiveEcuC/IpduM PLAIN_TEXT Init function description of IpduM in PostBuildPredefinedVariantView (Left) .
          vSetInitFunctionInstance: vSetInitPhase=INIT_TWO_COM, vSetConfigPtrName=IpduM_Config_Ptr
        Irq_Init: vSetHeader=Irq.h, vSetModuleRef=Irq  # /Irq/Irq PLAIN_TEXT Created Irq_Init by Extended Init XML Service
          vSetInitFunctionInstance: vSetInitPhase=NO_INIT
        KeyM_InitMemory: vSetHeader=KeyM.h, vSetModuleRef=KeyM  # /ActiveEcuC/KeyM PLAIN_TEXT Initializes variables of the MICROSAR KeyM
          vSetInitFunctionInstance: vSetInitPhase=INIT_MEMORY
        KeyM_Init: vSetHeader=KeyM.h, vSetConfigType=KeyM_ConfigType, vSetConfigPtrClass=KEYM_INIT_DATA, vSetModuleRef=KeyM  # /ActiveEcuC/KeyM PLAIN_TEXT Initializes the MICROSAR KeyM
          vSetInitFunctionInstance: vSetInitPhase=INIT_TWO_SYS, vSetConfigPtrName=NULL_PTR
        McalLib_Init: vSetHeader=McalLib.h, vSetModuleRef=McalLib  # /McalLib/McalLib PLAIN_TEXT Created McalLib_Init by Extended Init XML Service
          vSetInitFunctionInstance: vSetInitPhase=NO_INIT
        Mcu_Init: vSetHeader=Mcu.h, vSetConfigType=Mcu_ConfigType, vSetConfigPtrClass=AUTOMATIC, vSetModuleRef=Mcu  # /Mcu/Mcu PLAIN_TEXT Created Mcu_Init by Extended Init XML Service
          vSetInitFunctionInstance:
            vSetAdditionalInitCode = Mcu_InitClock(0);while (MCU_PLL_LOCKED != Mcu_GetPllStatus());Mcu_DistributePllClock();
            vSetInitPhase = INIT_ONE_EARLY
            vSetConfigPtrName = &Mcu_Config
        Nm_Init: vSetHeader=Nm.h, vSetConfigType=Nm_ConfigType, vSetConfigPtrClass=NM_INIT_DATA, vSetModuleRef=Nm  # /ActiveEcuC/Nm PLAIN_TEXT Init function description of Nm in PostBuildPredefinedVariantView (Left) .
          vSetInitFunctionInstance:
            vSetInitPhase = INIT_TWO_NM
            vSetConfigPtrName = Nm_Config_Left_Ptr if post-build-variant-condition{matching-criterion=SideAllocation, value=0}
            vSetConfigPtrName = Nm_Config_Right_Ptr if post-build-variant-condition{matching-criterion=SideAllocation, value=1}
        Nm_PostInit: vSetHeader=Nm.h, vSetModuleRef=Nm  # /ActiveEcuC/Nm PLAIN_TEXT Post-Initialization of the Network Management and its internal state machine
          vSetInitFunctionInstance: vSetInitPhase=INIT_THREE
        Nm_InitMemory: vSetHeader=Nm.h, vSetModuleRef=Nm  # /ActiveEcuC/Nm PLAIN_TEXT InitMemory function description of Nm in PostBuildPredefinedVariantView (Left) .
          vSetInitFunctionInstance: vSetInitPhase=INIT_MEMORY
        Nm_PreInit: vSetHeader=Nm.h, vSetConfigType=Nm_ConfigType, vSetConfigPtrClass=NM_INIT_DATA, vSetModuleRef=Nm  # /ActiveEcuC/Nm PLAIN_TEXT PreInit function description of Nm in PostBuildPredefinedVariantView (Left) .
          vSetInitFunctionInstance:
            vSetInitPhase = INIT_ONE
            vSetConfigPtrName = Nm_Config_Left_Ptr if post-build-variant-condition{matching-criterion=SideAllocation, value=0}
            vSetConfigPtrName = Nm_Config_Right_Ptr if post-build-variant-condition{matching-criterion=SideAllocation, value=1}
        NvM_Init: vSetHeader=NvM.h, vSetModuleRef=NvM  # /ActiveEcuC/NvM PLAIN_TEXT Initialization of the NVRAM Manager, to make it ready for NvM_ReadAll being requested
          vSetInitFunctionInstance: vSetInitPhase=INIT_TWO_SYS
        PduR_PreInit: vSetHeader=PduR.h, vSetConfigType=PduR_PBConfigType, vSetConfigPtrClass=PDUR_INIT_DATA, vSetModuleRef=PduR  # /ActiveEcuC/PduR PLAIN_TEXT PreInit function description of PduR in PostBuildPredefinedVariantView (Left) .
          vSetInitFunctionInstance:
            vSetInitPhase = INIT_ONE
            vSetConfigPtrName = PduR_Config_Left_Ptr if post-build-variant-condition{matching-criterion=SideAllocation, value=0}
            vSetConfigPtrName = PduR_Config_Right_Ptr if post-build-variant-condition{matching-criterion=SideAllocation, value=1}
        PduR_InitMemory: vSetHeader=PduR.h, vSetModuleRef=PduR  # /ActiveEcuC/PduR PLAIN_TEXT InitMemory function description of PduR in PostBuildPredefinedVariantView (Left) .
          vSetInitFunctionInstance: vSetInitPhase=INIT_MEMORY
        PduR_Init: vSetHeader=PduR.h, vSetConfigType=PduR_PBConfigType, vSetConfigPtrClass=PDUR_INIT_DATA, vSetModuleRef=PduR  # /ActiveEcuC/PduR PLAIN_TEXT Init function description of PduR in PostBuildPredefinedVariantView (Left) .
          vSetInitFunctionInstance:
            vSetInitPhase = INIT_TWO_COM
            vSetConfigPtrName = PduR_Config_Left_Ptr if post-build-variant-condition{matching-criterion=SideAllocation, value=0}
            vSetConfigPtrName = PduR_Config_Right_Ptr if post-build-variant-condition{matching-criterion=SideAllocation, value=1}
        Port_Init: vSetHeader=Port.h, vSetConfigType=Port_ConfigType, vSetConfigPtrClass=AUTOMATIC, vSetModuleRef=Port  # /Port/Port PLAIN_TEXT Created Port_Init by Extended Init XML Service
          vSetInitFunctionInstance: vSetInitPhase=INIT_ONE_EARLY, vSetConfigPtrName=&Port_Config
        Pwm_17_GtmCcu6_Init: vSetHeader=Pwm_17_GtmCcu6.h, vSetConfigType=Pwm_17_GtmCcu6_ConfigType, vSetConfigPtrClass=AUTOMATIC, vSetModuleRef=Pwm  # /ActiveEcuC/Pwm PLAIN_TEXT Created Pwm_17_GtmCcu6_Init by Extended Init XML Service
          vSetInitFunctionInstance: vSetInitPhase=INIT_ONE, vSetConfigPtrName=&Pwm_17_GtmCcu6_Config
        ResourceM_Init: vSetHeader=ResourceM.h, vSetModuleRef=ResourceM  # /ResourceM/ResourceM PLAIN_TEXT Created ResourceM_Init by Extended Init XML Service
          vSetInitFunctionInstance: vSetInitPhase=NO_INIT
        SchM_StartTiming: vSetHeader=Rte_Main.h, vSetModuleRef=Rte  # /ActiveEcuC/Rte PLAIN_TEXT Automatically generated by BswInitFctConfigurationService.
          vSetInitFunctionInstance: vSetInitPhase=NO_INIT
        Rte_StartTiming: vSetHeader=Rte_Main.h, vSetModuleRef=Rte  # /ActiveEcuC/Rte PLAIN_TEXT Automatically generated by BswInitFctConfigurationService.
          vSetInitFunctionInstance: vSetInitPhase=NO_INIT
        Rte_Start: vSetHeader=Rte_Main.h, vSetModuleRef=Rte  # /ActiveEcuC/Rte PLAIN_TEXT Automatically generated by BswInitFctConfigurationService.
          vSetInitFunctionInstance: vSetInitPhase=INIT_THREE
        SchM_Init: vSetHeader=Rte_Main.h, vSetConfigType=SchM_ConfigType, vSetConfigPtrClass=RTE_CONST, vSetModuleRef=Rte  # /ActiveEcuC/Rte PLAIN_TEXT Automatically generated by BswInitFctConfigurationService.
          vSetInitFunctionInstance:
            vSetInitPhase = NO_INIT
            vSetConfigPtrName = &Rte_Config_Left if post-build-variant-condition{matching-criterion=SideAllocation, value=0}
            vSetConfigPtrName = &Rte_Config_Right if post-build-variant-condition{matching-criterion=SideAllocation, value=1}
        SchM_Start: vSetHeader=Rte_Main.h, vSetModuleRef=Rte  # /ActiveEcuC/Rte PLAIN_TEXT Automatically generated by BswInitFctConfigurationService.
          vSetInitFunctionInstance: vSetInitPhase=NO_INIT
        Rte_InitMemory: vSetHeader=Rte_Main.h, vSetModuleRef=Rte  # /ActiveEcuC/Rte PLAIN_TEXT Automatically generated by BswInitFctConfigurationService.
          vSetInitFunctionInstance: vSetInitPhase=INIT_MEMORY
        SecOC_Init: vSetHeader=SecOC.h, vSetConfigType=SecOC_ConfigType, vSetConfigPtrClass=SECOC_INIT_DATA, vSetModuleRef=SecOC  # /ActiveEcuC/SecOC PLAIN_TEXT Init function description of SecOC in PostBuildPredefinedVariantView (Left) .
          vSetInitFunctionInstance: vSetInitPhase=INIT_TWO_COM, vSetConfigPtrName=SecOC_Config_Ptr
        SecOC_InitMemory: vSetHeader=SecOC.h, vSetModuleRef=SecOC  # /ActiveEcuC/SecOC PLAIN_TEXT InitMemory function description of SecOC in PostBuildPredefinedVariantView (Left) .
          vSetInitFunctionInstance: vSetInitPhase=INIT_MEMORY
        Smu_Init: vSetHeader=Smu.h, vSetConfigType=Smu_ConfigType, vSetConfigPtrClass=AUTOMATIC, vSetModuleRef=Smu  # /ActiveEcuC/Smu PLAIN_TEXT Created Smu_Init by Extended Init XML Service
          vSetInitFunctionInstance: vSetInitPhase=INIT_ONE, vSetConfigPtrName=&Smu_Config
        Spi_Init: vSetHeader=Spi.h, vSetConfigType=Spi_ConfigType, vSetConfigPtrClass=AUTOMATIC, vSetModuleRef=Spi  # /Spi/Spi PLAIN_TEXT Created Spi_Init by Extended Init XML Service
          vSetInitFunctionInstance: vSetInitPhase=INIT_ONE, vSetConfigPtrName=&Spi_Config
        StbM_Init: vSetHeader=StbM.h, vSetConfigType=StbM_ConfigType, vSetConfigPtrClass=STBM_INIT_DATA, vSetModuleRef=StbM  # /ActiveEcuC/StbM PLAIN_TEXT Init function description of StbM in PostBuildPredefinedVariantView (Left) .
          vSetInitFunctionInstance: vSetInitPhase=INIT_TWO_SYS, vSetConfigPtrName=StbM_Config_Ptr
        StbM_InitMemory: vSetHeader=StbM.h, vSetModuleRef=StbM  # /ActiveEcuC/StbM PLAIN_TEXT InitMemory function description of StbM in PostBuildPredefinedVariantView (Left) .
          vSetInitFunctionInstance: vSetInitPhase=INIT_MEMORY
        WdgM_Init: vSetHeader=WdgM.h, vSetConfigType=WdgM_ConfigType, vSetConfigPtrClass=WDGM_APPL_CONST, vSetModuleRef=WdgM  # /ActiveEcuC/WdgM PLAIN_TEXT Initialization of WdgM Module
          vSetInitFunctionInstance: vSetInitPhase=INIT_TWO_IF, vSetConfigPtrName=&WdgMConfig_Mode0_core0
        Wdg_17_Scu_Init: vSetHeader=Wdg_17_Scu.h, vSetConfigType=Wdg_17_Scu_ConfigType, vSetConfigPtrClass=AUTOMATIC, vSetModuleRef=Wdg  # /Wdg/Wdg PLAIN_TEXT Created Wdg_17_Scu_Init by Extended Init XML Service
          vSetInitFunctionInstance: vSetInitPhase=INIT_ONE, vSetConfigPtrName=&Wdg_17_Scu_Config_0
        Brs_Init: vSetHeader=, vSetModuleRef=vBRS  # /ActiveEcuC/vBRS PLAIN_TEXT Automatically generated by BswInitFctConfigurationService.
          vSetInitFunctionInstance: vSetInitPhase=NO_INIT
        vBaseEnv_Init: vSetHeader=, vSetModuleRef=vBaseEnv  # /ActiveEcuC/vBaseEnv PLAIN_TEXT Created vBaseEnv_Init by Extended Init XML Service
          vSetInitFunctionInstance: vSetInitPhase=NO_INIT
        vLinkGen_Init: vSetHeader=vLinkGen_Lcfg.h, vSetModuleRef=vLinkGen  # /ActiveEcuC/vLinkGen PLAIN_TEXT Dummy initialization of the vLinkGen
          vSetInitFunctionInstance: vSetInitPhase=NO_INIT
        StbM_PreInit: vSetHeader=StbM.h, vSetConfigType=StbM_ConfigType, vSetConfigPtrClass=STBM_INIT_DATA, vSetModuleRef=StbM  # /ActiveEcuC/StbM PLAIN_TEXT PreInit function description of StbM in PostBuildPredefinedVariantView (Left) .
          vSetInitFunctionInstance: vSetInitPhase=INIT_ONE, vSetConfigPtrName=StbM_Config_Ptr
        StbM_PostInit: vSetHeader=StbM.h, vSetModuleRef=StbM  # /ActiveEcuC/StbM PLAIN_TEXT PostInit function description of StbM in PostBuildPredefinedVariantView (Left) .
          vSetInitFunctionInstance: vSetInitPhase=INIT_THREE
        Rtm_InitMemory: vSetHeader=Rtm.h, vSetModuleRef=Rtm  # /ActiveEcuC/Rtm PLAIN_TEXT Memory Initialization function of module Rtm.
          vSetInitFunctionInstance: vSetInitPhase=INIT_MEMORY
        Rtm_Init: vSetHeader=Rtm.h, vSetModuleRef=Rtm  # /ActiveEcuC/Rtm PLAIN_TEXT Module Initialization function of module Rtm.
          vSetInitFunctionInstance: vSetInitPhase=INIT_TWO_POST_NVMREADALL
        CanTSyn_PreInit: vSetHeader=CanTSyn.h, vSetConfigType=CanTSyn_ConfigType, vSetConfigPtrClass=CANTSYN_INIT_DATA, vSetModuleRef=CanTSyn  # /ActiveEcuC/CanTSyn PLAIN_TEXT PreInit function description of CanTSyn in PostBuildPredefinedVariantView (Left) . PreInit function description of CanTSyn in PostBuildPredefinedVariantView (Right) .
          vSetInitFunctionInstance: vSetInitPhase=INIT_ONE, vSetConfigPtrName=CanTSyn_Config_Ptr
