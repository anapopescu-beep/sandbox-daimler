AUTOSAR XML (schema 00049)
package /ActiveEcuC
  module config ComM: implementation-config-variant=VARIANT-POST-BUILD-SELECTABLE, module-description=ComM_Impl
    ComMGeneral:
      ComMPncGatewayEnabled = false
      ComMPncIdCounting = COMM_PNC_ID_COUNT_FROM_NM_MESSAGE
      ComMPncPrepareSleepTimer = 1.3
      ComMPncSupport = true
      ComMDevErrorDetect = false
      ComMEcuGroupClassification = 3
      ComMModeLimitationEnabled = true
      ComMSynchronousWakeUp = true
      ComMTMinFullComModeDuration = 3
      ComMVersionInfoApi = false
      ComMWakeupInhibitionEnabled = true
      ComMSafeBswChecks = true
      ComMResetAfterForcingNoComm = true
      ComMGeneration: ComMOutOfBoundsWriteSanitizer=false, ComMOutOfBoundsReadSanitizer=false
    ComMConfigSet: ComMPncEnabled=true
      PNC_00_MAPPING_60241c9f (ComMUser): ComMUserIdentifier=1, ComMUserModeNotification=false
      RBTM_FL_BODY3_8uqv9blm85ehm0msat385m76v_03d5f5f6 (ComMChannel):
        ComMBusType = COMM_BUS_TYPE_CAN
        ComMChannelId = 0
        ComMPncGatewayType = COMM_GATEWAY_TYPE_NONE
        ComMFullCommRequestNotificationEnabled = false
        ComMMainFunctionPeriod = 0.005
        ComMNoCom = false
        ComMNoWakeup = false
        variation-point = post-build-variant-condition{matching-criterion=SideAllocation, value=0}
        ComMNetworkManagement: ComMNmVariant=FULL, ComMPncNmRequest=true
        RBTM_FL_BODY3_8uqv9blm85ehm0msat385m76v_f6dc70ca (ComMUserPerChannel): ComMUserChannel=RBTM_FL_BODY3_8uqv9blm85ehm0msat385m76v_a4eabb6e
      RBTM_FL_BODY3_8uqv9blm85ehm0msat385m76v_a4eabb6e (ComMUser): ComMUserIdentifier=0, ComMUserModeNotification=false, variation-point=post-build-variant-condition{matching-criterion=SideAllocation, value=0}
      PNC_00_MAPPING_b2c42696 (ComMPnc):
        ComMPncId = 8
        ComMChannelPerPnc = RBTM_FL_BODY3_8uqv9blm85ehm0msat385m76v_03d5f5f6 if post-build-variant-condition{matching-criterion=SideAllocation, value=0}
        ComMUserPerPnc = PNC_00_MAPPING_60241c9f
        ComMChannelPerPnc = RBTM_FR_BODY3_4xwwtd59665s787n6ctawh7k8_23a94727 if post-build-variant-condition{matching-criterion=SideAllocation, value=1}
        3 x ComMPncComSignal, all with ComMPncComSignalKind=EIRA:
          NM_RBTM_FL_ST3_PNC_785a2d76_Tx_acd61a18: ComMPncComSignalDirection=TX, ComMPncComSignalChannelRef=RBTM_FL_BODY3_8uqv9blm85ehm0msat385m76v_03d5f5f6, ComMPncComSignalRef=NM_RBTM_FL_ST3_PNC_785a2d76_Tx, variation-point=post-build-variant-condition{matching-criterion=SideAllocation, value=0}
          ComSignalPnc_EIRA_CAN_Rx_1e4792f2: ComMPncComSignalDirection=RX, ComMPncComSignalRef=ComSignalPnc_EIRA_CAN_Rx
          NM_RBTM_FR_ST3_PNC_0103a546_Tx_2e08d951: ComMPncComSignalDirection=TX, ComMPncComSignalChannelRef=RBTM_FR_BODY3_4xwwtd59665s787n6ctawh7k8_23a94727, ComMPncComSignalRef=NM_RBTM_FR_ST3_PNC_0103a546_Tx, variation-point=post-build-variant-condition{matching-criterion=SideAllocation, value=1}
      PNC_20_MAPPING_4fe27ecf (ComMUser): ComMUserIdentifier=2, ComMUserModeNotification=false
      PNC_20_MAPPING_796df885 (ComMPnc):
        ComMPncId = 28
        ComMChannelPerPnc = RBTM_FL_BODY3_8uqv9blm85ehm0msat385m76v_03d5f5f6 if post-build-variant-condition{matching-criterion=SideAllocation, value=0}
        ComMUserPerPnc = PNC_20_MAPPING_4fe27ecf
        ComMChannelPerPnc = RBTM_FR_BODY3_4xwwtd59665s787n6ctawh7k8_23a94727 if post-build-variant-condition{matching-criterion=SideAllocation, value=1}
        3 x ComMPncComSignal, all with ComMPncComSignalKind=EIRA:
          NM_RBTM_FL_ST3_PNC_785a2d76_Tx_acd61a18: ComMPncComSignalDirection=TX, ComMPncComSignalChannelRef=RBTM_FL_BODY3_8uqv9blm85ehm0msat385m76v_03d5f5f6, ComMPncComSignalRef=NM_RBTM_FL_ST3_PNC_785a2d76_Tx, variation-point=post-build-variant-condition{matching-criterion=SideAllocation, value=0}
          ComSignalPnc_EIRA_CAN_Rx_1e4792f2: ComMPncComSignalDirection=RX, ComMPncComSignalRef=ComSignalPnc_EIRA_CAN_Rx
          NM_RBTM_FR_ST3_PNC_0103a546_Tx_2e08d951: ComMPncComSignalDirection=TX, ComMPncComSignalChannelRef=RBTM_FR_BODY3_4xwwtd59665s787n6ctawh7k8_23a94727, ComMPncComSignalRef=NM_RBTM_FR_ST3_PNC_0103a546_Tx, variation-point=post-build-variant-condition{matching-criterion=SideAllocation, value=1}
      RBTM_FR_BODY3_4xwwtd59665s787n6ctawh7k8_23a94727 (ComMChannel):
        ComMBusType = COMM_BUS_TYPE_CAN
        ComMChannelId = 1
        ComMPncGatewayType = COMM_GATEWAY_TYPE_NONE
        ComMFullCommRequestNotificationEnabled = false
        ComMMainFunctionPeriod = 0.005
        ComMNoCom = false
        ComMNoWakeup = false
        variation-point = post-build-variant-condition{matching-criterion=SideAllocation, value=1}
        ComMNetworkManagement: ComMNmVariant=FULL, ComMPncNmRequest=true
        RBTM_FR_BODY3_4xwwtd59665s787n6ctawh7k8_dbac4b95 (ComMUserPerChannel): ComMUserChannel=RBTM_FR_BODY3_4xwwtd59665s787n6ctawh7k8_1f2180a7
      RBTM_FR_BODY3_4xwwtd59665s787n6ctawh7k8_1f2180a7 (ComMUser): ComMUserIdentifier=0, ComMUserModeNotification=false, variation-point=post-build-variant-condition{matching-criterion=SideAllocation, value=1}
