AUTOSAR XML (schema 00049)
package /ActiveEcuC
  module config Os: implementation-config-variant=VARIANT-PRE-COMPILE, module-description=Os_Impl
    vHsmResponseIsr (OsIsr):
      OsIsrInterruptPriority = 1
      OsIsrCategory = CATEGORY_2
      OsIsrInterruptType = EXTERNAL
      OsIsrInterruptSource = 2160
      OsIsrStackSize = 1024
      OsIsrEnableNesting = false
      OsIsrUsesFpu = false
      OsIsrInitialEnableInterruptSource = true
    OsPublishedInformation: OsKernelVersion=7, OsPlatformName=TriCoreAurix
      TC32xL (OsDerivativeInformation):
        OsMpuAlignment = 8
        OsMpuMemoryGapSize = 16
        OsMpuEndAddressAccessible = false
        OsStackAlignment = 8
        OsExceptionVectorTableAlignment = 256
        OsInterruptVectorTableAlignment = 8192
        OsHardwareManuals = User Manual: TC33x_TC32x_um_appx_v1.4.0.pdf TC3xx_um_v1.4.0_part1.pdf TC3xx_um_v1.4.0_part2.pdf
        OsMpuPrivilegedRegionsConfigurable = false
        OsCyberSecurityConfiguration = false
        Core0 (OsPhysicalCore):
          OsPhysicalCoreId = 0
          OsPhysicalCoreDefaultEntrySymbol = _start_tc0
          OsPhysicalCoreType = TC1.6.2P
          OsPhysicalCoreExceptionSources = 8
          OsPhysicalCoreMasterStartAllowed = true
          OsPhysicalCorePrivelegedHwAccess = true
          OsPhysicalCoreIsAutostart = true
          OsPhysicalCoreStackProtectionUnit = OsPhysicalCore0DataMpu
          OsPhysicalCore0DataMpu (OsPhysicalCoreMpu): OsPhysicalCoreMpuId=0, OsPhysicalCoreMpuMaxRegions=18, OsPhysicalCoreMpuType=DATA
          OsPhysicalCore0CodeMpu (OsPhysicalCoreMpu): OsPhysicalCoreMpuId=1, OsPhysicalCoreMpuMaxRegions=10, OsPhysicalCoreMpuType=CODE
        STM0 (OsHardwareTimer): OsHardwareTimerSize=32, OsHardwareTimerUnit=FRT, OsHardwareTimerBaseAddress=4026535936, OsHardwareTimerId=0, OsHardwareTimerType=STM
          STM0_Ch0 (OsHardwareTimerChannel): OsHardwareTimerChannelIntSource=768, OsHardwareTimerChannelOffset=0, OsHardwareTimerChannelId=0
          STM0_Ch1 (OsHardwareTimerChannel): OsHardwareTimerChannelIntSource=772, OsHardwareTimerChannelOffset=1, OsHardwareTimerChannelId=1
        AURIXTC3XX_IR (OsSystemIntCtrl): OsSystemIntCtrlMaxPrios=255, OsSystemIntCtrlPrioOrder=ASC, OsSystemIntCtrlMaxSources=8192, OsSystemIntCtrlBaseAddress=4026757120
        GPT (OsHardwareTimer): OsHardwareTimerSize=16, OsHardwareTimerUnit=PIT, OsHardwareTimerBaseAddress=4026537984, OsHardwareTimerId=0, OsHardwareTimerType=PIT
          GPT_Ch0 (OsHardwareTimerChannel): OsHardwareTimerChannelIntSource=744, OsHardwareTimerChannelOffset=0, OsHardwareTimerChannelId=0
          GPT_Ch1 (OsHardwareTimerChannel): OsHardwareTimerChannelIntSource=756, OsHardwareTimerChannelOffset=1, OsHardwareTimerChannelId=1
        OsMemoryRegionSpecifics
          18 x OsMemoryRegionAccess:
            PS0_R: OsMemoryRegionAccessRights=R, OsMemoryRegionAccessType=PROTECTION_SET0
            PS0_W: OsMemoryRegionAccessRights=W, OsMemoryRegionAccessType=PROTECTION_SET0
            PS0_X: OsMemoryRegionAccessRights=X, OsMemoryRegionAccessType=PROTECTION_SET0
            PS1_R: OsMemoryRegionAccessRights=R, OsMemoryRegionAccessType=PROTECTION_SET1
            PS1_W: OsMemoryRegionAccessRights=W, OsMemoryRegionAccessType=PROTECTION_SET1
            PS1_X: OsMemoryRegionAccessRights=X, OsMemoryRegionAccessType=PROTECTION_SET1
            PS2_R: OsMemoryRegionAccessRights=R, OsMemoryRegionAccessType=PROTECTION_SET2
            PS2_W: OsMemoryRegionAccessRights=W, OsMemoryRegionAccessType=PROTECTION_SET2
            PS2_X: OsMemoryRegionAccessRights=X, OsMemoryRegionAccessType=PROTECTION_SET2
            PS3_R: OsMemoryRegionAccessRights=R, OsMemoryRegionAccessType=PROTECTION_SET3
            PS3_W: OsMemoryRegionAccessRights=W, OsMemoryRegionAccessType=PROTECTION_SET3
            PS3_X: OsMemoryRegionAccessRights=X, OsMemoryRegionAccessType=PROTECTION_SET3
            PS4_R: OsMemoryRegionAccessRights=R, OsMemoryRegionAccessType=PROTECTION_SET4
            PS4_W: OsMemoryRegionAccessRights=W, OsMemoryRegionAccessType=PROTECTION_SET4
            PS4_X: OsMemoryRegionAccessRights=X, OsMemoryRegionAccessType=PROTECTION_SET4
            PS5_R: OsMemoryRegionAccessRights=R, OsMemoryRegionAccessType=PROTECTION_SET5
            PS5_W: OsMemoryRegionAccessRights=W, OsMemoryRegionAccessType=PROTECTION_SET5
            PS5_X: OsMemoryRegionAccessRights=X, OsMemoryRegionAccessType=PROTECTION_SET5
        DMA (OsInterruptSupportedType):
          OsInterruptSupportedTypeSeparateSources = false
          OsInterruptSupportedTypeSeparatePriority = true
          OsInterruptSupportedTypeIsMapped = false
          OsInterruptSupportedTypePostActionRequired = false
    OS_APPMODE_ANY (OsAppMode)
    OSDEFAULTAPPMODE (OsAppMode)
    OsOS:
      OsStackMonitoring = true
      OsStatus = EXTENDED
      OsUseGetServiceId = false
      OsUseParameterAccess = false
      OsUseResScheduler = false
      OsForcibleTermination = false
      OsGenerateCalloutStubs = true
      OsGenerateMemMap = COMPLETE
      OsGenerateMemMapForNearAddressing = true
      OsGenerateMemMapForThreads = false
      OsServiceProtection = false
      OsStackUsageMeasurement = true
      OsUseXSignalAsyncApiCalls = false
      OsFpuUsage = NONE
      OsScalabilityClass = SC1
      OsNumberOfCores = 1
      OsUseCase = STANDARD
      OsUseArti = false
      OsMasterCore = OsCore0
      OsSystemTimer = SystemTimer
      OsStackSummary
        16 x OsStack, all with OsStackCore=OsCore0:
          OsCore0_Kernel: OsStackSize=1024, OsStackType=CORE_KERNEL_STACK, OsStackUser=OsCore0
          OsCore0_Init: OsStackSize=1024, OsStackType=CORE_INIT_STACK, OsStackUser=OsCore0
          OsCore0_Error: OsStackSize=1024, OsStackType=CORE_ERROR_STACK, OsStackUser=OsCore0
          OsCore0_Task_Prio4294967295: OsStackSize=64, OsStackType=TASK_SHARED_PRIORITY_STACK, OsStackUser=IdleTask_OsCore0
          OsCore0_Isr_Core: OsStackSize=1024, OsStackType=ISR_SHARED_CORE_STACK, OsStackUser=CounterIsr_SystemTimer, OsStackUser=CanIsr_1, OsStackUser=vHsmResponseIsr, OsStackUser=RCM_PFlashEccFailure_Notification, OsStackUser=RCM_SRamEccFailure_Notification
          OsCore0_Task_Prio0: OsStackSize=3584, OsStackType=TASK_SHARED_PRIORITY_STACK, OsStackUser=BackgroundTask_Core0
          OsCore0_Task_Prio5: OsStackSize=4096, OsStackType=TASK_SHARED_PRIORITY_STACK, OsStackUser=ApplBackgroundTask_Core0
          BswTask_Core0_HighPrio: OsStackSize=2048, OsStackType=TASK_EXTENDED_STACK, OsStackUser=Os/BswTask_Core0_HighPrio
          BswTask_Core0_LowPrio: OsStackSize=4096, OsStackType=TASK_EXTENDED_STACK, OsStackUser=Os/BswTask_Core0_LowPrio
          ApplTask_Core0_LowPrio: OsStackSize=1536, OsStackType=TASK_EXTENDED_STACK, OsStackUser=Os/ApplTask_Core0_LowPrio
          ApplTask_Core0_HighPrio: OsStackSize=512, OsStackType=TASK_EXTENDED_STACK, OsStackUser=Os/ApplTask_Core0_HighPrio
          OsCore0_Task_Prio90: OsStackSize=512, OsStackType=TASK_SHARED_PRIORITY_STACK, OsStackUser=ApplInitTask_Core0
          OsCore0_Task_Prio100: OsStackSize=1024, OsStackType=TASK_SHARED_PRIORITY_STACK, OsStackUser=Default_Init_Task
          OsCore0_Task_Prio99: OsStackSize=256, OsStackType=TASK_SHARED_PRIORITY_STACK, OsStackUser=Default_Init_Task_Trusted
          OsCore0_Shutdown: OsStackSize=1024, OsStackType=CORE_SHUTDOWN_STACK, OsStackUser=OsCore0
          OsTask_ALV_BeltFunctionAlgo: OsStackSize=512, OsStackType=TASK_EXTENDED_STACK, OsStackUser=Os/OsTask_ALV_BeltFunctionAlgo
      OsHooks: OsErrorHook=true, OsPostTaskHook=false, OsPreTaskHook=true, OsShutdownHook=true, OsStartupHook=false
      OsDebug: OsAssertions=false, OsORTIDebugSupport=ORTI_23_ADDITIONAL, OsTimingHooksIncludeHeader=Rtm.h
    SystemTimer (OsCounter):
      OsCounterMaxAllowedValue = 1073741823
      OsCounterMinCycle = 1
      OsCounterTicksPerBase = 80000
      OsCounterType = HARDWARE
      OsSecondsPerTick = 0.001
      OsCounterAccessingApplication = SystemApplication_OsCore0
      OsDriver: OsDriverHighResolution=false, OsDriverHardwareTimerChannelRef=STM0_Ch1, OsDriverIsrRef=CounterIsr_SystemTimer
    OsCore0 (OsCore):
      OsCoreIsAutostart = true
      OsCoreIsAutosar = true
      OsCoreEntrySymbol = _start_tc0
      OsCorePhysicalCoreRef = Core0
      OsCoreEcucCoreRef = EcucCoreDefinition
      OsCoreIdleTask = IdleTask_OsCore0
      OsCoreSystemApplication = SystemApplication_OsCore0
      OsCoreStacks:
        OsCoreKernelStackSize = 1024
        OsCoreStartupStackSize = 1024
        OsCoreShutdownStackSize = 1024
        OsCoreErrorStackSize = 1024
        OsCoreProtectionStackSize = 1024
        OsCoreInitStackSize = 1024
    IdleTask_OsCore0 (OsTask):
      OsTaskActivation = 1
      OsTaskPriority = 4294967295
      OsTaskSchedule = FULL
      OsTaskStackSharing = false
      OsTaskStackSize = 64
      OsTaskType = AUTO
      OsTaskUsesFpu = false
      OsTaskAccessingApplication = SystemApplication_OsCore0
      OsTaskAutostart: OsTaskAppModeRef=OS_APPMODE_ANY
    SystemApplication_OsCore0 (OsApplication):
      OsTrusted = true
      OsTrustedApplicationDelayTimingViolationCall = false
      OsTrustedApplicationWithProtection = false
      OsApplicationIsPrivileged = true
      OsAppUseTrustedFunctionStubs = false
      OsApplicationCoreRef = EcucCoreDefinition
      OsAppCounterRef = SystemTimer
      OsAppTaskRef = IdleTask_OsCore0
      OsAppIsrRef = CounterIsr_SystemTimer
      OsAppIsrRef = CanIsr_1
      OsAppAlarmRef = Rte_Al_TE_SBC_SBC_MainFunction
      OsAppIsrRef = RCM_PFlashEccFailure_Notification
      OsAppIsrRef = RCM_SRamEccFailure_Notification
      OsApplicationHooks: OsAppErrorHook=false, OsAppShutdownHook=false, OsAppStartupHook=false
    CounterIsr_SystemTimer (OsIsr):
      OsIsrInterruptPriority = 50
      OsIsrCategory = CATEGORY_2
      OsIsrInterruptType = EXTERNAL
      OsIsrInterruptSource = 772
      OsIsrStackSize = 1024
      OsIsrEnableNesting = false
      OsIsrUsesFpu = false
      OsIsrInitialEnableInterruptSource = false
      OsIsrSpecialFunctionName = Os_TimerPfrtIsr
    OsApplication_Trusted_Core0 (OsApplication):
      OsTrusted = true
      OsTrustedApplicationDelayTimingViolationCall = false
      OsTrustedApplicationWithProtection = false
      OsApplicationIsPrivileged = true
      OsAppUseTrustedFunctionStubs = false
      OsApplicationCoreRef = EcucCoreDefinition
      OsAppTaskRef = Os/BswTask_Core0_LowPrio
      OsAppTaskRef = Os/BswTask_Core0_HighPrio
      OsAppTaskRef = BackgroundTask_Core0
      OsAppTaskRef = ApplInitTask_Core0
      OsAppTaskRef = Os/ApplTask_Core0_LowPrio
      OsAppTaskRef = Os/ApplTask_Core0_HighPrio
      OsAppTaskRef = ApplBackgroundTask_Core0
      OsAppAlarmRef = Rte_Al_TE2_BswTask_Core0_HighPrio_0_10ms
      OsAppAlarmRef = Rte_Al_TE2_BswTask_Core0_HighPrio_0_5ms
      OsAppAlarmRef = Rte_Al_TE2_BswTask_Core0_LowPrio_0_10ms
      OsAppAlarmRef = Rte_Al_TE2_BswTask_Core0_LowPrio_0_5ms
      OsAppAlarmRef = Rte_Al_TE_ApplTask_Core0_LowPrio_0_10ms
      OsAppTaskRef = Default_Init_Task_Trusted
      OsAppAlarmRef = Rte_Al_TE2_BswTask_Core0_HighPrio_0_3ms
      OsAppTaskRef = Default_Init_Task
      OsAppAlarmRef = Rte_Al_TE_ApplTask_Core0_LowPrio_0_100ms
      OsAppAlarmRef = Rte_Al_TE_ApplTask_Core0_LowPrio_0_1000ms
      OsAppAlarmRef = Rte_Al_TE_ApplTask_Core0_LowPrio_0_250ms
      OsAppAlarmRef = Rte_Al_TE_ApplTask_Core0_LowPrio_0_1ms
      OsAppIsrRef = vHsmResponseIsr
      OsAppAlarmRef = Rte_Al_TE_BaseFunction_BaseFunction_Main
      OsAppAlarmRef = Rte_Al_TE_AdcIf_AdcIf_MainFunction
      OsAppAlarmRef = Rte_Al_TE_BFE_BFE_runExecuteStandardSteps
      OsAppTaskRef = Os/OsTask_ALV_BeltFunctionAlgo
      OsAppAlarmRef = Rte_Al_TE_OsTask_ALV_BeltFunctionAlgo_0_10ms
      OsAppAlarmRef = Rte_Al_TE_ApplTask_Core0_LowPrio_0_2ms
      OsAppIsrRef = OS_ISR_BMM_HES_IT
      OsAppIsrRef = OS_ISR_BMM_HES_TOUT
      OsAppAlarmRef = Rte_Al_TE_DIA_DIA_cyclicProcessingTask
      OsAppEcucPartitionRef = EcucPartition_OsApplication_Trusted_Core0
      OsAppAlarmRef = Rte_Al_TE_DiagFunction_DiagFunction_MainFunction
      OsApplicationHooks: OsAppErrorHook=false, OsAppShutdownHook=false, OsAppStartupHook=false
    CanIsr_1 (OsIsr):  # /ActiveEcuC/Can PLAIN_TEXT Can messages event (for a specific controllers) COVERS: ARCH_SW_OS_00202; ARCH_SW_OS_00402
      OsIsrInterruptPriority = 60
      OsIsrCategory = CATEGORY_2
      OsIsrInterruptType = EXTERNAL
      OsIsrInterruptSource = 1460
      OsIsrStackSize = 1024
      OsIsrEnableNesting = false
      OsIsrUsesFpu = false
      OsIsrInitialEnableInterruptSource = true
    15 x OsEvent:
      Rte_Ev_Run_Ssa_BcTp_Ssa_BcTp_ReceiveDiagnosticAuthentication
      Rte_Ev_Run_Ssa_BcTp_Ssa_BcTp_ReceiveRealTimeOffset
      Rte_Ev_Run_Ssa_BcTp_Ssa_BcTp_ReceiveSharedSecret
      Rte_Ev_Run_Ssa_BcTp_Ssa_BcTp_ReceiveTickCount
      Rte_Ev_Run_Ssa_BcTp_Ssa_BcTp_ReceiveTickCountTimeout
      Rte_Ev_Run_Ssa_BcTp_Ssa_BcTp_ReceiveVIN
      Rte_Ev_Run_Ssa_Coding_Ssa_Coding_VIN_Receive
      Rte_Ev_Run_Ssa_FvM_Ssa_FvM_Com_ReceiveTickCount
      Rte_Ev_Run_Ssa_FvM_Ssa_FvM_Com_ReceiveTickCountTimeout
      Rte_Ev_Run_Ssa_KeyM_Ssa_KeyM_Com_VehicleSharedSecretNotification
      Rte_Ev_Run_Ssa_RightsM_Ssa_RightsM_Com_ReceiveBroadcastAuthentication
      Rte_Ev_Run_Ssa_SecLog_Ssa_SecLog_LogEvent_FailedSecOcMacVerificationSecureBroadcast
      Rte_Ev_Run_Ssa_TimeM_Ssa_TimeM_Com_ReceiveRealTimeOffset
      Rte_Ev_Run_Ssa_TimeM_Ssa_TimeM_PowernetMgmtStateChanged
      Rte_Ev_Run_Ssa_TimeM_Ssa_TimeM_ReceiveChangeTickCountEvent
    7 x OsTask, all with OsTaskActivation=1, OsTaskStackSharing=false, OsTaskType=AUTO, OsTaskUsesFpu=false, OsTaskAccessingApplication=SystemApplication_OsCore0:
      BswTask_Core0_LowPrio: OsTaskPriority=30, OsTaskSchedule=FULL, OsTaskStackSize=4096, OsTaskEventRef=Rte_Ev_Cyclic2_BswTask_Core0_LowPrio_0_10ms, OsTaskEventRef=Rte_Ev_Cyclic2_BswTask_Core0_LowPrio_0_5ms, OsTaskResourceRef=OsResource_EcuM, OsTaskEventRef=Rte_Ev_Run_AdcIf_AdcIf_MainFunction
      BswTask_Core0_HighPrio: OsTaskPriority=60, OsTaskSchedule=NON, OsTaskStackSize=2048, OsTaskEventRef=Rte_Ev_Cyclic2_BswTask_Core0_HighPrio_0_10ms, OsTaskEventRef=Rte_Ev_Cyclic2_BswTask_Core0_HighPrio_0_5ms, OsTaskEventRef=Rte_Ev_Cyclic2_BswTask_Core0_HighPrio_0_3ms, OsTaskResourceRef=OsResource_EcuM, OsTaskEventRef=Rte_Ev_Run_SBC_SBC_MainFunction
      BackgroundTask_Core0: OsTaskPriority=0, OsTaskSchedule=FULL, OsTaskStackSize=3584
      ApplInitTask_Core0: OsTaskPriority=90, OsTaskSchedule=NON, OsTaskStackSize=512
      ApplTask_Core0_LowPrio: OsTaskPriority=20, OsTaskSchedule=FULL, OsTaskStackSize=1536, OsTaskEventRef=Rte_Ev_Cyclic_ApplTask_Core0_LowPrio_0_10ms, OsTaskEventRef=Rte_Ev_Run_Ssa_BcTp_Ssa_BcTp_ReceiveTickCountTimeout, OsTaskEventRef=Rte_Ev_Run_Ssa_Coding_Ssa_Coding_VIN_Receive, OsTaskEventRef=Rte_Ev_Run_Ssa_FvM_Ssa_FvM_Com_ReceiveTickCount, OsTaskEventRef=Rte_Ev_Run_Ssa_FvM_Ssa_FvM_Com_ReceiveTickCountTimeout, OsTaskEventRef=Rte_Ev_Run_Ssa_KeyM_Ssa_KeyM_Com_VehicleSharedSecretNotification, OsTaskEventRef=Rte_Ev_Run_Ssa_RightsM_Ssa_RightsM_Com_ReceiveBroadcastAuthentication, OsTaskEventRef=Rte_Ev_Run_Ssa_SecLog_Ssa_SecLog_LogEvent_FailedSecOcMacVerificationSecureBroadcast, OsTaskEventRef=Rte_Ev_Run_Ssa_TimeM_Ssa_TimeM_Com_ReceiveRealTimeOffset, OsTaskEventRef=Rte_Ev_Run_Ssa_TimeM_Ssa_TimeM_PowernetMgmtStateChanged, OsTaskEventRef=Rte_Ev_Run_Ssa_TimeM_Ssa_TimeM_ReceiveChangeTickCountEvent, OsTaskEventRef=Rte_Ev_Cyclic_ApplTask_Core0_LowPrio_0_100ms, OsTaskEventRef=Rte_Ev_Cyclic_ApplTask_Core0_LowPrio_0_1000ms, OsTaskEventRef=Rte_Ev_Cyclic_ApplTask_Core0_LowPrio_0_250ms, OsTaskEventRef=Rte_Ev_Cyclic_ApplTask_Core0_LowPrio_0_1ms, OsTaskEventRef=Rte_Ev_Run_Ct_MBBL_ResetManager_ResetServiceExecution, OsTaskEventRef=Rte_Ev_Run_BaseFunction_BaseFunction_Main, OsTaskEventRef=Rte_Ev_Run_Ssa_RightsM_Ssa_RightsM_DiagnosticSessionChangeIndication, OsTaskEventRef=Rte_Ev_Run_Ssa_BcTp_Ssa_BcTp_ReceiveVINTimeout, OsTaskEventRef=Rte_Ev_Run_Ssa_Coding_Ssa_Coding_VIN_Receive_Timeout, OsTaskEventRef=Rte_Ev_Run_Cdd_MBBL_EcuStatHandler_DiagSessionChange_ExitExtendedSession, OsTaskEventRef=Rte_Ev_OnEntry_ApplTask_Core0_LowPrio_Dcm_DcmDiagnosticSessionControl_DcmDiagnosticSessionControl_EXTENDED_SESSION, OsTaskEventRef=Rte_Ev_Cyclic_ApplTask_Core0_LowPrio_0_2ms, OsTaskEventRef=Rte_Ev_Run_DIA_DIA_cyclicProcessingTask, OsTaskEventRef=Rte_Ev_Run_DiagFunction_RoELite_SecureEventNotification, OsTaskEventRef=Rte_Ev_Run_Ssa_SecLog_Ssa_SecLog_IgnitionStatusChanged, OsTaskEventRef=Rte_Ev_Run_DiagFunction_RoELite_AvailabilityDataHandler, OsTaskEventRef=Rte_Ev_Run_DiagFunction_RoELite_ObsolescenceDataHandler, OsTaskEventRef=Rte_Ev_Run_DiagFunction_DiagFunction_MainFunction
      ApplTask_Core0_HighPrio: OsTaskPriority=50, OsTaskSchedule=FULL, OsTaskStackSize=512, OsTaskEventRef=Rte_Ev_Run_Ssa_BcTp_Ssa_BcTp_ReceiveDiagnosticAuthentication, OsTaskEventRef=Rte_Ev_Run_Ssa_BcTp_Ssa_BcTp_ReceiveRealTimeOffset, OsTaskEventRef=Rte_Ev_Run_Ssa_BcTp_Ssa_BcTp_ReceiveSharedSecret, OsTaskEventRef=Rte_Ev_Run_Ssa_BcTp_Ssa_BcTp_ReceiveTickCount, OsTaskEventRef=Rte_Ev_Run_Ssa_BcTp_Ssa_BcTp_ReceiveVIN
      ApplBackgroundTask_Core0: OsTaskPriority=5, OsTaskSchedule=FULL, OsTaskStackSize=4096
    Rte_Al_TE2_BswTask_Core0_HighPrio_0_10ms (OsAlarm): OsAlarmCounterRef=SystemTimer, OsAlarmAccessingApplication=SystemApplication_OsCore0
      OsAlarmAction
        OsAlarmSetEvent: OsAlarmSetEventRef=Rte_Ev_Cyclic2_BswTask_Core0_HighPrio_0_10ms, OsAlarmSetEventTaskRef=Os/BswTask_Core0_HighPrio
    Rte_Ev_Cyclic2_BswTask_Core0_HighPrio_0_10ms (OsEvent)
    Rte_Al_TE2_BswTask_Core0_HighPrio_0_5ms (OsAlarm): OsAlarmCounterRef=SystemTimer, OsAlarmAccessingApplication=SystemApplication_OsCore0
      OsAlarmAction
        OsAlarmSetEvent: OsAlarmSetEventRef=Rte_Ev_Cyclic2_BswTask_Core0_HighPrio_0_5ms, OsAlarmSetEventTaskRef=Os/BswTask_Core0_HighPrio
    3 x OsEvent:
      Rte_Ev_Cyclic2_BswTask_Core0_HighPrio_0_5ms
      Rte_Ev_Cyclic2_BswTask_Core0_LowPrio_0_10ms
      Rte_Ev_Cyclic2_BswTask_Core0_LowPrio_0_5ms
    3 x OsAlarm, all with OsAlarmCounterRef=SystemTimer, OsAlarmAccessingApplication=SystemApplication_OsCore0:
      Rte_Al_TE2_BswTask_Core0_LowPrio_0_10ms
        OsAlarmAction
          OsAlarmSetEvent: OsAlarmSetEventRef=Rte_Ev_Cyclic2_BswTask_Core0_LowPrio_0_10ms, OsAlarmSetEventTaskRef=Os/BswTask_Core0_LowPrio
      Rte_Al_TE2_BswTask_Core0_LowPrio_0_5ms
        OsAlarmAction
          OsAlarmSetEvent: OsAlarmSetEventRef=Rte_Ev_Cyclic2_BswTask_Core0_LowPrio_0_5ms, OsAlarmSetEventTaskRef=Os/BswTask_Core0_LowPrio
      Rte_Al_TE_ApplTask_Core0_LowPrio_0_10ms
        OsAlarmAction
          OsAlarmSetEvent: OsAlarmSetEventRef=Rte_Ev_Cyclic_ApplTask_Core0_LowPrio_0_10ms, OsAlarmSetEventTaskRef=Os/ApplTask_Core0_LowPrio
    Rte_Ev_Cyclic_ApplTask_Core0_LowPrio_0_10ms (OsEvent)
    Default_Init_Task_Trusted (OsTask):  # COVERS : PLAIN_TEXT ARCH_SW_OS_0051; ARCH_SW_OS_0301
      OsTaskActivation = 1
      OsTaskPriority = 99
      OsTaskSchedule = FULL
      OsTaskStackSharing = false
      OsTaskStackSize = 256
      OsTaskType = BASIC
      OsTaskUsesFpu = false
      OsTaskAccessingApplication = SystemApplication_OsCore0
      OsTaskAutostart: OsTaskAppModeRef=OSDEFAULTAPPMODE
    Rte_Al_TE2_BswTask_Core0_HighPrio_0_3ms (OsAlarm): OsAlarmCounterRef=SystemTimer, OsAlarmAccessingApplication=SystemApplication_OsCore0
      OsAlarmAction
        OsAlarmSetEvent: OsAlarmSetEventRef=Rte_Ev_Cyclic2_BswTask_Core0_HighPrio_0_3ms, OsAlarmSetEventTaskRef=Os/BswTask_Core0_HighPrio
    Rte_Ev_Cyclic2_BswTask_Core0_HighPrio_0_3ms (OsEvent)
    OsResource_EcuM (OsResource):
      OsResourceProperty = STANDARD
      OsResourceAccessingApplication = OsApplication_Trusted_Core0
      OsResourceAccessingApplication = SystemApplication_OsCore0
    Default_Init_Task (OsTask):
      OsTaskActivation = 1
      OsTaskPriority = 100
      OsTaskSchedule = FULL
      OsTaskStackSharing = false
      OsTaskStackSize = 1024
      OsTaskType = BASIC
      OsTaskUsesFpu = false
      OsTaskAccessingApplication = SystemApplication_OsCore0
      OsTaskAutostart: OsTaskAppModeRef=OSDEFAULTAPPMODE
    Rte_Al_TE_ApplTask_Core0_LowPrio_0_100ms (OsAlarm): OsAlarmCounterRef=SystemTimer, OsAlarmAccessingApplication=SystemApplication_OsCore0
      OsAlarmAction
        OsAlarmSetEvent: OsAlarmSetEventRef=Rte_Ev_Cyclic_ApplTask_Core0_LowPrio_0_100ms, OsAlarmSetEventTaskRef=Os/ApplTask_Core0_LowPrio
    Rte_Ev_Cyclic_ApplTask_Core0_LowPrio_0_100ms (OsEvent)
    Rte_Al_TE_ApplTask_Core0_LowPrio_0_1000ms (OsAlarm): OsAlarmCounterRef=SystemTimer, OsAlarmAccessingApplication=SystemApplication_OsCore0
      OsAlarmAction
        OsAlarmSetEvent: OsAlarmSetEventRef=Rte_Ev_Cyclic_ApplTask_Core0_LowPrio_0_1000ms, OsAlarmSetEventTaskRef=Os/ApplTask_Core0_LowPrio
    Rte_Ev_Cyclic_ApplTask_Core0_LowPrio_0_1000ms (OsEvent)
    Rte_Al_TE_ApplTask_Core0_LowPrio_0_250ms (OsAlarm): OsAlarmCounterRef=SystemTimer, OsAlarmAccessingApplication=SystemApplication_OsCore0
      OsAlarmAction
        OsAlarmSetEvent: OsAlarmSetEventRef=Rte_Ev_Cyclic_ApplTask_Core0_LowPrio_0_250ms, OsAlarmSetEventTaskRef=Os/ApplTask_Core0_LowPrio
    Rte_Ev_Cyclic_ApplTask_Core0_LowPrio_0_250ms (OsEvent)
    Rte_Ev_Cyclic_ApplTask_Core0_LowPrio_0_1ms (OsEvent)
    Rte_Al_TE_ApplTask_Core0_LowPrio_0_1ms (OsAlarm): OsAlarmCounterRef=SystemTimer, OsAlarmAccessingApplication=SystemApplication_OsCore0
      OsAlarmAction
        OsAlarmSetEvent: OsAlarmSetEventRef=Rte_Ev_Cyclic_ApplTask_Core0_LowPrio_0_1ms, OsAlarmSetEventTaskRef=Os/ApplTask_Core0_LowPrio
    Rte_Ev_Run_Ct_MBBL_ResetManager_ResetServiceExecution (OsEvent)
    Rte_Al_TE_BaseFunction_BaseFunction_Main (OsAlarm): OsAlarmCounterRef=SystemTimer, OsAlarmAccessingApplication=SystemApplication_OsCore0
      OsAlarmAction
        OsAlarmSetEvent: OsAlarmSetEventRef=Rte_Ev_Run_BaseFunction_BaseFunction_Main, OsAlarmSetEventTaskRef=Os/ApplTask_Core0_LowPrio
    4 x OsEvent:
      Rte_Ev_Run_BaseFunction_BaseFunction_Main
      Rte_Ev_Run_Ssa_RightsM_Ssa_RightsM_DiagnosticSessionChangeIndication
      Rte_Ev_Run_Ssa_BcTp_Ssa_BcTp_ReceiveVINTimeout
      Rte_Ev_Run_Ssa_Coding_Ssa_Coding_VIN_Receive_Timeout
    Rte_Al_TE_SBC_SBC_MainFunction (OsAlarm): OsAlarmCounterRef=SystemTimer, OsAlarmAccessingApplication=SystemApplication_OsCore0
      OsAlarmAction
        OsAlarmSetEvent: OsAlarmSetEventRef=Rte_Ev_Run_SBC_SBC_MainFunction, OsAlarmSetEventTaskRef=Os/BswTask_Core0_HighPrio
    3 x OsEvent:
      Rte_Ev_Run_SBC_SBC_MainFunction
      Rte_Ev_Run_Cdd_MBBL_EcuStatHandler_DiagSessionChange_ExitExtendedSession
      Rte_Ev_OnEntry_ApplTask_Core0_LowPrio_Dcm_DcmDiagnosticSessionControl_DcmDiagnosticSessionControl_EXTENDED_SESSION
    Rte_Al_TE_AdcIf_AdcIf_MainFunction (OsAlarm): OsAlarmCounterRef=SystemTimer, OsAlarmAccessingApplication=SystemApplication_OsCore0
      OsAlarmAction
        OsAlarmSetEvent: OsAlarmSetEventRef=Rte_Ev_Run_AdcIf_AdcIf_MainFunction, OsAlarmSetEventTaskRef=Os/BswTask_Core0_LowPrio
    Rte_Ev_Run_AdcIf_AdcIf_MainFunction (OsEvent)
    Rte_Al_TE_BFE_BFE_runExecuteStandardSteps (OsAlarm): OsAlarmCounterRef=SystemTimer, OsAlarmAccessingApplication=SystemApplication_OsCore0
      OsAlarmAction
        OsAlarmSetEvent: OsAlarmSetEventRef=Rte_Ev_Run_BFE_BFE_runExecuteStandardSteps, OsAlarmSetEventTaskRef=Os/OsTask_ALV_BeltFunctionAlgo
    OsTask_ALV_BeltFunctionAlgo (OsTask):
      OsTaskActivation = 1
      OsTaskPriority = 21
      OsTaskSchedule = FULL
      OsTaskStackSharing = false
      OsTaskStackSize = 512
      OsTaskType = AUTO
      OsTaskUsesFpu = false
      OsTaskAccessingApplication = SystemApplication_OsCore0
      OsTaskEventRef = Rte_Ev_Cyclic_BeltFunctionSelection_10msA
      OsTaskEventRef = Rte_Ev_Cyclic_BeltFunctionAlgo_10ms
      OsTaskEventRef = Rte_Ev_Cyclic_BeltFunctionAlgo_2ms
      OsTaskEventRef = Rte_Ev_Cyclic_OsTask_ALV_BeltFunctionsExec_0_10msA
      OsTaskEventRef = Rte_Ev_Run_BFE_BFE_runExecuteStandardStepsA
      OsTaskEventRef = Rte_Ev_Cyclic_OsTask_ALV_BeltFunctionAlgo_0_10ms
      OsTaskEventRef = Rte_Ev_Run_BFE_BFE_runExecuteStandardSteps
    Rte_Al_TE_OsTask_ALV_BeltFunctionAlgo_0_10ms (OsAlarm): OsAlarmCounterRef=SystemTimer, OsAlarmAccessingApplication=SystemApplication_OsCore0
      OsAlarmAction
        OsAlarmSetEvent: OsAlarmSetEventRef=Rte_Ev_Cyclic_OsTask_ALV_BeltFunctionAlgo_0_10ms, OsAlarmSetEventTaskRef=Os/OsTask_ALV_BeltFunctionAlgo
    7 x OsEvent:
      Rte_Ev_Cyclic_BeltFunctionSelection_10msA
      Rte_Ev_Cyclic_BeltFunctionAlgo_10ms
      Rte_Ev_Cyclic_BeltFunctionAlgo_2ms
      Rte_Ev_Cyclic_OsTask_ALV_BeltFunctionsExec_0_10msA
      Rte_Ev_Run_BFE_BFE_runExecuteStandardStepsA
      Rte_Ev_Cyclic_OsTask_ALV_BeltFunctionAlgo_0_10ms
      Rte_Ev_Run_BFE_BFE_runExecuteStandardSteps
    RCM_PFlashEccFailure_Notification (OsIsr):
      OsIsrInterruptPriority = 62
      OsIsrCategory = CATEGORY_2
      OsIsrInterruptType = EXTERNAL
      OsIsrInterruptSource = 2260
      OsIsrStackSize = 1024
      OsIsrEnableNesting = false
      OsIsrUsesFpu = false
      OsIsrInitialEnableInterruptSource = true
    RCM_SRamEccFailure_Notification (OsIsr):
      OsIsrInterruptPriority = 61
      OsIsrCategory = CATEGORY_2
      OsIsrInterruptType = EXTERNAL
      OsIsrInterruptSource = 2256
      OsIsrStackSize = 1024
      OsIsrEnableNesting = false
      OsIsrUsesFpu = false
      OsIsrInitialEnableInterruptSource = true
    Rte_Al_TE_ApplTask_Core0_LowPrio_0_2ms (OsAlarm): OsAlarmCounterRef=SystemTimer, OsAlarmAccessingApplication=SystemApplication_OsCore0
      OsAlarmAction
        OsAlarmSetEvent: OsAlarmSetEventRef=Rte_Ev_Cyclic_ApplTask_Core0_LowPrio_0_2ms, OsAlarmSetEventTaskRef=Os/ApplTask_Core0_LowPrio
    Rte_Ev_Cyclic_ApplTask_Core0_LowPrio_0_2ms (OsEvent)
    OS_ISR_BMM_HES_IT (OsIsr):
      OsIsrInterruptPriority = 63
      OsIsrCategory = CATEGORY_1
      OsIsrInterruptType = EXTERNAL
      OsIsrInterruptSource = 736
      OsIsrStackSize = 1024
      OsIsrEnableNesting = false
      OsIsrUsesFpu = false
      OsIsrInitialEnableInterruptSource = false
      OsIsrSpecialFunctionName = OS_ISR_BMM_HES_IT
    OS_ISR_BMM_HES_TOUT (OsIsr):
      OsIsrInterruptPriority = 64
      OsIsrCategory = CATEGORY_1
      OsIsrInterruptType = EXTERNAL
      OsIsrInterruptSource = 752
      OsIsrStackSize = 1024
      OsIsrEnableNesting = false
      OsIsrUsesFpu = false
      OsIsrInitialEnableInterruptSource = false
      OsIsrSpecialFunctionName = OS_ISR_BMM_HES_TOUT
    Rte_Al_TE_DIA_DIA_cyclicProcessingTask (OsAlarm): OsAlarmCounterRef=SystemTimer, OsAlarmAccessingApplication=SystemApplication_OsCore0
      OsAlarmAction
        OsAlarmSetEvent: OsAlarmSetEventRef=Rte_Ev_Run_DIA_DIA_cyclicProcessingTask, OsAlarmSetEventTaskRef=Os/ApplTask_Core0_LowPrio
    5 x OsEvent:
      Rte_Ev_Run_DIA_DIA_cyclicProcessingTask
      Rte_Ev_Run_DiagFunction_RoELite_SecureEventNotification
      Rte_Ev_Run_Ssa_SecLog_Ssa_SecLog_IgnitionStatusChanged
      Rte_Ev_Run_DiagFunction_RoELite_AvailabilityDataHandler
      Rte_Ev_Run_DiagFunction_RoELite_ObsolescenceDataHandler
    Rte_Al_TE_DiagFunction_DiagFunction_MainFunction (OsAlarm): OsAlarmCounterRef=SystemTimer, OsAlarmAccessingApplication=SystemApplication_OsCore0
      OsAlarmAction
        OsAlarmSetEvent: OsAlarmSetEventRef=Rte_Ev_Run_DiagFunction_DiagFunction_MainFunction, OsAlarmSetEventTaskRef=Os/ApplTask_Core0_LowPrio
    Rte_Ev_Run_DiagFunction_DiagFunction_MainFunction (OsEvent)
