AUTOSAR XML (schema 00049)
package /ActiveEcuC
  module config Smu: implementation-config-variant=VARIANT-POST-BUILD, module-description=Smu_Impl
    SmuConfigSet
      SmuCoreConfig
        SmuCoreRecoveryTimer: SmuCoreEnableRT0=SMU_RT_DISABLE, SmuCoreEnableRT1=SMU_RT_DISABLE, SmuCoreRTDuration=16383
        4 x SmuCoreRT0Alarm, all with SmuCoreRT0AlarmGroupId=SMU_ALARM_GROUP0:
          SmuCoreRT0Alarm: SmuCoreRT0AlarmId=0
          SmuCoreRT0Alarm_{1..3}: SmuCoreRT0AlarmId={1..3}
        4 x SmuCoreRT1Alarm, all with SmuCoreRT1AlarmGroupId=SMU_ALARM_GROUP0:
          SmuCoreRT1Alarm: SmuCoreRT1AlarmId=0
          SmuCoreRT1Alarm_{1..3}: SmuCoreRT1AlarmId={1..3}
        SmuCoreAlarmGlobalConfig:
          SmuCoreInterruptSet{0..2} = SMU_SELECT_INT{0..2}
          SmuCoreCpu{0..5}ResetRequest = false
          SmuCoreIGCS{0..2}ActivatePES = false
          SmuCoreNMIActivatePES = false
          SmuCoreCpuResetActivatePES = false
          SmuCoreEnableFaultToRunState = SMU_EFRST_DISABLE
        SmuCoreFSPHandling:
          SmuCoreFSPPrescaler1 = SMU_REF_CLK_FRQ_DIV_2
          SmuCoreFSPPrescaler2 = SMU_REF_CLK_FRQ_DIV_512
          SmuCoreFSPSignalingMode = SMU_FSP_BISTABLE_PROTOCOL
          SmuCorePESOnFSP = SMU_FSP_PES_DISABLE
          SmuCoreFSPFaultStateDuration = 1
        12 x SmuCoreAlarmGroup:
          SmuCoreAlarmGroup: SmuCoreAlmGrpId=0
            32 x SmuCoreAlarmBehavior, all with SmuCoreAlarmFSP=SMU_ALARM_FSP_DISABLED:
              SmuCoreAlarmBehavior: SmuCoreAlmBehaviourId=0, SmuCoreAlarmIntBeh=SMU_NA_INT_ACTION
              SmuCoreAlarmBehavior_{1..6}: SmuCoreAlmBehaviourId={1..6}, SmuCoreAlarmIntBeh=SMU_NA_INT_ACTION
              SmuCoreAlarmBehavior_7: SmuCoreAlmBehaviourId=7, SmuCoreAlarmIntBeh=SMU_IGCS0_INT_ACTION
              SmuCoreAlarmBehavior_8: SmuCoreAlmBehaviourId=8, SmuCoreAlarmIntBeh=SMU_NA_INT_ACTION
              SmuCoreAlarmBehavior_9: SmuCoreAlmBehaviourId=9, SmuCoreAlarmIntBeh=SMU_NA_INT_ACTION
              SmuCoreAlarmBehavior_10: SmuCoreAlmBehaviourId=10, SmuCoreAlarmIntBeh=SMU_IGCS0_INT_ACTION
              SmuCoreAlarmBehavior_11: SmuCoreAlmBehaviourId=11, SmuCoreAlarmIntBeh=SMU_NA_INT_ACTION
              SmuCoreAlarmBehavior_12: SmuCoreAlmBehaviourId=12, SmuCoreAlarmIntBeh=SMU_NA_INT_ACTION
              SmuCoreAlarmBehavior_13: SmuCoreAlmBehaviourId=13, SmuCoreAlarmIntBeh=SMU_IGCS0_INT_ACTION
              SmuCoreAlarmBehavior_{14..31}: SmuCoreAlmBehaviourId={14..31}, SmuCoreAlarmIntBeh=SMU_NA_INT_ACTION
          SmuCoreAlarmGroup_1: SmuCoreAlmGrpId=1
            32 x SmuCoreAlarmBehavior, all with SmuCoreAlarmIntBeh=SMU_NA_INT_ACTION, SmuCoreAlarmFSP=SMU_ALARM_FSP_DISABLED:
              SmuCoreAlarmBehavior_32: SmuCoreAlmBehaviourId=0
              SmuCoreAlarmBehavior_33: SmuCoreAlmBehaviourId=1
              SmuCoreAlarmBehavior_34: SmuCoreAlmBehaviourId=2
              SmuCoreAlarmBehavior_35: SmuCoreAlmBehaviourId=3
              SmuCoreAlarmBehavior_36: SmuCoreAlmBehaviourId=4
              SmuCoreAlarmBehavior_37: SmuCoreAlmBehaviourId=5
              SmuCoreAlarmBehavior_38: SmuCoreAlmBehaviourId=6
              SmuCoreAlarmBehavior_39: SmuCoreAlmBehaviourId=7
              SmuCoreAlarmBehavior_40: SmuCoreAlmBehaviourId=8
              SmuCoreAlarmBehavior_41: SmuCoreAlmBehaviourId=9
              SmuCoreAlarmBehavior_42: SmuCoreAlmBehaviourId=10
              SmuCoreAlarmBehavior_43: SmuCoreAlmBehaviourId=11
              SmuCoreAlarmBehavior_44: SmuCoreAlmBehaviourId=12
              SmuCoreAlarmBehavior_45: SmuCoreAlmBehaviourId=13
              SmuCoreAlarmBehavior_46: SmuCoreAlmBehaviourId=14
              SmuCoreAlarmBehavior_47: SmuCoreAlmBehaviourId=15
              SmuCoreAlarmBehavior_48: SmuCoreAlmBehaviourId=16
              SmuCoreAlarmBehavior_49: SmuCoreAlmBehaviourId=17
              SmuCoreAlarmBehavior_50: SmuCoreAlmBehaviourId=18
              SmuCoreAlarmBehavior_51: SmuCoreAlmBehaviourId=19
              SmuCoreAlarmBehavior_52: SmuCoreAlmBehaviourId=20
              SmuCoreAlarmBehavior_53: SmuCoreAlmBehaviourId=21
              SmuCoreAlarmBehavior_54: SmuCoreAlmBehaviourId=22
              SmuCoreAlarmBehavior_55: SmuCoreAlmBehaviourId=23
              SmuCoreAlarmBehavior_56: SmuCoreAlmBehaviourId=24
              SmuCoreAlarmBehavior_57: SmuCoreAlmBehaviourId=25
              SmuCoreAlarmBehavior_58: SmuCoreAlmBehaviourId=26
              SmuCoreAlarmBehavior_59: SmuCoreAlmBehaviourId=27
              SmuCoreAlarmBehavior_60: SmuCoreAlmBehaviourId=28
              SmuCoreAlarmBehavior_61: SmuCoreAlmBehaviourId=29
              SmuCoreAlarmBehavior_62: SmuCoreAlmBehaviourId=30
              SmuCoreAlarmBehavior_63: SmuCoreAlmBehaviourId=31
          SmuCoreAlarmGroup_2: SmuCoreAlmGrpId=2
            32 x SmuCoreAlarmBehavior, all with SmuCoreAlarmIntBeh=SMU_NA_INT_ACTION, SmuCoreAlarmFSP=SMU_ALARM_FSP_DISABLED:
              SmuCoreAlarmBehavior_64: SmuCoreAlmBehaviourId=0
              SmuCoreAlarmBehavior_65: SmuCoreAlmBehaviourId=1
              SmuCoreAlarmBehavior_66: SmuCoreAlmBehaviourId=2
              SmuCoreAlarmBehavior_67: SmuCoreAlmBehaviourId=3
              SmuCoreAlarmBehavior_68: SmuCoreAlmBehaviourId=4
              SmuCoreAlarmBehavior_69: SmuCoreAlmBehaviourId=5
              SmuCoreAlarmBehavior_70: SmuCoreAlmBehaviourId=6
              SmuCoreAlarmBehavior_71: SmuCoreAlmBehaviourId=7
              SmuCoreAlarmBehavior_72: SmuCoreAlmBehaviourId=8
              SmuCoreAlarmBehavior_73: SmuCoreAlmBehaviourId=9
              SmuCoreAlarmBehavior_74: SmuCoreAlmBehaviourId=10
              SmuCoreAlarmBehavior_75: SmuCoreAlmBehaviourId=11
              SmuCoreAlarmBehavior_76: SmuCoreAlmBehaviourId=12
              SmuCoreAlarmBehavior_77: SmuCoreAlmBehaviourId=13
              SmuCoreAlarmBehavior_78: SmuCoreAlmBehaviourId=14
              SmuCoreAlarmBehavior_79: SmuCoreAlmBehaviourId=15
              SmuCoreAlarmBehavior_80: SmuCoreAlmBehaviourId=16
              SmuCoreAlarmBehavior_81: SmuCoreAlmBehaviourId=17
              SmuCoreAlarmBehavior_82: SmuCoreAlmBehaviourId=18
              SmuCoreAlarmBehavior_83: SmuCoreAlmBehaviourId=19
              SmuCoreAlarmBehavior_84: SmuCoreAlmBehaviourId=20
              SmuCoreAlarmBehavior_85: SmuCoreAlmBehaviourId=21
              SmuCoreAlarmBehavior_86: SmuCoreAlmBehaviourId=22
              SmuCoreAlarmBehavior_87: SmuCoreAlmBehaviourId=23
              SmuCoreAlarmBehavior_88: SmuCoreAlmBehaviourId=24
              SmuCoreAlarmBehavior_89: SmuCoreAlmBehaviourId=25
              SmuCoreAlarmBehavior_90: SmuCoreAlmBehaviourId=26
              SmuCoreAlarmBehavior_91: SmuCoreAlmBehaviourId=27
              SmuCoreAlarmBehavior_92: SmuCoreAlmBehaviourId=28
              SmuCoreAlarmBehavior_93: SmuCoreAlmBehaviourId=29
              SmuCoreAlarmBehavior_94: SmuCoreAlmBehaviourId=30
              SmuCoreAlarmBehavior_95: SmuCoreAlmBehaviourId=31
          SmuCoreAlarmGroup_3: SmuCoreAlmGrpId=3
            32 x SmuCoreAlarmBehavior, all with SmuCoreAlarmIntBeh=SMU_NA_INT_ACTION, SmuCoreAlarmFSP=SMU_ALARM_FSP_DISABLED:
              SmuCoreAlarmBehavior_96: SmuCoreAlmBehaviourId=0
              SmuCoreAlarmBehavior_97: SmuCoreAlmBehaviourId=1
              SmuCoreAlarmBehavior_98: SmuCoreAlmBehaviourId=2
              SmuCoreAlarmBehavior_99: SmuCoreAlmBehaviourId=3
              SmuCoreAlarmBehavior_100: SmuCoreAlmBehaviourId=4
              SmuCoreAlarmBehavior_101: SmuCoreAlmBehaviourId=5
              SmuCoreAlarmBehavior_102: SmuCoreAlmBehaviourId=6
              SmuCoreAlarmBehavior_103: SmuCoreAlmBehaviourId=7
              SmuCoreAlarmBehavior_104: SmuCoreAlmBehaviourId=8
              SmuCoreAlarmBehavior_105: SmuCoreAlmBehaviourId=9
              SmuCoreAlarmBehavior_106: SmuCoreAlmBehaviourId=10
              SmuCoreAlarmBehavior_107: SmuCoreAlmBehaviourId=11
              SmuCoreAlarmBehavior_108: SmuCoreAlmBehaviourId=12
              SmuCoreAlarmBehavior_109: SmuCoreAlmBehaviourId=13
              SmuCoreAlarmBehavior_110: SmuCoreAlmBehaviourId=14
              SmuCoreAlarmBehavior_111: SmuCoreAlmBehaviourId=15
              SmuCoreAlarmBehavior_112: SmuCoreAlmBehaviourId=16
              SmuCoreAlarmBehavior_113: SmuCoreAlmBehaviourId=17
              SmuCoreAlarmBehavior_114: SmuCoreAlmBehaviourId=18
              SmuCoreAlarmBehavior_115: SmuCoreAlmBehaviourId=19
              SmuCoreAlarmBehavior_116: SmuCoreAlmBehaviourId=20
              SmuCoreAlarmBehavior_117: SmuCoreAlmBehaviourId=21
              SmuCoreAlarmBehavior_118: SmuCoreAlmBehaviourId=22
              SmuCoreAlarmBehavior_119: SmuCoreAlmBehaviourId=23
              SmuCoreAlarmBehavior_120: SmuCoreAlmBehaviourId=24
              SmuCoreAlarmBehavior_121: SmuCoreAlmBehaviourId=25
              SmuCoreAlarmBehavior_122: SmuCoreAlmBehaviourId=26
              SmuCoreAlarmBehavior_123: SmuCoreAlmBehaviourId=27
              SmuCoreAlarmBehavior_124: SmuCoreAlmBehaviourId=28
              SmuCoreAlarmBehavior_125: SmuCoreAlmBehaviourId=29
              SmuCoreAlarmBehavior_126: SmuCoreAlmBehaviourId=30
              SmuCoreAlarmBehavior_127: SmuCoreAlmBehaviourId=31
          SmuCoreAlarmGroup_4: SmuCoreAlmGrpId=4
            32 x SmuCoreAlarmBehavior, all with SmuCoreAlarmIntBeh=SMU_NA_INT_ACTION, SmuCoreAlarmFSP=SMU_ALARM_FSP_DISABLED:
              SmuCoreAlarmBehavior_128: SmuCoreAlmBehaviourId=0
              SmuCoreAlarmBehavior_129: SmuCoreAlmBehaviourId=1
              SmuCoreAlarmBehavior_130: SmuCoreAlmBehaviourId=2
              SmuCoreAlarmBehavior_131: SmuCoreAlmBehaviourId=3
              SmuCoreAlarmBehavior_132: SmuCoreAlmBehaviourId=4
              SmuCoreAlarmBehavior_133: SmuCoreAlmBehaviourId=5
              SmuCoreAlarmBehavior_134: SmuCoreAlmBehaviourId=6
              SmuCoreAlarmBehavior_135: SmuCoreAlmBehaviourId=7
              SmuCoreAlarmBehavior_136: SmuCoreAlmBehaviourId=8
              SmuCoreAlarmBehavior_137: SmuCoreAlmBehaviourId=9
              SmuCoreAlarmBehavior_138: SmuCoreAlmBehaviourId=10
              SmuCoreAlarmBehavior_139: SmuCoreAlmBehaviourId=11
              SmuCoreAlarmBehavior_140: SmuCoreAlmBehaviourId=12
              SmuCoreAlarmBehavior_141: SmuCoreAlmBehaviourId=13
              SmuCoreAlarmBehavior_142: SmuCoreAlmBehaviourId=14
              SmuCoreAlarmBehavior_143: SmuCoreAlmBehaviourId=15
              SmuCoreAlarmBehavior_144: SmuCoreAlmBehaviourId=16
              SmuCoreAlarmBehavior_145: SmuCoreAlmBehaviourId=17
              SmuCoreAlarmBehavior_146: SmuCoreAlmBehaviourId=18
              SmuCoreAlarmBehavior_147: SmuCoreAlmBehaviourId=19
              SmuCoreAlarmBehavior_148: SmuCoreAlmBehaviourId=20
              SmuCoreAlarmBehavior_149: SmuCoreAlmBehaviourId=21
              SmuCoreAlarmBehavior_150: SmuCoreAlmBehaviourId=22
              SmuCoreAlarmBehavior_151: SmuCoreAlmBehaviourId=23
              SmuCoreAlarmBehavior_152: SmuCoreAlmBehaviourId=24
              SmuCoreAlarmBehavior_153: SmuCoreAlmBehaviourId=25
              SmuCoreAlarmBehavior_154: SmuCoreAlmBehaviourId=26
              SmuCoreAlarmBehavior_155: SmuCoreAlmBehaviourId=27
              SmuCoreAlarmBehavior_156: SmuCoreAlmBehaviourId=28
              SmuCoreAlarmBehavior_157: SmuCoreAlmBehaviourId=29
              SmuCoreAlarmBehavior_158: SmuCoreAlmBehaviourId=30
              SmuCoreAlarmBehavior_159: SmuCoreAlmBehaviourId=31
          SmuCoreAlarmGroup_5: SmuCoreAlmGrpId=5
            32 x SmuCoreAlarmBehavior, all with SmuCoreAlarmIntBeh=SMU_NA_INT_ACTION, SmuCoreAlarmFSP=SMU_ALARM_FSP_DISABLED:
              SmuCoreAlarmBehavior_160: SmuCoreAlmBehaviourId=0
              SmuCoreAlarmBehavior_161: SmuCoreAlmBehaviourId=1
              SmuCoreAlarmBehavior_162: SmuCoreAlmBehaviourId=2
              SmuCoreAlarmBehavior_163: SmuCoreAlmBehaviourId=3
              SmuCoreAlarmBehavior_164: SmuCoreAlmBehaviourId=4
              SmuCoreAlarmBehavior_165: SmuCoreAlmBehaviourId=5
              SmuCoreAlarmBehavior_166: SmuCoreAlmBehaviourId=6
              SmuCoreAlarmBehavior_167: SmuCoreAlmBehaviourId=7
              SmuCoreAlarmBehavior_168: SmuCoreAlmBehaviourId=8
              SmuCoreAlarmBehavior_169: SmuCoreAlmBehaviourId=9
              SmuCoreAlarmBehavior_170: SmuCoreAlmBehaviourId=10
              SmuCoreAlarmBehavior_171: SmuCoreAlmBehaviourId=11
              SmuCoreAlarmBehavior_172: SmuCoreAlmBehaviourId=12
              SmuCoreAlarmBehavior_173: SmuCoreAlmBehaviourId=13
              SmuCoreAlarmBehavior_174: SmuCoreAlmBehaviourId=14
              SmuCoreAlarmBehavior_175: SmuCoreAlmBehaviourId=15
              SmuCoreAlarmBehavior_176: SmuCoreAlmBehaviourId=16
              SmuCoreAlarmBehavior_177: SmuCoreAlmBehaviourId=17
              SmuCoreAlarmBehavior_178: SmuCoreAlmBehaviourId=18
              SmuCoreAlarmBehavior_179: SmuCoreAlmBehaviourId=19
              SmuCoreAlarmBehavior_180: SmuCoreAlmBehaviourId=20
              SmuCoreAlarmBehavior_181: SmuCoreAlmBehaviourId=21
              SmuCoreAlarmBehavior_182: SmuCoreAlmBehaviourId=22
              SmuCoreAlarmBehavior_183: SmuCoreAlmBehaviourId=23
              SmuCoreAlarmBehavior_184: SmuCoreAlmBehaviourId=24
              SmuCoreAlarmBehavior_185: SmuCoreAlmBehaviourId=25
              SmuCoreAlarmBehavior_186: SmuCoreAlmBehaviourId=26
              SmuCoreAlarmBehavior_187: SmuCoreAlmBehaviourId=27
              SmuCoreAlarmBehavior_188: SmuCoreAlmBehaviourId=28
              SmuCoreAlarmBehavior_189: SmuCoreAlmBehaviourId=29
              SmuCoreAlarmBehavior_190: SmuCoreAlmBehaviourId=30
              SmuCoreAlarmBehavior_191: SmuCoreAlmBehaviourId=31
          SmuCoreAlarmGroup_6: SmuCoreAlmGrpId=6
            32 x SmuCoreAlarmBehavior, all with SmuCoreAlarmFSP=SMU_ALARM_FSP_DISABLED:
              SmuCoreAlarmBehavior_192: SmuCoreAlmBehaviourId=0, SmuCoreAlarmIntBeh=SMU_NA_INT_ACTION
              SmuCoreAlarmBehavior_193: SmuCoreAlmBehaviourId=1, SmuCoreAlarmIntBeh=SMU_NA_INT_ACTION
              SmuCoreAlarmBehavior_194: SmuCoreAlmBehaviourId=2, SmuCoreAlarmIntBeh=SMU_NA_INT_ACTION
              SmuCoreAlarmBehavior_195: SmuCoreAlmBehaviourId=3, SmuCoreAlarmIntBeh=SMU_NA_INT_ACTION
              SmuCoreAlarmBehavior_196: SmuCoreAlmBehaviourId=4, SmuCoreAlarmIntBeh=SMU_NA_INT_ACTION
              SmuCoreAlarmBehavior_197: SmuCoreAlmBehaviourId=5, SmuCoreAlarmIntBeh=SMU_NA_INT_ACTION
              SmuCoreAlarmBehavior_198: SmuCoreAlmBehaviourId=6, SmuCoreAlarmIntBeh=SMU_NA_INT_ACTION
              SmuCoreAlarmBehavior_199: SmuCoreAlmBehaviourId=7, SmuCoreAlarmIntBeh=SMU_NA_INT_ACTION
              SmuCoreAlarmBehavior_200: SmuCoreAlmBehaviourId=8, SmuCoreAlarmIntBeh=SMU_NA_INT_ACTION
              SmuCoreAlarmBehavior_201: SmuCoreAlmBehaviourId=9, SmuCoreAlarmIntBeh=SMU_NA_INT_ACTION
              SmuCoreAlarmBehavior_202: SmuCoreAlmBehaviourId=10, SmuCoreAlarmIntBeh=SMU_NA_INT_ACTION
              SmuCoreAlarmBehavior_203: SmuCoreAlmBehaviourId=11, SmuCoreAlarmIntBeh=SMU_NA_INT_ACTION
              SmuCoreAlarmBehavior_204: SmuCoreAlmBehaviourId=12, SmuCoreAlarmIntBeh=SMU_NA_INT_ACTION
              SmuCoreAlarmBehavior_205: SmuCoreAlmBehaviourId=13, SmuCoreAlarmIntBeh=SMU_NA_INT_ACTION
              SmuCoreAlarmBehavior_206: SmuCoreAlmBehaviourId=14, SmuCoreAlarmIntBeh=SMU_NA_INT_ACTION
              SmuCoreAlarmBehavior_207: SmuCoreAlmBehaviourId=15, SmuCoreAlarmIntBeh=SMU_NA_INT_ACTION
              SmuCoreAlarmBehavior_208: SmuCoreAlmBehaviourId=16, SmuCoreAlarmIntBeh=SMU_NA_INT_ACTION
              SmuCoreAlarmBehavior_209: SmuCoreAlmBehaviourId=17, SmuCoreAlarmIntBeh=SMU_NA_INT_ACTION
              SmuCoreAlarmBehavior_210: SmuCoreAlmBehaviourId=18, SmuCoreAlarmIntBeh=SMU_NA_INT_ACTION
              SmuCoreAlarmBehavior_211: SmuCoreAlmBehaviourId=19, SmuCoreAlarmIntBeh=SMU_NA_INT_ACTION
              SmuCoreAlarmBehavior_212: SmuCoreAlmBehaviourId=20, SmuCoreAlarmIntBeh=SMU_IGCS0_INT_ACTION
              SmuCoreAlarmBehavior_213: SmuCoreAlmBehaviourId=21, SmuCoreAlarmIntBeh=SMU_NA_INT_ACTION
              SmuCoreAlarmBehavior_214: SmuCoreAlmBehaviourId=22, SmuCoreAlarmIntBeh=SMU_NA_INT_ACTION
              SmuCoreAlarmBehavior_215: SmuCoreAlmBehaviourId=23, SmuCoreAlarmIntBeh=SMU_IGCS0_INT_ACTION
              SmuCoreAlarmBehavior_216: SmuCoreAlmBehaviourId=24, SmuCoreAlarmIntBeh=SMU_NA_INT_ACTION
              SmuCoreAlarmBehavior_217: SmuCoreAlmBehaviourId=25, SmuCoreAlarmIntBeh=SMU_NA_INT_ACTION
              SmuCoreAlarmBehavior_218: SmuCoreAlmBehaviourId=26, SmuCoreAlarmIntBeh=SMU_NA_INT_ACTION
              SmuCoreAlarmBehavior_219: SmuCoreAlmBehaviourId=27, SmuCoreAlarmIntBeh=SMU_NA_INT_ACTION
              SmuCoreAlarmBehavior_220: SmuCoreAlmBehaviourId=28, SmuCoreAlarmIntBeh=SMU_NA_INT_ACTION
              SmuCoreAlarmBehavior_221: SmuCoreAlmBehaviourId=29, SmuCoreAlarmIntBeh=SMU_NA_INT_ACTION
              SmuCoreAlarmBehavior_222: SmuCoreAlmBehaviourId=30, SmuCoreAlarmIntBeh=SMU_NA_INT_ACTION
              SmuCoreAlarmBehavior_223: SmuCoreAlmBehaviourId=31, SmuCoreAlarmIntBeh=SMU_NA_INT_ACTION
          SmuCoreAlarmGroup_7: SmuCoreAlmGrpId=7
            32 x SmuCoreAlarmBehavior, all with SmuCoreAlarmFSP=SMU_ALARM_FSP_DISABLED:
              SmuCoreAlarmBehavior_224: SmuCoreAlmBehaviourId=0, SmuCoreAlarmIntBeh=SMU_NA_INT_ACTION
              SmuCoreAlarmBehavior_225: SmuCoreAlmBehaviourId=1, SmuCoreAlarmIntBeh=SMU_NA_INT_ACTION
              SmuCoreAlarmBehavior_226: SmuCoreAlmBehaviourId=2, SmuCoreAlarmIntBeh=SMU_NA_INT_ACTION
              SmuCoreAlarmBehavior_227: SmuCoreAlmBehaviourId=3, SmuCoreAlarmIntBeh=SMU_NA_INT_ACTION
              SmuCoreAlarmBehavior_228: SmuCoreAlmBehaviourId=4, SmuCoreAlarmIntBeh=SMU_NA_INT_ACTION
              SmuCoreAlarmBehavior_229: SmuCoreAlmBehaviourId=5, SmuCoreAlarmIntBeh=SMU_NA_INT_ACTION
              SmuCoreAlarmBehavior_230: SmuCoreAlmBehaviourId=6, SmuCoreAlarmIntBeh=SMU_NA_INT_ACTION
              SmuCoreAlarmBehavior_231: SmuCoreAlmBehaviourId=7, SmuCoreAlarmIntBeh=SMU_NA_INT_ACTION
              SmuCoreAlarmBehavior_232: SmuCoreAlmBehaviourId=8, SmuCoreAlarmIntBeh=SMU_NA_INT_ACTION
              SmuCoreAlarmBehavior_233: SmuCoreAlmBehaviourId=9, SmuCoreAlarmIntBeh=SMU_NA_INT_ACTION
              SmuCoreAlarmBehavior_234: SmuCoreAlmBehaviourId=10, SmuCoreAlarmIntBeh=SMU_NA_INT_ACTION
              SmuCoreAlarmBehavior_235: SmuCoreAlmBehaviourId=11, SmuCoreAlarmIntBeh=SMU_NA_INT_ACTION
              SmuCoreAlarmBehavior_236: SmuCoreAlmBehaviourId=12, SmuCoreAlarmIntBeh=SMU_NA_INT_ACTION
              SmuCoreAlarmBehavior_237: SmuCoreAlmBehaviourId=13, SmuCoreAlarmIntBeh=SMU_NA_INT_ACTION
              SmuCoreAlarmBehavior_238: SmuCoreAlmBehaviourId=14, SmuCoreAlarmIntBeh=SMU_NA_INT_ACTION
              SmuCoreAlarmBehavior_239: SmuCoreAlmBehaviourId=15, SmuCoreAlarmIntBeh=SMU_NA_INT_ACTION
              SmuCoreAlarmBehavior_240: SmuCoreAlmBehaviourId=16, SmuCoreAlarmIntBeh=SMU_NA_INT_ACTION
              SmuCoreAlarmBehavior_241: SmuCoreAlmBehaviourId=17, SmuCoreAlarmIntBeh=SMU_NA_INT_ACTION
              SmuCoreAlarmBehavior_242: SmuCoreAlmBehaviourId=18, SmuCoreAlarmIntBeh=SMU_NA_INT_ACTION
              SmuCoreAlarmBehavior_243: SmuCoreAlmBehaviourId=19, SmuCoreAlarmIntBeh=SMU_NA_INT_ACTION
              SmuCoreAlarmBehavior_244: SmuCoreAlmBehaviourId=20, SmuCoreAlarmIntBeh=SMU_NA_INT_ACTION
              SmuCoreAlarmBehavior_245: SmuCoreAlmBehaviourId=21, SmuCoreAlarmIntBeh=SMU_NA_INT_ACTION
              SmuCoreAlarmBehavior_246: SmuCoreAlmBehaviourId=22, SmuCoreAlarmIntBeh=SMU_NA_INT_ACTION
              SmuCoreAlarmBehavior_247: SmuCoreAlmBehaviourId=23, SmuCoreAlarmIntBeh=SMU_NA_INT_ACTION
              SmuCoreAlarmBehavior_248: SmuCoreAlmBehaviourId=24, SmuCoreAlarmIntBeh=SMU_NA_INT_ACTION
              SmuCoreAlarmBehavior_249: SmuCoreAlmBehaviourId=25, SmuCoreAlarmIntBeh=SMU_NA_INT_ACTION
              SmuCoreAlarmBehavior_250: SmuCoreAlmBehaviourId=26, SmuCoreAlarmIntBeh=SMU_IGCS1_INT_ACTION
              SmuCoreAlarmBehavior_251: SmuCoreAlmBehaviourId=27, SmuCoreAlarmIntBeh=SMU_NA_INT_ACTION
              SmuCoreAlarmBehavior_252: SmuCoreAlmBehaviourId=28, SmuCoreAlarmIntBeh=SMU_IGCS1_INT_ACTION
              SmuCoreAlarmBehavior_253: SmuCoreAlmBehaviourId=29, SmuCoreAlarmIntBeh=SMU_NA_INT_ACTION
              SmuCoreAlarmBehavior_254: SmuCoreAlmBehaviourId=30, SmuCoreAlarmIntBeh=SMU_NA_INT_ACTION
              SmuCoreAlarmBehavior_255: SmuCoreAlmBehaviourId=31, SmuCoreAlarmIntBeh=SMU_NA_INT_ACTION
          SmuCoreAlarmGroup_8: SmuCoreAlmGrpId=8
            32 x SmuCoreAlarmBehavior, all with SmuCoreAlarmIntBeh=SMU_NA_INT_ACTION, SmuCoreAlarmFSP=SMU_ALARM_FSP_DISABLED:
              SmuCoreAlarmBehavior_256: SmuCoreAlmBehaviourId=0
              SmuCoreAlarmBehavior_257: SmuCoreAlmBehaviourId=1
              SmuCoreAlarmBehavior_258: SmuCoreAlmBehaviourId=2
              SmuCoreAlarmBehavior_259: SmuCoreAlmBehaviourId=3
              SmuCoreAlarmBehavior_260: SmuCoreAlmBehaviourId=4
              SmuCoreAlarmBehavior_261: SmuCoreAlmBehaviourId=5
              SmuCoreAlarmBehavior_262: SmuCoreAlmBehaviourId=6
              SmuCoreAlarmBehavior_263: SmuCoreAlmBehaviourId=7
              SmuCoreAlarmBehavior_264: SmuCoreAlmBehaviourId=8
              SmuCoreAlarmBehavior_265: SmuCoreAlmBehaviourId=9
              SmuCoreAlarmBehavior_266: SmuCoreAlmBehaviourId=10
              SmuCoreAlarmBehavior_267: SmuCoreAlmBehaviourId=11
              SmuCoreAlarmBehavior_268: SmuCoreAlmBehaviourId=12
              SmuCoreAlarmBehavior_269: SmuCoreAlmBehaviourId=13
              SmuCoreAlarmBehavior_270: SmuCoreAlmBehaviourId=14
              SmuCoreAlarmBehavior_271: SmuCoreAlmBehaviourId=15
              SmuCoreAlarmBehavior_272: SmuCoreAlmBehaviourId=16
              SmuCoreAlarmBehavior_273: SmuCoreAlmBehaviourId=17
              SmuCoreAlarmBehavior_274: SmuCoreAlmBehaviourId=18
              SmuCoreAlarmBehavior_275: SmuCoreAlmBehaviourId=19
              SmuCoreAlarmBehavior_276: SmuCoreAlmBehaviourId=20
              SmuCoreAlarmBehavior_277: SmuCoreAlmBehaviourId=21
              SmuCoreAlarmBehavior_278: SmuCoreAlmBehaviourId=22
              SmuCoreAlarmBehavior_279: SmuCoreAlmBehaviourId=23
              SmuCoreAlarmBehavior_280: SmuCoreAlmBehaviourId=24
              SmuCoreAlarmBehavior_281: SmuCoreAlmBehaviourId=25
              SmuCoreAlarmBehavior_282: SmuCoreAlmBehaviourId=26
              SmuCoreAlarmBehavior_283: SmuCoreAlmBehaviourId=27
              SmuCoreAlarmBehavior_284: SmuCoreAlmBehaviourId=28
              SmuCoreAlarmBehavior_285: SmuCoreAlmBehaviourId=29
              SmuCoreAlarmBehavior_286: SmuCoreAlmBehaviourId=30
              SmuCoreAlarmBehavior_287: SmuCoreAlmBehaviourId=31
          SmuCoreAlarmGroup_9: SmuCoreAlmGrpId=9
            32 x SmuCoreAlarmBehavior, all with SmuCoreAlarmIntBeh=SMU_NA_INT_ACTION, SmuCoreAlarmFSP=SMU_ALARM_FSP_DISABLED:
              SmuCoreAlarmBehavior_288: SmuCoreAlmBehaviourId=0
              SmuCoreAlarmBehavior_289: SmuCoreAlmBehaviourId=1
              SmuCoreAlarmBehavior_290: SmuCoreAlmBehaviourId=2
              SmuCoreAlarmBehavior_291: SmuCoreAlmBehaviourId=3
              SmuCoreAlarmBehavior_292: SmuCoreAlmBehaviourId=4
              SmuCoreAlarmBehavior_293: SmuCoreAlmBehaviourId=5
              SmuCoreAlarmBehavior_294: SmuCoreAlmBehaviourId=6
              SmuCoreAlarmBehavior_295: SmuCoreAlmBehaviourId=7
              SmuCoreAlarmBehavior_296: SmuCoreAlmBehaviourId=8
              SmuCoreAlarmBehavior_297: SmuCoreAlmBehaviourId=9
              SmuCoreAlarmBehavior_298: SmuCoreAlmBehaviourId=10
              SmuCoreAlarmBehavior_299: SmuCoreAlmBehaviourId=11
              SmuCoreAlarmBehavior_300: SmuCoreAlmBehaviourId=12
              SmuCoreAlarmBehavior_301: SmuCoreAlmBehaviourId=13
              SmuCoreAlarmBehavior_302: SmuCoreAlmBehaviourId=14
              SmuCoreAlarmBehavior_303: SmuCoreAlmBehaviourId=15
              SmuCoreAlarmBehavior_304: SmuCoreAlmBehaviourId=16
              SmuCoreAlarmBehavior_305: SmuCoreAlmBehaviourId=17
              SmuCoreAlarmBehavior_306: SmuCoreAlmBehaviourId=18
              SmuCoreAlarmBehavior_307: SmuCoreAlmBehaviourId=19
              SmuCoreAlarmBehavior_308: SmuCoreAlmBehaviourId=20
              SmuCoreAlarmBehavior_309: SmuCoreAlmBehaviourId=21
              SmuCoreAlarmBehavior_310: SmuCoreAlmBehaviourId=22
              SmuCoreAlarmBehavior_311: SmuCoreAlmBehaviourId=23
              SmuCoreAlarmBehavior_312: SmuCoreAlmBehaviourId=24
              SmuCoreAlarmBehavior_313: SmuCoreAlmBehaviourId=25
              SmuCoreAlarmBehavior_314: SmuCoreAlmBehaviourId=26
              SmuCoreAlarmBehavior_315: SmuCoreAlmBehaviourId=27
              SmuCoreAlarmBehavior_316: SmuCoreAlmBehaviourId=28
              SmuCoreAlarmBehavior_317: SmuCoreAlmBehaviourId=29
              SmuCoreAlarmBehavior_318: SmuCoreAlmBehaviourId=30
              SmuCoreAlarmBehavior_319: SmuCoreAlmBehaviourId=31
          SmuCoreAlarmGroup_10: SmuCoreAlmGrpId=10
            32 x SmuCoreAlarmBehavior, all with SmuCoreAlarmIntBeh=SMU_NA_INT_ACTION, SmuCoreAlarmFSP=SMU_ALARM_FSP_DISABLED:
              SmuCoreAlarmBehavior_320: SmuCoreAlmBehaviourId=0
              SmuCoreAlarmBehavior_321: SmuCoreAlmBehaviourId=1
              SmuCoreAlarmBehavior_322: SmuCoreAlmBehaviourId=2
              SmuCoreAlarmBehavior_323: SmuCoreAlmBehaviourId=3
              SmuCoreAlarmBehavior_324: SmuCoreAlmBehaviourId=4
              SmuCoreAlarmBehavior_325: SmuCoreAlmBehaviourId=5
              SmuCoreAlarmBehavior_326: SmuCoreAlmBehaviourId=6
              SmuCoreAlarmBehavior_327: SmuCoreAlmBehaviourId=7
              SmuCoreAlarmBehavior_328: SmuCoreAlmBehaviourId=8
              SmuCoreAlarmBehavior_329: SmuCoreAlmBehaviourId=9
              SmuCoreAlarmBehavior_330: SmuCoreAlmBehaviourId=10
              SmuCoreAlarmBehavior_331: SmuCoreAlmBehaviourId=11
              SmuCoreAlarmBehavior_332: SmuCoreAlmBehaviourId=12
              SmuCoreAlarmBehavior_333: SmuCoreAlmBehaviourId=13
              SmuCoreAlarmBehavior_334: SmuCoreAlmBehaviourId=14
              SmuCoreAlarmBehavior_335: SmuCoreAlmBehaviourId=15
              SmuCoreAlarmBehavior_336: SmuCoreAlmBehaviourId=16
              SmuCoreAlarmBehavior_337: SmuCoreAlmBehaviourId=17
              SmuCoreAlarmBehavior_338: SmuCoreAlmBehaviourId=18
              SmuCoreAlarmBehavior_339: SmuCoreAlmBehaviourId=19
              SmuCoreAlarmBehavior_340: SmuCoreAlmBehaviourId=20
              SmuCoreAlarmBehavior_341: SmuCoreAlmBehaviourId=21
              SmuCoreAlarmBehavior_342: SmuCoreAlmBehaviourId=22
              SmuCoreAlarmBehavior_343: SmuCoreAlmBehaviourId=23
              SmuCoreAlarmBehavior_344: SmuCoreAlmBehaviourId=24
              SmuCoreAlarmBehavior_345: SmuCoreAlmBehaviourId=25
              SmuCoreAlarmBehavior_346: SmuCoreAlmBehaviourId=26
              SmuCoreAlarmBehavior_347: SmuCoreAlmBehaviourId=27
              SmuCoreAlarmBehavior_348: SmuCoreAlmBehaviourId=28
              SmuCoreAlarmBehavior_349: SmuCoreAlmBehaviourId=29
              SmuCoreAlarmBehavior_350: SmuCoreAlmBehaviourId=30
              SmuCoreAlarmBehavior_351: SmuCoreAlmBehaviourId=31
          SmuCoreAlarmGroup_11: SmuCoreAlmGrpId=11
            32 x SmuCoreAlarmBehavior, all with SmuCoreAlarmIntBeh=SMU_NA_INT_ACTION, SmuCoreAlarmFSP=SMU_ALARM_FSP_DISABLED:
              SmuCoreAlarmBehavior_352: SmuCoreAlmBehaviourId=0
              SmuCoreAlarmBehavior_353: SmuCoreAlmBehaviourId=1
              SmuCoreAlarmBehavior_354: SmuCoreAlmBehaviourId=2
              SmuCoreAlarmBehavior_355: SmuCoreAlmBehaviourId=3
              SmuCoreAlarmBehavior_356: SmuCoreAlmBehaviourId=4
              SmuCoreAlarmBehavior_357: SmuCoreAlmBehaviourId=5
              SmuCoreAlarmBehavior_358: SmuCoreAlmBehaviourId=6
              SmuCoreAlarmBehavior_359: SmuCoreAlmBehaviourId=7
              SmuCoreAlarmBehavior_360: SmuCoreAlmBehaviourId=8
              SmuCoreAlarmBehavior_361: SmuCoreAlmBehaviourId=9
              SmuCoreAlarmBehavior_362: SmuCoreAlmBehaviourId=10
              SmuCoreAlarmBehavior_363: SmuCoreAlmBehaviourId=11
              SmuCoreAlarmBehavior_364: SmuCoreAlmBehaviourId=12
              SmuCoreAlarmBehavior_365: SmuCoreAlmBehaviourId=13
              SmuCoreAlarmBehavior_366: SmuCoreAlmBehaviourId=14
              SmuCoreAlarmBehavior_367: SmuCoreAlmBehaviourId=15
              SmuCoreAlarmBehavior_368: SmuCoreAlmBehaviourId=16
              SmuCoreAlarmBehavior_369: SmuCoreAlmBehaviourId=17
              SmuCoreAlarmBehavior_370: SmuCoreAlmBehaviourId=18
              SmuCoreAlarmBehavior_371: SmuCoreAlmBehaviourId=19
              SmuCoreAlarmBehavior_372: SmuCoreAlmBehaviourId=20
              SmuCoreAlarmBehavior_373: SmuCoreAlmBehaviourId=21
              SmuCoreAlarmBehavior_374: SmuCoreAlmBehaviourId=22
              SmuCoreAlarmBehavior_375: SmuCoreAlmBehaviourId=23
              SmuCoreAlarmBehavior_376: SmuCoreAlmBehaviourId=24
              SmuCoreAlarmBehavior_377: SmuCoreAlmBehaviourId=25
              SmuCoreAlarmBehavior_378: SmuCoreAlmBehaviourId=26
              SmuCoreAlarmBehavior_379: SmuCoreAlmBehaviourId=27
              SmuCoreAlarmBehavior_380: SmuCoreAlmBehaviourId=28
              SmuCoreAlarmBehavior_381: SmuCoreAlmBehaviourId=29
              SmuCoreAlarmBehavior_382: SmuCoreAlmBehaviourId=30
              SmuCoreAlarmBehavior_383: SmuCoreAlmBehaviourId=31
      SmuStdbyConfig
        SmuStdbyAlarmGlobalConfig: SmuStdbyEnableFSP0=false, SmuStdbyEnableFSP1=false
        SmuStdbyAlarmGroup: SmuStdbyAlmGrpId=0
          32 x SmuStdbyAlarmBehavior, all with SmuStdbyAlarmFSP=SMU_ALARM_FSP_DISABLED:
            SmuStdbyAlarmBehavior: SmuStdbyAlmBehaviourId=0
            SmuStdbyAlarmBehavior_{1..31}: SmuStdbyAlmBehaviourId={1..31}
        SmuStdbyAlarmGroup_1 (SmuStdbyAlarmGroup): SmuStdbyAlmGrpId=1
          32 x SmuStdbyAlarmBehavior, all with SmuStdbyAlarmFSP=SMU_ALARM_FSP_DISABLED:
            SmuStdbyAlarmBehavior_32: SmuStdbyAlmBehaviourId=0
            SmuStdbyAlarmBehavior_33: SmuStdbyAlmBehaviourId=1
            SmuStdbyAlarmBehavior_34: SmuStdbyAlmBehaviourId=2
            SmuStdbyAlarmBehavior_35: SmuStdbyAlmBehaviourId=3
            SmuStdbyAlarmBehavior_36: SmuStdbyAlmBehaviourId=4
            SmuStdbyAlarmBehavior_37: SmuStdbyAlmBehaviourId=5
            SmuStdbyAlarmBehavior_38: SmuStdbyAlmBehaviourId=6
            SmuStdbyAlarmBehavior_39: SmuStdbyAlmBehaviourId=7
            SmuStdbyAlarmBehavior_40: SmuStdbyAlmBehaviourId=8
            SmuStdbyAlarmBehavior_41: SmuStdbyAlmBehaviourId=9
            SmuStdbyAlarmBehavior_42: SmuStdbyAlmBehaviourId=10
            SmuStdbyAlarmBehavior_43: SmuStdbyAlmBehaviourId=11
            SmuStdbyAlarmBehavior_44: SmuStdbyAlmBehaviourId=12
            SmuStdbyAlarmBehavior_45: SmuStdbyAlmBehaviourId=13
            SmuStdbyAlarmBehavior_46: SmuStdbyAlmBehaviourId=14
            SmuStdbyAlarmBehavior_47: SmuStdbyAlmBehaviourId=15
            SmuStdbyAlarmBehavior_48: SmuStdbyAlmBehaviourId=16
            SmuStdbyAlarmBehavior_49: SmuStdbyAlmBehaviourId=17
            SmuStdbyAlarmBehavior_50: SmuStdbyAlmBehaviourId=18
            SmuStdbyAlarmBehavior_51: SmuStdbyAlmBehaviourId=19
            SmuStdbyAlarmBehavior_52: SmuStdbyAlmBehaviourId=20
            SmuStdbyAlarmBehavior_53: SmuStdbyAlmBehaviourId=21
            SmuStdbyAlarmBehavior_54: SmuStdbyAlmBehaviourId=22
            SmuStdbyAlarmBehavior_55: SmuStdbyAlmBehaviourId=23
            SmuStdbyAlarmBehavior_56: SmuStdbyAlmBehaviourId=24
            SmuStdbyAlarmBehavior_57: SmuStdbyAlmBehaviourId=25
            SmuStdbyAlarmBehavior_58: SmuStdbyAlmBehaviourId=26
            SmuStdbyAlarmBehavior_59: SmuStdbyAlmBehaviourId=27
            SmuStdbyAlarmBehavior_60: SmuStdbyAlmBehaviourId=28
            SmuStdbyAlarmBehavior_61: SmuStdbyAlmBehaviourId=29
            SmuStdbyAlarmBehavior_62: SmuStdbyAlmBehaviourId=30
            SmuStdbyAlarmBehavior_63: SmuStdbyAlmBehaviourId=31
    SmuGeneral:
      SmuStdbyEnable = false
      SmuDevErrorDetect = false
      SmuSafetyEnable = false
      SmuInitCheckApi = false
      SmuRuntimeApiMode = SMU_MCAL_SUPERVISOR
      SmuInitDeInitApiMode = SMU_MCAL_SUPERVISOR
      SmuVersionInfoApi = false
      SmuCoreFSP0OutputEnable = false
      SmuCoreFSP1OutputEnable = false
      SmuCoreFSP0PortEnable = false
      SmuCoreFSP1PortEnable = false
      SmuCoreGlitchFilterSCU = false
      SmuCoreGlitchFilterSTS = false
    CommonPublishedInformation:
      ArMajorVersion = 4
      ArMinorVersion = 4
      ArPatchVersion = 0
      SwMajorVersion = 20
      SwMinorVersion = 0
      SwPatchVersion = 2
      ModuleId = 255
      VendorId = 17
      Release = _TRICORE_TC332
