AUTOSAR XML (schema 00049)
package /Spi
  module config Spi: implementation-config-variant=VARIANT-POST-BUILD, module-description=Spi_Impl
    SpiPublishedInformation: SpiMaxHwUnit=3
    SpiHwConfiguration_0 (SpiHwConfiguration)
      SpiHwConfigurationQspi_0 (SpiHwConfigurationQspi):
        SpiExternalDemux = false
        SpiHWPinMRSTQspix = MRST1B_PORT11_PIN3
        SpiHwConfigKernel = QSPI1
        SpiJobQueueLengthQspix = 1
        SpiSLSO0StrobeDelay = 2
        SpiSleepEnableQspix = false
    SpiGeneral:
      SpiCancelApi = false
      SpiChannelBuffersAllowed = 0
      SpiDevErrorDetect = false
      SpiEnableLoopBackApi = false
      SpiHwStatusApi = false
      SpiInitCheckApi = false
      SpiInitDeInitApiMode = SPI_MCAL_SUPERVISOR
      SpiInterruptibleSeqAllowed = false
      SpiMultiCoreErrorDetect = false
      SpiRunTimeErrorDetect = true
      SpiRuntimeApiMode = SPI_MCAL_SUPERVISOR
      SpiSafetyEnable = false
      SpiSupportConcurrentSyncTransmit = false
      SpiSyncTransmitTimeoutDuration = 65535
      SpiVersionInfoApi = true
      SpiLevelDelivered = 2
    SpiDriver: SpiMaxChannel=1, SpiMaxJob=1, SpiMaxSequence=1, SpiSystemClock=McuClockReferencePointConfig
      SpiChannel_WDG (SpiChannel): SpiChannelId=0, SpiChannelType=IB, SpiDataWidth=8, SpiEbMaxLength=65535, SpiIbNBuffers=2, SpiTransferStart=LSB
      SpiExternalDevice_0 (SpiExternalDevice):
        SpiAutoCalcBaudParams = true
        SpiAutoCalcDelayParams = false
        SpiBaudrate = 2000000
        SpiCsIdentifier = CHANNEL4
        SpiCsPolarity = LOW
        SpiCsSelection = CS_VIA_PERIPHERAL_ENGINE
        SpiDataShiftEdge = LEADING
        SpiEnableCs = true
        SpiHwUnit = QSPI1
        SpiIdleTime = 0.00016384
        SpiParitySupport = UNUSED
        SpiShiftClockIdleLevel = LOW
        SpiTimeClk2Cs = 0.0001
        SpiTrailingTime = 0.0005
        SpiBaudrateParams_0 (SpiBaudrateParams): SpiBaudParamA=1, SpiBaudParamB=0, SpiBaudParamC=1, SpiBaudParamQ=10, SpiBaudParamTQ=2
        SpiDelayParams_0 (SpiDelayParams):
          SpiDelayParamIdleLength = 1
          SpiDelayParamIdlePre = 0
          SpiDelayParamLeadLength = 7
          SpiDelayParamLeadPre = 0
          SpiDelayParamTrailLength = 5
          SpiDelayParamTrailPre = 0
      SpiJob_0 (SpiJob): SpiFrameBasedCS=false, SpiJobId=0, SpiJobPriority=0, SpiDeviceAssignment=SpiExternalDevice_0
        SpiChannel_WDG (SpiChannelList): SpiChannelIndex=0, SpiChannelAssignment=SpiDriver/SpiChannel_WDG
      SpiSequence_WDG_REFRESH (SpiSequence): SpiInterruptibleSequence=false, SpiSequenceId=0, SpiJobAssignment=SpiJob_0
    SpiDemEventParameterRefs_0 (SpiDemEventParameterRefs): SPI_E_HARDWARE_ERROR=SPI_E_HARDWARE_ERROR
    CommonPublishedInformation:
      ArMajorVersion = 4
      ArMinorVersion = 4
      ArPatchVersion = 0
      ModuleId = 83
      Release = _TRICORE_TC332
      SwMajorVersion = 20
      SwMinorVersion = 0
      SwPatchVersion = 2
      VendorId = 17
