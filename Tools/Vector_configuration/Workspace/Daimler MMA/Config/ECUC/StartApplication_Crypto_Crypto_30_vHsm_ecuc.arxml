AUTOSAR XML (schema 00049)
package /ActiveEcuC
  module config Crypto_30_vHsm: definition=Crypto, implementation-config-variant=VARIANT-PRE-COMPILE, module-description=Crypto_Impl
    CryptoGeneral: CryptoSafeBswChecks=true, CryptoDevErrorDetect=false, CryptoVersionInfoApi=false, CryptoMainFunctionPeriod=0.01
    CryptoKeyElements
      61 x CryptoKeyElement:
        vHsmDummyKeyElement: CryptoKeyElementSize=1, CryptoKeyElementAllowPartialAccess=true, CryptoKeyElementId=0, CryptoKeyElementPersist=false, CryptoKeyElementReadAccess=RA_ALLOWED, CryptoKeyElementWriteAccess=WA_ALLOWED
        Crypto_30_vHsm_Hwa_vHsm_Hal_FlashOperation: CryptoKeyElementAllowPartialAccess=false, CryptoKeyElementPersist=false, CryptoKeyElementId=3032, CryptoKeyElementSize=1, CryptoKeyElementReadAccess=RA_DENIED, CryptoKeyElementWriteAccess=WA_ALLOWED
        Crypto_30_vHsm_LibCv_Signature_Key: CryptoKeyElementAllowPartialAccess=false, CryptoKeyElementPersist=false, CryptoKeyElementId=1, CryptoKeyElementSize=32, CryptoKeyElementReadAccess=RA_ALLOWED, CryptoKeyElementWriteAccess=WA_ALLOWED
        Crypto_30_vHsm_LibCv_Cipher_Key: CryptoKeyElementAllowPartialAccess=false, CryptoKeyElementPersist=false, CryptoKeyElementId=1, CryptoKeyElementSize=16, CryptoKeyElementReadAccess=RA_ALLOWED, CryptoKeyElementWriteAccess=WA_ALLOWED
        Crypto_30_vHsm_LibCv_Cipher_IV: CryptoKeyElementAllowPartialAccess=false, CryptoKeyElementPersist=false, CryptoKeyElementId=5, CryptoKeyElementSize=16, CryptoKeyElementReadAccess=RA_ALLOWED, CryptoKeyElementWriteAccess=WA_ALLOWED
        Crypto_30_vHsm_LibCv_Cipher_Proof: CryptoKeyElementAllowPartialAccess=false, CryptoKeyElementPersist=false, CryptoKeyElementId=6, CryptoKeyElementSize=48, CryptoKeyElementReadAccess=RA_ALLOWED, CryptoKeyElementWriteAccess=WA_ALLOWED
        Crypto_30_vHsm_LibCv_KeyM_CertificateData: CryptoKeyElementAllowPartialAccess=false, CryptoKeyElementPersist=false, CryptoKeyElementId=0, CryptoKeyElementSize=1500, CryptoKeyElementReadAccess=RA_ALLOWED, CryptoKeyElementWriteAccess=WA_ALLOWED
        Crypto_30_vHsm_Hwa_RomKey: CryptoKeyElementAllowPartialAccess=false, CryptoKeyElementPersist=false, CryptoKeyElementId=7, CryptoKeyElementSize=16, CryptoKeyElementReadAccess=RA_DENIED, CryptoKeyElementWriteAccess=WA_DENIED
        Crypto_30_vHsm_vHsm_Core_vHsmLog_EventId: CryptoKeyElementAllowPartialAccess=false, CryptoKeyElementPersist=false, CryptoKeyElementId=0, CryptoKeyElementSize=1, CryptoKeyElementReadAccess=RA_ALLOWED, CryptoKeyElementWriteAccess=WA_DENIED
        Crypto_30_vHsm_LibCv_Random_Algorithm_Nist_800_90A_DRBG_AES128_DF: CryptoKeyElementAllowPartialAccess=false, CryptoKeyElementPersist=false, CryptoKeyElementId=4, CryptoKeyElementSize=1, CryptoKeyElementReadAccess=RA_ALLOWED, CryptoKeyElementWriteAccess=WA_ALLOWED
        Crypto_30_vHsm_LibCv_Random_Reseed_Counter: CryptoKeyElementAllowPartialAccess=false, CryptoKeyElementPersist=true, CryptoKeyElementId=3018, CryptoKeyElementSize=4, CryptoKeyElementReadAccess=RA_ALLOWED, CryptoKeyElementWriteAccess=WA_DENIED
        Crypto_30_vHsm_LibCv_Random_Seed: CryptoKeyElementAllowPartialAccess=false, CryptoKeyElementPersist=false, CryptoKeyElementId=3, CryptoKeyElementSize=20, CryptoKeyElementReadAccess=RA_ALLOWED, CryptoKeyElementWriteAccess=WA_ALLOWED
        Crypto_30_vHsm_LibCv_Ssa_Random_Nonce: CryptoKeyElementAllowPartialAccess=false, CryptoKeyElementPersist=false, CryptoKeyElementId=3017, CryptoKeyElementSize=16, CryptoKeyElementReadAccess=RA_ALLOWED, CryptoKeyElementWriteAccess=WA_ALLOWED
        Crypto_30_vHsm_LibCv_CryptoKeyElement_DummyWorkaround_RandomSeedSize: CryptoKeyElementAllowPartialAccess=false, CryptoKeyElementPersist=false, CryptoKeyElementId=999, CryptoKeyElementSize=209, CryptoKeyElementReadAccess=RA_ALLOWED, CryptoKeyElementWriteAccess=WA_ALLOWED
        Crypto_30_vHsm_LibCv_Ssa_SecurityAccesPublicKey: CryptoKeyElementAllowPartialAccess=false, CryptoKeyElementPersist=true, CryptoKeyElementId=1, CryptoKeyElementSize=32, CryptoKeyElementReadAccess=RA_ALLOWED, CryptoKeyElementWriteAccess=WA_ALLOWED
        Crypto_30_vHsm_LibCv_KeyExchange_Algorithm_X25519: CryptoKeyElementAllowPartialAccess=false, CryptoKeyElementPersist=false, CryptoKeyElementId=12, CryptoKeyElementSize=1, CryptoKeyElementReadAccess=RA_ALLOWED, CryptoKeyElementWriteAccess=WA_ALLOWED
        Crypto_30_vHsm_LibCv_KeyExchange_OwnPubKey: CryptoKeyElementAllowPartialAccess=false, CryptoKeyElementPersist=false, CryptoKeyElementId=10, CryptoKeyElementSize=32, CryptoKeyElementReadAccess=RA_ALLOWED, CryptoKeyElementWriteAccess=WA_ALLOWED
        Crypto_30_vHsm_LibCv_KeyExchange_Base: CryptoKeyElementAllowPartialAccess=false, CryptoKeyElementPersist=false, CryptoKeyElementId=8, CryptoKeyElementSize=16, CryptoKeyElementReadAccess=RA_ALLOWED, CryptoKeyElementWriteAccess=WA_ALLOWED
        Crypto_30_vHsm_LibCv_KeyExchange_PrivKey: CryptoKeyElementAllowPartialAccess=false, CryptoKeyElementPersist=false, CryptoKeyElementId=9, CryptoKeyElementSize=32, CryptoKeyElementReadAccess=RA_ALLOWED, CryptoKeyElementWriteAccess=WA_ALLOWED
        Crypto_30_vHsm_LibCv_KeyExchange_SharedValue: CryptoKeyElementAllowPartialAccess=false, CryptoKeyElementPersist=false, CryptoKeyElementId=1, CryptoKeyElementSize=32, CryptoKeyElementReadAccess=RA_ALLOWED, CryptoKeyElementWriteAccess=WA_ALLOWED
        Crypto_30_vHsm_LibCv_Ssa_SharedSecretHash: CryptoKeyElementAllowPartialAccess=false, CryptoKeyElementPersist=true, CryptoKeyElementId=2, CryptoKeyElementSize=4, CryptoKeyElementReadAccess=RA_ALLOWED, CryptoKeyElementWriteAccess=WA_ALLOWED
        Crypto_30_vHsm_LibCv_Ssa_BackendCert: CryptoKeyElementAllowPartialAccess=true, CryptoKeyElementPersist=true, CryptoKeyElementId=0, CryptoKeyElementSize=600, CryptoKeyElementReadAccess=RA_ALLOWED, CryptoKeyElementWriteAccess=WA_ALLOWED
        Crypto_30_vHsm_LibCv_Ssa_Cipher_IV: CryptoKeyElementAllowPartialAccess=false, CryptoKeyElementPersist=false, CryptoKeyElementId=5, CryptoKeyElementSize=16, CryptoKeyElementReadAccess=RA_ALLOWED, CryptoKeyElementWriteAccess=WA_ALLOWED
        Crypto_30_vHsm_LibCv_Ssa_Cipher_Key: CryptoKeyElementAllowPartialAccess=false, CryptoKeyElementPersist=false, CryptoKeyElementId=1, CryptoKeyElementSize=16, CryptoKeyElementReadAccess=RA_ALLOWED, CryptoKeyElementWriteAccess=WA_ALLOWED
        Crypto_30_vHsm_LibCv_Ssa_RootCert: CryptoKeyElementAllowPartialAccess=true, CryptoKeyElementPersist=true, CryptoKeyElementId=0, CryptoKeyElementSize=600, CryptoKeyElementReadAccess=RA_ALLOWED, CryptoKeyElementWriteAccess=WA_ALLOWED
        Crypto_30_vHsm_LibCv_Ssa_Mac_Key: CryptoKeyElementAllowPartialAccess=false, CryptoKeyElementPersist=true, CryptoKeyElementId=1, CryptoKeyElementSize=16, CryptoKeyElementReadAccess=RA_ALLOWED, CryptoKeyElementWriteAccess=WA_ALLOWED
        Crypto_30_vHsm_LibCv_Ssa_Mac_Proof: CryptoKeyElementAllowPartialAccess=false, CryptoKeyElementPersist=true, CryptoKeyElementId=2, CryptoKeyElementSize=4, CryptoKeyElementReadAccess=RA_ALLOWED, CryptoKeyElementWriteAccess=WA_ALLOWED
        Crypto_30_vHsm_vHsm_Core_vHsmInfo_Version: CryptoKeyElementAllowPartialAccess=false, CryptoKeyElementPersist=false, CryptoKeyElementId=3020, CryptoKeyElementSize=3, CryptoKeyElementReadAccess=RA_ALLOWED, CryptoKeyElementWriteAccess=WA_DENIED
        Crypto_30_vHsm_vHsm_Core_vHsmInfo_PerformPersist: CryptoKeyElementAllowPartialAccess=false, CryptoKeyElementPersist=false, CryptoKeyElementId=3022, CryptoKeyElementSize=1, CryptoKeyElementReadAccess=RA_ALLOWED, CryptoKeyElementWriteAccess=WA_DENIED
        Crypto_30_vHsm_vHsm_Core_vHsmInfo_PerformRepersist: CryptoKeyElementAllowPartialAccess=false, CryptoKeyElementPersist=false, CryptoKeyElementId=3036, CryptoKeyElementSize=1, CryptoKeyElementReadAccess=RA_DENIED, CryptoKeyElementWriteAccess=WA_ALLOWED
        Crypto_30_vHsm_vHsm_Core_vHsmInfo_StartFirmwareUpdater: CryptoKeyElementAllowPartialAccess=false, CryptoKeyElementPersist=false, CryptoKeyElementId=3038, CryptoKeyElementSize=1, CryptoKeyElementReadAccess=RA_DENIED, CryptoKeyElementWriteAccess=WA_ALLOWED
        Crypto_30_vHsm_vHsm_Core_vHsmInfo_SecureBootEnd: CryptoKeyElementAllowPartialAccess=false, CryptoKeyElementPersist=false, CryptoKeyElementId=3028, CryptoKeyElementSize=1, CryptoKeyElementReadAccess=RA_ALLOWED, CryptoKeyElementWriteAccess=WA_ALLOWED
        Crypto_30_vHsm_vHsm_Core_vHsmInfo_SecureBootResult: CryptoKeyElementAllowPartialAccess=false, CryptoKeyElementPersist=false, CryptoKeyElementId=3037, CryptoKeyElementSize=1, CryptoKeyElementReadAccess=RA_ALLOWED, CryptoKeyElementWriteAccess=WA_DENIED
        Crypto_30_vHsm_LibCv_Random_Algorithm_Nist_800_90A_DRBG_AES128: CryptoKeyElementAllowPartialAccess=false, CryptoKeyElementPersist=false, CryptoKeyElementId=4, CryptoKeyElementSize=1, CryptoKeyElementReadAccess=RA_ALLOWED, CryptoKeyElementWriteAccess=WA_ALLOWED
        Crypto_30_vHsm_LibCv_Random_PrivateString: CryptoKeyElementAllowPartialAccess=false, CryptoKeyElementPersist=false, CryptoKeyElementId=3015, CryptoKeyElementSize=16, CryptoKeyElementReadAccess=RA_ALLOWED, CryptoKeyElementWriteAccess=WA_ALLOWED
        Crypto_30_vHsm_LibCv_Random_Seed_Nist_800_90A_DRBG_AES128: CryptoKeyElementAllowPartialAccess=false, CryptoKeyElementPersist=true, CryptoKeyElementId=3, CryptoKeyElementSize=32, CryptoKeyElementReadAccess=RA_DENIED, CryptoKeyElementWriteAccess=WA_ALLOWED
        Crypto_30_vHsm_LibCv_Random_AdditionalInput: CryptoKeyElementAllowPartialAccess=false, CryptoKeyElementPersist=false, CryptoKeyElementId=3016, CryptoKeyElementSize=16, CryptoKeyElementReadAccess=RA_ALLOWED, CryptoKeyElementWriteAccess=WA_ALLOWED
        Crypto_30_vHsm_LibCv_KeyGenerate_Key: CryptoKeyElementAllowPartialAccess=false, CryptoKeyElementPersist=true, CryptoKeyElementId=1, CryptoKeyElementSize=32, CryptoKeyElementReadAccess=RA_ALLOWED, CryptoKeyElementWriteAccess=WA_ALLOWED
        Crypto_30_vHsm_LibCv_KeyGenerate_Algorithm_Ed25519: CryptoKeyElementAllowPartialAccess=false, CryptoKeyElementPersist=false, CryptoKeyElementId=17, CryptoKeyElementSize=1, CryptoKeyElementReadAccess=RA_ALLOWED, CryptoKeyElementWriteAccess=WA_ALLOWED
        Crypto_30_vHsm_LibCv_Signature_Key_replacementAuthority: CryptoKeyElementAllowPartialAccess=false, CryptoKeyElementPersist=false, CryptoKeyElementId=1, CryptoKeyElementSize=32, CryptoKeyElementReadAccess=RA_ALLOWED, CryptoKeyElementWriteAccess=WA_DENIED
        Crypto_30_vHsm_LibCv_Ssa_TrustModelEcuPublicCsr_StagingKey: CryptoKeyElementAllowPartialAccess=false, CryptoKeyElementPersist=true, CryptoKeyElementId=1, CryptoKeyElementSize=32, CryptoKeyElementReadAccess=RA_ALLOWED, CryptoKeyElementWriteAccess=WA_ALLOWED
        Crypto_30_vHsm_LibCv_Ssa_TrustModelEcuPublic_LiveKey: CryptoKeyElementAllowPartialAccess=false, CryptoKeyElementPersist=true, CryptoKeyElementId=1, CryptoKeyElementSize=32, CryptoKeyElementReadAccess=RA_ALLOWED, CryptoKeyElementWriteAccess=WA_ALLOWED
        Crypto_30_vHsm_LibCv_Ssa_TrustModelPrivateEcu_LiveKey: CryptoKeyElementAllowPartialAccess=false, CryptoKeyElementPersist=true, CryptoKeyElementId=1, CryptoKeyElementSize=32, CryptoKeyElementReadAccess=RA_DENIED, CryptoKeyElementWriteAccess=WA_ALLOWED
        Crypto_30_vHsm_LibCv_vHsm_Info_Uid: CryptoKeyElementAllowPartialAccess=false, CryptoKeyElementPersist=true, CryptoKeyElementId=3021, CryptoKeyElementSize=16, CryptoKeyElementReadAccess=RA_ALLOWED, CryptoKeyElementWriteAccess=WA_ALLOWED
        Crypto_30_vHsm_LibCv_vHsm_Info_ErrorLog: CryptoKeyElementAllowPartialAccess=true, CryptoKeyElementPersist=true, CryptoKeyElementId=3023, CryptoKeyElementSize=32, CryptoKeyElementReadAccess=RA_ALLOWED, CryptoKeyElementWriteAccess=WA_ALLOWED
        Crypto_30_vHsm_KeyM_KeyM_Certificate: CryptoKeyElementAllowPartialAccess=true, CryptoKeyElementPersist=false, CryptoKeyElementId=3080, CryptoKeyElementSize=600, CryptoKeyElementReadAccess=RA_ALLOWED, CryptoKeyElementWriteAccess=WA_ALLOWED
        Crypto_30_vHsm_KeyM_KeyM_GetStatus: CryptoKeyElementAllowPartialAccess=false, CryptoKeyElementPersist=false, CryptoKeyElementId=3081, CryptoKeyElementSize=1, CryptoKeyElementReadAccess=RA_ALLOWED, CryptoKeyElementWriteAccess=WA_DENIED
        Crypto_30_vHsm_KeyM_KeyM_VerifyCertificate: CryptoKeyElementAllowPartialAccess=true, CryptoKeyElementPersist=false, CryptoKeyElementId=3082, CryptoKeyElementSize=1, CryptoKeyElementReadAccess=RA_DENIED, CryptoKeyElementWriteAccess=WA_ALLOWED
        Crypto_30_vHsm_KeyM_KeyM_VerifyCertificates: CryptoKeyElementAllowPartialAccess=false, CryptoKeyElementPersist=false, CryptoKeyElementId=3083, CryptoKeyElementSize=2, CryptoKeyElementReadAccess=RA_DENIED, CryptoKeyElementWriteAccess=WA_ALLOWED
        Crypto_30_vHsm_LibCv_Ssa_MacKey_Hash_nonPersisting: CryptoKeyElementAllowPartialAccess=false, CryptoKeyElementPersist=false, CryptoKeyElementId=2, CryptoKeyElementSize=4, CryptoKeyElementReadAccess=RA_ALLOWED, CryptoKeyElementWriteAccess=WA_ALLOWED
        Crypto_30_vHsm_LibCv_Ssa_MacKey_nonPersisting: CryptoKeyElementAllowPartialAccess=false, CryptoKeyElementPersist=false, CryptoKeyElementId=1, CryptoKeyElementSize=16, CryptoKeyElementReadAccess=RA_ALLOWED, CryptoKeyElementWriteAccess=WA_ALLOWED
        Crypto_30_vHsm_LibCv_CryptoKeyElement_Cert_wPersist: CryptoKeyElementAllowPartialAccess=true, CryptoKeyElementPersist=true, CryptoKeyElementId=0, CryptoKeyElementSize=1000, CryptoKeyElementReadAccess=RA_ALLOWED, CryptoKeyElementWriteAccess=WA_ALLOWED
        Crypto_30_vHsm_LibCv_Ssa_TrustModel_Csr_Key_NonPersisting_Element: CryptoKeyElementAllowPartialAccess=false, CryptoKeyElementPersist=false, CryptoKeyElementId=1, CryptoKeyElementSize=32, CryptoKeyElementReadAccess=RA_ALLOWED, CryptoKeyElementWriteAccess=WA_ALLOWED
        Crypto_30_vHsm_LibCv_Fbl_Decrypt_Aes128_Iv: CryptoKeyElementAllowPartialAccess=false, CryptoKeyElementPersist=false, CryptoKeyElementId=5, CryptoKeyElementSize=16, CryptoKeyElementReadAccess=RA_ALLOWED, CryptoKeyElementWriteAccess=WA_ALLOWED
        Crypto_30_vHsm_LibCv_Fbl_Decrypt_Aes128_Key: CryptoKeyElementAllowPartialAccess=false, CryptoKeyElementPersist=false, CryptoKeyElementId=1, CryptoKeyElementSize=16, CryptoKeyElementReadAccess=RA_ALLOWED, CryptoKeyElementWriteAccess=WA_ALLOWED
        Crypto_30_vHsm_Hwa_Random_Algorithm_Fips186_Sha1: CryptoKeyElementAllowPartialAccess=false, CryptoKeyElementPersist=false, CryptoKeyElementId=5, CryptoKeyElementSize=16, CryptoKeyElementReadAccess=RA_ALLOWED, CryptoKeyElementWriteAccess=WA_ALLOWED
        Crypto_30_vHsm_Hwa_Random_Seed: CryptoKeyElementAllowPartialAccess=false, CryptoKeyElementPersist=false, CryptoKeyElementId=6, CryptoKeyElementSize=16, CryptoKeyElementReadAccess=RA_ALLOWED, CryptoKeyElementWriteAccess=WA_ALLOWED
        Crypto_30_vHsm_LibCv_Fbl_Signature_Ed25519_Key: CryptoKeyElementAllowPartialAccess=false, CryptoKeyElementPersist=false, CryptoKeyElementId=1, CryptoKeyElementSize=32, CryptoKeyElementReadAccess=RA_ALLOWED, CryptoKeyElementWriteAccess=WA_ALLOWED
        Crypto_30_vHsm_Hwa_Hash_Result: CryptoKeyElementAllowPartialAccess=false, CryptoKeyElementPersist=false, CryptoKeyElementId=4, CryptoKeyElementSize=20, CryptoKeyElementReadAccess=RA_ALLOWED, CryptoKeyElementWriteAccess=WA_ALLOWED
        Crypto_30_vHsm_LibCv_Fbl_SecurityAccess_Ed25519_Key: CryptoKeyElementAllowPartialAccess=false, CryptoKeyElementPersist=false, CryptoKeyElementId=1, CryptoKeyElementSize=32, CryptoKeyElementReadAccess=RA_ALLOWED, CryptoKeyElementWriteAccess=WA_ALLOWED
        Crypto_30_vHsm_LibCv_vHsm_Version: CryptoKeyElementAllowPartialAccess=false, CryptoKeyElementPersist=false, CryptoKeyElementId=1, CryptoKeyElementSize=3, CryptoKeyElementReadAccess=RA_ALLOWED, CryptoKeyElementWriteAccess=WA_ALLOWED
    CryptoKeys
      63 x CryptoKey, all with CryptoKeyDeriveIterations=1:
        vHsm_Hardware: CryptoKeyId=53, CryptoKeyTypeRef=Crypto_30_vHsm_Hwa_vHsm_Hal_Hardware
        vHsm_FirmwareUpdate_Signature: CryptoKeyId=61, CryptoKeyTypeRef=Crypto_30_vHsm_LibCv_Signature
        vHsm_Custom: CryptoKeyId=48, CryptoKeyTypeRef=Crypto_30_vHsm_LibCv_Cipher
        KeyM_Cert_Root: CryptoKeyId=16, CryptoKeyTypeRef=Crypto_30_vHsm_LibCv_KeyType_KeyM_CertificateData
        KeyM_ECC_Root: CryptoKeyId=18, CryptoKeyTypeRef=Crypto_30_vHsm_LibCv_Signature
        KeyM_ECC_Intermediate: CryptoKeyId=17, CryptoKeyTypeRef=Crypto_30_vHsm_LibCv_Signature
        vHsm_RomKey0: CryptoKeyId=57, CryptoKeyTypeRef=Crypto_30_vHsm_Hwa_RomKeyType
        vHsm_Log: CryptoKeyId=56, CryptoKeyTypeRef=Crypto_30_vHsm_vHsm_Core_vHsmLog_Type
        Ssa_RandomSeed: CryptoKeyId=39, CryptoKeyTypeRef=Crypto_30_vHsm_LibCv_Ssa_Random_Nist_800_90A_DRBG_AES_DF
        Ssa_SecurityAccessPublicKey: CryptoKeyId=42, CryptoKeyTypeRef=Crypto_30_vHsm_LibCv_Ssa_SecurityAccessPublicKey
        Ssa_SharedSecretExchangeKey: CryptoKeyId=43, CryptoKeyTypeRef=Crypto_30_vHsm_LibCv_KeyExchange_X25519
        Ssa_SharedSecretHash: CryptoKeyId=44, CryptoKeyTypeRef=CryptoKeyTypes/Crypto_30_vHsm_LibCv_Ssa_SharedSecretHash
        Ssa_BackendCert: CryptoKeyId=37, CryptoKeyTypeRef=Crypto_30_vHsm_LibCv_Ssa_BackEndCert
        Ssa_AesRamKey: CryptoKeyId=35, CryptoKeyTypeRef=Crypto_30_vHsm_LibCv_Ssa_Cipher
        Ssa_RootCert: CryptoKeyId=41, CryptoKeyTypeRef=CryptoKeyTypes/Crypto_30_vHsm_LibCv_Ssa_RootCert
        Ssa_RealTime: CryptoKeyId=40, CryptoKeyTypeRef=Crypto_30_vHsm_LibCv_Ssa_Mac
        SSA_SecOC_Int_MacVerify_Ign_Stat: CryptoKeyId=31, CryptoKeyTypeRef=Crypto_30_vHsm_LibCv_Ssa_Mac
        Ssa_SignatureRamKey: CryptoKeyId=45, CryptoKeyTypeRef=Crypto_30_vHsm_LibCv_Signature
        SSA_SecOC_Int_MacVerify_VehSpd_8: CryptoKeyId=34, CryptoKeyTypeRef=Crypto_30_vHsm_LibCv_Ssa_Mac
        SSA_SecOC_Int_MacVerify_PN14_Master_Stat1: CryptoKeyId=32, CryptoKeyTypeRef=Crypto_30_vHsm_LibCv_Ssa_Mac
        KeyM_SigVerifyKey_TrustModelRoot: CryptoKeyId=24, CryptoKeyTypeRef=Crypto_30_vHsm_LibCv_Signature
        SSA_SecOC_Int_MacVerify_DI_OdoSpeedometer: CryptoKeyId=30, CryptoKeyTypeRef=Crypto_30_vHsm_LibCv_Ssa_Mac
        KeyM_SigVerifyKey_TrustModelIntermediate: CryptoKeyId=22, CryptoKeyTypeRef=Crypto_30_vHsm_LibCv_Signature
        Ssa_VIN: CryptoKeyId=51, CryptoKeyTypeRef=Crypto_30_vHsm_LibCv_Ssa_Mac
        Ssa_Authentication: CryptoKeyId=36, CryptoKeyTypeRef=Crypto_30_vHsm_LibCv_Ssa_Mac
        KeyM_SigVerifyKey_TrustModelBackend: CryptoKeyId=19, CryptoKeyTypeRef=Crypto_30_vHsm_LibCv_Signature
        Ssa_TickCount: CryptoKeyId=46, CryptoKeyTypeRef=Crypto_30_vHsm_LibCv_Ssa_Mac
        SSA_SecOC_Int_MacVerify_PT4_PTCoor4: CryptoKeyId=33, CryptoKeyTypeRef=Crypto_30_vHsm_LibCv_Ssa_Mac
        vHsm_Info: CryptoKeyId=54, CryptoKeyTypeRef=Crypto_30_vHsm_vHsm_Core_vHsmInfo_Type
        Ssa_PduKeysMac: CryptoKeyId=38, CryptoKeyTypeRef=CryptoKeyTypes/Crypto_30_vHsm_LibCv_Ssa_MacKey_nonPersisting
        SSA_SecOC_Int_MacGen_COM_C04_Pdu03_secured_044596e0_Tx: CryptoKeyId=25, CryptoKeyTypeRef=Crypto_30_vHsm_LibCv_Ssa_Mac
        SSA_SecOC_Int_MacGen_COM_C04_Pdu20_secured_393d7a18_Tx: CryptoKeyId=26, CryptoKeyTypeRef=Crypto_30_vHsm_LibCv_Ssa_Mac
        SSA_SecOC_Int_MacGen_COM_C04_Pdu21_secured_2e466e5b_Tx: CryptoKeyId=27, CryptoKeyTypeRef=Crypto_30_vHsm_LibCv_Ssa_Mac
        SSA_SecOC_Int_MacVerify_COM_C0X_Pdu20_secured_3ef6961f_Rx: CryptoKeyId=28, CryptoKeyTypeRef=Crypto_30_vHsm_LibCv_Ssa_Mac
        SSA_SecOC_Int_MacVerify_COM_C0X_Pdu21_secured_298d825c_Rx: CryptoKeyId=29, CryptoKeyTypeRef=Crypto_30_vHsm_LibCv_Ssa_Mac
        KeyM_SigVerifyKey_TrustModelBackendPeer: CryptoKeyId=20, CryptoKeyTypeRef=Crypto_30_vHsm_LibCv_Signature
        KeyM_SigVerifyKey_TrustModelEcuPeer: CryptoKeyId=21, CryptoKeyTypeRef=Crypto_30_vHsm_LibCv_Signature
        KeyM_SigVerifyKey_TrustModelIntermediatePeer: CryptoKeyId=23, CryptoKeyTypeRef=Crypto_30_vHsm_LibCv_Signature
        vHsm_TRNG: CryptoKeyId=60, CryptoKeyTypeRef=Crypto_30_vHsm_LibCv_Random_Nist_800_90A_DRBG_AES_NoDF
        CryIfKey_Ssa_SignatureRamKey_replacementAuthority: CryptoKeyId=7, CryptoKeyTypeRef=Crypto_30_vHsm_LibCv_Signature_replacementAuthority
        CryIfKey_Ssa_TrustModelPrivateEcuUnique_StagingKey: CryptoKeyId=11, CryptoKeyTypeRef=Crypto_30_vHsm_LibCv_KeyGenerate_ED25519
        Ssa_TrustModelEcuPublicCsr_StagingKey: CryptoKeyId=47, CryptoKeyTypeRef=Crypto_30_vHsm_LibCv_Ssa_TrustModelEcuPublicKeyCsr
        Ssa_TrustModelEcuPublic_LiveKey: CryptoKeyId=49, CryptoKeyTypeRef=Crypto_30_vHsm_LibCv_Ssa_TrustModelEcuPublicKey
        Ssa_TrustModelPrivateEcu_LiveKey: CryptoKeyId=50, CryptoKeyTypeRef=Crypto_30_vHsm_LibCv_Ssa_TrustModelEcuPrivateKey
        CryIfKey_vHsm_Info: CryptoKeyId=15, CryptoKeyTypeRef=Crypto_30_vHsm_LibCv_vHsm_Info
        CryIfKey_KeyMCertificate_OSSL_X509_ECDSA_P384_IA: CryptoKeyId=6, CryptoKeyTypeRef=Crypto_30_vHsm_KeyM_KeyType_KeyM_Certificate
        CryIfKey_KeyMCertificate_OSSL_X509_ECDSA_P384_CA: CryptoKeyId=5, CryptoKeyTypeRef=Crypto_30_vHsm_KeyM_KeyType_KeyM_Certificate
        CryIfKey_Ssa_TrustModelBackendCert_inHSM: CryptoKeyId=8, CryptoKeyTypeRef=Crypto_30_vHsm_LibCv_Cert_wPersist
        CryIfKey_Ssa_TrustModelEcuCert_inHSM: CryptoKeyId=9, CryptoKeyTypeRef=Crypto_30_vHsm_LibCv_Cert_wPersist
        CryIfKey_Ssa_TrustModelIntermediateCert_inHSM: CryptoKeyId=10, CryptoKeyTypeRef=Crypto_30_vHsm_LibCv_Cert_wPersist
        CryIfKey_Ssa_TrustModelRootCert_inHSM: CryptoKeyId=12, CryptoKeyTypeRef=Crypto_30_vHsm_LibCv_Cert_wPersist
        CryIfKey_Ssa_TrustModel_Ecu_CsrPrivateKey: CryptoKeyId=13, CryptoKeyTypeRef=Crypto_30_vHsm_LibCv_Ssa_TrustModel_Csr_Key_NonPersisting_Type
        CryIfKey_Ssa_TrustModel_Ecu_CsrPublicKey: CryptoKeyId=14, CryptoKeyTypeRef=Crypto_30_vHsm_LibCv_Ssa_TrustModel_Csr_Key_NonPersisting_Type
        CryIfKey_Fbl_Decrypt_Aes128: CryptoKeyId=0, CryptoKeyTypeRef=Crypto_30_vHsm_LibCv_CryptoKeyType_Fbl_Decrypt_Aes128
        CryIfKey_Fbl_Rng_Fips186: CryptoKeyId=2, CryptoKeyTypeRef=Crypto_30_vHsm_Hwa_Random_Fips186_Sha1
        CryIfKey_Fbl_Signature_Ed25519: CryptoKeyId=4, CryptoKeyTypeRef=Crypto_30_vHsm_LibCv_CryptoKeyType_Fbl_Signature_Ed25519
        CryIfKey_Fbl_HashDummy: CryptoKeyId=1, CryptoKeyTypeRef=Crypto_30_vHsm_Hwa_Hash
        CryIfKey_Fbl_SecurityAccess_Ed25519: CryptoKeyId=3, CryptoKeyTypeRef=Crypto_30_vHsm_LibCv_CryptoKeyType_Fbl_SecurityAccess_Ed25519
        CryptoKey_CSK_15576CRYPTO_ALGOFAM_AES128_3d4fd2d7: CryptoKeyId=0, CryptoKeyTypeRef=Crypto_30_vHsm_LibCv_CryptoKeyType_Fbl_Decrypt_Aes128
        CryptoKey_CSK_27103CRYPTO_ALGOFAM_AES128_0b48e843: CryptoKeyId=0, CryptoKeyTypeRef=Crypto_30_vHsm_LibCv_CryptoKeyType_Fbl_Decrypt_Aes128
        CryptoKey_CSK_28212CRYPTO_ALGOFAM_AES128_3d56a060: CryptoKeyId=0, CryptoKeyTypeRef=Crypto_30_vHsm_LibCv_CryptoKeyType_Fbl_Decrypt_Aes128
        CryptoKey_CSK_37177CRYPTO_ALGOFAM_AES128_c64d457a: CryptoKeyId=0, CryptoKeyTypeRef=Crypto_30_vHsm_LibCv_CryptoKeyType_Fbl_Decrypt_Aes128
        vHSM_Custom_HSM_Version: CryptoKeyId=52, CryptoKeyTypeRef=Crypto_30_vHsm_LibCv_vHSM_Custom_HSM_Version
    CryptoKeyTypes
      33 x CryptoKeyType:
        vHsmDummyKeyType: CryptoKeyElementRef=vHsmDummyKeyElement
        Crypto_30_vHsm_Hwa_vHsm_Hal_Hardware: CryptoKeyElementRef=Crypto_30_vHsm_Hwa_vHsm_Hal_FlashOperation
        Crypto_30_vHsm_LibCv_Signature: CryptoKeyElementRef=Crypto_30_vHsm_LibCv_Signature_Key
        Crypto_30_vHsm_LibCv_Cipher: CryptoKeyElementRef=Crypto_30_vHsm_LibCv_Cipher_Key, CryptoKeyElementRef=Crypto_30_vHsm_LibCv_Cipher_IV, CryptoKeyElementRef=Crypto_30_vHsm_LibCv_Cipher_Proof
        Crypto_30_vHsm_LibCv_KeyType_KeyM_CertificateData: CryptoKeyElementRef=Crypto_30_vHsm_LibCv_KeyM_CertificateData
        Crypto_30_vHsm_Hwa_RomKeyType: CryptoKeyElementRef=Crypto_30_vHsm_Hwa_RomKey
        Crypto_30_vHsm_vHsm_Core_vHsmLog_Type: CryptoKeyElementRef=Crypto_30_vHsm_vHsm_Core_vHsmLog_EventId
        Crypto_30_vHsm_LibCv_Ssa_Random_Nist_800_90A_DRBG_AES_DF: CryptoKeyElementRef=Crypto_30_vHsm_LibCv_Random_Algorithm_Nist_800_90A_DRBG_AES128_DF, CryptoKeyElementRef=Crypto_30_vHsm_LibCv_Random_Reseed_Counter, CryptoKeyElementRef=Crypto_30_vHsm_LibCv_Random_Seed, CryptoKeyElementRef=Crypto_30_vHsm_LibCv_Ssa_Random_Nonce, CryptoKeyElementRef=Crypto_30_vHsm_LibCv_CryptoKeyElement_DummyWorkaround_RandomSeedSize
        Crypto_30_vHsm_LibCv_Ssa_SecurityAccessPublicKey: CryptoKeyElementRef=Crypto_30_vHsm_LibCv_Ssa_SecurityAccesPublicKey
        Crypto_30_vHsm_LibCv_KeyExchange_X25519: CryptoKeyElementRef=Crypto_30_vHsm_LibCv_KeyExchange_Algorithm_X25519, CryptoKeyElementRef=Crypto_30_vHsm_LibCv_KeyExchange_OwnPubKey, CryptoKeyElementRef=Crypto_30_vHsm_LibCv_KeyExchange_Base, CryptoKeyElementRef=Crypto_30_vHsm_LibCv_KeyExchange_PrivKey, CryptoKeyElementRef=Crypto_30_vHsm_LibCv_KeyExchange_SharedValue
        Crypto_30_vHsm_LibCv_Ssa_SharedSecretHash: CryptoKeyElementRef=CryptoKeyElements/Crypto_30_vHsm_LibCv_Ssa_SharedSecretHash
        Crypto_30_vHsm_LibCv_Ssa_BackEndCert: CryptoKeyElementRef=Crypto_30_vHsm_LibCv_Ssa_BackendCert
        Crypto_30_vHsm_LibCv_Ssa_Cipher: CryptoKeyElementRef=Crypto_30_vHsm_LibCv_Ssa_Cipher_IV, CryptoKeyElementRef=Crypto_30_vHsm_LibCv_Ssa_Cipher_Key
        Crypto_30_vHsm_LibCv_Ssa_RootCert: CryptoKeyElementRef=CryptoKeyElements/Crypto_30_vHsm_LibCv_Ssa_RootCert
        Crypto_30_vHsm_LibCv_Ssa_Mac: CryptoKeyElementRef=Crypto_30_vHsm_LibCv_Ssa_Mac_Key, CryptoKeyElementRef=Crypto_30_vHsm_LibCv_Ssa_Mac_Proof
        Crypto_30_vHsm_vHsm_Core_vHsmInfo_Type: CryptoKeyElementRef=Crypto_30_vHsm_vHsm_Core_vHsmInfo_Version, CryptoKeyElementRef=Crypto_30_vHsm_vHsm_Core_vHsmInfo_PerformPersist, CryptoKeyElementRef=Crypto_30_vHsm_vHsm_Core_vHsmInfo_PerformRepersist, CryptoKeyElementRef=Crypto_30_vHsm_vHsm_Core_vHsmInfo_StartFirmwareUpdater, CryptoKeyElementRef=Crypto_30_vHsm_vHsm_Core_vHsmInfo_SecureBootEnd, CryptoKeyElementRef=Crypto_30_vHsm_vHsm_Core_vHsmInfo_SecureBootResult
        Crypto_30_vHsm_LibCv_Ssa_TrustModelEcuPrivateKey: CryptoKeyElementRef=Crypto_30_vHsm_LibCv_Ssa_TrustModelPrivateEcu_LiveKey
        Crypto_30_vHsm_LibCv_Random_Nist_800_90A_DRBG_AES_NoDF: CryptoKeyElementRef=Crypto_30_vHsm_LibCv_Random_Algorithm_Nist_800_90A_DRBG_AES128, CryptoKeyElementRef=Crypto_30_vHsm_LibCv_Random_PrivateString, CryptoKeyElementRef=Crypto_30_vHsm_LibCv_Random_Reseed_Counter, CryptoKeyElementRef=Crypto_30_vHsm_LibCv_Random_Seed_Nist_800_90A_DRBG_AES128, CryptoKeyElementRef=Crypto_30_vHsm_LibCv_Random_AdditionalInput
        Crypto_30_vHsm_LibCv_Ssa_TrustModelEcuPublicKey: CryptoKeyElementRef=Crypto_30_vHsm_LibCv_Ssa_TrustModelEcuPublic_LiveKey
        Crypto_30_vHsm_LibCv_Ssa_TrustModelEcuPublicKeyCsr: CryptoKeyElementRef=Crypto_30_vHsm_LibCv_Ssa_TrustModelEcuPublicCsr_StagingKey
        Crypto_30_vHsm_LibCv_KeyGenerate_ED25519: CryptoKeyElementRef=Crypto_30_vHsm_LibCv_KeyGenerate_Key, CryptoKeyElementRef=Crypto_30_vHsm_LibCv_KeyExchange_OwnPubKey, CryptoKeyElementRef=Crypto_30_vHsm_LibCv_KeyGenerate_Algorithm_Ed25519
        Crypto_30_vHsm_LibCv_Signature_replacementAuthority: CryptoKeyElementRef=Crypto_30_vHsm_LibCv_Signature_Key_replacementAuthority
        Crypto_30_vHsm_LibCv_vHsm_Info: CryptoKeyElementRef=Crypto_30_vHsm_LibCv_vHsm_Info_Uid, CryptoKeyElementRef=Crypto_30_vHsm_LibCv_vHsm_Info_ErrorLog
        Crypto_30_vHsm_KeyM_KeyType_KeyM_Certificate: CryptoKeyElementRef=Crypto_30_vHsm_KeyM_KeyM_Certificate, CryptoKeyElementRef=Crypto_30_vHsm_KeyM_KeyM_GetStatus, CryptoKeyElementRef=Crypto_30_vHsm_KeyM_KeyM_VerifyCertificate, CryptoKeyElementRef=Crypto_30_vHsm_KeyM_KeyM_VerifyCertificates
        Crypto_30_vHsm_LibCv_Ssa_MacKey_nonPersisting: CryptoKeyElementRef=Crypto_30_vHsm_LibCv_Ssa_MacKey_Hash_nonPersisting, CryptoKeyElementRef=CryptoKeyElements/Crypto_30_vHsm_LibCv_Ssa_MacKey_nonPersisting
        Crypto_30_vHsm_LibCv_Cert_wPersist: CryptoKeyElementRef=Crypto_30_vHsm_LibCv_CryptoKeyElement_Cert_wPersist
        Crypto_30_vHsm_LibCv_Ssa_TrustModel_Csr_Key_NonPersisting_Type: CryptoKeyElementRef=Crypto_30_vHsm_LibCv_Ssa_TrustModel_Csr_Key_NonPersisting_Element, CryptoKeyElementRef=Crypto_30_vHsm_LibCv_KeyGenerate_Algorithm_Ed25519, CryptoKeyElementRef=Crypto_30_vHsm_LibCv_KeyExchange_OwnPubKey
        Crypto_30_vHsm_LibCv_CryptoKeyType_Fbl_Decrypt_Aes128: CryptoKeyElementRef=Crypto_30_vHsm_LibCv_Fbl_Decrypt_Aes128_Iv, CryptoKeyElementRef=Crypto_30_vHsm_LibCv_Fbl_Decrypt_Aes128_Key
        Crypto_30_vHsm_Hwa_Random_Fips186_Sha1: CryptoKeyElementRef=Crypto_30_vHsm_Hwa_Random_Algorithm_Fips186_Sha1, CryptoKeyElementRef=Crypto_30_vHsm_Hwa_Random_Seed
        Crypto_30_vHsm_LibCv_CryptoKeyType_Fbl_Signature_Ed25519: CryptoKeyElementRef=Crypto_30_vHsm_LibCv_Fbl_Signature_Ed25519_Key
        Crypto_30_vHsm_Hwa_Hash: CryptoKeyElementRef=Crypto_30_vHsm_Hwa_Hash_Result
        Crypto_30_vHsm_LibCv_CryptoKeyType_Fbl_SecurityAccess_Ed25519: CryptoKeyElementRef=Crypto_30_vHsm_LibCv_Fbl_SecurityAccess_Ed25519_Key
        Crypto_30_vHsm_LibCv_vHSM_Custom_HSM_Version: CryptoKeyElementRef=Crypto_30_vHsm_LibCv_vHsm_Version
    CryptoDriverObjects
      7 x CryptoDriverObject, all with CryptoDriverObjectQueueSize=1:
        Crypto_30_vHsm_Core: CryptoDriverObjectId=0, CryptoBufferSize=512, CryptoPrimitiveRef=Crypto_30_vHsm_vHsm_Core_vHsmSecureBoot, CryptoPrimitiveRef=Crypto_30_vHsm_vHsm_Core_vHsmFirmwareUpdate, CryptoPrimitiveRef=Crypto_30_vHsm_vHsm_Core_vHsmSecureBootUpdate, CryptoPrimitiveRef=Crypto_30_vHsm_vHsm_Core_vHsmSecureSoftwareDownload, CryptoPrimitiveRef=Crypto_30_vHsm_vHsm_Core_vHsmSecureBootConfirmation, CryptoPrimitiveRef=Crypto_30_vHsm_vHsm_Core_vHsmPersistency
        Crypto_30_vHsm_LibCv: CryptoDriverObjectId=6, CryptoBufferSize=512, CryptoPrimitiveRef=Crypto_30_vHsm_LibCv_SHA256, CryptoPrimitiveRef=Crypto_30_vHsm_LibCv_AesDecrypt, CryptoPrimitiveRef=Crypto_30_vHsm_LibCv_AesEncrypt, CryptoPrimitiveRef=Crypto_30_vHsm_LibCv_AesCmacGenerate, CryptoPrimitiveRef=Crypto_30_vHsm_LibCv_AesCmacVerify, CryptoPrimitiveRef=Crypto_30_vHsm_LibCv_RngDrbgAes128, CryptoPrimitiveRef=Crypto_30_vHsm_LibCv_EccNistP256R1VerifySha256, CryptoPrimitiveRef=Crypto_30_vHsm_LibCv_EcDsaEd25519Generate, CryptoPrimitiveRef=Crypto_30_vHsm_LibCv_EcDsaEd25519Verify, CryptoPrimitiveRef=Crypto_30_vHsm_LibCv_SHA512, CryptoPrimitiveRef=Crypto_30_vHsm_LibCv_KeyGenerateEd25519
        Crypto_30_vHsm_KeyManagement: CryptoDriverObjectId=5, CryptoBufferSize=640, CryptoPrimitiveRef=vHsmUsageForbidden
        Crypto_30_vHsm_LibCv_HighPrio: CryptoDriverObjectId=7, CryptoBufferSize=512, CryptoPrimitiveRef=Crypto_30_vHsm_LibCv_SHA256, CryptoPrimitiveRef=Crypto_30_vHsm_LibCv_AesDecrypt, CryptoPrimitiveRef=Crypto_30_vHsm_LibCv_AesEncrypt, CryptoPrimitiveRef=Crypto_30_vHsm_LibCv_AesCmacGenerate, CryptoPrimitiveRef=Crypto_30_vHsm_LibCv_AesCmacVerify, CryptoPrimitiveRef=Crypto_30_vHsm_LibCv_RngDrbgAes128, CryptoPrimitiveRef=Crypto_30_vHsm_LibCv_SHA512
        Crypto_30_vHsm_KeyM_LibCv: CryptoDriverObjectId=4, CryptoBufferSize=512, CryptoPrimitiveRef=Crypto_30_vHsm_LibCv_EccNistP256R1VerifySha256
        Crypto_30_vHsm_Hwa_HighPrio: CryptoDriverObjectId=2, CryptoBufferSize=512, CryptoPrimitiveRef=Crypto_30_vHsm_Hwa_AesCmacVerify, CryptoPrimitiveRef=Crypto_30_vHsm_Hwa_AesCmacGenerate
        Crypto_30_vHsm_Hwa: CryptoDriverObjectId=1, CryptoBufferSize=512, CryptoPrimitiveRef=Crypto_30_vHsm_Hwa_Trng, CryptoPrimitiveRef=Crypto_30_vHsm_Hwa_AesDecrypt, CryptoPrimitiveRef=Crypto_30_vHsm_Hwa_AesEncrypt, CryptoPrimitiveRef=Crypto_30_vHsm_Hwa_AesCmacVerify, CryptoPrimitiveRef=Crypto_30_vHsm_Hwa_AesCmacGenerate, CryptoPrimitiveRef=Crypto_30_vHsm_Hwa_AesGCMDecrypt, CryptoPrimitiveRef=Crypto_30_vHsm_Hwa_AesGCMEncrypt, CryptoPrimitiveRef=Crypto_30_vHsm_Hwa_Ed25519VerifySHA2_512, CryptoPrimitiveRef=Crypto_30_vHsm_Hwa_Ed25519GenerateSHA2_512
    CryptoPrimitives
      21 x CryptoPrimitive:
        vHsmUsageForbidden: CryptoPrimitiveService=CRYPTO_RANDOM, CryptoPrimitiveAlgorithmFamily=CRYPTO_ALGOFAM_NOT_SET, CryptoPrimitiveAlgorithmMode=CRYPTO_ALGOMODE_NOT_SET, CryptoPrimitiveAlgorithmSecondaryFamily=CRYPTO_ALGOFAM_NOT_SET
        Crypto_30_vHsm_LibCv_SHA256: CryptoPrimitiveService=CRYPTO_HASH, CryptoPrimitiveAlgorithmFamily=CRYPTO_ALGOFAM_SHA2_256, CryptoPrimitiveAlgorithmMode=CRYPTO_ALGOMODE_NOT_SET, CryptoPrimitiveAlgorithmSecondaryFamily=CRYPTO_ALGOFAM_NOT_SET, CryptoPrimitiveSupportContext=false
        Crypto_30_vHsm_LibCv_AesDecrypt: CryptoPrimitiveService=CRYPTO_DECRYPT, CryptoPrimitiveAlgorithmFamily=CRYPTO_ALGOFAM_AES, CryptoPrimitiveAlgorithmMode=CRYPTO_ALGOMODE_ECB, CryptoPrimitiveAlgorithmMode=CRYPTO_ALGOMODE_CBC, CryptoPrimitiveAlgorithmMode=CRYPTO_ALGOMODE_CTR, CryptoPrimitiveAlgorithmSecondaryFamily=CRYPTO_ALGOFAM_NOT_SET, CryptoPrimitiveAlgorithmSecondaryFamily=CRYPTO_ALGOFAM_CUSTOM_PADDING_PKCS7, CryptoPrimitiveAlgorithmSecondaryFamily=CRYPTO_ALGOFAM_CUSTOM, CryptoPrimitiveSupportContext=false, CryptoPrimitiveAlgorithmSecondaryFamilyCustomRef=Crypto_30_vHsm_LibCv_PaddingPKCS7
        Crypto_30_vHsm_LibCv_AesEncrypt: CryptoPrimitiveService=CRYPTO_ENCRYPT, CryptoPrimitiveAlgorithmFamily=CRYPTO_ALGOFAM_AES, CryptoPrimitiveAlgorithmMode=CRYPTO_ALGOMODE_ECB, CryptoPrimitiveAlgorithmMode=CRYPTO_ALGOMODE_CBC, CryptoPrimitiveAlgorithmMode=CRYPTO_ALGOMODE_CTR, CryptoPrimitiveAlgorithmSecondaryFamily=CRYPTO_ALGOFAM_NOT_SET, CryptoPrimitiveAlgorithmSecondaryFamily=CRYPTO_ALGOFAM_CUSTOM_PADDING_PKCS7, CryptoPrimitiveAlgorithmSecondaryFamily=CRYPTO_ALGOFAM_CUSTOM, CryptoPrimitiveSupportContext=false, CryptoPrimitiveAlgorithmSecondaryFamilyCustomRef=Crypto_30_vHsm_LibCv_PaddingPKCS7
        Crypto_30_vHsm_LibCv_AesCmacGenerate: CryptoPrimitiveService=CRYPTO_MAC_GENERATE, CryptoPrimitiveAlgorithmFamily=CRYPTO_ALGOFAM_AES, CryptoPrimitiveAlgorithmMode=CRYPTO_ALGOMODE_CMAC, CryptoPrimitiveAlgorithmSecondaryFamily=CRYPTO_ALGOFAM_NOT_SET, CryptoPrimitiveSupportContext=false
        Crypto_30_vHsm_LibCv_AesCmacVerify: CryptoPrimitiveService=CRYPTO_MAC_VERIFY, CryptoPrimitiveAlgorithmFamily=CRYPTO_ALGOFAM_AES, CryptoPrimitiveAlgorithmMode=CRYPTO_ALGOMODE_CMAC, CryptoPrimitiveAlgorithmSecondaryFamily=CRYPTO_ALGOFAM_NOT_SET, CryptoPrimitiveSupportContext=false
        Crypto_30_vHsm_LibCv_RngDrbgAes128: CryptoPrimitiveService=CRYPTO_RANDOM, CryptoPrimitiveAlgorithmFamily=CRYPTO_ALGOFAM_CUSTOM_DRBG, CryptoPrimitiveAlgorithmMode=CRYPTO_ALGOMODE_NOT_SET, CryptoPrimitiveAlgorithmSecondaryFamily=CRYPTO_ALGOFAM_AES, CryptoPrimitiveSupportContext=false, CryptoPrimitiveAlgorithmFamilyCustomRef=Crypto_30_vHsm_LibCv_DRBG
        Crypto_30_vHsm_LibCv_SHA512: CryptoPrimitiveService=CRYPTO_HASH, CryptoPrimitiveAlgorithmFamily=CRYPTO_ALGOFAM_SHA2_512, CryptoPrimitiveAlgorithmMode=CRYPTO_ALGOMODE_NOT_SET, CryptoPrimitiveAlgorithmSecondaryFamily=CRYPTO_ALGOFAM_NOT_SET, CryptoPrimitiveSupportContext=false
        Crypto_30_vHsm_LibCv_EccNistP256R1VerifySha256: CryptoPrimitiveService=CRYPTO_SIGNATURE_VERIFY, CryptoPrimitiveAlgorithmFamily=CRYPTO_ALGOFAM_ECCNIST, CryptoPrimitiveAlgorithmMode=CRYPTO_ALGOMODE_CUSTOM_P256R1, CryptoPrimitiveAlgorithmSecondaryFamily=CRYPTO_ALGOFAM_SHA2_256, CryptoPrimitiveSupportContext=false, CryptoPrimitiveAlgorithmModeCustomRef=Crypto_30_vHsm_LibCv_P256r1
        Crypto_30_vHsm_vHsm_Core_vHsmSecureBoot: CryptoPrimitiveService=CRYPTO_MAC_VERIFY, CryptoPrimitiveAlgorithmFamily=CRYPTO_ALGOFAM_CUSTOM_VHSM_SECURE_BOOT, CryptoPrimitiveAlgorithmMode=CRYPTO_ALGOMODE_CMAC, CryptoPrimitiveAlgorithmMode=CRYPTO_ALGOMODE_NOT_SET, CryptoPrimitiveAlgorithmMode=CRYPTO_ALGOMODE_CUSTOM, CryptoPrimitiveAlgorithmSecondaryFamily=CRYPTO_ALGOFAM_NOT_SET, CryptoPrimitiveSupportContext=false, CryptoPrimitiveAlgorithmModeCustomRef=Crypto_30_vHsm_vHsm_Core_ForceSequential, CryptoPrimitiveAlgorithmFamilyCustomRef=Crypto_30_vHsm_vHsm_Core_SecureBoot
        Crypto_30_vHsm_vHsm_Core_vHsmFirmwareUpdate: CryptoPrimitiveService=CRYPTO_AEADENCRYPT, CryptoPrimitiveAlgorithmFamily=CRYPTO_ALGOFAM_CUSTOM_VHSM_FIRMWARE_UPDATE, CryptoPrimitiveAlgorithmMode=CRYPTO_ALGOMODE_GCM, CryptoPrimitiveAlgorithmMode=CRYPTO_ALGOMODE_NOT_SET, CryptoPrimitiveAlgorithmSecondaryFamily=CRYPTO_ALGOFAM_NOT_SET, CryptoPrimitiveSupportContext=false, CryptoPrimitiveAlgorithmFamilyCustomRef=Crypto_30_vHsm_vHsm_Core_FirmwareUpdate
        Crypto_30_vHsm_vHsm_Core_vHsmSecureBootUpdate: CryptoPrimitiveService=CRYPTO_SIGNATURE_VERIFY, CryptoPrimitiveAlgorithmFamily=CRYPTO_ALGOFAM_CUSTOM, CryptoPrimitiveAlgorithmMode=CRYPTO_ALGOMODE_NOT_SET, CryptoPrimitiveAlgorithmSecondaryFamily=CRYPTO_ALGOFAM_NOT_SET, CryptoPrimitiveSupportContext=false, CryptoPrimitiveAlgorithmFamilyCustomRef=Crypto_30_vHsm_vHsm_Core_SecureBootUpdate
        Crypto_30_vHsm_vHsm_Core_vHsmSecureSoftwareDownload: CryptoPrimitiveService=CRYPTO_SIGNATURE_VERIFY, CryptoPrimitiveAlgorithmFamily=CRYPTO_ALGOFAM_CUSTOM_VHSM_SOFTWARE_DOWNLOAD, CryptoPrimitiveAlgorithmMode=CRYPTO_ALGOMODE_NOT_SET, CryptoPrimitiveAlgorithmSecondaryFamily=CRYPTO_ALGOFAM_NOT_SET, CryptoPrimitiveSupportContext=false, CryptoPrimitiveAlgorithmSecondaryFamilyCustomRef=Crypto_30_vHsm_vHsm_Core_SoftwareDownload
        Crypto_30_vHsm_LibCv_EcDsaEd25519Generate: CryptoPrimitiveService=CRYPTO_SIGNATURE_GENERATE, CryptoPrimitiveAlgorithmFamily=CRYPTO_ALGOFAM_ED25519, CryptoPrimitiveAlgorithmMode=CRYPTO_ALGOMODE_NOT_SET, CryptoPrimitiveAlgorithmSecondaryFamily=CRYPTO_ALGOFAM_NOT_SET, CryptoPrimitiveAlgorithmSecondaryFamily=CRYPTO_ALGOFAM_SHA2_512, CryptoPrimitiveSupportContext=false
        Crypto_30_vHsm_LibCv_EcDsaEd25519Verify: CryptoPrimitiveService=CRYPTO_SIGNATURE_VERIFY, CryptoPrimitiveAlgorithmFamily=CRYPTO_ALGOFAM_ED25519, CryptoPrimitiveAlgorithmMode=CRYPTO_ALGOMODE_NOT_SET, CryptoPrimitiveAlgorithmSecondaryFamily=CRYPTO_ALGOFAM_NOT_SET, CryptoPrimitiveAlgorithmSecondaryFamily=CRYPTO_ALGOFAM_SHA2_512, CryptoPrimitiveSupportContext=false
        Crypto_30_vHsm_LibCv_KeyGenerateEd25519: CryptoPrimitiveService=CRYPTO_KEY_GENERATE, CryptoPrimitiveAlgorithmFamily=CRYPTO_ALGOFAM_ED25519, CryptoPrimitiveAlgorithmMode=CRYPTO_ALGOMODE_NOT_SET, CryptoPrimitiveAlgorithmSecondaryFamily=CRYPTO_ALGOFAM_NOT_SET, CryptoPrimitiveSupportContext=false
        Crypto_30_vHsm_Hwa_AesCmacVerify: CryptoPrimitiveService=CRYPTO_MAC_VERIFY, CryptoPrimitiveAlgorithmFamily=CRYPTO_ALGOFAM_AES, CryptoPrimitiveAlgorithmMode=CRYPTO_ALGOMODE_CMAC, CryptoPrimitiveAlgorithmSecondaryFamily=CRYPTO_ALGOFAM_NOT_SET, CryptoPrimitiveSupportContext=false
        Crypto_30_vHsm_Hwa_AesCmacGenerate: CryptoPrimitiveService=CRYPTO_MAC_GENERATE, CryptoPrimitiveAlgorithmFamily=CRYPTO_ALGOFAM_AES, CryptoPrimitiveAlgorithmMode=CRYPTO_ALGOMODE_CMAC, CryptoPrimitiveAlgorithmSecondaryFamily=CRYPTO_ALGOFAM_NOT_SET, CryptoPrimitiveSupportContext=false
        Crypto_30_vHsm_Hwa_Trng: CryptoPrimitiveService=CRYPTO_RANDOM, CryptoPrimitiveAlgorithmFamily=CRYPTO_ALGOFAM_RNG, CryptoPrimitiveAlgorithmMode=CRYPTO_ALGOMODE_NOT_SET, CryptoPrimitiveAlgorithmSecondaryFamily=CRYPTO_ALGOFAM_NOT_SET, CryptoPrimitiveSupportContext=false
        Crypto_30_vHsm_Hwa_AesDecrypt: CryptoPrimitiveService=CRYPTO_DECRYPT, CryptoPrimitiveAlgorithmFamily=CRYPTO_ALGOFAM_AES, CryptoPrimitiveAlgorithmMode=CRYPTO_ALGOMODE_ECB, CryptoPrimitiveAlgorithmMode=CRYPTO_ALGOMODE_CBC, CryptoPrimitiveAlgorithmMode=CRYPTO_ALGOMODE_CTR, CryptoPrimitiveAlgorithmSecondaryFamily=CRYPTO_ALGOFAM_NOT_SET, CryptoPrimitiveSupportContext=false, CryptoPrimitiveAlgorithmSecondaryFamilyCustomRef=Crypto_30_vHsm_Hwa_PaddingPKCS7
        Crypto_30_vHsm_Hwa_AesEncrypt: CryptoPrimitiveService=CRYPTO_ENCRYPT, CryptoPrimitiveAlgorithmFamily=CRYPTO_ALGOFAM_AES, CryptoPrimitiveAlgorithmMode=CRYPTO_ALGOMODE_ECB, CryptoPrimitiveAlgorithmMode=CRYPTO_ALGOMODE_CBC, CryptoPrimitiveAlgorithmMode=CRYPTO_ALGOMODE_CTR, CryptoPrimitiveAlgorithmSecondaryFamily=CRYPTO_ALGOFAM_NOT_SET, CryptoPrimitiveSupportContext=false, CryptoPrimitiveAlgorithmSecondaryFamilyCustomRef=Crypto_30_vHsm_Hwa_PaddingPKCS7
      Crypto_30_vHsm_LibCv_PaddingPKCS7 (CryptoPrimitiveAlgorithmFamilyCustom): CryptoPrimitiveAlgorithmFamilyCustomId=133
      Crypto_30_vHsm_LibCv_P256r1 (CryptoPrimitiveAlgorithmModeCustom): CryptoPrimitiveAlgorithmModeCustomId=128
      Crypto_30_vHsm_LibCv_DRBG (CryptoPrimitiveAlgorithmFamilyCustom): CryptoPrimitiveAlgorithmFamilyCustomId=131
      Crypto_30_vHsm_vHsm_Core_ForceSequential (CryptoPrimitiveAlgorithmModeCustom): CryptoPrimitiveAlgorithmModeCustomId=133
      5 x CryptoPrimitiveAlgorithmFamilyCustom:
        Crypto_30_vHsm_vHsm_Core_SecureBoot: CryptoPrimitiveAlgorithmFamilyCustomId=160
        Crypto_30_vHsm_vHsm_Core_FirmwareUpdate: CryptoPrimitiveAlgorithmFamilyCustomId=163
        Crypto_30_vHsm_vHsm_Core_SecureBootUpdate: CryptoPrimitiveAlgorithmFamilyCustomId=164
        Crypto_30_vHsm_vHsm_Core_SoftwareDownload: CryptoPrimitiveAlgorithmFamilyCustomId=161
        Crypto_30_vHsm_Hwa_PaddingPKCS7: CryptoPrimitiveAlgorithmFamilyCustomId=133
      Crypto_30_vHsm_vHsm_Core_vHsmSecureBootConfirmation (CryptoPrimitive):
        CryptoPrimitiveService = CRYPTO_SIGNATURE_VERIFY
        CryptoPrimitiveAlgorithmFamily = CRYPTO_ALGOFAM_CUSTOM
        CryptoPrimitiveAlgorithmMode = CRYPTO_ALGOMODE_NOT_SET
        CryptoPrimitiveAlgorithmSecondaryFamily = CRYPTO_ALGOFAM_NOT_SET
        CryptoPrimitiveSupportContext = false
        CryptoPrimitiveAlgorithmFamilyCustomRef = Crypto_30_vHsm_vHsm_Core_SecureBootConfirmation
      Crypto_30_vHsm_vHsm_Core_SecureBootConfirmation (CryptoPrimitiveAlgorithmFamilyCustom): CryptoPrimitiveAlgorithmFamilyCustomId=165
      Crypto_30_vHsm_vHsm_Core_vHsmPersistency (CryptoPrimitive):
        CryptoPrimitiveService = CRYPTO_RANDOM
        CryptoPrimitiveAlgorithmFamily = CRYPTO_ALGOFAM_CUSTOM
        CryptoPrimitiveAlgorithmMode = CRYPTO_ALGOMODE_CUSTOM
        CryptoPrimitiveAlgorithmSecondaryFamily = CRYPTO_ALGOFAM_NOT_SET
        CryptoPrimitiveSupportContext = false
        CryptoPrimitiveAlgorithmModeCustomRef = Crypto_30_vHsm_vHsm_Core_PersistDeferred
        CryptoPrimitiveAlgorithmFamilyCustomRef = Crypto_30_vHsm_vHsm_Core_Persistency
        CryptoPrimitiveAlgorithmModeCustomRef = Crypto_30_vHsm_vHsm_Core_Repersist
      Crypto_30_vHsm_vHsm_Core_PersistDeferred (CryptoPrimitiveAlgorithmModeCustom): CryptoPrimitiveAlgorithmModeCustomId=152
      Crypto_30_vHsm_vHsm_Core_Persistency (CryptoPrimitiveAlgorithmFamilyCustom): CryptoPrimitiveAlgorithmFamilyCustomId=192
      Crypto_30_vHsm_vHsm_Core_Repersist (CryptoPrimitiveAlgorithmModeCustom): CryptoPrimitiveAlgorithmModeCustomId=153
      4 x CryptoPrimitive, all with CryptoPrimitiveSupportContext=false:
        Crypto_30_vHsm_Hwa_AesGCMDecrypt: CryptoPrimitiveService=CRYPTO_AEADDECRYPT, CryptoPrimitiveAlgorithmFamily=CRYPTO_ALGOFAM_AES, CryptoPrimitiveAlgorithmMode=CRYPTO_ALGOMODE_GCM, CryptoPrimitiveAlgorithmSecondaryFamily=CRYPTO_ALGOFAM_NOT_SET
        Crypto_30_vHsm_Hwa_AesGCMEncrypt: CryptoPrimitiveService=CRYPTO_AEADENCRYPT, CryptoPrimitiveAlgorithmFamily=CRYPTO_ALGOFAM_AES, CryptoPrimitiveAlgorithmMode=CRYPTO_ALGOMODE_GCM, CryptoPrimitiveAlgorithmSecondaryFamily=CRYPTO_ALGOFAM_NOT_SET
        Crypto_30_vHsm_Hwa_Ed25519VerifySHA2_512: CryptoPrimitiveService=CRYPTO_SIGNATURE_VERIFY, CryptoPrimitiveAlgorithmFamily=CRYPTO_ALGOFAM_ED25519, CryptoPrimitiveAlgorithmMode=CRYPTO_ALGOMODE_CUSTOM, CryptoPrimitiveAlgorithmSecondaryFamily=CRYPTO_ALGOFAM_SHA2_512, CryptoPrimitiveAlgorithmModeCustomRef=Crypto_30_vHsm_Hwa_Ed25519Pure, CryptoPrimitiveAlgorithmModeCustomRef=Crypto_30_vHsm_Hwa_Ed25519Ctx, CryptoPrimitiveAlgorithmModeCustomRef=Crypto_30_vHsm_Hwa_Ed25519Ph
        Crypto_30_vHsm_Hwa_Ed25519GenerateSHA2_512: CryptoPrimitiveService=CRYPTO_SIGNATURE_GENERATE, CryptoPrimitiveAlgorithmFamily=CRYPTO_ALGOFAM_ED25519, CryptoPrimitiveAlgorithmMode=CRYPTO_ALGOMODE_CUSTOM, CryptoPrimitiveAlgorithmSecondaryFamily=CRYPTO_ALGOFAM_SHA2_512, CryptoPrimitiveAlgorithmModeCustomRef=Crypto_30_vHsm_Hwa_Ed25519Pure, CryptoPrimitiveAlgorithmModeCustomRef=Crypto_30_vHsm_Hwa_Ed25519Ctx, CryptoPrimitiveAlgorithmModeCustomRef=Crypto_30_vHsm_Hwa_Ed25519Ph
      3 x CryptoPrimitiveAlgorithmModeCustom:
        Crypto_30_vHsm_Hwa_Ed25519Pure: CryptoPrimitiveAlgorithmModeCustomId=174
        Crypto_30_vHsm_Hwa_Ed25519Ctx: CryptoPrimitiveAlgorithmModeCustomId=175
        Crypto_30_vHsm_Hwa_Ed25519Ph: CryptoPrimitiveAlgorithmModeCustomId=176
    CryptovHsm:
      CryptoIpcChannels = 2
      CryptoIpcProtocolVersion = 3
      CryptoKeyElementDeleteSupport = true
      CryptoInterruptMode = true
      CryptoRedirection = true
      CryptoIpcMacJobOptimization = false
      CryptoDetInstanceMask = 0
      CryptoKeyDeriveJobSupport = true
      CryptoHost2HsmAddress = 4026794040
      CryptoHsm2HostAddress = 4026794036
      CryptoIpcInstanceId = 0
      CryptoIpcInitialization = true
      CryptoWaitLoopCallout = Appl_Crypto_30_vHsm_WaitLoopCallout
      CryptoManagementDriverObject = Crypto_30_vHsm_KeyManagement
      CryptoJobRequestInterrupt: CryptoJobRequestInterruptFlagSetAddress=4026794016, CryptoJobRequestInterruptFlagSetMask=1, CryptoJobRequestInterruptFlagSetting=true
      CryptoJobResponseInterrupt:
        CryptoJobResponseInterruptFlagClearAddress = 4026794024
        CryptoJobResponseInterruptFlagClearMask = 1
        CryptoJobResponseInterruptFlagClearValue = 1
        CryptoJobResponseInterruptFlagClearing = true
      7 x CryptoMemoryArea, all with CryptoAreaPriority=0, CryptoAreaEnabled=true:
        TC3xx_CPU0_CPU1_CPU2: CryptoAreaStart=1342177280, CryptoAreaStop=2147483647, CryptoAreaType=CRYPTO_AREA_HSM_READ_ACCESS
        TC3xx_CPU3_CPU4: CryptoAreaStart=805306368, CryptoAreaStop=1107296255, CryptoAreaType=CRYPTO_AREA_HSM_READ_ACCESS
        TC3xx_CPU5: CryptoAreaStart=268435456, CryptoAreaStop=536870911, CryptoAreaType=CRYPTO_AREA_HSM_READ_ACCESS
        TC3xx_LMURAM_noncached: CryptoAreaStart=2952790016, CryptoAreaStop=2953969663, CryptoAreaType=CRYPTO_AREA_HSM_READWRITE_ACCESS
        TC3xx_PFLASH_noncached: CryptoAreaStart=2684616704, CryptoAreaStop=2701131775, CryptoAreaType=CRYPTO_AREA_HSM_READ_ACCESS
        TC3xx_PFLASH_cached: CryptoAreaStart=2147745792, CryptoAreaStop=2164260863, CryptoAreaType=CRYPTO_AREA_HSM_READ_ACCESS
        TC3xx_LMURAM_cached_HOST: CryptoAreaStart=2415919104, CryptoAreaStop=2417098751, CryptoAreaType=CRYPTO_AREA_HSM_READWRITE_ACCESS
