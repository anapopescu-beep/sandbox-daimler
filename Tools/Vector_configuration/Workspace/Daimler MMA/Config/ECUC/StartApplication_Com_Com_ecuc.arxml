AUTOSAR XML (schema 00049)
package /ActiveEcuC
  module config Com: implementation-config-variant=VARIANT-POST-BUILD-SELECTABLE, module-description=Com_Impl
    ComGeneration:
      ComOutOfBoundsWriteProtectionStrategy = NONE
      ComOutOfBoundsWriteSanitizer = false
      ComOutOfBoundsReadSanitizer = false
      ComReduceConstantData2Define = false
      ComBoolDataInArrayOfStructStrategy = BOOLEAN
      ComDeduplicateIndirectedData = true
      ComDataDeduplicationStrategy = WITH_CAST
      ComReduceBoolDataByNegationThreshold = 0
      ComReduceBoolDataByNumericalComparisonThreshold = 0
      ComReduceBoolDataByNumericalRelationThreshold = 0
      ComReduceBoolDataByNumericalOperandStrategy = NONE
      ComReduceNumericalDataByOffsetThreshold = 0
      ComReduceNumericalDataByArraySubtractionThreshold = 0
      ComReduceDataByStreaming = false
      ComShortSymbols = false
      ComInterfacesForDeactivatedData = false
      ComReferringKeysInComments = false
      ComNumberOfElementsCommentThreshold = 1000
    ComOptimization:
      ComTxProcessingISRLockThreshold = 10
      ComRxProcessingISRLockThreshold = 10
      ComGatewayProcessingISRLockThreshold = 10
      ComGatewayDescriptionProcessingISRLockThreshold = 10
      ComIPduGroupISRLockThreshold = 10
    ComConfig: ComConfigurationId=0, ComRxDeferredNotificationCacheSize=16, ComRxImmediateNotificationCacheSize=0, ComRxDeferredEventCacheSize=31
      PN14_Master_Stat1_ST3_eba3e383_Rx (ComIPdu):
        ComIPduDirection = RECEIVE
        ComIPduType = NORMAL
        ComIPduHandleId = 18
        ComIPduSignalProcessing = DEFERRED
        ComIPduCancellationSupport = false
        ComIPduGroupRef = RBTM_FL_BODY3_Rx_PNC_20_54c591d6 if post-build-variant-condition{matching-criterion=SideAllocation, value=0}
        ComIPduGroupRef = RBTM_FL_BODY3_Rx_PNC_All_Active_46e8c3b2 if post-build-variant-condition{matching-criterion=SideAllocation, value=0}
        ComIPduSignalRef = PN14_DDP_Sw_Stat_ST3_568ad7e6_Rx
        ComIPduSignalRef = PN14_ProdMd_Stat_ST3_be2b5dfe_Rx
        ComIPduSignalRef = PN14_SupBat_Volt_ST3_946fd9c6_Rx
        ComIPduSignalRef = PN14_TransMd_Stat_ST3_2208da29_Rx
        ComPduIdRef = PN14_Master_Stat1_ST3_eba3e383_Rx
        ComIPduMainFunctionRef = ComMainFunctionRx
        ComIPduGroupRef = RBTM_FR_BODY3_Rx_PNC_20_02b0f03d if post-build-variant-condition{matching-criterion=SideAllocation, value=1}
        ComIPduGroupRef = RBTM_FR_BODY3_Rx_PNC_All_Active_592f1bcd if post-build-variant-condition{matching-criterion=SideAllocation, value=1}
      Impact3_ST3_d832457c_Rx (ComIPdu):
        ComIPduDirection = RECEIVE
        ComIPduType = NORMAL
        ComIPduHandleId = 16
        ComIPduSignalProcessing = DEFERRED
        ComIPduCancellationSupport = false
        ComIPduGroupRef = RBTM_FL_BODY3_Rx_PNC_20_54c591d6 if post-build-variant-condition{matching-criterion=SideAllocation, value=0}
        ComIPduGroupRef = RBTM_FL_BODY3_Rx_PNC_All_Active_46e8c3b2 if post-build-variant-condition{matching-criterion=SideAllocation, value=0}
        ComIPduSignalGroupRef = ORC_Impact3_Pr5_ST3_c4pqnkonfjwv3uiohsxhe9dwu_1bc89a3a_Rx
        ComPduIdRef = Impact3_ST3_d832457c_Rx
        ComIPduMainFunctionRef = ComMainFunctionRx
        ComIPduGroupRef = RBTM_FR_BODY3_Rx_PNC_20_02b0f03d if post-build-variant-condition{matching-criterion=SideAllocation, value=1}
        ComIPduGroupRef = RBTM_FR_BODY3_Rx_PNC_All_Active_592f1bcd if post-build-variant-condition{matching-criterion=SideAllocation, value=1}
      CLkS_DrRltch_Stat_Pr5_ST3_7at68qvnk0r9npofyykyfq82v_10e0cb0e_Rx (ComSignalGroup):
        ComSignalGroupArrayAccess = true
        ComTransferProperty = TRIGGERED_ON_CHANGE
        ComSignalGroupAccess = ACCESS_UNCLEAR
        ComHandleId = 4
        ComSystemTemplateSignalGroupRef = CLkS_DrRltch_Stat_Pr5_ST3_7at68qvnk0r9npofyykyfq82v
        6 x ComGroupSignal, all with ComSignalEndianness=LITTLE_ENDIAN, ComSignalAccess=ACCESS_UNCLEAR:
          DrRLtch_FL_Stat_ST3_ce64a199_Rx: ComBitPosition=24, ComBitSize=2, ComSignalDataInvalidValue=3, ComSignalInitValue=3, ComSignalType=UINT8, ComHandleId=45, ComSystemTemplateSystemSignalRef=DrRLtch_FL_Stat_ST3
          SQC_CLkS_DrRltch_Stat_Pr5_ST3_150acc51_Rx: ComBitPosition=16, ComBitSize=8, ComSignalInitValue=0, ComSignalType=UINT8, ComHandleId=49, ComSystemTemplateSystemSignalRef=SQC_CLkS_DrRltch_Stat_Pr5_ST3
          CRC_CLkS_DrRltch_Stat_Pr5_ST3_911c4673_Rx: ComBitPosition=0, ComBitSize=16, ComSignalInitValue=18640, ComSignalType=UINT16, ComHandleId=44, ComSystemTemplateSystemSignalRef=CRC_CLkS_DrRltch_Stat_Pr5_ST3
          DrRLtch_FR_Stat_ST3_f70310c2_Rx: ComBitPosition=26, ComBitSize=2, ComSignalDataInvalidValue=3, ComSignalInitValue=3, ComSignalType=UINT8, ComHandleId=46, ComSystemTemplateSystemSignalRef=DrRLtch_FR_Stat_ST3
          DrRLtch_RR_Stat_ST3_e92ca78b_Rx: ComBitPosition=30, ComBitSize=2, ComSignalDataInvalidValue=3, ComSignalInitValue=3, ComSignalType=UINT8, ComHandleId=48, ComSystemTemplateSystemSignalRef=DrRLtch_RR_Stat_ST3
          DrRLtch_RL_Stat_ST3_d04b16d0_Rx: ComBitPosition=28, ComBitSize=2, ComSignalDataInvalidValue=3, ComSignalInitValue=3, ComSignalType=UINT8, ComHandleId=47, ComSystemTemplateSystemSignalRef=DrRLtch_RL_Stat_ST3
      Ign_Stat_Pr5_ST3_csgs1dv6drms80o1i9p49677w_7bdae87d_Rx (ComSignalGroup):
        ComSignalGroupArrayAccess = true
        ComTimeout = 1
        ComTransferProperty = TRIGGERED_ON_CHANGE
        ComSignalGroupAccess = ACCESS_NEEDED_BY_SWC_OR_COM
        ComHandleId = 9
        ComTimeoutNotification = CIL_Ignition_TimeoutError
        ComNotification = CIL_ComNotification_Ign_Stat_Pr5_ST3_csgs1dv6drms80o1i9p49677w_7bdae87d_Rx
        ComFirstTimeout = 1
        ComSystemTemplateSignalGroupRef = Ign_Stat_Pr5_ST3_csgs1dv6drms80o1i9p49677w
        5 x ComGroupSignal, all with ComSignalEndianness=LITTLE_ENDIAN, ComSignalAccess=ACCESS_NEEDED_BY_SWC_OR_COM:
          KG_StartSw_Psd_ST3_b1980089_Rx: ComBitPosition=31, ComBitSize=1, ComSignalInitValue=0, ComSignalType=BOOLEAN, ComHandleId=74, ComSystemTemplateSystemSignalRef=KG_StartSw_Psd_ST3
          CRC_Ign_Stat_Pr5_ST3_ef30f764_Rx: ComBitPosition=0, ComBitSize=16, ComSignalInitValue=20886, ComSignalType=UINT16, ComHandleId=72, ComSystemTemplateSystemSignalRef=CRC_Ign_Stat_Pr5_ST3
          SQC_Ign_Stat_Pr5_ST3_aca0dae8_Rx: ComBitPosition=16, ComBitSize=8, ComSignalInitValue=0, ComSignalType=UINT8, ComHandleId=75, ComSystemTemplateSystemSignalRef=SQC_Ign_Stat_Pr5_ST3
          Veh_Op_Mode_ST3_e0acb0c9_Rx: ComBitPosition=27, ComBitSize=4, ComSignalDataInvalidValue=15, ComSignalInitValue=0, ComSignalType=UINT8, ComHandleId=76, ComSystemTemplateSystemSignalRef=Veh_Op_Mode_ST3
          ISw_Stat_ST3_20c6e8e0_Rx: ComBitPosition=24, ComBitSize=3, ComSignalDataInvalidValue=7, ComSignalInitValue=7, ComSignalType=UINT8, ComHandleId=73, ComSystemTemplateSystemSignalRef=ISw_Stat_ST3
      4 x ComIPdu, all with ComIPduType=NORMAL, ComIPduSignalProcessing=DEFERRED, ComIPduCancellationSupport=false:
        ADAS_PROFILE_SHORT_ST3_1_506b5dfc_Rx: ComIPduDirection=RECEIVE, ComIPduHandleId=3, ComIPduGroupRef=RBTM_FL_BODY3_Rx_PNC_20_54c591d6 if post-build-variant-condition{matching-criterion=SideAllocation, value=0}, ComIPduGroupRef=RBTM_FL_BODY3_Rx_PNC_All_Active_46e8c3b2 if post-build-variant-condition{matching-criterion=SideAllocation, value=0}, ComIPduSignalGroupRef=ADAS_Profile_Short_CurvLn_ST3_96e9ejcafisp13h7moqj5malh_1_aac62a51_Rx, ComIPduSignalRef=ADAS_ProfShort_ProfTyp_ST31_a96eaafe_Rx, ComPduIdRef=ADAS_PROFILE_SHORT_ST3_1_506b5dfc_Rx, ComIPduMainFunctionRef=ComMainFunctionRx, ComIPduGroupRef=RBTM_FR_BODY3_Rx_PNC_20_02b0f03d if post-build-variant-condition{matching-criterion=SideAllocation, value=1}, ComIPduGroupRef=RBTM_FR_BODY3_Rx_PNC_All_Active_592f1bcd if post-build-variant-condition{matching-criterion=SideAllocation, value=1}
        Meas8_RBTM_FL_ST3_a92f14da_Tx: ComIPduDirection=SEND, ComIPduHandleId=3, ComIPduGroupRef=TxMess_RBTM_FL_BODY3_e804245a, ComIPduSignalGroupRef=Meas8_RBTM_FL_ST3_72jyquhuktrmjm0hkqempja37_23ddfefa_Tx, ComPduIdRef=Meas8_RBTM_FL_ST3_a92f14da_Tx, ComIPduMainFunctionRef=ComMainFunctionTx, variation-point=post-build-variant-condition{matching-criterion=SideAllocation, value=0}
          ComTxIPdu: ComMinimumDelayTime=0.005, ComTxIPduUnusedAreasDefault=0
            ComTxModeTrue
              ComTxMode: ComTxModeMode=DIRECT, ComTxModeNumberOfRepetitions=0
            ComTxModeFalse
              ComTxMode: ComTxModeMode=NONE
        RBTM_FR_Stat_ST3_e44387fa_Rx: ComIPduDirection=RECEIVE, ComIPduHandleId=32, ComIPduGroupRef=RBTM_FL_BODY3_Rx_PNC_20_54c591d6, ComIPduGroupRef=RBTM_FL_BODY3_Rx_PNC_All_Active_46e8c3b2, ComIPduSignalRef=RevBltTns_FR_SafeCyc_Actv_ST3_5c8c6ad4_Rx, ComPduIdRef=RBTM_FR_Stat_ST3_e44387fa_Rx, ComIPduMainFunctionRef=ComMainFunctionRx, variation-point=post-build-variant-condition{matching-criterion=SideAllocation, value=0}
        Impact2_ST3_e5526ccc_Rx: ComIPduDirection=RECEIVE, ComIPduHandleId=15, ComIPduGroupRef=RBTM_FL_BODY3_Rx_PNC_20_54c591d6 if post-build-variant-condition{matching-criterion=SideAllocation, value=0}, ComIPduGroupRef=RBTM_FL_BODY3_Rx_PNC_All_Active_46e8c3b2 if post-build-variant-condition{matching-criterion=SideAllocation, value=0}, ComIPduSignalGroupRef=ORC_Impact2_Pr5_ST3_b9l09rrslyv7vj3o92j69irnd_2f5ae8ac_Rx, ComPduIdRef=Impact2_ST3_e5526ccc_Rx, ComIPduMainFunctionRef=ComMainFunctionRx, ComIPduGroupRef=RBTM_FR_BODY3_Rx_PNC_20_02b0f03d if post-build-variant-condition{matching-criterion=SideAllocation, value=1}, ComIPduGroupRef=RBTM_FR_BODY3_Rx_PNC_All_Active_592f1bcd if post-build-variant-condition{matching-criterion=SideAllocation, value=1}
      VSS_TP_SecTickCount_Lvl2_ST3_9eubq13iosat764o0lqh5xb6r_01efe31e_Rx (ComSignalGroup):
        ComTransferProperty = TRIGGERED
        ComSignalGroupAccess = ACCESS_UNCLEAR
        ComHandleId = 19
        ComNotification = Rte_COMCbk_VSS_TP_SecTickCount_Lvl2_ST3_9eubq13iosat764o0lqh5xb6r_01efe31e_Rx
        ComTimeoutNotification = Rte_COMCbkRxTOut_VSS_TP_SecTickCount_Lvl2_ST3_9eubq13iosat764o0lqh5xb6r_01efe31e_Rx
        ComTimeout = 1
        ComSystemTemplateSignalGroupRef = VSS_TP_SecTickCount_Lvl2_ST3_9eubq13iosat764o0lqh5xb6r
        8 x ComGroupSignal, all with ComBitSize=8, ComSignalEndianness=LITTLE_ENDIAN, ComSignalInitValue=255, ComSignalType=UINT8, ComSignalAccess=ACCESS_UNCLEAR:
          VSS_TP_SecTickCount_Lvl2_2_ST3_a005e968_Rx: ComBitPosition=16, ComHandleId=156, ComSystemTemplateSystemSignalRef=VSS_TP_SecTickCount_Lvl2_2_ST3
          VSS_TP_SecTickCount_Lvl2_0_ST3_dac5ba08_Rx: ComBitPosition=0, ComHandleId=154, ComSystemTemplateSystemSignalRef=VSS_TP_SecTickCount_Lvl2_0_ST3
          VSS_TP_SecTickCount_Lvl2_1_ST3_e7a593b8_Rx: ComBitPosition=8, ComHandleId=155, ComSystemTemplateSystemSignalRef=VSS_TP_SecTickCount_Lvl2_1_ST3
          VSS_TP_SecTickCount_Lvl2_5_ST3_12253578_Rx: ComBitPosition=40, ComHandleId=159, ComSystemTemplateSystemSignalRef=VSS_TP_SecTickCount_Lvl2_5_ST3
          VSS_TP_SecTickCount_Lvl2_3_ST3_9d65c0d8_Rx: ComBitPosition=24, ComHandleId=157, ComSystemTemplateSystemSignalRef=VSS_TP_SecTickCount_Lvl2_3_ST3
          VSS_TP_SecTickCount_Lvl2_6_ST3_55854fa8_Rx: ComBitPosition=48, ComHandleId=160, ComSystemTemplateSystemSignalRef=VSS_TP_SecTickCount_Lvl2_6_ST3
          VSS_TP_SecTickCount_Lvl2_4_ST3_2f451cc8_Rx: ComBitPosition=32, ComHandleId=158, ComSystemTemplateSystemSignalRef=VSS_TP_SecTickCount_Lvl2_4_ST3
          VSS_TP_SecTickCount_Lvl2_7_ST3_68e56618_Rx: ComBitPosition=56, ComHandleId=161, ComSystemTemplateSystemSignalRef=VSS_TP_SecTickCount_Lvl2_7_ST3
      EVC_CfgList_01_08_Pr5_ST3_32c5e6fb_Rx (ComIPdu):
        ComIPduDirection = RECEIVE
        ComIPduType = NORMAL
        ComIPduHandleId = 13
        ComIPduSignalProcessing = DEFERRED
        ComIPduCancellationSupport = false
        ComIPduGroupRef = RBTM_FL_BODY3_Rx_PNC_20_54c591d6 if post-build-variant-condition{matching-criterion=SideAllocation, value=0}
        ComIPduGroupRef = RBTM_FL_BODY3_Rx_PNC_All_Active_46e8c3b2 if post-build-variant-condition{matching-criterion=SideAllocation, value=0}
        ComIPduSignalGroupRef = EVC_CfgList_01_08_Pr5_ST3_co3q1mwsf7pwxo2ix5jryc04x_3a43a00a_Rx
        ComPduIdRef = EVC_CfgList_01_08_Pr5_ST3_32c5e6fb_Rx
        ComIPduMainFunctionRef = ComMainFunctionRx
        ComIPduGroupRef = RBTM_FR_BODY3_Rx_PNC_20_02b0f03d if post-build-variant-condition{matching-criterion=SideAllocation, value=1}
        ComIPduGroupRef = RBTM_FR_BODY3_Rx_PNC_All_Active_592f1bcd if post-build-variant-condition{matching-criterion=SideAllocation, value=1}
      4 x ComSignalGroup, all with ComTransferProperty=TRIGGERED, ComSignalGroupAccess=ACCESS_UNCLEAR:
        VSS_TP_RealTmOffset_ST3_1t7vc44gftc0wv35k5kgc2in9_d3385ce4_Rx: ComHandleId=18, ComNotification=Rte_COMCbk_VSS_TP_RealTmOffset_ST3_1t7vc44gftc0wv35k5kgc2in9_d3385ce4_Rx, ComSystemTemplateSignalGroupRef=VSS_TP_RealTmOffset_ST3_1t7vc44gftc0wv35k5kgc2in9
          8 x ComGroupSignal, all with ComBitSize=8, ComSignalEndianness=LITTLE_ENDIAN, ComSignalInitValue=255, ComSignalType=UINT8, ComSignalAccess=ACCESS_UNCLEAR:
            VSS_TP_RealTmOffset_0_ST3_a2539a58_Rx: ComBitPosition=0, ComHandleId=146, ComSystemTemplateSystemSignalRef=VSS_TP_RealTmOffset_0_ST3
            VSS_TP_RealTmOffset_3_ST3_e5f3e088_Rx: ComBitPosition=24, ComHandleId=149, ComSystemTemplateSystemSignalRef=VSS_TP_RealTmOffset_3_ST3
            VSS_TP_RealTmOffset_5_ST3_6ab31528_Rx: ComBitPosition=40, ComHandleId=151, ComSystemTemplateSystemSignalRef=VSS_TP_RealTmOffset_5_ST3
            VSS_TP_RealTmOffset_2_ST3_d893c938_Rx: ComBitPosition=16, ComHandleId=148, ComSystemTemplateSystemSignalRef=VSS_TP_RealTmOffset_2_ST3
            VSS_TP_RealTmOffset_7_ST3_10734648_Rx: ComBitPosition=56, ComHandleId=153, ComSystemTemplateSystemSignalRef=VSS_TP_RealTmOffset_7_ST3
            VSS_TP_RealTmOffset_6_ST3_2d136ff8_Rx: ComBitPosition=48, ComHandleId=152, ComSystemTemplateSystemSignalRef=VSS_TP_RealTmOffset_6_ST3
            VSS_TP_RealTmOffset_4_ST3_57d33c98_Rx: ComBitPosition=32, ComHandleId=150, ComSystemTemplateSystemSignalRef=VSS_TP_RealTmOffset_4_ST3
            VSS_TP_RealTmOffset_1_ST3_9f33b3e8_Rx: ComBitPosition=8, ComHandleId=147, ComSystemTemplateSystemSignalRef=VSS_TP_RealTmOffset_1_ST3
        VSS_TP_SharedSecret_ST3_8pj4t8t4rm3tw3pk5hj7vonti_d9a21e4b_Rx: ComHandleId=20, ComNotification=Rte_COMCbk_VSS_TP_SharedSecret_ST3_8pj4t8t4rm3tw3pk5hj7vonti_d9a21e4b_Rx, ComSystemTemplateSignalGroupRef=VSS_TP_SharedSecret_ST3_8pj4t8t4rm3tw3pk5hj7vonti
          8 x ComGroupSignal, all with ComBitSize=8, ComSignalEndianness=LITTLE_ENDIAN, ComSignalInitValue=255, ComSignalType=UINT8, ComSignalAccess=ACCESS_UNCLEAR:
            VSS_TP_SharedSecret_3_ST3_3343a1eb_Rx: ComBitPosition=24, ComHandleId=165, ComSystemTemplateSystemSignalRef=VSS_TP_SharedSecret_3_ST3
            VSS_TP_SharedSecret_5_ST3_bc03544b_Rx: ComBitPosition=40, ComHandleId=167, ComSystemTemplateSystemSignalRef=VSS_TP_SharedSecret_5_ST3
            VSS_TP_SharedSecret_2_ST3_0e23885b_Rx: ComBitPosition=16, ComHandleId=164, ComSystemTemplateSystemSignalRef=VSS_TP_SharedSecret_2_ST3
            VSS_TP_SharedSecret_6_ST3_fba32e9b_Rx: ComBitPosition=48, ComHandleId=168, ComSystemTemplateSystemSignalRef=VSS_TP_SharedSecret_6_ST3
            VSS_TP_SharedSecret_4_ST3_81637dfb_Rx: ComBitPosition=32, ComHandleId=166, ComSystemTemplateSystemSignalRef=VSS_TP_SharedSecret_4_ST3
            VSS_TP_SharedSecret_7_ST3_c6c3072b_Rx: ComBitPosition=56, ComHandleId=169, ComSystemTemplateSystemSignalRef=VSS_TP_SharedSecret_7_ST3
            VSS_TP_SharedSecret_0_ST3_74e3db3b_Rx: ComBitPosition=0, ComHandleId=162, ComSystemTemplateSystemSignalRef=VSS_TP_SharedSecret_0_ST3
            VSS_TP_SharedSecret_1_ST3_4983f28b_Rx: ComBitPosition=8, ComHandleId=163, ComSystemTemplateSystemSignalRef=VSS_TP_SharedSecret_1_ST3
        VSS_TP_Auth_ST3_6j4id7sghlvlbroli4wjozjik_2ac87786_Rx: ComHandleId=17, ComNotification=Rte_COMCbk_VSS_TP_Auth_ST3_6j4id7sghlvlbroli4wjozjik_2ac87786_Rx, ComSystemTemplateSignalGroupRef=VSS_TP_Auth_ST3_6j4id7sghlvlbroli4wjozjik
          8 x ComGroupSignal, all with ComBitSize=8, ComSignalEndianness=LITTLE_ENDIAN, ComSignalInitValue=255, ComSignalType=UINT8, ComSignalAccess=ACCESS_UNCLEAR:
            VSS_TP_Auth_5_ST3_45cb5ebf_Rx: ComBitPosition=40, ComHandleId=143, ComSystemTemplateSystemSignalRef=VSS_TP_Auth_5_ST3
            VSS_TP_Auth_3_ST3_ca8bab1f_Rx: ComBitPosition=24, ComHandleId=141, ComSystemTemplateSystemSignalRef=VSS_TP_Auth_3_ST3
            VSS_TP_Auth_4_ST3_78ab770f_Rx: ComBitPosition=32, ComHandleId=142, ComSystemTemplateSystemSignalRef=VSS_TP_Auth_4_ST3
            VSS_TP_Auth_2_ST3_f7eb82af_Rx: ComBitPosition=16, ComHandleId=140, ComSystemTemplateSystemSignalRef=VSS_TP_Auth_2_ST3
            VSS_TP_Auth_7_ST3_3f0b0ddf_Rx: ComBitPosition=56, ComHandleId=145, ComSystemTemplateSystemSignalRef=VSS_TP_Auth_7_ST3
            VSS_TP_Auth_0_ST3_8d2bd1cf_Rx: ComBitPosition=0, ComHandleId=138, ComSystemTemplateSystemSignalRef=VSS_TP_Auth_0_ST3
            VSS_TP_Auth_1_ST3_b04bf87f_Rx: ComBitPosition=8, ComHandleId=139, ComSystemTemplateSystemSignalRef=VSS_TP_Auth_1_ST3
            VSS_TP_Auth_6_ST3_026b246f_Rx: ComBitPosition=48, ComHandleId=144, ComSystemTemplateSystemSignalRef=VSS_TP_Auth_6_ST3
        Develop8_Rq_RBTM_FL_ST3_48g6nu8rjjp9s4bhq1x3pz06u_6f2fac01_Rx: ComHandleId=22, ComSystemTemplateSignalGroupRef=Develop8_Rq_RBTM_FL_ST3_48g6nu8rjjp9s4bhq1x3pz06u, variation-point=post-build-variant-condition{matching-criterion=SideAllocation, value=0}
          8 x ComGroupSignal, all with ComBitSize=8, ComSignalEndianness=LITTLE_ENDIAN, ComSignalInitValue=0, ComSignalType=UINT8, ComSignalAccess=ACCESS_UNCLEAR:
            Develop_Rq_RBTM_FL_03_ST3_1a04acc1_Rx: ComBitPosition=16, ComHandleId=182, ComSystemTemplateSystemSignalRef=Develop_Rq_RBTM_FL_03_ST3
            Develop_Rq_RBTM_FL_08_ST3_6dd49dd0_Rx: ComBitPosition=56, ComHandleId=187, ComSystemTemplateSystemSignalRef=Develop_Rq_RBTM_FL_08_ST3
            Develop_Rq_RBTM_FL_07_ST3_ef840a01_Rx: ComBitPosition=48, ComHandleId=186, ComSystemTemplateSystemSignalRef=Develop_Rq_RBTM_FL_07_ST3
            Develop_Rq_RBTM_FL_01_ST3_60c4ffa1_Rx: ComBitPosition=0, ComHandleId=180, ComSystemTemplateSystemSignalRef=Develop_Rq_RBTM_FL_01_ST3
            Develop_Rq_RBTM_FL_05_ST3_95445961_Rx: ComBitPosition=32, ComHandleId=184, ComSystemTemplateSystemSignalRef=Develop_Rq_RBTM_FL_05_ST3
            Develop_Rq_RBTM_FL_06_ST3_d2e423b1_Rx: ComBitPosition=40, ComHandleId=185, ComSystemTemplateSystemSignalRef=Develop_Rq_RBTM_FL_06_ST3
            Develop_Rq_RBTM_FL_04_ST3_a82470d1_Rx: ComBitPosition=24, ComHandleId=183, ComSystemTemplateSystemSignalRef=Develop_Rq_RBTM_FL_04_ST3
            Develop_Rq_RBTM_FL_02_ST3_27648571_Rx: ComBitPosition=8, ComHandleId=181, ComSystemTemplateSystemSignalRef=Develop_Rq_RBTM_FL_02_ST3
      ADAS_PREDICTION_ST3_6_262b63d1_Rx (ComIPdu):
        ComIPduDirection = RECEIVE
        ComIPduType = NORMAL
        ComIPduHandleId = 1
        ComIPduSignalProcessing = DEFERRED
        ComIPduCancellationSupport = false
        ComIPduGroupRef = RBTM_FL_BODY3_Rx_PNC_20_54c591d6 if post-build-variant-condition{matching-criterion=SideAllocation, value=0}
        ComIPduGroupRef = RBTM_FL_BODY3_Rx_PNC_All_Active_46e8c3b2 if post-build-variant-condition{matching-criterion=SideAllocation, value=0}
        ComIPduSignalGroupRef = ADAS_Meta_ST3_40sly585w5zu8pqjwib3nr7y7_6_d1dcd94d_Rx
        ComIPduSignalRef = ADAS_Prediction_MsgTyp_ST36_11a04f12_Rx
        ComPduIdRef = ADAS_PREDICTION_ST3_6_262b63d1_Rx
        ComIPduMainFunctionRef = ComMainFunctionRx
        ComIPduGroupRef = RBTM_FR_BODY3_Rx_PNC_20_02b0f03d if post-build-variant-condition{matching-criterion=SideAllocation, value=1}
        ComIPduGroupRef = RBTM_FR_BODY3_Rx_PNC_All_Active_592f1bcd if post-build-variant-condition{matching-criterion=SideAllocation, value=1}
      ECU_Stat_RBTM_FL_ST3_f703b6eb_Tx (ComIPdu):
        ComIPduDirection = SEND
        ComIPduType = NORMAL
        ComIPduHandleId = 2
        ComIPduSignalProcessing = DEFERRED
        ComIPduCancellationSupport = false
        ComIPduGroupRef = RBTM_FL_BODY3_Tx_PNC_20_27dfe85c
        ComIPduGroupRef = RBTM_FL_BODY3_Tx_PNC_All_Active_e1dc74ba
        ComIPduSignalRef = Awake_Diag_Actv_RBTM_FL_ST3_5efe61d8_Tx
        ComIPduSignalRef = Awake_Ignition_On_RBTM_FL_ST3_49d22bbd_Tx
        ComIPduSignalRef = Awake_NwStart_RBTM_FL_ST3_393ce9b3_Tx
        ComIPduSignalRef = ECU_Id_RBTM_FL_ST3_b4de0ce2_Tx
        ComIPduSignalRef = WakeupRsn_RBTM_FL_ST3_91bb10a0_Tx
        ComPduIdRef = ECU_Stat_RBTM_FL_ST3_f703b6eb_Tx
        ComIPduMainFunctionRef = ComMainFunctionTx
        variation-point = post-build-variant-condition{matching-criterion=SideAllocation, value=0}
        ComTxIPdu: ComTxIPduUnusedAreasDefault=0, ComMinimumDelayTime=0
          ComTxModeTrue
            ComTxMode: ComTxModeMode=PERIODIC, ComTxModeTimeOffset=0, ComTxModeTimePeriod=1
          ComTxModeFalse
            ComTxMode: ComTxModeMode=NONE
      Meas8_RBTM_FL_ST3_72jyquhuktrmjm0hkqempja37_23ddfefa_Tx (ComSignalGroup):
        ComTransferProperty = TRIGGERED
        ComSignalGroupAccess = ACCESS_UNCLEAR
        ComHandleId = 1
        ComSystemTemplateSignalGroupRef = Meas8_RBTM_FL_ST3_72jyquhuktrmjm0hkqempja37
        variation-point = post-build-variant-condition{matching-criterion=SideAllocation, value=0}
        8 x ComGroupSignal, all with ComBitSize=8, ComSignalEndianness=LITTLE_ENDIAN, ComSignalInitValue=0, ComSignalType=UINT8, ComSignalAccess=ACCESS_UNCLEAR, ComTransferProperty=PENDING:
          Meas_RBTM_FL_04_ST3_d179403b_Tx: ComBitPosition=24, ComHandleId=16, ComSystemTemplateSystemSignalRef=Meas_RBTM_FL_04_ST3
          Meas_RBTM_FL_02_ST3_5e39b59b_Tx: ComBitPosition=8, ComHandleId=14, ComSystemTemplateSystemSignalRef=Meas_RBTM_FL_02_ST3
          Meas_RBTM_FL_07_ST3_96d93aeb_Tx: ComBitPosition=48, ComHandleId=19, ComSystemTemplateSystemSignalRef=Meas_RBTM_FL_07_ST3
          Meas_RBTM_FL_05_ST3_ec19698b_Tx: ComBitPosition=32, ComHandleId=17, ComSystemTemplateSystemSignalRef=Meas_RBTM_FL_05_ST3
          Meas_RBTM_FL_01_ST3_1999cf4b_Tx: ComBitPosition=0, ComHandleId=13, ComSystemTemplateSystemSignalRef=Meas_RBTM_FL_01_ST3
          Meas_RBTM_FL_06_ST3_abb9135b_Tx: ComBitPosition=40, ComHandleId=18, ComSystemTemplateSystemSignalRef=Meas_RBTM_FL_06_ST3
          Meas_RBTM_FL_03_ST3_63599c2b_Tx: ComBitPosition=16, ComHandleId=15, ComSystemTemplateSystemSignalRef=Meas_RBTM_FL_03_ST3
          Meas_RBTM_FL_08_ST3_1489ad3a_Tx: ComBitPosition=56, ComHandleId=20, ComSystemTemplateSystemSignalRef=Meas_RBTM_FL_08_ST3
      PT4_PTCoor4_Pr5_ST3_af4fxb1ykieox3itqdfzs0kpb_2277a854_Rx (ComSignalGroup):
        ComSignalGroupArrayAccess = true
        ComTimeout = 1
        ComTransferProperty = TRIGGERED_ON_CHANGE
        ComSignalGroupAccess = ACCESS_UNCLEAR
        ComHandleId = 12
        ComTimeoutNotification = CIL_Powertrain_TimeoutError
        ComNotification = CIL_ComNotification_PT4_PTCoor4_Pr5_ST3_af4fxb1ykieox3itqdfzs0kpb_2277a854_Rx
        ComFirstTimeout = 1
        ComSystemTemplateSignalGroupRef = PT4_PTCoor4_Pr5_ST3_af4fxb1ykieox3itqdfzs0kpb
        6 x ComGroupSignal, all with ComSignalEndianness=LITTLE_ENDIAN, ComSignalAccess=ACCESS_UNCLEAR:
          PT4_PTCoor_PT_Rdy_ST3_3039cfe2_Rx: ComBitPosition=24, ComBitSize=2, ComSignalDataInvalidValue=3, ComSignalInitValue=0, ComSignalType=UINT8, ComHandleId=102, ComSystemTemplateSystemSignalRef=PT4_PTCoor_PT_Rdy_ST3
          CRC_PT4_PTCoor4_Pr5_ST3_7d33cb58_Rx: ComBitPosition=0, ComBitSize=16, ComSignalInitValue=4203, ComSignalType=UINT16, ComHandleId=100, ComSystemTemplateSystemSignalRef=CRC_PT4_PTCoor4_Pr5_ST3
          PT4_PTCoor_EngStartPN14_Stat_ST3_b3436bd4_Rx: ComBitPosition=28, ComBitSize=3, ComSignalDataInvalidValue=7, ComSignalInitValue=0, ComSignalType=UINT8, ComHandleId=101, ComSystemTemplateSystemSignalRef=PT4_PTCoor_EngStartPN14_Stat_ST3
          SQC_PT4_PTCoor4_Pr5_ST3_4539e054_Rx: ComBitPosition=16, ComBitSize=8, ComSignalInitValue=0, ComSignalType=UINT8, ComHandleId=105, ComSystemTemplateSystemSignalRef=SQC_PT4_PTCoor4_Pr5_ST3
          PT4_PTCoor_SSA_EngSp_ST3_b458926e_Rx: ComBitPosition=26, ComBitSize=2, ComSignalDataInvalidValue=3, ComSignalInitValue=3, ComSignalType=UINT8, ComHandleId=103, ComSystemTemplateSystemSignalRef=PT4_PTCoor_SSA_EngSp_ST3
          Rsrv1_PT4_PTCoor_PT_Rdy_Pr5_ST3_e7f327eb_Rx: ComBitPosition=31, ComBitSize=1, ComSignalDataInvalidValue=1, ComSignalInitValue=1, ComSignalType=UINT8, ComHandleId=104, ComSystemTemplateSystemSignalRef=Rsrv1_PT4_PTCoor_PT_Rdy_Pr5_ST3
      VSS_TP_RealTmOffset_ST3_62955a84_Rx (ComIPdu):
        ComIPduDirection = RECEIVE
        ComIPduType = NORMAL
        ComIPduHandleId = 25
        ComIPduSignalProcessing = DEFERRED
        ComIPduCancellationSupport = false
        ComIPduGroupRef = RBTM_FL_BODY3_Rx_PNC_20_54c591d6 if post-build-variant-condition{matching-criterion=SideAllocation, value=0}
        ComIPduGroupRef = RBTM_FL_BODY3_Rx_PNC_All_Active_46e8c3b2 if post-build-variant-condition{matching-criterion=SideAllocation, value=0}
        ComIPduSignalGroupRef = VSS_TP_RealTmOffset_ST3_1t7vc44gftc0wv35k5kgc2in9_d3385ce4_Rx
        ComPduIdRef = VSS_TP_RealTmOffset_ST3_62955a84_Rx
        ComIPduMainFunctionRef = ComMainFunctionRx
        ComIPduGroupRef = RBTM_FR_BODY3_Rx_PNC_20_02b0f03d if post-build-variant-condition{matching-criterion=SideAllocation, value=1}
        ComIPduGroupRef = RBTM_FR_BODY3_Rx_PNC_All_Active_592f1bcd if post-build-variant-condition{matching-criterion=SideAllocation, value=1}
      BltSlckDec_Md_FL_Stat_ST3_e47e790a_Tx (ComSignal):
        ComBitPosition = 0
        ComBitSize = 2
        ComSignalDataInvalidValue = 3
        ComSignalEndianness = LITTLE_ENDIAN
        ComSignalInitValue = 3
        ComSignalType = UINT8
        ComTransferProperty = TRIGGERED_ON_CHANGE
        ComSignalAccess = ACCESS_UNCLEAR
        ComHandleId = 3
        ComSystemTemplateSystemSignalRef = BltSlckDec_Md_FL_Stat_ST3
        variation-point = post-build-variant-condition{matching-criterion=SideAllocation, value=0}
      ADAS_PROFILE_SHORT_ST3_31_05b1585f_Rx (ComIPdu):
        ComIPduDirection = RECEIVE
        ComIPduType = NORMAL
        ComIPduHandleId = 4
        ComIPduSignalProcessing = DEFERRED
        ComIPduCancellationSupport = false
        ComIPduGroupRef = RBTM_FL_BODY3_Rx_PNC_20_54c591d6 if post-build-variant-condition{matching-criterion=SideAllocation, value=0}
        ComIPduGroupRef = RBTM_FL_BODY3_Rx_PNC_All_Active_46e8c3b2 if post-build-variant-condition{matching-criterion=SideAllocation, value=0}
        ComIPduSignalRef = ADAS_ProfShort_ProfTyp_ST331_eb463c84_Rx
        ComPduIdRef = ADAS_PROFILE_SHORT_ST3_31_05b1585f_Rx
        ComIPduMainFunctionRef = ComMainFunctionRx
        ComIPduGroupRef = RBTM_FR_BODY3_Rx_PNC_20_02b0f03d if post-build-variant-condition{matching-criterion=SideAllocation, value=1}
        ComIPduGroupRef = RBTM_FR_BODY3_Rx_PNC_All_Active_592f1bcd if post-build-variant-condition{matching-criterion=SideAllocation, value=1}
      Develop8_Rs_RBTM_FL_ST3_7jg1r8p1skn6yj1t9z2s157vt_a69dcfbb_Tx (ComSignalGroup):
        ComTransferProperty = TRIGGERED
        ComSignalGroupAccess = ACCESS_UNCLEAR
        ComHandleId = 0
        ComSystemTemplateSignalGroupRef = Develop8_Rs_RBTM_FL_ST3_7jg1r8p1skn6yj1t9z2s157vt
        variation-point = post-build-variant-condition{matching-criterion=SideAllocation, value=0}
        8 x ComGroupSignal, all with ComBitSize=8, ComSignalEndianness=LITTLE_ENDIAN, ComSignalInitValue=0, ComSignalType=UINT8, ComSignalAccess=ACCESS_UNCLEAR, ComTransferProperty=PENDING:
          Develop_Rs_RBTM_FL_01_ST3_7a76cd90_Tx: ComBitPosition=0, ComHandleId=4, ComSystemTemplateSystemSignalRef=Develop_Rs_RBTM_FL_01_ST3
          Develop_Rs_RBTM_FL_06_ST3_c8561180_Tx: ComBitPosition=40, ComHandleId=9, ComSystemTemplateSystemSignalRef=Develop_Rs_RBTM_FL_06_ST3
          Develop_Rs_RBTM_FL_05_ST3_8ff66b50_Tx: ComBitPosition=32, ComHandleId=8, ComSystemTemplateSystemSignalRef=Develop_Rs_RBTM_FL_05_ST3
          Develop_Rs_RBTM_FL_04_ST3_b29642e0_Tx: ComBitPosition=24, ComHandleId=7, ComSystemTemplateSystemSignalRef=Develop_Rs_RBTM_FL_04_ST3
          Develop_Rs_RBTM_FL_03_ST3_00b69ef0_Tx: ComBitPosition=16, ComHandleId=6, ComSystemTemplateSystemSignalRef=Develop_Rs_RBTM_FL_03_ST3
          Develop_Rs_RBTM_FL_07_ST3_f5363830_Tx: ComBitPosition=48, ComHandleId=10, ComSystemTemplateSystemSignalRef=Develop_Rs_RBTM_FL_07_ST3
          Develop_Rs_RBTM_FL_08_ST3_7766afe1_Tx: ComBitPosition=56, ComHandleId=11, ComSystemTemplateSystemSignalRef=Develop_Rs_RBTM_FL_08_ST3
          Develop_Rs_RBTM_FL_02_ST3_3dd6b740_Tx: ComBitPosition=8, ComHandleId=5, ComSystemTemplateSystemSignalRef=Develop_Rs_RBTM_FL_02_ST3
      VSS_TP_SecTickCount_Lvl2_ST3_4917056b_Rx (ComIPdu):
        ComIPduDirection = RECEIVE
        ComIPduType = NORMAL
        ComIPduHandleId = 26
        ComIPduSignalProcessing = DEFERRED
        ComIPduCancellationSupport = false
        ComIPduGroupRef = RBTM_FL_BODY3_Rx_PNC_20_54c591d6 if post-build-variant-condition{matching-criterion=SideAllocation, value=0}
        ComIPduGroupRef = RBTM_FL_BODY3_Rx_PNC_All_Active_46e8c3b2 if post-build-variant-condition{matching-criterion=SideAllocation, value=0}
        ComIPduSignalGroupRef = VSS_TP_SecTickCount_Lvl2_ST3_9eubq13iosat764o0lqh5xb6r_01efe31e_Rx
        ComPduIdRef = VSS_TP_SecTickCount_Lvl2_ST3_4917056b_Rx
        ComIPduMainFunctionRef = ComMainFunctionRx
        ComIPduGroupRef = RBTM_FR_BODY3_Rx_PNC_20_02b0f03d if post-build-variant-condition{matching-criterion=SideAllocation, value=1}
        ComIPduGroupRef = RBTM_FR_BODY3_Rx_PNC_All_Active_592f1bcd if post-build-variant-condition{matching-criterion=SideAllocation, value=1}
      Bckl_Sw_Fx_Stat_Pr5_ST3_dihag5a55iw4h5qk539fx0kup_4c948f24_Rx (ComSignalGroup):
        ComSignalGroupArrayAccess = true
        ComTimeout = 1 if post-build-variant-condition{matching-criterion=SideAllocation, value=0}
        ComTransferProperty = TRIGGERED_ON_CHANGE
        ComSignalGroupAccess = ACCESS_NEEDED_BY_SWC_OR_COM
        ComHandleId = 3
        ComTimeoutNotification = CIL_Buckle_TimeoutError
        ComNotification = CIL_ComNotification_Bckl_Sw_Fx_Stat_Pr5_ST3_dihag5a55iw4h5qk539fx0kup_4c948f24_Rx
        ComFirstTimeout = 1
        ComTimeout = 1 if post-build-variant-condition{matching-criterion=SideAllocation, value=1}
        ComSystemTemplateSignalGroupRef = Bckl_Sw_Fx_Stat_Pr5_ST3_dihag5a55iw4h5qk539fx0kup
        5 x ComGroupSignal, all with ComSignalEndianness=LITTLE_ENDIAN, ComSignalAccess=ACCESS_UNCLEAR:
          Rsrv1_Bckl_Sw_Fx_Stat_ST3_8584783a_Rx: ComBitPosition=28, ComBitSize=4, ComSignalDataInvalidValue=15, ComSignalInitValue=15, ComSignalType=UINT8, ComHandleId=41, ComSystemTemplateSystemSignalRef=Rsrv1_Bckl_Sw_Fx_Stat_ST3
          SQC_Bckl_Sw_Fx_Stat_Pr5_ST3_4b42e447_Rx: ComBitPosition=16, ComBitSize=8, ComSignalInitValue=0, ComSignalType=UINT8, ComHandleId=42, ComSystemTemplateSystemSignalRef=SQC_Bckl_Sw_Fx_Stat_Pr5_ST3
          CRC_Bckl_Sw_Fx_Stat_Pr5_ST3_e761a2ea_Rx: ComBitPosition=0, ComBitSize=16, ComSignalInitValue=33522, ComSignalType=UINT16, ComHandleId=40, ComSystemTemplateSystemSignalRef=CRC_Bckl_Sw_Fx_Stat_Pr5_ST3
          Bckl_Sw_FP_Stat_ST3_0736b261_Rx: ComBitPosition=26, ComBitSize=2, ComSignalDataInvalidValue=3, ComSignalInitValue=3, ComSignalType=UINT8, ComHandleId=39, ComSystemTemplateSystemSignalRef=Bckl_Sw_FP_Stat_ST3
          Bckl_Sw_D_Stat_ST3_cb403d1d_Rx: ComBitPosition=24, ComBitSize=2, ComSignalDataInvalidValue=3, ComSignalInitValue=3, ComSignalType=UINT8, ComHandleId=38, ComSystemTemplateSystemSignalRef=Bckl_Sw_D_Stat_ST3
      VSS_TP_Auth_ST3_7c9f23ce_Rx (ComIPdu):
        ComIPduDirection = RECEIVE
        ComIPduType = NORMAL
        ComIPduHandleId = 24
        ComIPduSignalProcessing = DEFERRED
        ComIPduCancellationSupport = false
        ComIPduGroupRef = RBTM_FL_BODY3_Rx_PNC_20_54c591d6 if post-build-variant-condition{matching-criterion=SideAllocation, value=0}
        ComIPduGroupRef = RBTM_FL_BODY3_Rx_PNC_All_Active_46e8c3b2 if post-build-variant-condition{matching-criterion=SideAllocation, value=0}
        ComIPduSignalGroupRef = VSS_TP_Auth_ST3_6j4id7sghlvlbroli4wjozjik_2ac87786_Rx
        ComPduIdRef = VSS_TP_Auth_ST3_7c9f23ce_Rx
        ComIPduMainFunctionRef = ComMainFunctionRx
        ComIPduGroupRef = RBTM_FR_BODY3_Rx_PNC_20_02b0f03d if post-build-variant-condition{matching-criterion=SideAllocation, value=1}
        ComIPduGroupRef = RBTM_FR_BODY3_Rx_PNC_All_Active_592f1bcd if post-build-variant-condition{matching-criterion=SideAllocation, value=1}
      PT4_PTCoor_DrvPosn_Gear_Pr5_ST3_5p8cvrni3ypvuac33rj2asfy9_2f73a7b3_Rx (ComSignalGroup):
        ComSignalGroupArrayAccess = true
        ComTransferProperty = TRIGGERED_ON_CHANGE
        ComSignalGroupAccess = ACCESS_UNCLEAR
        ComHandleId = 14
        ComNotification = CIL_ComNotification_PT4_PTCoor_DrvPosn_Gear_Pr5_ST3_5p8cvrni3ypvuac33rj2asfy9_2f73a7b3_Rx
        ComSystemTemplateSignalGroupRef = PT4_PTCoor_DrvPosn_Gear_Pr5_ST3_5p8cvrni3ypvuac33rj2asfy9
        15 x ComGroupSignal, all with ComSignalEndianness=LITTLE_ENDIAN, ComSignalAccess=ACCESS_UNCLEAR:
          PT4_PTCoor_ShW_MnTrctAxl_N_Allowed_ST3_c9d6edca_Rx: ComBitPosition=52, ComBitSize=2, ComSignalDataInvalidValue=3, ComSignalInitValue=3, ComSignalType=UINT8, ComHandleId=116, ComSystemTemplateSystemSignalRef=PT4_PTCoor_ShW_MnTrctAxl_N_Allowed_ST3
          PT4_PTCoor_DrvPosn_Disp_Rq_ST3_d775bf02_Rx: ComBitPosition=38, ComBitSize=8, ComSignalDataInvalidValue=255, ComSignalInitValue=255, ComSignalType=UINT8, ComHandleId=108, ComSystemTemplateSystemSignalRef=PT4_PTCoor_DrvPosn_Disp_Rq_ST3
          PT4_PTCoor_Gr_ST3_dd0b905e_Rx: ComBitPosition=30, ComBitSize=4, ComSignalDataInvalidValue=15, ComSignalInitValue=15, ComSignalType=UINT8, ComHandleId=112, ComSystemTemplateSystemSignalRef=PT4_PTCoor_Gr_ST3
          PT4_PTCoor_ShW_MnTrctAxl_D_Allowed_ST3_f3898bec_Rx: ComBitPosition=46, ComBitSize=2, ComSignalDataInvalidValue=3, ComSignalInitValue=3, ComSignalType=UINT8, ComHandleId=115, ComSystemTemplateSystemSignalRef=PT4_PTCoor_ShW_MnTrctAxl_D_Allowed_ST3
          PT4_PTCoor_ShW_MnTrctAxl_P_Allow_Drv_ST3_901488c0_Rx: ComBitPosition=60, ComBitSize=2, ComSignalDataInvalidValue=3, ComSignalInitValue=3, ComSignalType=UINT8, ComHandleId=117, ComSystemTemplateSystemSignalRef=PT4_PTCoor_ShW_MnTrctAxl_P_Allow_Drv_ST3
          SQC_PT4_PTCoor_DrvPosn_Gear_Pr5_ST3_940d6b76_Rx: ComBitPosition=16, ComBitSize=8, ComSignalInitValue=0, ComSignalType=UINT8, ComHandleId=121, ComSystemTemplateSystemSignalRef=SQC_PT4_PTCoor_DrvPosn_Gear_Pr5_ST3
          Rsrv1_PT4_PTCoor_DrvPosn_Gear_Pr5_ST3_83426982_Rx: ComBitPosition=62, ComBitSize=2, ComSignalDataInvalidValue=3, ComSignalInitValue=3, ComSignalType=UINT8, ComHandleId=120, ComSystemTemplateSystemSignalRef=Rsrv1_PT4_PTCoor_DrvPosn_Gear_Pr5_ST3
          CRC_PT4_PTCoor_DrvPosn_Gear_Pr5_ST3_b671dc67_Rx: ComBitPosition=0, ComBitSize=16, ComSignalInitValue=47286, ComSignalType=UINT16, ComHandleId=107, ComSystemTemplateSystemSignalRef=CRC_PT4_PTCoor_DrvPosn_Gear_Pr5_ST3
          PT4_PTCoor_Gr_Target_ST3_b5aa8bc3_Rx: ComBitPosition=34, ComBitSize=4, ComSignalDataInvalidValue=15, ComSignalInitValue=15, ComSignalType=UINT8, ComHandleId=113, ComSystemTemplateSystemSignalRef=PT4_PTCoor_Gr_Target_ST3
          PT4_PTCoor_ShW_MnTrctAxl_R_Allowed_ST3_e76bf2eb_Rx: ComBitPosition=58, ComBitSize=2, ComSignalDataInvalidValue=3, ComSignalInitValue=3, ComSignalType=UINT8, ComHandleId=119, ComSystemTemplateSystemSignalRef=PT4_PTCoor_ShW_MnTrctAxl_R_Allowed_ST3
          PT4_PTCoor_DrvPosn_N_Actv_ST3_209a5852_Rx: ComBitPosition=28, ComBitSize=2, ComSignalDataInvalidValue=3, ComSignalInitValue=3, ComSignalType=UINT8, ComHandleId=109, ComSystemTemplateSystemSignalRef=PT4_PTCoor_DrvPosn_N_Actv_ST3
          PT4_PTCoor_DrvPosn_Stat_ST3_af5d60f3_Rx: ComBitPosition=24, ComBitSize=4, ComSignalDataInvalidValue=15, ComSignalInitValue=15, ComSignalType=UINT8, ComHandleId=110, ComSystemTemplateSystemSignalRef=PT4_PTCoor_DrvPosn_Stat_ST3
          PT4_PTCoor_ShW_MnTrctAxl_P_Allowed_ST3_873747a0_Rx: ComBitPosition=54, ComBitSize=2, ComSignalDataInvalidValue=3, ComSignalInitValue=3, ComSignalType=UINT8, ComHandleId=118, ComSystemTemplateSystemSignalRef=PT4_PTCoor_ShW_MnTrctAxl_P_Allowed_ST3
          PT4_PTCoor_DrvPosn_Target_ST3_bba2a0e0_Rx: ComBitPosition=48, ComBitSize=4, ComSignalDataInvalidValue=15, ComSignalInitValue=15, ComSignalType=UINT8, ComHandleId=111, ComSystemTemplateSystemSignalRef=PT4_PTCoor_DrvPosn_Target_ST3
          PT4_PTCoor_SSA_Standby_Stat_ST3_3cbc753b_Rx: ComBitPosition=56, ComBitSize=2, ComSignalDataInvalidValue=3, ComSignalInitValue=0, ComSignalType=UINT8, ComHandleId=114, ComSystemTemplateSystemSignalRef=PT4_PTCoor_SSA_Standby_Stat_ST3
      3 x ComIPdu, all with ComIPduType=NORMAL, ComIPduSignalProcessing=DEFERRED, ComIPduCancellationSupport=false:
        BeltAdj_FL_Stat_ST3_d2ce0dbb_Tx: ComIPduDirection=SEND, ComIPduHandleId=0, ComIPduGroupRef=RBTM_FL_BODY3_Tx_PNC_20_27dfe85c, ComIPduGroupRef=RBTM_FL_BODY3_Tx_PNC_All_Active_e1dc74ba, ComIPduSignalRef=BltSlckDec_Md_FL_Stat_ST3_e47e790a_Tx, ComIPduSignalRef=RevBltTns_FL_ComCyc_Actv_ST3_4c5f745f_Tx, ComPduIdRef=BeltAdj_FL_Stat_ST3_d2ce0dbb_Tx, ComIPduMainFunctionRef=ComMainFunctionTx, variation-point=post-build-variant-condition{matching-criterion=SideAllocation, value=0}
          ComTxIPdu: ComMinimumDelayTime=0.04, ComTxIPduUnusedAreasDefault=255
            ComTxModeTrue
              ComTxMode: ComTxModeMode=MIXED, ComTxModeNumberOfRepetitions=0, ComTxModeTimeOffset=0.01, ComTxModeTimePeriod=1
            ComTxModeFalse
              ComTxMode: ComTxModeMode=NONE
        Bckl_Sw_Fx_Stat_ST3_9c2de10c_Rx: ComIPduDirection=RECEIVE, ComIPduHandleId=5, ComIPduGroupRef=RBTM_FL_BODY3_Rx_PNC_20_54c591d6 if post-build-variant-condition{matching-criterion=SideAllocation, value=0}, ComIPduGroupRef=RBTM_FL_BODY3_Rx_PNC_All_Active_46e8c3b2 if post-build-variant-condition{matching-criterion=SideAllocation, value=0}, ComIPduSignalGroupRef=Bckl_Sw_Fx_Stat_Pr5_ST3_dihag5a55iw4h5qk539fx0kup_4c948f24_Rx, ComPduIdRef=Bckl_Sw_Fx_Stat_ST3_9c2de10c_Rx, ComIPduMainFunctionRef=ComMainFunctionRx, ComIPduGroupRef=RBTM_FR_BODY3_Rx_PNC_20_02b0f03d if post-build-variant-condition{matching-criterion=SideAllocation, value=1}, ComIPduGroupRef=RBTM_FR_BODY3_Rx_PNC_All_Active_592f1bcd if post-build-variant-condition{matching-criterion=SideAllocation, value=1}
        DI_OdoSpeedometer_ST3_6fef7507_Rx: ComIPduDirection=RECEIVE, ComIPduHandleId=10, ComIPduGroupRef=RBTM_FL_BODY3_Rx_PNC_20_54c591d6 if post-build-variant-condition{matching-criterion=SideAllocation, value=0}, ComIPduGroupRef=RBTM_FL_BODY3_Rx_PNC_All_Active_46e8c3b2 if post-build-variant-condition{matching-criterion=SideAllocation, value=0}, ComIPduSignalGroupRef=DI_Odo_Pr5_ST3_e68xmtlkywxgxsdwekdjjhw3t_eb760b63_Rx, ComIPduSignalRef=VehSpd_Disp_ST3_4922a2fd_Rx, ComPduIdRef=DI_OdoSpeedometer_ST3_6fef7507_Rx, ComIPduMainFunctionRef=ComMainFunctionRx, ComIPduGroupRef=RBTM_FR_BODY3_Rx_PNC_20_02b0f03d if post-build-variant-condition{matching-criterion=SideAllocation, value=1}, ComIPduGroupRef=RBTM_FR_BODY3_Rx_PNC_All_Active_592f1bcd if post-build-variant-condition{matching-criterion=SideAllocation, value=1}
      ADAS_Posn_ST3_cre9f2x2lehhx0k4gxnl4u9sg_7bfda340_Rx (ComSignalGroup):
        ComTimeout = 5.1
        ComTransferProperty = PENDING
        ComSignalGroupAccess = ACCESS_UNCLEAR
        ComHandleId = 1
        ComSystemTemplateSignalGroupRef = ADAS_Posn_ST3_cre9f2x2lehhx0k4gxnl4u9sg
        11 x ComGroupSignal, all with ComSignalEndianness=LITTLE_ENDIAN, ComSignalAccess=ACCESS_UNCLEAR:
          ADAS_Posn_Idx_ST3_77906c1b_Rx: ComBitPosition=30, ComBitSize=2, ComSignalInitValue=0, ComSignalType=UINT8, ComHandleId=15, ComSystemTemplateSystemSignalRef=ADAS_Posn_Idx_ST3
          ADAS_Posn_PathIdx_ST3_767b1017_Rx: ComBitPosition=16, ComBitSize=6, ComSignalInitValue=0, ComSignalType=UINT8, ComHandleId=18, ComSystemTemplateSystemSignalRef=ADAS_Posn_PathIdx_ST3
          ADAS_Posn_CycCnt_ST3_1a5fd650_Rx: ComBitPosition=22, ComBitSize=2, ComSignalInitValue=0, ComSignalType=UINT8, ComHandleId=14, ComSystemTemplateSystemSignalRef=ADAS_Posn_CycCnt_ST3
          ADAS_Posn_MsgTyp_ST3_5cd85424_Rx: ComBitPosition=0, ComBitSize=3, ComSignalDataInvalidValue=7, ComSignalInitValue=1, ComSignalType=UINT8, ComHandleId=16, ComSystemTemplateSystemSignalRef=ADAS_Posn_MsgTyp_ST3
          ADAS_Posn_RelHead_ST3_3452334b_Rx: ComBitPosition=56, ComBitSize=8, ComSignalDataInvalidValue=255, ComSignalInitValue=255, ComSignalType=UINT8, ComHandleId=21, ComSystemTemplateSystemSignalRef=ADAS_Posn_RelHead_ST3
          ADAS_Posn_Offset_ST3_f95ee08b_Rx: ComBitPosition=3, ComBitSize=13, ComSignalDataInvalidValue=8191, ComSignalInitValue=8191, ComSignalType=UINT16, ComHandleId=17, ComSystemTemplateSystemSignalRef=ADAS_Posn_Offset_ST3
          ADAS_Posn_CurLane_ST3_a4b581c7_Rx: ComBitPosition=41, ComBitSize=3, ComSignalDataInvalidValue=7, ComSignalInitValue=0, ComSignalType=UINT8, ComHandleId=13, ComSystemTemplateSystemSignalRef=ADAS_Posn_CurLane_ST3
          ADAS_Posn_Age_ST3_5a9b03e1_Rx: ComBitPosition=32, ComBitSize=9, ComSignalDataInvalidValue=511, ComSignalInitValue=511, ComSignalType=UINT32, ComHandleId=12, ComSystemTemplateSystemSignalRef=ADAS_Posn_Age_ST3
          ADAS_Posn_Spd_ST3_89699595_Rx: ComBitPosition=47, ComBitSize=9, ComSignalDataInvalidValue=511, ComSignalInitValue=511, ComSignalType=UINT16, ComHandleId=22, ComSystemTemplateSystemSignalRef=ADAS_Posn_Spd_ST3
          ADAS_Posn_PosProbb_ST3_8f4d30bf_Rx: ComBitPosition=25, ComBitSize=5, ComSignalDataInvalidValue=31, ComSignalInitValue=31, ComSignalType=UINT8, ComHandleId=20, ComSystemTemplateSystemSignalRef=ADAS_Posn_PosProbb_ST3
          ADAS_Posn_PosConfdc_ST3_48dd3431_Rx: ComBitPosition=44, ComBitSize=3, ComSignalDataInvalidValue=7, ComSignalInitValue=7, ComSignalType=UINT8, ComHandleId=19, ComSystemTemplateSystemSignalRef=ADAS_Posn_PosConfdc_ST3
      RBTM_FL_Stat_ST3_dd2436a1_Tx (ComIPdu):
        ComIPduDirection = SEND
        ComIPduType = NORMAL
        ComIPduHandleId = 5
        ComIPduSignalProcessing = DEFERRED
        ComIPduCancellationSupport = false
        ComIPduGroupRef = RBTM_FL_BODY3_Tx_PNC_20_27dfe85c
        ComIPduGroupRef = RBTM_FL_BODY3_Tx_PNC_All_Active_e1dc74ba
        ComIPduSignalRef = PS_Curve_FL_Stat_ST3_b0d41119_Tx
        ComIPduSignalRef = RBTM_FL_Disp_Rq_ST3_c372540c_Tx
        ComIPduSignalRef = RBTM_FL_Tgl_ST3_1fe530ed_Tx
        ComIPduSignalRef = RevBltTns_FL_SafeCyc_Actv_ST3_b0efc754_Tx
        ComPduIdRef = RBTM_FL_Stat_ST3_dd2436a1_Tx
        ComIPduMainFunctionRef = ComMainFunctionTx
        variation-point = post-build-variant-condition{matching-criterion=SideAllocation, value=0}
        ComTxIPdu: ComMinimumDelayTime=0.04, ComTxIPduUnusedAreasDefault=255
          ComTxModeTrue
            ComTxMode: ComTxModeMode=MIXED, ComTxModeNumberOfRepetitions=0, ComTxModeTimeOffset=0.02, ComTxModeTimePeriod=1
          ComTxModeFalse
            ComTxMode: ComTxModeMode=NONE
      ROE_RBTM_FL_ST3_a66ccb5f_Tx (ComIPdu):
        ComIPduDirection = SEND
        ComIPduType = NORMAL
        ComIPduHandleId = 7
        ComIPduSignalProcessing = DEFERRED
        ComIPduCancellationSupport = false
        ComIPduGroupRef = RBTM_FL_BODY3_Tx_PNC_20_27dfe85c
        ComIPduGroupRef = RBTM_FL_BODY3_Tx_PNC_All_Active_e1dc74ba
        ComIPduSignalGroupRef = ROE_RBTM_FL_ST3_6e0rxnifai2txra0wamb18g4m_4feaeebf_Tx
        ComPduIdRef = ROE_RBTM_FL_ST3_a66ccb5f_Tx
        ComIPduMainFunctionRef = ComMainFunctionTx
        variation-point = post-build-variant-condition{matching-criterion=SideAllocation, value=0}
        ComTxIPdu: ComMinimumDelayTime=0.2, ComTxIPduUnusedAreasDefault=0
          ComTxModeTrue
            ComTxMode: ComTxModeMode=DIRECT, ComTxModeNumberOfRepetitions=0
          ComTxModeFalse
            ComTxMode: ComTxModeMode=NONE
      4 x ComSignal, all with ComSignalEndianness=LITTLE_ENDIAN, ComSignalAccess=ACCESS_UNCLEAR:
        ADAS_Prediction_MsgTyp_ST37_66a77f84_Rx: ComBitPosition=0, ComBitSize=3, ComSignalDataInvalidValue=7, ComSignalInitValue=7, ComSignalType=UINT8, ComHandleId=24, ComSystemTemplateSystemSignalRef=ADAS_Prediction_MsgTyp_ST37
        ADAS_ProfShort_ProfTyp_ST331_eb463c84_Rx: ComBitPosition=27, ComBitSize=5, ComSignalDataInvalidValue=31, ComSignalInitValue=31, ComSignalType=UINT8, ComHandleId=26, ComSystemTemplateSystemSignalRef=ADAS_ProfShort_ProfTyp_ST331
        PN14_ProdMd_Stat_ST3_be2b5dfe_Rx: ComBitPosition=5, ComBitSize=3, ComSignalDataInvalidValue=7, ComSignalInitValue=7, ComSignalType=UINT8, ComHandleId=97, ComNotification=CIL_ComNotification_ProdMd_Stat_ST3_be2b5dfe_Rx, ComSystemTemplateSystemSignalRef=PN14_ProdMd_Stat_ST3
        RBTM_FL_Tgl_ST3_1fe530ed_Tx: ComBitPosition=26, ComBitSize=1, ComSignalInitValue=0, ComSignalType=BOOLEAN, ComTransferProperty=PENDING, ComHandleId=27, ComSystemTemplateSystemSignalRef=RBTM_FL_Tgl_ST3, variation-point=post-build-variant-condition{matching-criterion=SideAllocation, value=0}
      PresfAct_Adj_Pr5_ST3_2joar1a41xrgjqab60epnbplm_25141edc_Rx (ComSignalGroup):
        ComSignalGroupArrayAccess = true
        ComTimeout = 2
        ComTransferProperty = PENDING
        ComSignalGroupAccess = ACCESS_NEEDED_BY_SWC_OR_COM
        ComHandleId = 15
        ComTimeoutNotification = CIL_Presafe_TimeoutError
        ComNotification = CIL_ComNotification_PresfAct_Adj_Pr5_ST3_2joar1a41xrgjqab60epnbplm_25141edc_Rx
        ComFirstTimeout = 2
        ComSystemTemplateSignalGroupRef = PresfAct_Adj_Pr5_ST3_2joar1a41xrgjqab60epnbplm
        11 x ComGroupSignal, all with ComSignalEndianness=LITTLE_ENDIAN, ComSignalAccess=ACCESS_UNCLEAR:
          PresfAccelReset_NotExcd_ST3_c7c4d546_Rx: ComBitPosition=24, ComBitSize=2, ComSignalDataInvalidValue=3, ComSignalInitValue=2, ComSignalType=UINT8, ComHandleId=123, ComSystemTemplateSystemSignalRef=PresfAccelReset_NotExcd_ST3
          Presf_Fric_Fctr_Lo_ST3_9b2a29ac_Rx: ComBitPosition=47, ComBitSize=2, ComSignalDataInvalidValue=3, ComSignalInitValue=3, ComSignalType=UINT8, ComHandleId=128, ComSystemTemplateSystemSignalRef=Presf_Fric_Fctr_Lo_ST3
          Presf_Enbl_ST3_40bed323_Rx: ComBitPosition=45, ComBitSize=2, ComSignalDataInvalidValue=3, ComSignalInitValue=3, ComSignalType=UINT8, ComHandleId=126, ComSystemTemplateSystemSignalRef=Presf_Enbl_ST3
          CRC_PresfAct_Adj_Pr5_ST3_901db976_Rx: ComBitPosition=0, ComBitSize=16, ComSignalInitValue=56639, ComSignalType=UINT16, ComHandleId=122, ComSystemTemplateSystemSignalRef=CRC_PresfAct_Adj_Pr5_ST3
          SQC_PresfAct_Adj_Pr5_ST3_9993ff76_Rx: ComBitPosition=16, ComBitSize=8, ComSignalInitValue=0, ComSignalType=UINT8, ComHandleId=132, ComSystemTemplateSystemSignalRef=SQC_PresfAct_Adj_Pr5_ST3
          Presf_FricCoeff_Estim_ST3_b142a105_Rx: ComBitPosition=52, ComBitSize=4, ComSignalDataInvalidValue=15, ComSignalInitValue=15, ComSignalType=UINT8, ComHandleId=127, ComSystemTemplateSystemSignalRef=Presf_FricCoeff_Estim_ST3
          Presf_Lvl_ST3_dc8c82ac_Rx: ComBitPosition=28, ComBitSize=4, ComSignalDataInvalidValue=15, ComSignalInitValue=0, ComSignalType=UINT8, ComHandleId=129, ComSystemTemplateSystemSignalRef=Presf_Lvl_ST3
          Presf_Snd_Rq_ST3_6cb03b74_Rx: ComBitPosition=26, ComBitSize=2, ComSignalDataInvalidValue=3, ComSignalInitValue=0, ComSignalType=UINT8, ComHandleId=130, ComSystemTemplateSystemSignalRef=Presf_Snd_Rq_ST3
          Rsrv6_Presf_Adj_ST3_f21bcfa6_Rx: ComBitPosition=56, ComBitSize=8, ComSignalDataInvalidValue=255, ComSignalInitValue=255, ComSignalType=UINT8, ComHandleId=131, ComSystemTemplateSystemSignalRef=Rsrv6_Presf_Adj_ST3
          PresfAct_Adj_Rq_ST3_e5b37ffb_Rx: ComBitPosition=32, ComBitSize=13, ComSignalInitValue=0, ComSignalType=UINT32, ComHandleId=124, ComSystemTemplateSystemSignalRef=PresfAct_Adj_Rq_ST3
          PresfAct_TensSupp_Rq_ST3_62b93d7a_Rx: ComBitPosition=49, ComBitSize=3, ComSignalDataInvalidValue=7, ComSignalInitValue=7, ComSignalType=UINT8, ComHandleId=125, ComSystemTemplateSystemSignalRef=PresfAct_TensSupp_Rq_ST3
      ComIPduPnc_EIRA_CAN_Rx (ComIPdu):
        ComIPduDirection = RECEIVE
        ComIPduHandleId = 8
        ComIPduSignalProcessing = DEFERRED
        ComIPduType = NORMAL
        ComIPduCancellationSupport = false
        ComIPduSignalRef = ComSignalPnc_EIRA_CAN_Rx
        ComPduIdRef = PduPnc_EIRA_CAN_Rx
        ComIPduMainFunctionRef = ComMainFunctionRx
      TxMess_RBTM_FL_BODY3_e804245a (ComIPduGroup): ComIPduGroupHandleId=4, variation-point=post-build-variant-condition{matching-criterion=SideAllocation, value=0}
      ECU_Id_RBTM_FL_ST3_b4de0ce2_Tx (ComSignal):
        ComBitPosition = 0
        ComBitSize = 12
        ComSignalDataInvalidValue = 4095
        ComSignalEndianness = LITTLE_ENDIAN
        ComSignalInitValue = 420
        ComSignalType = UINT16
        ComTransferProperty = PENDING
        ComSignalAccess = ACCESS_UNCLEAR
        ComHandleId = 12
        ComSystemTemplateSystemSignalRef = ECU_Id_RBTM_FL_ST3
        variation-point = post-build-variant-condition{matching-criterion=SideAllocation, value=0}
      ADAS_Meta_ST3_40sly585w5zu8pqjwib3nr7y7_6_d1dcd94d_Rx (ComSignalGroup):
        ComTimeout = 10.1
        ComTransferProperty = PENDING
        ComSignalGroupAccess = ACCESS_UNCLEAR
        ComHandleId = 0
        ComSystemTemplateSignalGroupRef = ADAS_Meta_ST3_40sly585w5zu8pqjwib3nr7y7
        12 x ComGroupSignal, all with ComSignalEndianness=LITTLE_ENDIAN, ComSignalAccess=ACCESS_UNCLEAR:
          ADAS_Meta_CycCnt_ST36_bb9cdf27_Rx: ComBitPosition=22, ComBitSize=2, ComSignalInitValue=0, ComSignalType=UINT8, ComHandleId=1, ComSystemTemplateSystemSignalRef=ADAS_Meta_CycCnt_ST36
          ADAS_Meta_MapVerQuar_ST36_c498289a_Rx: ComBitPosition=54, ComBitSize=2, ComSignalInitValue=0, ComSignalType=UINT8, ComHandleId=5, ComSystemTemplateSystemSignalRef=ADAS_Meta_MapVerQuar_ST36
          ADAS_Meta_RegionCode_ST36_9e8c91d6_Rx: ComBitPosition=33, ComBitSize=15, ComSignalDataInvalidValue=32767, ComSignalInitValue=32767, ComSignalType=UINT16, ComHandleId=10, ComSystemTemplateSystemSignalRef=ADAS_Meta_RegionCode_ST36
          ADAS_Meta_MapVerYear_ST36_03fbbba9_Rx: ComBitPosition=48, ComBitSize=6, ComSignalDataInvalidValue=63, ComSignalInitValue=63, ComSignalType=UINT8, ComHandleId=6, ComSystemTemplateSystemSignalRef=ADAS_Meta_MapVerYear_ST36
          ADAS_Meta_CountryCode_ST36_533f1e2d_Rx: ComBitPosition=6, ComBitSize=10, ComSignalDataInvalidValue=1023, ComSignalInitValue=0, ComSignalType=UINT16, ComHandleId=0, ComSystemTemplateSystemSignalRef=ADAS_Meta_CountryCode_ST36
          ADAS_Meta_DrvSide_ST36_22c578f2_Rx: ComBitPosition=16, ComBitSize=1, ComSignalInitValue=1, ComSignalType=UINT8, ComHandleId=2, ComSystemTemplateSystemSignalRef=ADAS_Meta_DrvSide_ST36
          ADAS_Meta_SpdUnits_ST36_b689c97b_Rx: ComBitPosition=60, ComBitSize=1, ComSignalInitValue=0, ComSignalType=UINT8, ComHandleId=11, ComSystemTemplateSystemSignalRef=ADAS_Meta_SpdUnits_ST36
          ADAS_Meta_HwVer_ST36_1eda5958_Rx: ComBitPosition=24, ComBitSize=9, ComSignalInitValue=0, ComSignalType=UINT16, ComHandleId=3, ComSystemTemplateSystemSignalRef=ADAS_Meta_HwVer_ST36
          ADAS_Meta_MapProvid_ST36_a95ee03c_Rx: ComBitPosition=3, ComBitSize=3, ComSignalDataInvalidValue=7, ComSignalInitValue=7, ComSignalType=UINT8, ComHandleId=4, ComSystemTemplateSystemSignalRef=ADAS_Meta_MapProvid_ST36
          ADAS_Meta_ProtVer_Major_ST36_db37cb7d_Rx: ComBitPosition=20, ComBitSize=2, ComSignalInitValue=0, ComSignalType=UINT8, ComHandleId=7, ComSystemTemplateSystemSignalRef=ADAS_Meta_ProtVer_Major_ST36
          ADAS_Meta_ProtVer_MinorSub_ST36_acb19add_Rx: ComBitPosition=17, ComBitSize=3, ComSignalInitValue=0, ComSignalType=UINT8, ComHandleId=8, ComSystemTemplateSystemSignalRef=ADAS_Meta_ProtVer_MinorSub_ST36
          ADAS_Meta_ProtVer_Minor_ST36_e4a5679f_Rx: ComBitPosition=56, ComBitSize=4, ComSignalInitValue=0, ComSignalType=UINT8, ComHandleId=9, ComSystemTemplateSystemSignalRef=ADAS_Meta_ProtVer_Minor_ST36
      Awake_Diag_Actv_RBTM_FL_ST3_5efe61d8_Tx (ComSignal):
        ComBitPosition = 30
        ComBitSize = 1
        ComSignalEndianness = LITTLE_ENDIAN
        ComSignalInitValue = 0
        ComSignalType = BOOLEAN
        ComTransferProperty = PENDING
        ComSignalAccess = ACCESS_UNCLEAR
        ComHandleId = 0
        ComSystemTemplateSystemSignalRef = Awake_Diag_Actv_RBTM_FL_ST3
        variation-point = post-build-variant-condition{matching-criterion=SideAllocation, value=0}
      Navi_RouteGuidance_Stat_ST3_ac3bae27_Rx (ComSignal):
        ComBitPosition = 8
        ComBitSize = 2
        ComSignalDataInvalidValue = 3
        ComSignalEndianness = LITTLE_ENDIAN
        ComSignalInitValue = 3
        ComSignalType = UINT8
        ComTimeout = 10.1
        ComSignalAccess = ACCESS_UNCLEAR
        ComHandleId = 77
        ComSystemTemplateSystemSignalRef = Navi_RouteGuidance_Stat_ST3
      VSS_TP_SharedSecret_ST3_605b0fee_Rx (ComIPdu):
        ComIPduDirection = RECEIVE
        ComIPduType = NORMAL
        ComIPduHandleId = 27
        ComIPduSignalProcessing = DEFERRED
        ComIPduCancellationSupport = false
        ComIPduGroupRef = RBTM_FL_BODY3_Rx_PNC_20_54c591d6 if post-build-variant-condition{matching-criterion=SideAllocation, value=0}
        ComIPduGroupRef = RBTM_FL_BODY3_Rx_PNC_All_Active_46e8c3b2 if post-build-variant-condition{matching-criterion=SideAllocation, value=0}
        ComIPduSignalGroupRef = VSS_TP_SharedSecret_ST3_8pj4t8t4rm3tw3pk5hj7vonti_d9a21e4b_Rx
        ComPduIdRef = VSS_TP_SharedSecret_ST3_605b0fee_Rx
        ComIPduMainFunctionRef = ComMainFunctionRx
        ComIPduGroupRef = RBTM_FR_BODY3_Rx_PNC_20_02b0f03d if post-build-variant-condition{matching-criterion=SideAllocation, value=1}
        ComIPduGroupRef = RBTM_FR_BODY3_Rx_PNC_All_Active_592f1bcd if post-build-variant-condition{matching-criterion=SideAllocation, value=1}
      DidA_ExtTest_Pres_ST3_7e50ca1d_Rx (ComSignal):
        ComBitPosition = 2
        ComBitSize = 2
        ComSignalDataInvalidValue = 3
        ComSignalEndianness = LITTLE_ENDIAN
        ComSignalInitValue = 3
        ComSignalType = UINT8
        ComSignalAccess = ACCESS_UNCLEAR
        ComHandleId = 55
        ComTimeout = 1
        ComTimeoutNotification = CIL_ExtTest_Pres_TimeoutError
        ComNotification = CIL_ComNotification_ExtTest_Pres_ST3_7e50ca1d_Rx
        ComFirstTimeout = 1
        ComSystemTemplateSystemSignalRef = DidA_ExtTest_Pres_ST3
      PT4_PTCoor4_ST3_bf069154_Rx (ComIPdu):
        ComIPduDirection = RECEIVE
        ComIPduType = NORMAL
        ComIPduHandleId = 19
        ComIPduSignalProcessing = DEFERRED
        ComIPduCancellationSupport = false
        ComIPduGroupRef = RBTM_FL_BODY3_Rx_PNC_20_54c591d6 if post-build-variant-condition{matching-criterion=SideAllocation, value=0}
        ComIPduGroupRef = RBTM_FL_BODY3_Rx_PNC_All_Active_46e8c3b2 if post-build-variant-condition{matching-criterion=SideAllocation, value=0}
        ComIPduSignalGroupRef = PT4_PTCoor4_Pr5_ST3_af4fxb1ykieox3itqdfzs0kpb_2277a854_Rx
        ComPduIdRef = PT4_PTCoor4_ST3_bf069154_Rx
        ComIPduMainFunctionRef = ComMainFunctionRx
        ComIPduGroupRef = RBTM_FR_BODY3_Rx_PNC_20_02b0f03d if post-build-variant-condition{matching-criterion=SideAllocation, value=1}
        ComIPduGroupRef = RBTM_FR_BODY3_Rx_PNC_All_Active_592f1bcd if post-build-variant-condition{matching-criterion=SideAllocation, value=1}
      ELC_Lvr_Stat_ST3_d97bab99_Rx (ComIPdu):
        ComIPduDirection = RECEIVE
        ComIPduType = NORMAL
        ComIPduHandleId = 12
        ComIPduSignalProcessing = DEFERRED
        ComIPduCancellationSupport = false
        ComIPduGroupRef = RBTM_FL_BODY3_Rx_PNC_20_54c591d6 if post-build-variant-condition{matching-criterion=SideAllocation, value=0}
        ComIPduGroupRef = RBTM_FL_BODY3_Rx_PNC_All_Active_46e8c3b2 if post-build-variant-condition{matching-criterion=SideAllocation, value=0}
        ComIPduSignalGroupRef = ELC_Lvr_Stat_Pr5_ST3_7b68ktfwrvsk1oyozi7cntryn_cd318e5f_Rx
        ComPduIdRef = ELC_Lvr_Stat_ST3_d97bab99_Rx
        ComIPduMainFunctionRef = ComMainFunctionRx
        ComIPduGroupRef = RBTM_FR_BODY3_Rx_PNC_20_02b0f03d if post-build-variant-condition{matching-criterion=SideAllocation, value=1}
        ComIPduGroupRef = RBTM_FR_BODY3_Rx_PNC_All_Active_592f1bcd if post-build-variant-condition{matching-criterion=SideAllocation, value=1}
      RBTM_FL_Disp_Rq_ST3_c372540c_Tx (ComSignal):
        ComBitPosition = 24
        ComBitSize = 2
        ComSignalEndianness = LITTLE_ENDIAN
        ComSignalInitValue = 0
        ComSignalType = UINT8
        ComTransferProperty = TRIGGERED_ON_CHANGE
        ComSignalAccess = ACCESS_UNCLEAR
        ComHandleId = 26
        ComSystemTemplateSystemSignalRef = RBTM_FL_Disp_Rq_ST3
        variation-point = post-build-variant-condition{matching-criterion=SideAllocation, value=0}
      Ign_Stat_ST3_1e3dc39f_Rx (ComIPdu):
        ComIPduDirection = RECEIVE
        ComIPduType = NORMAL
        ComIPduHandleId = 14
        ComIPduSignalProcessing = DEFERRED
        ComIPduCancellationSupport = false
        ComIPduGroupRef = RBTM_FL_BODY3_Rx_PNC_20_54c591d6 if post-build-variant-condition{matching-criterion=SideAllocation, value=0}
        ComIPduGroupRef = RBTM_FL_BODY3_Rx_PNC_All_Active_46e8c3b2 if post-build-variant-condition{matching-criterion=SideAllocation, value=0}
        ComIPduSignalGroupRef = Ign_Stat_Pr5_ST3_csgs1dv6drms80o1i9p49677w_7bdae87d_Rx
        ComPduIdRef = Ign_Stat_ST3_1e3dc39f_Rx
        ComIPduMainFunctionRef = ComMainFunctionRx
        ComIPduGroupRef = RBTM_FR_BODY3_Rx_PNC_20_02b0f03d if post-build-variant-condition{matching-criterion=SideAllocation, value=1}
        ComIPduGroupRef = RBTM_FR_BODY3_Rx_PNC_All_Active_592f1bcd if post-build-variant-condition{matching-criterion=SideAllocation, value=1}
      3 x ComSignal, all with ComBitPosition=0, ComSignalAccess=ACCESS_UNCLEAR:
        RevBltTns_FR_SafeCyc_Actv_ST3_5c8c6ad4_Rx: ComBitSize=2, ComSignalDataInvalidValue=3, ComSignalEndianness=LITTLE_ENDIAN, ComSignalInitValue=3, ComSignalType=UINT8, ComHandleId=190, ComSystemTemplateSystemSignalRef=RevBltTns_FR_SafeCyc_Actv_ST3, variation-point=post-build-variant-condition{matching-criterion=SideAllocation, value=0}
        RevBltTns_FL_SafeCyc_Actv_ST3_b0efc754_Tx: ComBitSize=2, ComSignalDataInvalidValue=3, ComSignalEndianness=LITTLE_ENDIAN, ComSignalInitValue=3, ComSignalType=UINT8, ComTransferProperty=TRIGGERED_ON_CHANGE, ComHandleId=37, ComSystemTemplateSystemSignalRef=RevBltTns_FL_SafeCyc_Actv_ST3, variation-point=post-build-variant-condition{matching-criterion=SideAllocation, value=0}
        ComSignalPnc_EIRA_CAN_Rx: ComSignalInitValue=0 0 0 0 0 0 0, ComSignalLength=7, ComSignalType=UINT8_N, ComSignalEndianness=opaque, ComHandleId=50, ComNotification=ComM_ComCbk_ComSignalPnc_EIRA_CAN_Rx
      VSS_TP_VIN_ST3_bz1xsv84cxzl09j028gn39p69_f31ab3e3_Rx (ComSignalGroup):
        ComTransferProperty = TRIGGERED
        ComSignalGroupAccess = ACCESS_UNCLEAR
        ComHandleId = 21
        ComNotification = Rte_COMCbk_VSS_TP_VIN_ST3_bz1xsv84cxzl09j028gn39p69_f31ab3e3_Rx
        ComTimeoutNotification = Rte_COMCbkRxTOut_VSS_TP_VIN_ST3_bz1xsv84cxzl09j028gn39p69_f31ab3e3_Rx
        ComTimeout = 5
        ComSystemTemplateSignalGroupRef = VSS_TP_VIN_ST3_bz1xsv84cxzl09j028gn39p69
        8 x ComGroupSignal, all with ComBitSize=8, ComSignalEndianness=LITTLE_ENDIAN, ComSignalInitValue=63, ComSignalType=UINT8, ComSignalAccess=ACCESS_UNCLEAR:
          VSS_TP_VIN_6_ST3_7376f174_Rx: ComBitPosition=48, ComHandleId=176, ComSystemTemplateSystemSignalRef=VSS_TP_VIN_6_ST3
          VSS_TP_VIN_4_ST3_09b6a214_Rx: ComBitPosition=32, ComHandleId=174, ComSystemTemplateSystemSignalRef=VSS_TP_VIN_4_ST3
          VSS_TP_VIN_0_ST3_fc3604d4_Rx: ComBitPosition=0, ComHandleId=170, ComSystemTemplateSystemSignalRef=VSS_TP_VIN_0_ST3
          VSS_TP_VIN_3_ST3_bb967e04_Rx: ComBitPosition=24, ComHandleId=173, ComSystemTemplateSystemSignalRef=VSS_TP_VIN_3_ST3
          VSS_TP_VIN_2_ST3_86f657b4_Rx: ComBitPosition=16, ComHandleId=172, ComSystemTemplateSystemSignalRef=VSS_TP_VIN_2_ST3
          VSS_TP_VIN_1_ST3_c1562d64_Rx: ComBitPosition=8, ComHandleId=171, ComSystemTemplateSystemSignalRef=VSS_TP_VIN_1_ST3
          VSS_TP_VIN_7_ST3_4e16d8c4_Rx: ComBitPosition=56, ComHandleId=177, ComSystemTemplateSystemSignalRef=VSS_TP_VIN_7_ST3
          VSS_TP_VIN_5_ST3_34d68ba4_Rx: ComBitPosition=40, ComHandleId=175, ComSystemTemplateSystemSignalRef=VSS_TP_VIN_5_ST3
      Develop8_Rs_RBTM_FL_ST3_9a3b4dd1_Tx (ComIPdu):
        ComIPduDirection = SEND
        ComIPduType = NORMAL
        ComIPduHandleId = 1
        ComIPduSignalProcessing = DEFERRED
        ComIPduCancellationSupport = false
        ComIPduGroupRef = TxMess_RBTM_FL_BODY3_e804245a
        ComIPduSignalGroupRef = Develop8_Rs_RBTM_FL_ST3_7jg1r8p1skn6yj1t9z2s157vt_a69dcfbb_Tx
        ComPduIdRef = Develop8_Rs_RBTM_FL_ST3_9a3b4dd1_Tx
        ComIPduMainFunctionRef = ComMainFunctionTx
        variation-point = post-build-variant-condition{matching-criterion=SideAllocation, value=0}
        ComTxIPdu: ComMinimumDelayTime=0.02, ComTxIPduUnusedAreasDefault=0
          ComTxModeTrue
            ComTxMode: ComTxModeMode=DIRECT, ComTxModeNumberOfRepetitions=0
          ComTxModeFalse
            ComTxMode: ComTxModeMode=NONE
      RevBltTns_FR_ComCyc_Actv_ST3_4c00d29e_Rx (ComSignal):
        ComBitPosition = 2
        ComBitSize = 2
        ComSignalDataInvalidValue = 3
        ComSignalEndianness = LITTLE_ENDIAN
        ComSignalInitValue = 3
        ComSignalType = UINT8
        ComSignalAccess = ACCESS_UNCLEAR
        ComHandleId = 189
        ComSystemTemplateSystemSignalRef = RevBltTns_FR_ComCyc_Actv_ST3
        variation-point = post-build-variant-condition{matching-criterion=SideAllocation, value=0}
      DIAG_Stat_ST3_3a031d4a_Rx (ComIPdu):
        ComIPduDirection = RECEIVE
        ComIPduType = NORMAL
        ComIPduHandleId = 9
        ComIPduSignalProcessing = DEFERRED
        ComIPduCancellationSupport = false
        ComIPduGroupRef = RBTM_FL_BODY3_Rx_PNC_20_54c591d6 if post-build-variant-condition{matching-criterion=SideAllocation, value=0}
        ComIPduGroupRef = RBTM_FL_BODY3_Rx_PNC_All_Active_46e8c3b2 if post-build-variant-condition{matching-criterion=SideAllocation, value=0}
        ComIPduSignalRef = DidA_ExtTest_Pres_ST3_7e50ca1d_Rx
        ComPduIdRef = DIAG_Stat_ST3_3a031d4a_Rx
        ComIPduMainFunctionRef = ComMainFunctionRx
        ComIPduGroupRef = RBTM_FR_BODY3_Rx_PNC_20_02b0f03d if post-build-variant-condition{matching-criterion=SideAllocation, value=1}
        ComIPduGroupRef = RBTM_FR_BODY3_Rx_PNC_All_Active_592f1bcd if post-build-variant-condition{matching-criterion=SideAllocation, value=1}
      PS_Curve_FL_Rq_HU_ST3_6cd299ba_Rx (ComSignal):
        ComBitPosition = 2
        ComBitSize = 2
        ComSignalDataInvalidValue = 3
        ComSignalEndianness = LITTLE_ENDIAN
        ComSignalInitValue = 3
        ComSignalType = UINT8
        ComTimeout = 10.1
        ComSignalAccess = ACCESS_UNCLEAR
        ComHandleId = 188
        ComNotification = Rte_COMCbk_PS_Curve_FL_Rq_HU_ST3_6cd299ba_Rx
        ComTimeoutNotification = Rte_COMCbkRxTOut_PS_Curve_FL_Rq_HU_ST3_6cd299ba_Rx
        ComSystemTemplateSystemSignalRef = PS_Curve_FL_Rq_HU_ST3
        variation-point = post-build-variant-condition{matching-criterion=SideAllocation, value=0}
      RBTM_FL_BODY3_Rx_PNC_All_Active_46e8c3b2 (ComIPduGroup): ComIPduGroupHandleId=1, variation-point=post-build-variant-condition{matching-criterion=SideAllocation, value=0}
      ORC_Impact2_Pr5_ST3_b9l09rrslyv7vj3o92j69irnd_2f5ae8ac_Rx (ComSignalGroup):
        ComSignalGroupArrayAccess = true
        ComTransferProperty = PENDING
        ComSignalGroupAccess = ACCESS_NEEDED_BY_SWC_OR_COM
        ComHandleId = 10
        ComNotification = CIL_ComNotification_ORC_Impact2_Pr5_ST3_b9l09rrslyv7vj3o92j69irnd_2f5ae8ac_Rx
        ComSystemTemplateSignalGroupRef = ORC_Impact2_Pr5_ST3_b9l09rrslyv7vj3o92j69irnd
        8 x ComGroupSignal, all with ComSignalEndianness=LITTLE_ENDIAN, ComSignalAccess=ACCESS_UNCLEAR:
          Impact_R2_ST3_72adc146_Rx: ComBitPosition=26, ComBitSize=1, ComSignalInitValue=0, ComSignalType=BOOLEAN, ComHandleId=81, ComSystemTemplateSystemSignalRef=Impact_R2_ST3
          SQC_ORC_Impact2_Pr5_ST3_6ce0fba5_Rx: ComBitPosition=16, ComBitSize=8, ComSignalInitValue=0, ComSignalType=UINT8, ComHandleId=84, ComSystemTemplateSystemSignalRef=SQC_ORC_Impact2_Pr5_ST3
          VehPosn_ST3_ea170185_Rx: ComBitPosition=29, ComBitSize=3, ComSignalDataInvalidValue=7, ComSignalInitValue=0, ComSignalType=UINT8, ComHandleId=85, ComSystemTemplateSystemSignalRef=VehPosn_ST3
          Impact_R1_ST3_350dbb96_Rx: ComBitPosition=27, ComBitSize=1, ComSignalInitValue=0, ComSignalType=BOOLEAN, ComHandleId=80, ComSystemTemplateSystemSignalRef=Impact_R1_ST3
          Impact_Y_ST3_8edd3644_Rx: ComBitPosition=24, ComBitSize=1, ComSignalInitValue=0, ComSignalType=BOOLEAN, ComHandleId=82, ComSystemTemplateSystemSignalRef=Impact_Y_ST3
          CRC_ORC_Impact2_Pr5_ST3_54ead0a9_Rx: ComBitPosition=0, ComBitSize=16, ComSignalInitValue=38142, ComSignalType=UINT16, ComHandleId=78, ComSystemTemplateSystemSignalRef=CRC_ORC_Impact2_Pr5_ST3
          Impact_P_ST3_83cd5435_Rx: ComBitPosition=28, ComBitSize=1, ComSignalInitValue=0, ComSignalType=BOOLEAN, ComHandleId=79, ComSystemTemplateSystemSignalRef=Impact_P_ST3
          Impact_minor_ST3_4534635b_Rx: ComBitPosition=25, ComBitSize=1, ComSignalInitValue=0, ComSignalType=BOOLEAN, ComHandleId=83, ComSystemTemplateSystemSignalRef=Impact_minor_ST3
      ADAS_Prediction_MsgTyp_ST36_11a04f12_Rx (ComSignal):
        ComBitPosition = 0
        ComBitSize = 3
        ComSignalDataInvalidValue = 7
        ComSignalEndianness = LITTLE_ENDIAN
        ComSignalInitValue = 7
        ComSignalType = UINT8
        ComSignalAccess = ACCESS_UNCLEAR
        ComHandleId = 23
        ComSystemTemplateSystemSignalRef = ADAS_Prediction_MsgTyp_ST36
      Awake_Ignition_On_RBTM_FL_ST3_49d22bbd_Tx (ComSignal):
        ComBitPosition = 32
        ComBitSize = 1
        ComSignalEndianness = LITTLE_ENDIAN
        ComSignalInitValue = 0
        ComSignalType = BOOLEAN
        ComTransferProperty = PENDING
        ComSignalAccess = ACCESS_UNCLEAR
        ComHandleId = 1
        ComSystemTemplateSystemSignalRef = Awake_Ignition_On_RBTM_FL_ST3
        variation-point = post-build-variant-condition{matching-criterion=SideAllocation, value=0}
      PT4_PTCoor9_Pr5_ST3_6r95o81sst3tk9w2lzz600cw3_5dfe4b97_Rx (ComSignalGroup):
        ComTimeout = 5.1
        ComTransferProperty = TRIGGERED_ON_CHANGE
        ComUpdateBitPosition = 7
        ComSignalGroupAccess = ACCESS_UNCLEAR
        ComHandleId = 13
        ComNotification = Rte_COMCbk_PT4_PTCoor9_Pr5_ST3_6r95o81sst3tk9w2lzz600cw3_5dfe4b97_Rx if post-build-variant-condition{matching-criterion=SideAllocation, value=0}
        ComTimeoutNotification = Rte_COMCbkRxTOut_PT4_PTCoor9_Pr5_ST3_6r95o81sst3tk9w2lzz600cw3_5dfe4b97_Rx if post-build-variant-condition{matching-criterion=SideAllocation, value=0}
        ComSystemTemplateSignalGroupRef = PT4_PTCoor9_Pr5_ST3_6r95o81sst3tk9w2lzz600cw3
        PT4_PTCoor_Accel_Md_ST3_cd32fba3_Rx (ComGroupSignal):
          ComBitPosition = 0
          ComBitSize = 3
          ComSignalDataInvalidValue = 7
          ComSignalEndianness = LITTLE_ENDIAN
          ComSignalInitValue = 7
          ComSignalType = UINT8
          ComSignalAccess = ACCESS_UNCLEAR
          ComHandleId = 106
          ComSystemTemplateSystemSignalRef = PT4_PTCoor_Accel_Md_ST3
      3 x ComIPdu, all with ComIPduDirection=RECEIVE, ComIPduType=NORMAL, ComIPduSignalProcessing=DEFERRED, ComIPduCancellationSupport=false, ComIPduGroupRef=RBTM_FL_BODY3_Rx_PNC_20_54c591d6 if post-build-variant-condition{matching-criterion=SideAllocation, value=0}, ComIPduGroupRef=RBTM_FL_BODY3_Rx_PNC_All_Active_46e8c3b2 if post-build-variant-condition{matching-criterion=SideAllocation, value=0}, ComIPduMainFunctionRef=ComMainFunctionRx, ComIPduGroupRef=RBTM_FR_BODY3_Rx_PNC_20_02b0f03d if post-build-variant-condition{matching-criterion=SideAllocation, value=1}, ComIPduGroupRef=RBTM_FR_BODY3_Rx_PNC_All_Active_592f1bcd if post-build-variant-condition{matching-criterion=SideAllocation, value=1}:
        ADAS_POSITION_ST3_0b61d436_Rx: ComIPduHandleId=0, ComIPduSignalGroupRef=ADAS_Posn_ST3_cre9f2x2lehhx0k4gxnl4u9sg_7bfda340_Rx, ComPduIdRef=ADAS_POSITION_ST3_0b61d436_Rx
        DPC_Md_Rq_ESP_d1_ST3_e30f951d_Rx: ComIPduHandleId=11, ComIPduSignalGroupRef=DPC_Md_Rq_ESP_Pr5_ST3_dcsny138uwpesz5bmssj1scqi_6b0a3c02_Rx, ComPduIdRef=DPC_Md_Rq_ESP_d1_ST3_e30f951d_Rx
        ADAS_PREDICTION_ST3_7_512c5347_Rx: ComIPduHandleId=2, ComIPduSignalRef=ADAS_Prediction_MsgTyp_ST37_66a77f84_Rx, ComPduIdRef=ADAS_PREDICTION_ST3_7_512c5347_Rx
      3 x ComSignal, all with ComSignalEndianness=LITTLE_ENDIAN, ComSignalAccess=ACCESS_UNCLEAR:
        WakeupRsn_RBTM_FL_ST3_91bb10a0_Tx: ComBitPosition=20, ComBitSize=10, ComSignalDataInvalidValue=1023, ComSignalInitValue=1023, ComSignalType=UINT16, ComTransferProperty=PENDING, ComHandleId=38, ComSystemTemplateSystemSignalRef=WakeupRsn_RBTM_FL_ST3, variation-point=post-build-variant-condition{matching-criterion=SideAllocation, value=0}
        PS_Curve_FL_Stat_ST3_b0d41119_Tx: ComBitPosition=2, ComBitSize=2, ComSignalDataInvalidValue=3, ComSignalInitValue=3, ComSignalType=UINT8, ComTransferProperty=TRIGGERED_ON_CHANGE, ComHandleId=22, ComSystemTemplateSystemSignalRef=PS_Curve_FL_Stat_ST3, variation-point=post-build-variant-condition{matching-criterion=SideAllocation, value=0}
        PN14_TransMd_Stat_ST3_2208da29_Rx: ComBitPosition=0, ComBitSize=2, ComSignalDataInvalidValue=3, ComSignalInitValue=3, ComSignalType=UINT8, ComHandleId=99, ComNotification=CIL_ComNotification_PN14_TransMd_Stat_ST3_2208da29_Rx, ComSystemTemplateSystemSignalRef=PN14_TransMd_Stat_ST3
      PT4_PTCoor_DrvPosn_Gear_ST3_6b508375_Rx (ComIPdu):
        ComIPduDirection = RECEIVE
        ComIPduType = NORMAL
        ComIPduHandleId = 21
        ComIPduSignalProcessing = DEFERRED
        ComIPduCancellationSupport = false
        ComIPduGroupRef = RBTM_FL_BODY3_Rx_PNC_20_54c591d6 if post-build-variant-condition{matching-criterion=SideAllocation, value=0}
        ComIPduGroupRef = RBTM_FL_BODY3_Rx_PNC_All_Active_46e8c3b2 if post-build-variant-condition{matching-criterion=SideAllocation, value=0}
        ComIPduSignalGroupRef = PT4_PTCoor_DrvPosn_Gear_Pr5_ST3_5p8cvrni3ypvuac33rj2asfy9_2f73a7b3_Rx
        ComPduIdRef = PT4_PTCoor_DrvPosn_Gear_ST3_6b508375_Rx
        ComIPduMainFunctionRef = ComMainFunctionRx
        ComIPduGroupRef = RBTM_FR_BODY3_Rx_PNC_20_02b0f03d if post-build-variant-condition{matching-criterion=SideAllocation, value=1}
        ComIPduGroupRef = RBTM_FR_BODY3_Rx_PNC_All_Active_592f1bcd if post-build-variant-condition{matching-criterion=SideAllocation, value=1}
      PT4_PTCoor9_d1_BC_F_ST3_da786b84_Rx (ComIPdu):
        ComIPduDirection = RECEIVE
        ComIPduType = NORMAL
        ComIPduHandleId = 20
        ComIPduSignalProcessing = DEFERRED
        ComIPduCancellationSupport = false
        ComIPduGroupRef = RBTM_FL_BODY3_Rx_PNC_20_54c591d6 if post-build-variant-condition{matching-criterion=SideAllocation, value=0}
        ComIPduGroupRef = RBTM_FL_BODY3_Rx_PNC_All_Active_46e8c3b2 if post-build-variant-condition{matching-criterion=SideAllocation, value=0}
        ComIPduSignalGroupRef = PT4_PTCoor9_Pr5_ST3_6r95o81sst3tk9w2lzz600cw3_5dfe4b97_Rx
        ComPduIdRef = PT4_PTCoor9_d1_BC_F_ST3_da786b84_Rx
        ComIPduMainFunctionRef = ComMainFunctionRx
        ComIPduGroupRef = RBTM_FR_BODY3_Rx_PNC_20_02b0f03d if post-build-variant-condition{matching-criterion=SideAllocation, value=1}
        ComIPduGroupRef = RBTM_FR_BODY3_Rx_PNC_All_Active_592f1bcd if post-build-variant-condition{matching-criterion=SideAllocation, value=1}
      Awake_NwStart_RBTM_FL_ST3_393ce9b3_Tx (ComSignal):
        ComBitPosition = 31
        ComBitSize = 1
        ComSignalEndianness = LITTLE_ENDIAN
        ComSignalInitValue = 0
        ComSignalType = BOOLEAN
        ComTransferProperty = PENDING
        ComSignalAccess = ACCESS_UNCLEAR
        ComHandleId = 2
        ComSystemTemplateSystemSignalRef = Awake_NwStart_RBTM_FL_ST3
        variation-point = post-build-variant-condition{matching-criterion=SideAllocation, value=0}
      PresfAct_Adj_ST3_61c58c91_Rx (ComIPdu):
        ComIPduDirection = RECEIVE
        ComIPduType = NORMAL
        ComIPduHandleId = 22
        ComIPduSignalProcessing = DEFERRED
        ComIPduCancellationSupport = false
        ComIPduGroupRef = RBTM_FL_BODY3_Rx_PNC_20_54c591d6 if post-build-variant-condition{matching-criterion=SideAllocation, value=0}
        ComIPduGroupRef = RBTM_FL_BODY3_Rx_PNC_All_Active_46e8c3b2 if post-build-variant-condition{matching-criterion=SideAllocation, value=0}
        ComIPduSignalGroupRef = PresfAct_Adj_Pr5_ST3_2joar1a41xrgjqab60epnbplm_25141edc_Rx
        ComPduIdRef = PresfAct_Adj_ST3_61c58c91_Rx
        ComIPduMainFunctionRef = ComMainFunctionRx
        ComIPduGroupRef = RBTM_FR_BODY3_Rx_PNC_20_02b0f03d if post-build-variant-condition{matching-criterion=SideAllocation, value=1}
        ComIPduGroupRef = RBTM_FR_BODY3_Rx_PNC_All_Active_592f1bcd if post-build-variant-condition{matching-criterion=SideAllocation, value=1}
      BltSlckDec_Md_Rq_HU_ST3_64a95ccf_Rx (ComSignal):
        ComBitPosition = 0
        ComBitSize = 2
        ComSignalDataInvalidValue = 3
        ComSignalEndianness = LITTLE_ENDIAN
        ComSignalInitValue = 3
        ComSignalType = UINT8
        ComTimeout = 10.5
        ComSignalAccess = ACCESS_UNCLEAR
        ComHandleId = 43
        ComNotification = CIL_ComNotification_BltSlckDec_Md_Rq_HU_ST3_64a95ccf_Rx
        ComTimeoutNotification = CIL_BeltAdj_TimeoutError
        ComFirstTimeout = 10
        ComSystemTemplateSystemSignalRef = BltSlckDec_Md_Rq_HU_ST3
      VSS_TP_VIN_ST3_8e87972a_Rx (ComIPdu):
        ComIPduDirection = RECEIVE
        ComIPduType = NORMAL
        ComIPduHandleId = 28
        ComIPduSignalProcessing = DEFERRED
        ComIPduCancellationSupport = false
        ComIPduGroupRef = RBTM_FL_BODY3_Rx_PNC_20_54c591d6 if post-build-variant-condition{matching-criterion=SideAllocation, value=0}
        ComIPduGroupRef = RBTM_FL_BODY3_Rx_PNC_All_Active_46e8c3b2 if post-build-variant-condition{matching-criterion=SideAllocation, value=0}
        ComIPduSignalGroupRef = VSS_TP_VIN_ST3_bz1xsv84cxzl09j028gn39p69_f31ab3e3_Rx
        ComPduIdRef = VSS_TP_VIN_ST3_8e87972a_Rx
        ComIPduMainFunctionRef = ComMainFunctionRx
        ComIPduGroupRef = RBTM_FR_BODY3_Rx_PNC_20_02b0f03d if post-build-variant-condition{matching-criterion=SideAllocation, value=1}
        ComIPduGroupRef = RBTM_FR_BODY3_Rx_PNC_All_Active_592f1bcd if post-build-variant-condition{matching-criterion=SideAllocation, value=1}
      RevBltTns_FL_ComCyc_Actv_ST3_4c5f745f_Tx (ComSignal):
        ComBitPosition = 2
        ComBitSize = 2
        ComSignalDataInvalidValue = 3
        ComSignalEndianness = LITTLE_ENDIAN
        ComSignalInitValue = 3
        ComSignalType = UINT8
        ComTransferProperty = TRIGGERED_ON_CHANGE
        ComSignalAccess = ACCESS_UNCLEAR
        ComHandleId = 36
        ComSystemTemplateSystemSignalRef = RevBltTns_FL_ComCyc_Actv_ST3
        variation-point = post-build-variant-condition{matching-criterion=SideAllocation, value=0}
      BeltHdOvr_FL_State_ST3_342163b7_Rx (ComIPdu):
        ComIPduDirection = RECEIVE
        ComIPduType = NORMAL
        ComIPduHandleId = 30
        ComIPduSignalProcessing = DEFERRED
        ComIPduCancellationSupport = false
        ComIPduGroupRef = RBTM_FL_BODY3_Rx_PNC_20_54c591d6
        ComIPduGroupRef = RBTM_FL_BODY3_Rx_PNC_All_Active_46e8c3b2
        ComIPduSignalRef = BeltHdOvr_FL_Stat_ST3_3489841d_Rx
        ComPduIdRef = BeltHdOvr_FL_State_ST3_342163b7_Rx
        ComIPduMainFunctionRef = ComMainFunctionRx
        variation-point = post-build-variant-condition{matching-criterion=SideAllocation, value=0}
      ADAS_ProfShort_ProfTyp_ST31_a96eaafe_Rx (ComSignal):
        ComBitPosition = 27
        ComBitSize = 5
        ComSignalDataInvalidValue = 31
        ComSignalEndianness = LITTLE_ENDIAN
        ComSignalInitValue = 31
        ComSignalType = UINT8
        ComSignalAccess = ACCESS_UNCLEAR
        ComHandleId = 25
        ComSystemTemplateSystemSignalRef = ADAS_ProfShort_ProfTyp_ST31
      BeltAdj_UI_Set_Rq_ST3_1223a83d_Rx (ComIPdu):
        ComIPduDirection = RECEIVE
        ComIPduType = NORMAL
        ComIPduHandleId = 6
        ComIPduSignalProcessing = DEFERRED
        ComIPduCancellationSupport = false
        ComIPduGroupRef = RBTM_FL_BODY3_Rx_PNC_20_54c591d6 if post-build-variant-condition{matching-criterion=SideAllocation, value=0}
        ComIPduGroupRef = RBTM_FL_BODY3_Rx_PNC_All_Active_46e8c3b2 if post-build-variant-condition{matching-criterion=SideAllocation, value=0}
        ComIPduSignalRef = BltSlckDec_Md_Rq_HU_ST3_64a95ccf_Rx
        ComIPduSignalRef = PS_Curve_FL_Rq_HU_ST3_6cd299ba_Rx if post-build-variant-condition{matching-criterion=SideAllocation, value=0}
        ComPduIdRef = BeltAdj_UI_Set_Rq_ST3_1223a83d_Rx
        ComIPduMainFunctionRef = ComMainFunctionRx
        ComIPduGroupRef = RBTM_FR_BODY3_Rx_PNC_20_02b0f03d if post-build-variant-condition{matching-criterion=SideAllocation, value=1}
        ComIPduGroupRef = RBTM_FR_BODY3_Rx_PNC_All_Active_592f1bcd if post-build-variant-condition{matching-criterion=SideAllocation, value=1}
        ComIPduSignalRef = PS_Curve_FR_Rq_HU_ST3_90527677_Rx if post-build-variant-condition{matching-criterion=SideAllocation, value=1}
      DPC_Md_Rq_ESP_Pr5_ST3_dcsny138uwpesz5bmssj1scqi_6b0a3c02_Rx (ComSignalGroup):
        ComTransferProperty = TRIGGERED_ON_CHANGE
        ComUpdateBitPosition = 5
        ComSignalGroupAccess = ACCESS_UNCLEAR
        ComHandleId = 6
        ComSystemTemplateSignalGroupRef = DPC_Md_Rq_ESP_Pr5_ST3_dcsny138uwpesz5bmssj1scqi
        DPC_Md_PT_Rq_ST3_221f27a4_Rx (ComGroupSignal):
          ComBitPosition = 0
          ComBitSize = 5
          ComSignalDataInvalidValue = 31
          ComSignalEndianness = LITTLE_ENDIAN
          ComSignalInitValue = 0
          ComSignalType = UINT8
          ComSignalAccess = ACCESS_UNCLEAR
          ComHandleId = 54
          ComSystemTemplateSystemSignalRef = DPC_Md_PT_Rq_ST3
      NM_RBTM_FL_ST3_PNC_785a2d76_Tx (ComSignal):
        ComBitPosition = 0
        ComSignalEndianness = opaque
        ComSignalInitValue = 0 0 0 0 0 0 0
        ComSignalLength = 7
        ComSignalType = UINT8_N
        ComTransferProperty = PENDING
        ComSignalAccess = ACCESS_UNCLEAR
        ComHandleId = 21
        ComSystemTemplateSystemSignalRef = NM_RBTM_FL_ST3_PNC
        variation-point = post-build-variant-condition{matching-criterion=SideAllocation, value=0}
      EVC_CfgList_01_08_Pr5_ST3_co3q1mwsf7pwxo2ix5jryc04x_3a43a00a_Rx (ComSignalGroup):
        ComSignalGroupArrayAccess = true
        ComTimeout = 2.5
        ComTransferProperty = PENDING
        ComSignalGroupAccess = ACCESS_UNCLEAR
        ComHandleId = 8
        ComTimeoutNotification = Rte_COMCbkRxTOut_EVC_CfgList_01_08_Pr5_ST3_co3q1mwsf7pwxo2ix5jryc04x_3a43a00a_Rx
        ComNotification = CIL_ComNotification_EVC_CfgList_01_08_Pr5_ST3_co3q1mwsf7pwxo2ix5jryc04x_3a43a00a_Rx
        ComSystemTemplateSignalGroupRef = EVC_CfgList_01_08_Pr5_ST3_co3q1mwsf7pwxo2ix5jryc04x
        11 x ComGroupSignal, all with ComSignalEndianness=LITTLE_ENDIAN, ComSignalAccess=ACCESS_UNCLEAR:
          EVC_List02_VehLine_ST3_bbfa2725_Rx: ComBitPosition=32, ComBitSize=6, ComSignalInitValue=63, ComSignalType=UINT8, ComHandleId=64, ComSystemTemplateSystemSignalRef=EVC_List02_VehLine_ST3
          EVC_List07_TxStyle_ST3_fcb30cad_Rx: ComBitPosition=56, ComBitSize=4, ComSignalInitValue=15, ComSignalType=UINT8, ComHandleId=69, ComSystemTemplateSystemSignalRef=EVC_List07_TxStyle_ST3
          EVC_List04_YrOfModf_2_ST3_3da05805_Rx: ComBitPosition=40, ComBitSize=4, ComSignalInitValue=15, ComSignalType=UINT8, ComHandleId=66, ComSystemTemplateSystemSignalRef=EVC_List04_YrOfModf_2_ST3
          EVC_List08_HL_Style_ST3_f988c239_Rx: ComBitPosition=60, ComBitSize=4, ComSignalInitValue=15, ComSignalType=UINT8, ComHandleId=70, ComSystemTemplateSystemSignalRef=EVC_List08_HL_Style_ST3
          SQC_EVC_CfgList_01_08_Pr5_ST3_cb2c2130_Rx: ComBitPosition=16, ComBitSize=8, ComSignalInitValue=0, ComSignalType=UINT8, ComHandleId=71, ComSystemTemplateSystemSignalRef=SQC_EVC_CfgList_01_08_Pr5_ST3
          EVC_List06_Country_ST3_82113093_Rx: ComBitPosition=48, ComBitSize=8, ComSignalInitValue=255, ComSignalType=UINT8, ComHandleId=68, ComSystemTemplateSystemSignalRef=EVC_List06_Country_ST3
          EVC_List01_BodyStyle_ST3_a3504531_Rx: ComBitPosition=26, ComBitSize=6, ComSignalInitValue=63, ComSignalType=UINT8, ComHandleId=63, ComSystemTemplateSystemSignalRef=EVC_List01_BodyStyle_ST3
          EVC_List03_StStyle_ST3_0f0d9336_Rx: ComBitPosition=38, ComBitSize=2, ComSignalDataInvalidValue=3, ComSignalInitValue=3, ComSignalType=UINT8, ComHandleId=65, ComSystemTemplateSystemSignalRef=EVC_List03_StStyle_ST3
          EVC_List05_YrOfModf_1_ST3_d468b344_Rx: ComBitPosition=44, ComBitSize=4, ComSignalInitValue=15, ComSignalType=UINT8, ComHandleId=67, ComSystemTemplateSystemSignalRef=EVC_List05_YrOfModf_1_ST3
          CRC_EVC_CfgList_01_08_Pr5_ST3_4f3aab12_Rx: ComBitPosition=0, ComBitSize=16, ComSignalInitValue=46137, ComSignalType=UINT16, ComHandleId=61, ComSystemTemplateSystemSignalRef=CRC_EVC_CfgList_01_08_Pr5_ST3
          EVC_CfgList_01_08_Stat_ST3_93476784_Rx: ComBitPosition=24, ComBitSize=2, ComSignalDataInvalidValue=3, ComSignalInitValue=3, ComSignalType=UINT8, ComHandleId=62, ComSystemTemplateSystemSignalRef=EVC_CfgList_01_08_Stat_ST3
      PN14_DDP_Sw_Stat_ST3_568ad7e6_Rx (ComSignal):
        ComBitPosition = 2
        ComBitSize = 3
        ComSignalDataInvalidValue = 7
        ComSignalEndianness = LITTLE_ENDIAN
        ComSignalInitValue = 0
        ComSignalType = UINT8
        ComSignalAccess = ACCESS_UNCLEAR
        ComHandleId = 96
        ComNotification = Rte_COMCbk_PN14_DDP_Sw_Stat_ST3_568ad7e6_Rx
        ComSystemTemplateSystemSignalRef = PN14_DDP_Sw_Stat_ST3
      CLkS_Dr_State_ST3_513e9c19_Rx (ComIPdu):
        ComIPduDirection = RECEIVE
        ComIPduType = NORMAL
        ComIPduHandleId = 7
        ComIPduSignalProcessing = DEFERRED
        ComIPduCancellationSupport = false
        ComIPduGroupRef = RBTM_FL_BODY3_Rx_PNC_20_54c591d6 if post-build-variant-condition{matching-criterion=SideAllocation, value=0}
        ComIPduGroupRef = RBTM_FL_BODY3_Rx_PNC_All_Active_46e8c3b2 if post-build-variant-condition{matching-criterion=SideAllocation, value=0}
        ComIPduSignalGroupRef = CLkS_DrRltch_Stat_Pr5_ST3_7at68qvnk0r9npofyykyfq82v_10e0cb0e_Rx
        ComPduIdRef = CLkS_Dr_State_ST3_513e9c19_Rx
        ComIPduMainFunctionRef = ComMainFunctionRx
        ComIPduGroupRef = RBTM_FR_BODY3_Rx_PNC_20_02b0f03d if post-build-variant-condition{matching-criterion=SideAllocation, value=1}
        ComIPduGroupRef = RBTM_FR_BODY3_Rx_PNC_All_Active_592f1bcd if post-build-variant-condition{matching-criterion=SideAllocation, value=1}
      DI_Odo_Pr5_ST3_e68xmtlkywxgxsdwekdjjhw3t_eb760b63_Rx (ComSignalGroup):
        ComSignalGroupArrayAccess = true
        ComTransferProperty = TRIGGERED_ON_CHANGE
        ComUpdateBitPosition = 63
        ComSignalGroupAccess = ACCESS_UNCLEAR
        ComHandleId = 5
        ComSystemTemplateSignalGroupRef = DI_Odo_Pr5_ST3_e68xmtlkywxgxsdwekdjjhw3t
        3 x ComGroupSignal, all with ComSignalEndianness=LITTLE_ENDIAN, ComSignalAccess=ACCESS_UNCLEAR:
          Odo_ST3_657046b6_Rx: ComBitPosition=24, ComBitSize=24, ComSignalDataInvalidValue=16777215, ComSignalInitValue=16777215, ComSignalType=UINT32, ComHandleId=52, ComSystemTemplateSystemSignalRef=Odo_ST3
          CRC_DI_Odo_Pr5_ST3_ca96419c_Rx: ComBitPosition=0, ComBitSize=16, ComSignalInitValue=8633, ComSignalType=UINT16, ComHandleId=51, ComSystemTemplateSystemSignalRef=CRC_DI_Odo_Pr5_ST3
          SQC_DI_Odo_Pr5_ST3_b7af4600_Rx: ComBitPosition=16, ComBitSize=8, ComSignalInitValue=0, ComSignalType=UINT8, ComHandleId=53, ComSystemTemplateSystemSignalRef=SQC_DI_Odo_Pr5_ST3
      ELC_Lvr_Stat_Pr5_ST3_7b68ktfwrvsk1oyozi7cntryn_cd318e5f_Rx (ComSignalGroup):
        ComSignalGroupArrayAccess = true
        ComTimeout = 1.1
        ComTransferProperty = TRIGGERED_ON_CHANGE
        ComSignalGroupAccess = ACCESS_UNCLEAR
        ComHandleId = 7
        ComSystemTemplateSignalGroupRef = ELC_Lvr_Stat_Pr5_ST3_7b68ktfwrvsk1oyozi7cntryn
        5 x ComGroupSignal, all with ComSignalEndianness=LITTLE_ENDIAN, ComSignalAccess=ACCESS_UNCLEAR:
          ELC_TurnIndLvr_Stat_ST3_16708a3c_Rx: ComBitPosition=24, ComBitSize=2, ComSignalDataInvalidValue=3, ComSignalInitValue=0, ComSignalType=UINT8, ComHandleId=58, ComSystemTemplateSystemSignalRef=ELC_TurnIndLvr_Stat_ST3
          SQC_ELC_Lvr_Stat_Pr5_ST3_0faa536b_Rx: ComBitPosition=16, ComBitSize=8, ComSignalInitValue=0, ComSignalType=UINT8, ComHandleId=60, ComSystemTemplateSystemSignalRef=SQC_ELC_Lvr_Stat_Pr5_ST3
          CRC_ELC_Lvr_Stat_Pr5_ST3_0624156b_Rx: ComBitPosition=0, ComBitSize=16, ComSignalInitValue=40318, ComSignalType=UINT16, ComHandleId=56, ComSystemTemplateSystemSignalRef=CRC_ELC_Lvr_Stat_Pr5_ST3
          ELC_HiBmLvr_Stat_ST3_e6f8b687_Rx: ComBitPosition=26, ComBitSize=2, ComSignalDataInvalidValue=3, ComSignalInitValue=0, ComSignalType=UINT8, ComHandleId=57, ComSystemTemplateSystemSignalRef=ELC_HiBmLvr_Stat_ST3
          Rsrv1_ELC_Lvr_Stat_Pr5_ST3_f3d8e141_Rx: ComBitPosition=28, ComBitSize=4, ComSignalDataInvalidValue=15, ComSignalInitValue=15, ComSignalType=UINT8, ComHandleId=59, ComSystemTemplateSystemSignalRef=Rsrv1_ELC_Lvr_Stat_Pr5_ST3
      RBTM_FL_BODY3_Tx_PNC_All_Active_e1dc74ba (ComIPduGroup): ComIPduGroupHandleId=3, variation-point=post-build-variant-condition{matching-criterion=SideAllocation, value=0}
      BeltHdOvr_FL_Stat_ST3_3489841d_Rx (ComSignal):
        ComBitPosition = 0
        ComBitSize = 2
        ComSignalDataInvalidValue = 3
        ComSignalEndianness = LITTLE_ENDIAN
        ComSignalInitValue = 3
        ComSignalType = UINT8
        ComTimeout = 2.5
        ComSignalAccess = ACCESS_UNCLEAR
        ComHandleId = 179
        ComTimeoutNotification = CIL_BltHandoverLeft_TimeoutError
        ComNotification = CIL_ComNotification_BeltHdOvr_FL_Stat_ST3_3489841d_Rx
        ComFirstTimeout = 2.5
        ComSystemTemplateSystemSignalRef = BeltHdOvr_FL_Stat_ST3
        variation-point = post-build-variant-condition{matching-criterion=SideAllocation, value=0}
      ADAS_Profile_Short_CurvLn_ST3_96e9ejcafisp13h7moqj5malh_1_aac62a51_Rx (ComSignalGroup):
        ComTimeout = 1.1
        ComTransferProperty = PENDING
        ComSignalGroupAccess = ACCESS_UNCLEAR
        ComHandleId = 2
        ComSystemTemplateSignalGroupRef = ADAS_Profile_Short_CurvLn_ST3_96e9ejcafisp13h7moqj5malh
        11 x ComGroupSignal, all with ComSignalEndianness=LITTLE_ENDIAN, ComSignalAccess=ACCESS_UNCLEAR:
          ADAS_ProfShort_AccurClass_CL_ST31_f1371770_Rx: ComBitPosition=32, ComBitSize=2, ComSignalInitValue=0, ComSignalType=UINT8, ComHandleId=27, ComSystemTemplateSystemSignalRef=ADAS_ProfShort_AccurClass_CL_ST31
          ADAS_ProfShort_ReTr_CL_ST31_8166ae07_Rx: ComBitPosition=25, ComBitSize=1, ComSignalInitValue=0, ComSignalType=UINT8, ComHandleId=34, ComSystemTemplateSystemSignalRef=ADAS_ProfShort_ReTr_CL_ST31
          ADAS_ProfShort_Updt_CL_ST31_31b6d4b3_Rx: ComBitPosition=24, ComBitSize=1, ComSignalInitValue=0, ComSignalType=UINT8, ComHandleId=35, ComSystemTemplateSystemSignalRef=ADAS_ProfShort_Updt_CL_ST31
          ADAS_ProfShort_Value0_CL_ST31_6c970c4b_Rx: ComBitPosition=34, ComBitSize=10, ComSignalDataInvalidValue=1023, ComSignalInitValue=1023, ComSignalType=UINT16, ComHandleId=36, ComSystemTemplateSystemSignalRef=ADAS_ProfShort_Value0_CL_ST31
          ADAS_ProfShort_Value1_CL_ST31_7bec1808_Rx: ComBitPosition=54, ComBitSize=10, ComSignalDataInvalidValue=1023, ComSignalInitValue=0, ComSignalType=UINT16, ComHandleId=37, ComSystemTemplateSystemSignalRef=ADAS_ProfShort_Value1_CL_ST31
          ADAS_ProfShort_Dist1_CL_ST31_455ed63e_Rx: ComBitPosition=44, ComBitSize=10, ComSignalDataInvalidValue=1023, ComSignalInitValue=0, ComSignalType=UINT16, ComHandleId=30, ComSystemTemplateSystemSignalRef=ADAS_ProfShort_Dist1_CL_ST31
          ADAS_ProfShort_PathIdx_CL_ST31_9989379b_Rx: ComBitPosition=16, ComBitSize=6, ComSignalInitValue=0, ComSignalType=UINT8, ComHandleId=33, ComSystemTemplateSystemSignalRef=ADAS_ProfShort_PathIdx_CL_ST31
          ADAS_ProfShort_CtrlPoint_CL_ST31_6fbe8af5_Rx: ComBitPosition=26, ComBitSize=1, ComSignalInitValue=0, ComSignalType=UINT8, ComHandleId=28, ComSystemTemplateSystemSignalRef=ADAS_ProfShort_CtrlPoint_CL_ST31
          ADAS_ProfShort_MsgTyp_CL_ST31_44c68e23_Rx: ComBitPosition=0, ComBitSize=3, ComSignalDataInvalidValue=7, ComSignalInitValue=4, ComSignalType=UINT8, ComHandleId=31, ComSystemTemplateSystemSignalRef=ADAS_ProfShort_MsgTyp_CL_ST31
          ADAS_ProfShort_CycCnt_CL_ST31_a9579c2f_Rx: ComBitPosition=22, ComBitSize=2, ComSignalInitValue=0, ComSignalType=UINT8, ComHandleId=29, ComSystemTemplateSystemSignalRef=ADAS_ProfShort_CycCnt_CL_ST31
          ADAS_ProfShort_Offset_CL_ST31_58fcb916_Rx: ComBitPosition=3, ComBitSize=13, ComSignalDataInvalidValue=8191, ComSignalInitValue=8191, ComSignalType=UINT16, ComHandleId=32, ComSystemTemplateSystemSignalRef=ADAS_ProfShort_Offset_CL_ST31
      NTG_Master_Navi_ST3_dea580a6_Rx (ComIPdu):
        ComIPduDirection = RECEIVE
        ComIPduType = NORMAL
        ComIPduHandleId = 17
        ComIPduSignalProcessing = DEFERRED
        ComIPduCancellationSupport = false
        ComIPduGroupRef = RBTM_FL_BODY3_Rx_PNC_20_54c591d6 if post-build-variant-condition{matching-criterion=SideAllocation, value=0}
        ComIPduGroupRef = RBTM_FL_BODY3_Rx_PNC_All_Active_46e8c3b2 if post-build-variant-condition{matching-criterion=SideAllocation, value=0}
        ComIPduSignalRef = Navi_RouteGuidance_Stat_ST3_ac3bae27_Rx
        ComPduIdRef = NTG_Master_Navi_ST3_dea580a6_Rx
        ComIPduMainFunctionRef = ComMainFunctionRx
        ComIPduGroupRef = RBTM_FR_BODY3_Rx_PNC_20_02b0f03d if post-build-variant-condition{matching-criterion=SideAllocation, value=1}
        ComIPduGroupRef = RBTM_FR_BODY3_Rx_PNC_All_Active_592f1bcd if post-build-variant-condition{matching-criterion=SideAllocation, value=1}
      ORC_Impact3_Pr5_ST3_c4pqnkonfjwv3uiohsxhe9dwu_1bc89a3a_Rx (ComSignalGroup):
        ComSignalGroupArrayAccess = true
        ComTransferProperty = PENDING
        ComSignalGroupAccess = ACCESS_NEEDED_BY_SWC_OR_COM
        ComHandleId = 11
        ComNotification = CIL_ComNotification_ORC_Impact3_Pr5_ST3_c4pqnkonfjwv3uiohsxhe9dwu_1bc89a3a_Rx
        ComSystemTemplateSignalGroupRef = ORC_Impact3_Pr5_ST3_c4pqnkonfjwv3uiohsxhe9dwu
        10 x ComGroupSignal, all with ComSignalEndianness=LITTLE_ENDIAN, ComSignalAccess=ACCESS_UNCLEAR:
          Impact_F2_ST3_3d080193_Rx: ComBitPosition=25, ComBitSize=1, ComSignalInitValue=0, ComSignalType=BOOLEAN, ComHandleId=88, ComSystemTemplateSystemSignalRef=Impact_F2_ST3
          Impact_F1_ST3_7aa87b43_Rx: ComBitPosition=24, ComBitSize=1, ComSignalInitValue=0, ComSignalType=BOOLEAN, ComHandleId=87, ComSystemTemplateSystemSignalRef=Impact_F1_ST3
          Impact_RO_type1_ST3_6d14f528_Rx: ComBitPosition=29, ComBitSize=1, ComSignalInitValue=0, ComSignalType=BOOLEAN, ComHandleId=90, ComSystemTemplateSystemSignalRef=Impact_RO_type1_ST3
          Impact_X_ST3_5cefa915_Rx: ComBitPosition=31, ComBitSize=1, ComSignalInitValue=0, ComSignalType=BOOLEAN, ComHandleId=94, ComSystemTemplateSystemSignalRef=Impact_X_ST3
          Impact_S2_ST3_6e1392bb_Rx: ComBitPosition=28, ComBitSize=1, ComSignalInitValue=0, ComSignalType=BOOLEAN, ComHandleId=93, ComSystemTemplateSystemSignalRef=Impact_S2_ST3
          Impact_RO_type2_ST3_2ab48ff8_Rx: ComBitPosition=30, ComBitSize=1, ComSignalInitValue=0, ComSignalType=BOOLEAN, ComHandleId=91, ComSystemTemplateSystemSignalRef=Impact_RO_type2_ST3
          Impact_S1_ST3_29b3e86b_Rx: ComBitPosition=27, ComBitSize=1, ComSignalInitValue=0, ComSignalType=BOOLEAN, ComHandleId=92, ComSystemTemplateSystemSignalRef=Impact_S1_ST3
          Impact_F3_ST3_00682823_Rx: ComBitPosition=26, ComBitSize=1, ComSignalInitValue=0, ComSignalType=BOOLEAN, ComHandleId=89, ComSystemTemplateSystemSignalRef=Impact_F3_ST3
          SQC_ORC_Impact3_Pr5_ST3_189c36c2_Rx: ComBitPosition=16, ComBitSize=8, ComSignalInitValue=0, ComSignalType=UINT8, ComHandleId=95, ComSystemTemplateSystemSignalRef=SQC_ORC_Impact3_Pr5_ST3
          CRC_ORC_Impact3_Pr5_ST3_20961dce_Rx: ComBitPosition=0, ComBitSize=16, ComSignalInitValue=11251, ComSignalType=UINT16, ComHandleId=86, ComSystemTemplateSystemSignalRef=CRC_ORC_Impact3_Pr5_ST3
      VehSpd_Disp_ST3_4922a2fd_Rx (ComSignal):
        ComBitPosition = 48
        ComBitSize = 12
        ComSignalDataInvalidValue = 4095
        ComSignalEndianness = LITTLE_ENDIAN
        ComSignalInitValue = 4095
        ComSignalType = UINT16
        ComTimeout = 10 if post-build-variant-condition{matching-criterion=SideAllocation, value=0}
        ComSignalAccess = ACCESS_UNCLEAR
        ComHandleId = 178
        ComNotification = CIL_ComNotification_DI_Odo_Pr5_ST3_e68xmtlkywxgxsdwekdjjhw3t_eb760b63_Rx if post-build-variant-condition{matching-criterion=SideAllocation, value=0}
        ComTimeoutNotification = CIL_Odospeedometer_TimeoutError if post-build-variant-condition{matching-criterion=SideAllocation, value=0}
        ComTimeout = 10.5 if post-build-variant-condition{matching-criterion=SideAllocation, value=1}
        ComTimeoutNotification = CIL_Odospeedometer_TimeoutError if post-build-variant-condition{matching-criterion=SideAllocation, value=1}
        ComFirstTimeout = 10
        ComNotification = CIL_ComNotification_DI_Odo_Pr5_ST3_e68xmtlkywxgxsdwekdjjhw3t_eb760b63_Rx if post-build-variant-condition{matching-criterion=SideAllocation, value=1}
        ComSystemTemplateSystemSignalRef = VehSpd_Disp_ST3
      BeltAdj_FR_Stat_ST3_eba9bce0_Rx (ComIPdu):
        ComIPduDirection = RECEIVE
        ComIPduType = NORMAL
        ComIPduHandleId = 29
        ComIPduSignalProcessing = DEFERRED
        ComIPduCancellationSupport = false
        ComIPduGroupRef = RBTM_FL_BODY3_Rx_PNC_20_54c591d6
        ComIPduGroupRef = RBTM_FL_BODY3_Rx_PNC_All_Active_46e8c3b2
        ComIPduSignalRef = RevBltTns_FR_ComCyc_Actv_ST3_4c00d29e_Rx
        ComPduIdRef = BeltAdj_FR_Stat_ST3_eba9bce0_Rx
        ComIPduMainFunctionRef = ComMainFunctionRx
        variation-point = post-build-variant-condition{matching-criterion=SideAllocation, value=0}
      PN14_SupBat_Volt_ST3_946fd9c6_Rx (ComSignal):
        ComBitPosition = 22
        ComBitSize = 10
        ComSignalDataInvalidValue = 1023
        ComSignalEndianness = LITTLE_ENDIAN
        ComSignalInitValue = 1023
        ComSignalType = UINT16
        ComSignalAccess = ACCESS_UNCLEAR
        ComHandleId = 98
        ComSystemTemplateSystemSignalRef = PN14_SupBat_Volt_ST3
      ROE_RBTM_FL_ST3_6e0rxnifai2txra0wamb18g4m_4feaeebf_Tx (ComSignalGroup):
        ComTransferProperty = TRIGGERED
        ComSignalGroupAccess = ACCESS_UNCLEAR
        ComHandleId = 2
        ComSystemTemplateSignalGroupRef = ROE_RBTM_FL_ST3_6e0rxnifai2txra0wamb18g4m
        variation-point = post-build-variant-condition{matching-criterion=SideAllocation, value=0}
        8 x ComGroupSignal, all with ComBitSize=8, ComSignalEndianness=LITTLE_ENDIAN, ComSignalInitValue=0, ComSignalType=UINT8, ComSignalAccess=ACCESS_UNCLEAR, ComTransferProperty=PENDING:
          ROE_1_RBTM_FL_ST3_afc317a4_Tx: ComBitPosition=8, ComHandleId=29, ComSystemTemplateSystemSignalRef=ROE_1_RBTM_FL_ST3
          ROE_3_RBTM_FL_ST3_cf9fa2ef_Tx: ComBitPosition=24, ComHandleId=31, ComSystemTemplateSystemSignalRef=ROE_3_RBTM_FL_ST3
          ROE_6_RBTM_FL_ST3_d2b011fc_Tx: ComBitPosition=48, ComHandleId=34, ComSystemTemplateSystemSignalRef=ROE_6_RBTM_FL_ST3
          ROE_4_RBTM_FL_ST3_b2eca4b7_Tx: ComBitPosition=32, ComHandleId=32, ComSystemTemplateSystemSignalRef=ROE_4_RBTM_FL_ST3
          ROE_2_RBTM_FL_ST3_12097b6a_Tx: ComBitPosition=16, ComHandleId=30, ComSystemTemplateSystemSignalRef=ROE_2_RBTM_FL_ST3
          ROE_0_RBTM_FL_ST3_7255ce21_Tx: ComBitPosition=0, ComHandleId=28, ComSystemTemplateSystemSignalRef=ROE_0_RBTM_FL_ST3
          ROE_5_RBTM_FL_ST3_6f7a7d32_Tx: ComBitPosition=40, ComHandleId=33, ComSystemTemplateSystemSignalRef=ROE_5_RBTM_FL_ST3
          ROE_7_RBTM_FL_ST3_0f26c879_Tx: ComBitPosition=56, ComHandleId=35, ComSystemTemplateSystemSignalRef=ROE_7_RBTM_FL_ST3
      NM_RBTM_FL_ST3_0cdf2d0f_Tx (ComIPdu):
        ComIPduDirection = SEND
        ComIPduType = NORMAL
        ComIPduHandleId = 4
        ComIPduSignalProcessing = DEFERRED
        ComIPduCancellationSupport = false
        ComIPduSignalRef = NM_RBTM_FL_ST3_PNC_785a2d76_Tx
        ComPduIdRef = NM_RBTM_FL_ST3_0cdf2d0f_Tx
        ComIPduMainFunctionRef = ComMainFunctionTx
        variation-point = post-build-variant-condition{matching-criterion=SideAllocation, value=0}
        ComTxIPdu: ComTxIPduUnusedAreasDefault=0, ComMinimumDelayTime=0  # NM_RBTM_FL_ST3
          ComTxModeTrue
            ComTxMode: ComTxModeMode=PERIODIC, ComTxModeTimePeriod=1, ComTxModeTimeOffset=0
          ComTxModeFalse
            ComTxMode: ComTxModeMode=PERIODIC, ComTxModeTimePeriod=1, ComTxModeTimeOffset=0
      Develop8_Rq_RBTM_FL_ST3_fa67f89a_Rx (ComIPdu):
        ComIPduDirection = RECEIVE
        ComIPduType = NORMAL
        ComIPduHandleId = 31
        ComIPduSignalProcessing = DEFERRED
        ComIPduCancellationSupport = false
        ComIPduGroupRef = RBTM_FL_BODY3_Rx_PNC_20_54c591d6
        ComIPduGroupRef = RBTM_FL_BODY3_Rx_PNC_All_Active_46e8c3b2
        ComIPduSignalGroupRef = Develop8_Rq_RBTM_FL_ST3_48g6nu8rjjp9s4bhq1x3pz06u_6f2fac01_Rx
        ComPduIdRef = Develop8_Rq_RBTM_FL_ST3_fa67f89a_Rx
        ComIPduMainFunctionRef = ComMainFunctionRx
        variation-point = post-build-variant-condition{matching-criterion=SideAllocation, value=0}
      RBTM_FL_BODY3_Rx_PNC_20_54c591d6 (ComIPduGroup): ComIPduGroupHandleId=0, variation-point=post-build-variant-condition{matching-criterion=SideAllocation, value=0}
      RBTM_FL_BODY3_Tx_PNC_20_27dfe85c (ComIPduGroup): ComIPduGroupHandleId=2, variation-point=post-build-variant-condition{matching-criterion=SideAllocation, value=0}
      ComMainFunctionRx: ComMainRxTimeBase=0.005
      ComMainFunctionTx: ComMainTxTimeBase=0.005
      ComMainFunctionRouteSignals: ComMainRouteSignalsTimeBase=0.005
      RBTM_FL_Tens_ST3_553ec607_Tx (ComIPdu):
        ComIPduDirection = SEND
        ComIPduType = NORMAL
        ComIPduHandleId = 6
        ComIPduSignalProcessing = DEFERRED
        ComIPduCancellationSupport = false
        ComIPduGroupRef = RBTM_FL_BODY3_Tx_PNC_20_27dfe85c
        ComIPduGroupRef = RBTM_FL_BODY3_Tx_PNC_All_Active_e1dc74ba
        ComIPduSignalRef = RBTMFL_Actv_Lvl_ST35_6199228f_Tx
        ComIPduSignalRef = RBTMFL_SP_ActvClient_ST35_bec76928_Tx
        ComIPduSignalRef = RBTMFL_SP_FctPrecond_Stat_ST35_bbfa2c80_Tx
        ComPduIdRef = RBTM_FL_Tens_ST3_553ec607_Tx
        ComIPduMainFunctionRef = ComMainFunctionTx
        variation-point = post-build-variant-condition{matching-criterion=SideAllocation, value=0}
        ComTxIPdu: ComMinimumDelayTime=0.02, ComTxIPduUnusedAreasDefault=255
          ComTxModeTrue
            ComTxMode: ComTxModeMode=MIXED, ComTxModeNumberOfRepetitions=0, ComTxModeTimeOffset=0.005, ComTxModeTimePeriod=0.5
          ComTxModeFalse
            ComTxMode: ComTxModeMode=NONE
      SBeltTens_SP_Lvl_Pr5_ST3_4tqpkri37441o5ht9g9ekmyzh_4719328f_Rx (ComSignalGroup):
        ComSignalGroupArrayAccess = true
        ComTimeout = 2
        ComTransferProperty = TRIGGERED_ON_CHANGE
        ComSignalGroupAccess = ACCESS_NEEDED_BY_SWC_OR_COM
        ComHandleId = 16
        ComTimeoutNotification = CIL_API_TimeoutError
        ComNotification = CIL_ComNotification_SBeltTens_SP_Lvl_Pr5_ST3_4tqpkri37441o5ht9g9ekmyzh_4719328f_Rx
        ComFirstTimeout = 2
        ComSystemTemplateSignalGroupRef = SBeltTens_SP_Lvl_Pr5_ST3_4tqpkri37441o5ht9g9ekmyzh
        5 x ComGroupSignal, all with ComSignalEndianness=LITTLE_ENDIAN, ComSignalAccess=ACCESS_UNCLEAR:
          RBTMFL_SP_Lvl_Rq_ST35_1b9e7376_Rx: ComBitPosition=24, ComBitSize=6, ComSignalDataInvalidValue=63, ComSignalInitValue=0, ComSignalType=UINT8, ComHandleId=134, ComSystemTemplateSystemSignalRef=RBTMFL_SP_Lvl_Rq_ST35
          Rsrv0_SBeltTens_SP_Lvl_Pr5_ST3_aa2f8d25_Rx: ComBitPosition=36, ComBitSize=4, ComSignalDataInvalidValue=15, ComSignalInitValue=15, ComSignalType=UINT8, ComHandleId=136, ComSystemTemplateSystemSignalRef=Rsrv0_SBeltTens_SP_Lvl_Pr5_ST3
          CRC_SBeltTens_SP_Lvl_Pr5_ST3_ef88391d_Rx: ComBitPosition=0, ComBitSize=16, ComSignalInitValue=10339, ComSignalType=UINT16, ComHandleId=133, ComSystemTemplateSystemSignalRef=CRC_SBeltTens_SP_Lvl_Pr5_ST3
          SQC_SBeltTens_SP_Lvl_Pr5_ST3_4743c50e_Rx: ComBitPosition=16, ComBitSize=8, ComSignalInitValue=0, ComSignalType=UINT8, ComHandleId=137, ComSystemTemplateSystemSignalRef=SQC_SBeltTens_SP_Lvl_Pr5_ST3
          RBTMFR_SP_Lvl_Rq_ST35_dd3bbb43_Rx: ComBitPosition=30, ComBitSize=6, ComSignalDataInvalidValue=63, ComSignalInitValue=0, ComSignalType=UINT8, ComHandleId=135, ComSystemTemplateSystemSignalRef=RBTMFR_SP_Lvl_Rq_ST35
      3 x ComSignal, all with ComSignalEndianness=LITTLE_ENDIAN, ComSignalInitValue=0, ComTransferProperty=TRIGGERED_ON_CHANGE, ComSignalAccess=ACCESS_UNCLEAR, variation-point=post-build-variant-condition{matching-criterion=SideAllocation, value=0}:
        RBTMFL_SP_ActvClient_ST35_bec76928_Tx: ComBitPosition=16, ComBitSize=4, ComSignalDataInvalidValue=15, ComSignalType=UINT8, ComHandleId=24, ComSystemTemplateSystemSignalRef=RBTMFL_SP_ActvClient_ST35
        RBTMFL_SP_FctPrecond_Stat_ST35_bbfa2c80_Tx: ComBitPosition=0, ComBitSize=10, ComSignalType=UINT16, ComHandleId=25, ComSystemTemplateSystemSignalRef=RBTMFL_SP_FctPrecond_Stat_ST35
        RBTMFL_Actv_Lvl_ST35_6199228f_Tx: ComBitPosition=10, ComBitSize=6, ComSignalDataInvalidValue=63, ComSignalType=UINT8, ComHandleId=23, ComSystemTemplateSystemSignalRef=RBTMFL_Actv_Lvl_ST35
      SBeltTens_SP_Lvl_ST3_46421e11_Rx (ComIPdu):
        ComIPduDirection = RECEIVE
        ComIPduType = NORMAL
        ComIPduHandleId = 23
        ComIPduSignalProcessing = DEFERRED
        ComIPduCancellationSupport = false
        ComIPduGroupRef = RBTM_FL_BODY3_Rx_PNC_20_54c591d6 if post-build-variant-condition{matching-criterion=SideAllocation, value=0}
        ComIPduGroupRef = RBTM_FL_BODY3_Rx_PNC_All_Active_46e8c3b2 if post-build-variant-condition{matching-criterion=SideAllocation, value=0}
        ComIPduSignalGroupRef = SBeltTens_SP_Lvl_Pr5_ST3_4tqpkri37441o5ht9g9ekmyzh_4719328f_Rx
        ComPduIdRef = SBeltTens_SP_Lvl_ST3_46421e11_Rx
        ComIPduMainFunctionRef = ComMainFunctionRx
        ComIPduGroupRef = RBTM_FR_BODY3_Rx_PNC_20_02b0f03d if post-build-variant-condition{matching-criterion=SideAllocation, value=1}
        ComIPduGroupRef = RBTM_FR_BODY3_Rx_PNC_All_Active_592f1bcd if post-build-variant-condition{matching-criterion=SideAllocation, value=1}
      Develop8_Rq_RBTM_FR_ST3_bcqj2sqez8u9spf5qxmu4a35u_86f26259_Rx (ComSignalGroup):
        ComTransferProperty = TRIGGERED
        ComSignalGroupAccess = ACCESS_UNCLEAR
        ComHandleId = 22
        ComSystemTemplateSignalGroupRef = Develop8_Rq_RBTM_FR_ST3_bcqj2sqez8u9spf5qxmu4a35u
        variation-point = post-build-variant-condition{matching-criterion=SideAllocation, value=1}
        8 x ComGroupSignal, all with ComBitSize=8, ComSignalEndianness=LITTLE_ENDIAN, ComSignalInitValue=0, ComSignalType=UINT8, ComSignalAccess=ACCESS_UNCLEAR:
          Develop_Rq_RBTM_FR_05_ST3_4364c306_Rx: ComBitPosition=32, ComHandleId=184, ComSystemTemplateSystemSignalRef=Develop_Rq_RBTM_FR_05_ST3
          Develop_Rq_RBTM_FR_07_ST3_39a49066_Rx: ComBitPosition=48, ComHandleId=186, ComSystemTemplateSystemSignalRef=Develop_Rq_RBTM_FR_07_ST3
          Develop_Rq_RBTM_FR_08_ST3_bbf407b7_Rx: ComBitPosition=56, ComHandleId=187, ComSystemTemplateSystemSignalRef=Develop_Rq_RBTM_FR_08_ST3
          Develop_Rq_RBTM_FR_01_ST3_b6e465c6_Rx: ComBitPosition=0, ComHandleId=180, ComSystemTemplateSystemSignalRef=Develop_Rq_RBTM_FR_01_ST3
          Develop_Rq_RBTM_FR_03_ST3_cc2436a6_Rx: ComBitPosition=16, ComHandleId=182, ComSystemTemplateSystemSignalRef=Develop_Rq_RBTM_FR_03_ST3
          Develop_Rq_RBTM_FR_06_ST3_04c4b9d6_Rx: ComBitPosition=40, ComHandleId=185, ComSystemTemplateSystemSignalRef=Develop_Rq_RBTM_FR_06_ST3
          Develop_Rq_RBTM_FR_02_ST3_f1441f16_Rx: ComBitPosition=8, ComHandleId=181, ComSystemTemplateSystemSignalRef=Develop_Rq_RBTM_FR_02_ST3
          Develop_Rq_RBTM_FR_04_ST3_7e04eab6_Rx: ComBitPosition=24, ComHandleId=183, ComSystemTemplateSystemSignalRef=Develop_Rq_RBTM_FR_04_ST3
      ROE_RBTM_FR_ST3_79bce2bc_Tx (ComIPdu):
        ComIPduDirection = SEND
        ComIPduType = NORMAL
        ComIPduHandleId = 7
        ComIPduSignalProcessing = DEFERRED
        ComIPduCancellationSupport = false
        ComIPduGroupRef = RBTM_FR_BODY3_Tx_PNC_20_71aa89b7
        ComIPduGroupRef = RBTM_FR_BODY3_Tx_PNC_All_Active_fe1bacc5
        ComIPduSignalGroupRef = ROE_RBTM_FR_ST3_3f1btonh6ivdn6ytgyuu9rtt1_5c720902_Tx
        ComPduIdRef = ROE_RBTM_FR_ST3_79bce2bc_Tx
        ComIPduMainFunctionRef = ComMainFunctionTx
        variation-point = post-build-variant-condition{matching-criterion=SideAllocation, value=1}
        ComTxIPdu: ComMinimumDelayTime=0.2, ComTxIPduUnusedAreasDefault=0
          ComTxModeTrue
            ComTxMode: ComTxModeMode=DIRECT, ComTxModeNumberOfRepetitions=0
          ComTxModeFalse
            ComTxMode: ComTxModeMode=NONE
      PS_Curve_FR_Rq_HU_ST3_90527677_Rx (ComSignal):
        ComBitPosition = 4
        ComBitSize = 2
        ComSignalDataInvalidValue = 3
        ComSignalEndianness = LITTLE_ENDIAN
        ComSignalInitValue = 3
        ComSignalType = UINT8
        ComTimeout = 10.1
        ComSignalAccess = ACCESS_UNCLEAR
        ComHandleId = 188
        ComNotification = Rte_COMCbk_PS_Curve_FR_Rq_HU_ST3_90527677_Rx
        ComTimeoutNotification = Rte_COMCbkRxTOut_PS_Curve_FR_Rq_HU_ST3_90527677_Rx
        ComSystemTemplateSystemSignalRef = PS_Curve_FR_Rq_HU_ST3
        variation-point = post-build-variant-condition{matching-criterion=SideAllocation, value=1}
      RBTM_FR_BODY3_Tx_PNC_20_71aa89b7 (ComIPduGroup): ComIPduGroupHandleId=2, variation-point=post-build-variant-condition{matching-criterion=SideAllocation, value=1}
      Develop8_Rq_RBTM_FR_ST3_25b7d179_Rx (ComIPdu):
        ComIPduDirection = RECEIVE
        ComIPduType = NORMAL
        ComIPduHandleId = 31
        ComIPduSignalProcessing = DEFERRED
        ComIPduCancellationSupport = false
        ComIPduGroupRef = RBTM_FR_BODY3_Rx_PNC_20_02b0f03d
        ComIPduGroupRef = RBTM_FR_BODY3_Rx_PNC_All_Active_592f1bcd
        ComIPduSignalGroupRef = Develop8_Rq_RBTM_FR_ST3_bcqj2sqez8u9spf5qxmu4a35u_86f26259_Rx
        ComPduIdRef = Develop8_Rq_RBTM_FR_ST3_25b7d179_Rx
        ComIPduMainFunctionRef = ComMainFunctionRx
        variation-point = post-build-variant-condition{matching-criterion=SideAllocation, value=1}
      Awake_Diag_Actv_RBTM_FR_ST3_822fa87a_Tx (ComSignal):
        ComBitPosition = 30
        ComBitSize = 1
        ComSignalEndianness = LITTLE_ENDIAN
        ComSignalInitValue = 0
        ComSignalType = BOOLEAN
        ComTransferProperty = PENDING
        ComSignalAccess = ACCESS_UNCLEAR
        ComHandleId = 0
        ComSystemTemplateSystemSignalRef = Awake_Diag_Actv_RBTM_FR_ST3
        variation-point = post-build-variant-condition{matching-criterion=SideAllocation, value=1}
      Develop8_Rs_RBTM_FR_ST3_5t18pq0a13t698v0vsj7yvmmm_aab2c7df_Tx (ComSignalGroup):
        ComTransferProperty = TRIGGERED
        ComSignalGroupAccess = ACCESS_UNCLEAR
        ComHandleId = 0
        ComSystemTemplateSignalGroupRef = Develop8_Rs_RBTM_FR_ST3_5t18pq0a13t698v0vsj7yvmmm
        variation-point = post-build-variant-condition{matching-criterion=SideAllocation, value=1}
        8 x ComGroupSignal, all with ComBitSize=8, ComSignalEndianness=LITTLE_ENDIAN, ComSignalInitValue=0, ComSignalType=UINT8, ComSignalAccess=ACCESS_UNCLEAR, ComTransferProperty=PENDING:
          Develop_Rs_RBTM_FR_06_ST3_1e768be7_Tx: ComBitPosition=40, ComHandleId=9, ComSystemTemplateSystemSignalRef=Develop_Rs_RBTM_FR_06_ST3
          Develop_Rs_RBTM_FR_01_ST3_ac5657f7_Tx: ComBitPosition=0, ComHandleId=4, ComSystemTemplateSystemSignalRef=Develop_Rs_RBTM_FR_01_ST3
          Develop_Rs_RBTM_FR_07_ST3_2316a257_Tx: ComBitPosition=48, ComHandleId=10, ComSystemTemplateSystemSignalRef=Develop_Rs_RBTM_FR_07_ST3
          Develop_Rs_RBTM_FR_05_ST3_59d6f137_Tx: ComBitPosition=32, ComHandleId=8, ComSystemTemplateSystemSignalRef=Develop_Rs_RBTM_FR_05_ST3
          Develop_Rs_RBTM_FR_04_ST3_64b6d887_Tx: ComBitPosition=24, ComHandleId=7, ComSystemTemplateSystemSignalRef=Develop_Rs_RBTM_FR_04_ST3
          Develop_Rs_RBTM_FR_08_ST3_a1463586_Tx: ComBitPosition=56, ComHandleId=11, ComSystemTemplateSystemSignalRef=Develop_Rs_RBTM_FR_08_ST3
          Develop_Rs_RBTM_FR_02_ST3_ebf62d27_Tx: ComBitPosition=8, ComHandleId=5, ComSystemTemplateSystemSignalRef=Develop_Rs_RBTM_FR_02_ST3
          Develop_Rs_RBTM_FR_03_ST3_d6960497_Tx: ComBitPosition=16, ComHandleId=6, ComSystemTemplateSystemSignalRef=Develop_Rs_RBTM_FR_03_ST3
      5 x ComSignal, all with ComSignalAccess=ACCESS_UNCLEAR, variation-point=post-build-variant-condition{matching-criterion=SideAllocation, value=1}:
        BltSlckDec_Md_FR_Stat_ST3_8538ecdf_Tx: ComBitPosition=0, ComBitSize=2, ComSignalDataInvalidValue=3, ComSignalEndianness=LITTLE_ENDIAN, ComSignalInitValue=3, ComSignalType=UINT8, ComTransferProperty=TRIGGERED_ON_CHANGE, ComHandleId=3, ComSystemTemplateSystemSignalRef=BltSlckDec_Md_FR_Stat_ST3
        RevBltTns_FL_SafeCyc_Actv_ST3_b0efc754_Rx: ComBitPosition=0, ComBitSize=2, ComSignalDataInvalidValue=3, ComSignalEndianness=LITTLE_ENDIAN, ComSignalInitValue=3, ComSignalType=UINT8, ComHandleId=190, ComSystemTemplateSystemSignalRef=RevBltTns_FL_SafeCyc_Actv_ST3
        NM_RBTM_FR_ST3_PNC_0103a546_Tx: ComBitPosition=0, ComSignalEndianness=opaque, ComSignalInitValue=0 0 0 0 0 0 0, ComSignalLength=7, ComSignalType=UINT8_N, ComTransferProperty=PENDING, ComHandleId=21, ComSystemTemplateSystemSignalRef=NM_RBTM_FR_ST3_PNC
        RevBltTns_FL_ComCyc_Actv_ST3_4c5f745f_Rx: ComBitPosition=2, ComBitSize=2, ComSignalDataInvalidValue=3, ComSignalEndianness=LITTLE_ENDIAN, ComSignalInitValue=3, ComSignalType=UINT8, ComHandleId=189, ComSystemTemplateSystemSignalRef=RevBltTns_FL_ComCyc_Actv_ST3
        PS_Curve_FR_Stat_ST3_36a2193c_Tx: ComBitPosition=2, ComBitSize=2, ComSignalDataInvalidValue=3, ComSignalEndianness=LITTLE_ENDIAN, ComSignalInitValue=3, ComSignalType=UINT8, ComTransferProperty=TRIGGERED_ON_CHANGE, ComHandleId=22, ComSystemTemplateSystemSignalRef=PS_Curve_FR_Stat_ST3
      RBTM_FR_BODY3_Rx_PNC_All_Active_592f1bcd (ComIPduGroup): ComIPduGroupHandleId=1, variation-point=post-build-variant-condition{matching-criterion=SideAllocation, value=1}
      Awake_NwStart_RBTM_FR_ST3_59fd792e_Tx (ComSignal):
        ComBitPosition = 31
        ComBitSize = 1
        ComSignalEndianness = LITTLE_ENDIAN
        ComSignalInitValue = 0
        ComSignalType = BOOLEAN
        ComTransferProperty = PENDING
        ComSignalAccess = ACCESS_UNCLEAR
        ComHandleId = 2
        ComSystemTemplateSystemSignalRef = Awake_NwStart_RBTM_FR_ST3
        variation-point = post-build-variant-condition{matching-criterion=SideAllocation, value=1}
      RBTM_FR_Tgl_ST3_bb42027b_Tx (ComSignal):
        ComBitPosition = 26
        ComBitSize = 1
        ComSignalEndianness = LITTLE_ENDIAN
        ComSignalInitValue = 0
        ComSignalType = BOOLEAN
        ComTransferProperty = PENDING
        ComSignalAccess = ACCESS_UNCLEAR
        ComHandleId = 27
        ComSystemTemplateSystemSignalRef = RBTM_FR_Tgl_ST3
        variation-point = post-build-variant-condition{matching-criterion=SideAllocation, value=1}
      ROE_RBTM_FR_ST3_3f1btonh6ivdn6ytgyuu9rtt1_5c720902_Tx (ComSignalGroup):
        ComTransferProperty = TRIGGERED
        ComSignalGroupAccess = ACCESS_UNCLEAR
        ComHandleId = 2
        ComSystemTemplateSignalGroupRef = ROE_RBTM_FR_ST3_3f1btonh6ivdn6ytgyuu9rtt1
        variation-point = post-build-variant-condition{matching-criterion=SideAllocation, value=1}
        8 x ComGroupSignal, all with ComBitSize=8, ComSignalEndianness=LITTLE_ENDIAN, ComSignalInitValue=0, ComSignalType=UINT8, ComSignalAccess=ACCESS_UNCLEAR, ComTransferProperty=PENDING:
          ROE_2_RBTM_FR_ST3_21d8e599_Tx: ComBitPosition=16, ComHandleId=30, ComSystemTemplateSystemSignalRef=ROE_2_RBTM_FR_ST3
          ROE_7_RBTM_FR_ST3_3cf7568a_Tx: ComBitPosition=56, ComHandleId=35, ComSystemTemplateSystemSignalRef=ROE_7_RBTM_FR_ST3
          ROE_6_RBTM_FR_ST3_e1618f0f_Tx: ComBitPosition=48, ComHandleId=34, ComSystemTemplateSystemSignalRef=ROE_6_RBTM_FR_ST3
          ROE_1_RBTM_FR_ST3_9c128957_Tx: ComBitPosition=8, ComHandleId=29, ComSystemTemplateSystemSignalRef=ROE_1_RBTM_FR_ST3
          ROE_0_RBTM_FR_ST3_418450d2_Tx: ComBitPosition=0, ComHandleId=28, ComSystemTemplateSystemSignalRef=ROE_0_RBTM_FR_ST3
          ROE_3_RBTM_FR_ST3_fc4e3c1c_Tx: ComBitPosition=24, ComHandleId=31, ComSystemTemplateSystemSignalRef=ROE_3_RBTM_FR_ST3
          ROE_5_RBTM_FR_ST3_5cabe3c1_Tx: ComBitPosition=40, ComHandleId=33, ComSystemTemplateSystemSignalRef=ROE_5_RBTM_FR_ST3
          ROE_4_RBTM_FR_ST3_813d3a44_Tx: ComBitPosition=32, ComHandleId=32, ComSystemTemplateSystemSignalRef=ROE_4_RBTM_FR_ST3
      BeltHdOvr_FR_Stat_ST3_0eefd507_Rx (ComSignal):
        ComBitPosition = 0
        ComBitSize = 2
        ComSignalDataInvalidValue = 3
        ComSignalEndianness = LITTLE_ENDIAN
        ComSignalInitValue = 3
        ComSignalType = UINT8
        ComTimeout = 2.5
        ComSignalAccess = ACCESS_UNCLEAR
        ComHandleId = 179
        ComTimeoutNotification = CIL_BltHandoverRight_TimeoutError
        ComNotification = CIL_ComNotification_BeltHdOvr_FR_Stat_ST3_0eefd507_Rx
        ComFirstTimeout = 2.5
        ComSystemTemplateSystemSignalRef = BeltHdOvr_FR_Stat_ST3
        variation-point = post-build-variant-condition{matching-criterion=SideAllocation, value=1}
      ECU_Id_RBTM_FR_ST3_765534d2_Tx (ComSignal):
        ComBitPosition = 0
        ComBitSize = 12
        ComSignalDataInvalidValue = 4095
        ComSignalEndianness = LITTLE_ENDIAN
        ComSignalInitValue = 421
        ComSignalType = UINT16
        ComTransferProperty = PENDING
        ComSignalAccess = ACCESS_UNCLEAR
        ComHandleId = 12
        ComSystemTemplateSystemSignalRef = ECU_Id_RBTM_FR_ST3
        variation-point = post-build-variant-condition{matching-criterion=SideAllocation, value=1}
      TxMess_RBTM_FR_BODY3_dfe5c3c9 (ComIPduGroup): ComIPduGroupHandleId=4, variation-point=post-build-variant-condition{matching-criterion=SideAllocation, value=1}
      NM_RBTM_FR_ST3_d30f04ec_Tx (ComIPdu):
        ComIPduDirection = SEND
        ComIPduType = NORMAL
        ComIPduHandleId = 4
        ComIPduSignalProcessing = DEFERRED
        ComIPduCancellationSupport = false
        ComIPduSignalRef = NM_RBTM_FR_ST3_PNC_0103a546_Tx
        ComPduIdRef = NM_RBTM_FR_ST3_d30f04ec_Tx
        ComIPduMainFunctionRef = ComMainFunctionTx
        variation-point = post-build-variant-condition{matching-criterion=SideAllocation, value=1}
        ComTxIPdu: ComTxIPduUnusedAreasDefault=0, ComMinimumDelayTime=0  # NM_RBTM_FR_ST3
          ComTxModeTrue
            ComTxMode: ComTxModeMode=NONE
          ComTxModeFalse
            ComTxMode: ComTxModeMode=NONE
      Awake_Ignition_On_RBTM_FR_ST3_df6a9d63_Tx (ComSignal):
        ComBitPosition = 32
        ComBitSize = 1
        ComSignalEndianness = LITTLE_ENDIAN
        ComSignalInitValue = 0
        ComSignalType = BOOLEAN
        ComTransferProperty = PENDING
        ComSignalAccess = ACCESS_UNCLEAR
        ComHandleId = 1
        ComSystemTemplateSystemSignalRef = Awake_Ignition_On_RBTM_FR_ST3
        variation-point = post-build-variant-condition{matching-criterion=SideAllocation, value=1}
      Meas8_RBTM_FR_ST3_7ba3lhjy9fnhufd3n9dyw0p9p_19ed5f9c_Tx (ComSignalGroup):
        ComTransferProperty = TRIGGERED
        ComSignalGroupAccess = ACCESS_UNCLEAR
        ComHandleId = 1
        ComSystemTemplateSignalGroupRef = Meas8_RBTM_FR_ST3_7ba3lhjy9fnhufd3n9dyw0p9p
        variation-point = post-build-variant-condition{matching-criterion=SideAllocation, value=1}
        8 x ComGroupSignal, all with ComBitSize=8, ComSignalEndianness=LITTLE_ENDIAN, ComSignalInitValue=0, ComSignalType=UINT8, ComSignalAccess=ACCESS_UNCLEAR, ComTransferProperty=PENDING:
          Meas_RBTM_FR_06_ST3_dd4fe83d_Tx: ComBitPosition=40, ComHandleId=18, ComSystemTemplateSystemSignalRef=Meas_RBTM_FR_06_ST3
          Meas_RBTM_FR_04_ST3_a78fbb5d_Tx: ComBitPosition=24, ComHandleId=16, ComSystemTemplateSystemSignalRef=Meas_RBTM_FR_04_ST3
          Meas_RBTM_FR_02_ST3_28cf4efd_Tx: ComBitPosition=8, ComHandleId=14, ComSystemTemplateSystemSignalRef=Meas_RBTM_FR_02_ST3
          Meas_RBTM_FR_03_ST3_15af674d_Tx: ComBitPosition=16, ComHandleId=15, ComSystemTemplateSystemSignalRef=Meas_RBTM_FR_03_ST3
          Meas_RBTM_FR_05_ST3_9aef92ed_Tx: ComBitPosition=32, ComHandleId=17, ComSystemTemplateSystemSignalRef=Meas_RBTM_FR_05_ST3
          Meas_RBTM_FR_07_ST3_e02fc18d_Tx: ComBitPosition=48, ComHandleId=19, ComSystemTemplateSystemSignalRef=Meas_RBTM_FR_07_ST3
          Meas_RBTM_FR_01_ST3_6f6f342d_Tx: ComBitPosition=0, ComHandleId=13, ComSystemTemplateSystemSignalRef=Meas_RBTM_FR_01_ST3
          Meas_RBTM_FR_08_ST3_627f565c_Tx: ComBitPosition=56, ComHandleId=20, ComSystemTemplateSystemSignalRef=Meas_RBTM_FR_08_ST3
      BeltAdj_FL_Stat_ST3_d2ce0dbb_Rx (ComIPdu):
        ComIPduDirection = RECEIVE
        ComIPduType = NORMAL
        ComIPduHandleId = 29
        ComIPduSignalProcessing = DEFERRED
        ComIPduCancellationSupport = false
        ComIPduGroupRef = RBTM_FR_BODY3_Rx_PNC_20_02b0f03d
        ComIPduGroupRef = RBTM_FR_BODY3_Rx_PNC_All_Active_592f1bcd
        ComIPduSignalRef = RevBltTns_FL_ComCyc_Actv_ST3_4c5f745f_Rx
        ComPduIdRef = BeltAdj_FL_Stat_ST3_d2ce0dbb_Rx
        ComIPduMainFunctionRef = ComMainFunctionRx
        variation-point = post-build-variant-condition{matching-criterion=SideAllocation, value=1}
      RBTM_FR_Disp_Rq_ST3_4c4b9655_Tx (ComSignal):
        ComBitPosition = 24
        ComBitSize = 2
        ComSignalEndianness = LITTLE_ENDIAN
        ComSignalInitValue = 0
        ComSignalType = UINT8
        ComTransferProperty = TRIGGERED_ON_CHANGE
        ComSignalAccess = ACCESS_UNCLEAR
        ComHandleId = 26
        ComSystemTemplateSystemSignalRef = RBTM_FR_Disp_Rq_ST3
        variation-point = post-build-variant-condition{matching-criterion=SideAllocation, value=1}
      RBTM_FL_Stat_ST3_dd2436a1_Rx (ComIPdu):
        ComIPduDirection = RECEIVE
        ComIPduType = NORMAL
        ComIPduHandleId = 32
        ComIPduSignalProcessing = DEFERRED
        ComIPduCancellationSupport = false
        ComIPduGroupRef = RBTM_FR_BODY3_Rx_PNC_20_02b0f03d
        ComIPduGroupRef = RBTM_FR_BODY3_Rx_PNC_All_Active_592f1bcd
        ComIPduSignalRef = RevBltTns_FL_SafeCyc_Actv_ST3_b0efc754_Rx
        ComPduIdRef = RBTM_FL_Stat_ST3_dd2436a1_Rx
        ComIPduMainFunctionRef = ComMainFunctionRx
        variation-point = post-build-variant-condition{matching-criterion=SideAllocation, value=1}
      Meas8_RBTM_FR_ST3_76ff3d39_Tx (ComIPdu):
        ComIPduDirection = SEND
        ComIPduType = NORMAL
        ComIPduHandleId = 3
        ComIPduSignalProcessing = DEFERRED
        ComIPduCancellationSupport = false
        ComIPduGroupRef = TxMess_RBTM_FR_BODY3_dfe5c3c9
        ComIPduSignalGroupRef = Meas8_RBTM_FR_ST3_7ba3lhjy9fnhufd3n9dyw0p9p_19ed5f9c_Tx
        ComPduIdRef = Meas8_RBTM_FR_ST3_76ff3d39_Tx
        ComIPduMainFunctionRef = ComMainFunctionTx
        variation-point = post-build-variant-condition{matching-criterion=SideAllocation, value=1}
        ComTxIPdu: ComMinimumDelayTime=0.005, ComTxIPduUnusedAreasDefault=0
          ComTxModeTrue
            ComTxMode: ComTxModeMode=DIRECT, ComTxModeNumberOfRepetitions=0
          ComTxModeFalse
            ComTxMode: ComTxModeMode=NONE
      WakeupRsn_RBTM_FR_ST3_6ec4195b_Tx (ComSignal):
        ComBitPosition = 20
        ComBitSize = 10
        ComSignalDataInvalidValue = 1023
        ComSignalEndianness = LITTLE_ENDIAN
        ComSignalInitValue = 1023
        ComSignalType = UINT16
        ComTransferProperty = PENDING
        ComSignalAccess = ACCESS_UNCLEAR
        ComHandleId = 38
        ComSystemTemplateSystemSignalRef = WakeupRsn_RBTM_FR_ST3
        variation-point = post-build-variant-condition{matching-criterion=SideAllocation, value=1}
      RevBltTns_FR_SafeCyc_Actv_ST3_5c8c6ad4_Tx (ComSignal):
        ComBitPosition = 0
        ComBitSize = 2
        ComSignalDataInvalidValue = 3
        ComSignalEndianness = LITTLE_ENDIAN
        ComSignalInitValue = 3
        ComSignalType = UINT8
        ComTransferProperty = TRIGGERED_ON_CHANGE
        ComSignalAccess = ACCESS_UNCLEAR
        ComHandleId = 37
        ComSystemTemplateSystemSignalRef = RevBltTns_FR_SafeCyc_Actv_ST3
        variation-point = post-build-variant-condition{matching-criterion=SideAllocation, value=1}
      3 x ComIPdu, all with ComIPduDirection=SEND, ComIPduType=NORMAL, ComIPduSignalProcessing=DEFERRED, ComIPduCancellationSupport=false, ComIPduMainFunctionRef=ComMainFunctionTx, variation-point=post-build-variant-condition{matching-criterion=SideAllocation, value=1}:
        Develop8_Rs_RBTM_FR_ST3_45eb6432_Tx: ComIPduHandleId=1, ComIPduGroupRef=TxMess_RBTM_FR_BODY3_dfe5c3c9, ComIPduSignalGroupRef=Develop8_Rs_RBTM_FR_ST3_5t18pq0a13t698v0vsj7yvmmm_aab2c7df_Tx, ComPduIdRef=Develop8_Rs_RBTM_FR_ST3_45eb6432_Tx
          ComTxIPdu: ComMinimumDelayTime=0.02, ComTxIPduUnusedAreasDefault=0
            ComTxModeTrue
              ComTxMode: ComTxModeMode=DIRECT, ComTxModeNumberOfRepetitions=0
            ComTxModeFalse
              ComTxMode: ComTxModeMode=NONE
        ECU_Stat_RBTM_FR_ST3_28d39f08_Tx: ComIPduHandleId=2, ComIPduGroupRef=RBTM_FR_BODY3_Tx_PNC_20_71aa89b7, ComIPduGroupRef=RBTM_FR_BODY3_Tx_PNC_All_Active_fe1bacc5, ComIPduSignalRef=Awake_Diag_Actv_RBTM_FR_ST3_822fa87a_Tx, ComIPduSignalRef=Awake_Ignition_On_RBTM_FR_ST3_df6a9d63_Tx, ComIPduSignalRef=Awake_NwStart_RBTM_FR_ST3_59fd792e_Tx, ComIPduSignalRef=ECU_Id_RBTM_FR_ST3_765534d2_Tx, ComIPduSignalRef=WakeupRsn_RBTM_FR_ST3_6ec4195b_Tx, ComPduIdRef=ECU_Stat_RBTM_FR_ST3_28d39f08_Tx
          ComTxIPdu: ComTxIPduUnusedAreasDefault=0, ComMinimumDelayTime=0
            ComTxModeTrue
              ComTxMode: ComTxModeMode=PERIODIC, ComTxModeTimeOffset=0, ComTxModeTimePeriod=1
            ComTxModeFalse
              ComTxMode: ComTxModeMode=NONE
        RBTM_FR_Stat_ST3_e44387fa_Tx: ComIPduHandleId=5, ComIPduGroupRef=RBTM_FR_BODY3_Tx_PNC_20_71aa89b7, ComIPduGroupRef=RBTM_FR_BODY3_Tx_PNC_All_Active_fe1bacc5, ComIPduSignalRef=PS_Curve_FR_Stat_ST3_36a2193c_Tx, ComIPduSignalRef=RBTM_FR_Disp_Rq_ST3_4c4b9655_Tx, ComIPduSignalRef=RBTM_FR_Tgl_ST3_bb42027b_Tx, ComIPduSignalRef=RevBltTns_FR_SafeCyc_Actv_ST3_5c8c6ad4_Tx, ComPduIdRef=RBTM_FR_Stat_ST3_e44387fa_Tx
          ComTxIPdu: ComMinimumDelayTime=0.04, ComTxIPduUnusedAreasDefault=255
            ComTxModeTrue
              ComTxMode: ComTxModeMode=MIXED, ComTxModeNumberOfRepetitions=0, ComTxModeTimeOffset=0.01, ComTxModeTimePeriod=1
            ComTxModeFalse
              ComTxMode: ComTxModeMode=NONE
      RevBltTns_FR_ComCyc_Actv_ST3_4c00d29e_Tx (ComSignal):
        ComBitPosition = 2
        ComBitSize = 2
        ComSignalDataInvalidValue = 3
        ComSignalEndianness = LITTLE_ENDIAN
        ComSignalInitValue = 3
        ComSignalType = UINT8
        ComTransferProperty = TRIGGERED_ON_CHANGE
        ComSignalAccess = ACCESS_UNCLEAR
        ComHandleId = 36
        ComSystemTemplateSystemSignalRef = RevBltTns_FR_ComCyc_Actv_ST3
        variation-point = post-build-variant-condition{matching-criterion=SideAllocation, value=1}
      BeltAdj_FR_Stat_ST3_eba9bce0_Tx (ComIPdu):
        ComIPduDirection = SEND
        ComIPduType = NORMAL
        ComIPduHandleId = 0
        ComIPduSignalProcessing = DEFERRED
        ComIPduCancellationSupport = false
        ComIPduGroupRef = RBTM_FR_BODY3_Tx_PNC_20_71aa89b7
        ComIPduGroupRef = RBTM_FR_BODY3_Tx_PNC_All_Active_fe1bacc5
        ComIPduSignalRef = BltSlckDec_Md_FR_Stat_ST3_8538ecdf_Tx
        ComIPduSignalRef = RevBltTns_FR_ComCyc_Actv_ST3_4c00d29e_Tx
        ComPduIdRef = BeltAdj_FR_Stat_ST3_eba9bce0_Tx
        ComIPduMainFunctionRef = ComMainFunctionTx
        variation-point = post-build-variant-condition{matching-criterion=SideAllocation, value=1}
        ComTxIPdu: ComMinimumDelayTime=0.04, ComTxIPduUnusedAreasDefault=255
          ComTxModeTrue
            ComTxMode: ComTxModeMode=MIXED, ComTxModeNumberOfRepetitions=0, ComTxModeTimeOffset=0.02, ComTxModeTimePeriod=1
          ComTxModeFalse
            ComTxMode: ComTxModeMode=NONE
      RBTM_FR_BODY3_Rx_PNC_20_02b0f03d (ComIPduGroup): ComIPduGroupHandleId=0, variation-point=post-build-variant-condition{matching-criterion=SideAllocation, value=1}
      RBTM_FR_BODY3_Tx_PNC_All_Active_fe1bacc5 (ComIPduGroup): ComIPduGroupHandleId=3, variation-point=post-build-variant-condition{matching-criterion=SideAllocation, value=1}
      BeltHdOvr_FR_State_ST3_c8a18c7a_Rx (ComIPdu):
        ComIPduDirection = RECEIVE
        ComIPduType = NORMAL
        ComIPduHandleId = 30
        ComIPduSignalProcessing = DEFERRED
        ComIPduCancellationSupport = false
        ComIPduGroupRef = RBTM_FR_BODY3_Rx_PNC_20_02b0f03d
        ComIPduGroupRef = RBTM_FR_BODY3_Rx_PNC_All_Active_592f1bcd
        ComIPduSignalRef = BeltHdOvr_FR_Stat_ST3_0eefd507_Rx
        ComPduIdRef = BeltHdOvr_FR_State_ST3_c8a18c7a_Rx
        ComIPduMainFunctionRef = ComMainFunctionRx
        variation-point = post-build-variant-condition{matching-criterion=SideAllocation, value=1}
      3 x ComSignal, all with ComSignalEndianness=LITTLE_ENDIAN, ComSignalInitValue=0, ComTransferProperty=TRIGGERED_ON_CHANGE, ComSignalAccess=ACCESS_UNCLEAR, variation-point=post-build-variant-condition{matching-criterion=SideAllocation, value=1}:
        RBTMFR_SP_FctPrecond_Stat_ST35_ce5639ee_Tx: ComBitPosition=0, ComBitSize=10, ComSignalType=UINT16, ComHandleId=25, ComSystemTemplateSystemSignalRef=RBTMFR_SP_FctPrecond_Stat_ST35
        RBTMFR_SP_ActvClient_ST35_1fd8ade4_Tx: ComBitPosition=16, ComBitSize=4, ComSignalDataInvalidValue=15, ComSignalType=UINT8, ComHandleId=24, ComSystemTemplateSystemSignalRef=RBTMFR_SP_ActvClient_ST35
        RBTMFR_Actv_Lvl_ST35_77991ccb_Tx: ComBitPosition=10, ComBitSize=6, ComSignalDataInvalidValue=63, ComSignalType=UINT8, ComHandleId=23, ComSystemTemplateSystemSignalRef=RBTMFR_Actv_Lvl_ST35
      RBTM_FR_Tens_ST3_6c59775c_Tx (ComIPdu):
        ComIPduDirection = SEND
        ComIPduType = NORMAL
        ComIPduHandleId = 6
        ComIPduSignalProcessing = DEFERRED
        ComIPduCancellationSupport = false
        ComIPduGroupRef = RBTM_FR_BODY3_Tx_PNC_20_71aa89b7
        ComIPduGroupRef = RBTM_FR_BODY3_Tx_PNC_All_Active_fe1bacc5
        ComIPduSignalRef = RBTMFR_Actv_Lvl_ST35_77991ccb_Tx
        ComIPduSignalRef = RBTMFR_SP_ActvClient_ST35_1fd8ade4_Tx
        ComIPduSignalRef = RBTMFR_SP_FctPrecond_Stat_ST35_ce5639ee_Tx
        ComPduIdRef = RBTM_FR_Tens_ST3_6c59775c_Tx
        ComIPduMainFunctionRef = ComMainFunctionTx
        variation-point = post-build-variant-condition{matching-criterion=SideAllocation, value=1}
        ComTxIPdu: ComMinimumDelayTime=0.02, ComTxIPduUnusedAreasDefault=255
          ComTxModeTrue
            ComTxMode: ComTxModeMode=MIXED, ComTxModeNumberOfRepetitions=0, ComTxModeTimeOffset=0.005, ComTxModeTimePeriod=0.5
          ComTxModeFalse
            ComTxMode: ComTxModeMode=NONE
    ComGeneral:
      ComConfigurationUseDet = false
      ComSafeBswChecks = true
      ComEnableSignalGroupArrayApi = true
      ComRetryFailedTransmitRequests = true
      ComSupportedIPduGroups = 5
      ComVersionInfoApi = false
      ComMetaDataSupport = false
      ComDeferredEventCacheSupport = true
      ComDescriptionGateway = false
      ComStrictRepetitionPeriod = false
      ComMixedModePeriodicSuppression = false
      ComSignalGateway = NONE
      ComMultiPartition = false
      ComEnableMDTForCyclicTransmission = true
      ComUserCbkHeaderFile = Appl_Cbk.h
      ComUserCbkHeaderFile = Rte_Cbk.h
