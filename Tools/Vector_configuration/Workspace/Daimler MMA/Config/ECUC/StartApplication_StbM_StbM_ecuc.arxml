AUTOSAR XML (schema 00049)
package /ActiveEcuC
  module config StbM: implementation-config-variant=VARIANT-PRE-COMPILE, module-description=StbM_Impl
    StbMGeneral: StbMDevErrorDetect=false, StbMMainFunctionPeriod=0.005, StbMTimeRecordingSupport=true, StbMVersionInfoApi=false, StbMSafeBswChecks=true
    GTD_BODY3_0_14e64f11 (StbMSynchronizedTimeBase):
      StbMClearTimeleapCount = 3
      StbMIsSystemWideGlobalTimeMaster = false
      StbMSyncLossTimeout = 1.75
      StbMSynchronizedTimeBaseIdentifier = 0
      StbMTimeLeapFutureThreshold = 0.0017
      StbMTimeLeapPastThreshold = 0.0017
      StbMOsApplicationRef = OsApplication_Trusted_Core0
      StbMOsApplicationRef = SystemApplication_OsCore0
      StbMLocalTimeClock: StbMClockFrequency=40000000, StbMClockPrescaler=1, StbMLocalTimeHardware=GptChannelConfiguration_StbM_LocalTime
      StbMTimeRecording: StbMSyncTimeRecordTableBlockCount=1, StbMOffsetTimeRecordTableBlockCount=0, StbMSyncTimeRecordBlockCallback=SyncTimeRecordBlock
