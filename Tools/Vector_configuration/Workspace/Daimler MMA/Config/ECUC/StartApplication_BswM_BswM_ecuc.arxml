AUTOSAR XML (schema 00049)
package /ActiveEcuC
  module config BswM: implementation-config-variant=VARIANT-POST-BUILD-SELECTABLE, module-description=BswM_Impl
    BswMGeneral:
      BswMComMEnabled = true
      BswMEcuMEnabled = true
      BswMVersionInfoApi = false
      BswMCanSMEnabled = true
      BswMDcmEnabled = true
      BswMDevErrorDetect = false
      BswMEthIfEnabled = false
      BswMEthSMEnabled = false
      BswMFrSMEnabled = false
      BswMGenericRequestEnabled = true
      BswMJ1939DcmEnabled = false
      BswMJ1939NmEnabled = false
      BswMLinSMEnabled = false
      BswMLinTPEnabled = false
      BswMNmEnabled = false
      BswMNvMEnabled = true
      BswMPduREnabled = true
      BswMRuleControlEnabled = false
      BswMSdEnabled = false
      BswMWdgMEnabled = true
      BswMModeCheck = true
      BswMActionListQueueSearchAlgorithm = LINEAR_SEARCH
      BswMSafeBswChecks = true
      BswMMainFunctionPeriod = 0.005
      BswMSchMEnabled = true
      BswMCommonData_Left (BswMCommonData): variation-point=post-build-variant-condition{matching-criterion=SideAllocation, value=0}
      BswMGeneration:
        BswMOutOfBoundsWriteSanitizer = false
        BswMOutOfBoundsReadSanitizer = false
        BswMReduceConstantData2Define = true
        BswMBoolDataInArrayOfStructStrategy = BITMASKING
        BswMInterfacesForDeactivatedData = false
      BswMUserIncludeFiles: BswMUserIncludeFile=EcuM_Init_PBcfg.h
      BswMCommonData_Right (BswMCommonData): variation-point=post-build-variant-condition{matching-criterion=SideAllocation, value=1}
    BswMConfig
      BswMArbitration
        CC_Cond_CanSMIndication_RBTM_FL_BODY3_8uqv9blm85ehm0msat385m76v_03d5f5f6_EQ_CANSM_BSWM_FULL_COMMUNICATION (BswMModeCondition):
          BswMConditionType = BSWM_EQUALS
          BswMConditionMode = CC_CanSMIndication_RBTM_FL_BODY3_8uqv9blm85ehm0msat385m76v_03d5f5f6
          variation-point = post-build-variant-condition{matching-criterion=SideAllocation, value=0}
          BswMConditionValue
            BswMBswMode: BswMBswRequestedMode=CANSM_BSWM_FULL_COMMUNICATION
        CC_CanSMIndication_RBTM_FL_BODY3_8uqv9blm85ehm0msat385m76v_03d5f5f6 (BswMModeRequestPort):
          BswMArbitrateOnInit = false
          BswMRequestProcessing = BSWM_IMMEDIATE
          variation-point = post-build-variant-condition{matching-criterion=SideAllocation, value=0}
          BswMModeRequestSource
            BswMCanSMIndication: BswMCanSMChannelRef=RBTM_FL_BODY3_8uqv9blm85ehm0msat385m76v_03d5f5f6
          BswMModeInitValue
            BswMBswModeInitValue: BswMBswModeInitValueMode=CANSM_BSWM_NO_COMMUNICATION
        CC_RBTM_FL_BODY3_8uqv9blm85ehm0msat385m76v_03d5f5f6_TX (BswMRule):
          BswMNestedExecutionOnly = false
          BswMRuleId = 19
          BswMRuleInitState = BSWM_FALSE
          BswMRuleExpressionRef = CC_LE_RBTM_FL_BODY3_8uqv9blm85ehm0msat385m76v_03d5f5f6_TX
          BswMRuleFalseActionList = CC_AL_RBTM_FL_BODY3_8uqv9blm85ehm0msat385m76v_03d5f5f6_TX_Disable
          BswMRuleTrueActionList = CC_AL_RBTM_FL_BODY3_8uqv9blm85ehm0msat385m76v_03d5f5f6_TX_EnableNoinit
          variation-point = post-build-variant-condition{matching-criterion=SideAllocation, value=0}
        CC_LE_RBTM_FL_BODY3_8uqv9blm85ehm0msat385m76v_03d5f5f6_TX (BswMLogicalExpression):
          BswMLogicalOperator = BSWM_AND
          BswMArgumentRef = CC_Cond_CanSMIndication_RBTM_FL_BODY3_8uqv9blm85ehm0msat385m76v_03d5f5f6_EQ_CANSM_BSWM_FULL_COMMUNICATION
          BswMArgumentRef = CC_Cond_DcmComIndication_RBTM_FL_BODY3_8uqv9blm85ehm0msat385m76v_03d5f5f6_NEQ_DCM_ENABLE_RX_DISABLE_TX_NORM
          variation-point = post-build-variant-condition{matching-criterion=SideAllocation, value=0}
        ESH_RunToPostRun (BswMRule):
          BswMNestedExecutionOnly = false
          BswMRuleId = 7
          BswMRuleInitState = BSWM_FALSE
          BswMRuleExpressionRef = ESH_LE_RunToPostRunTransition
          BswMRuleTrueActionList = ESH_AL_ExitRun
        ESH_LE_RunToPostRunTransition (BswMLogicalExpression): BswMLogicalOperator=BSWM_AND, BswMArgumentRef=ESH_LE_RunReached, BswMArgumentRef=ESH_LE_NoRunAndNoKillAllRequest
        ESH_LE_RunReached (BswMLogicalExpression):
          BswMLogicalOperator = BSWM_AND
          BswMArgumentRef = ESH_Cond_StateIsRun
          BswMArgumentRef = ESH_Cond_ModeIsRun
          BswMArgumentRef = Cond_ESH_EcuMState_EQ_ECUM_STATE_APP_RUN
        ESH_Cond_StateIsRun (BswMModeCondition): BswMConditionType=BSWM_EQUALS, BswMConditionMode=ESH_State
          BswMConditionValue
            BswMBswMode: BswMBswRequestedMode=ESH_RUN
        ESH_State (BswMModeRequestPort): BswMArbitrateOnInit=true, BswMRequestProcessing=BSWM_IMMEDIATE
          BswMModeRequestSource
            BswMGenericRequest: BswMModeRequesterId=230, BswMRequestedModeMax=7
              7 x BswMGenericRequestMode:
                ESH_INIT: BswMGenericRequestModeValue=0
                ESH_RUN: BswMGenericRequestModeValue=1
                ESH_POST_RUN: BswMGenericRequestModeValue=2
                ESH_PREP_SHUTDOWN: BswMGenericRequestModeValue=3
                ESH_WAIT_FOR_NVM: BswMGenericRequestModeValue=4
                ESH_SHUTDOWN: BswMGenericRequestModeValue=5
                ESH_WAKEUP: BswMGenericRequestModeValue=6
          BswMModeInitValue
            BswMBswModeInitValue: BswMBswModeInitValueMode=ESH_INIT
        ESH_Cond_ModeIsRun (BswMModeCondition): BswMConditionType=BSWM_EQUALS, BswMConditionMode=ESH_ModeNotification
          BswMConditionValue
            BswMModeDeclaration: BswMModeValueRef=RUN
        ESH_ModeNotification (BswMModeRequestPort): BswMArbitrateOnInit=false, BswMRequestProcessing=BSWM_DEFERRED
          BswMModeRequestSource
            BswMSwcModeNotification: BswMSwcModeNotificationModeDeclarationGroupPrototypeRef=BswM_MDGP_ESH_Mode
          BswMModeInitValue
            BswMSwcModeInitValue: BswMSwcModeInitValueRef=STARTUP
        Cond_ESH_EcuMState_EQ_ECUM_STATE_APP_RUN (BswMModeCondition): BswMConditionType=BSWM_EQUALS, BswMConditionMode=ESH_EcuMState
          BswMConditionValue
            BswMBswMode: BswMBswRequestedMode=ECUM_STATE_APP_RUN
        ESH_EcuMState (BswMModeRequestPort): BswMArbitrateOnInit=false, BswMRequestProcessing=BSWM_DEFERRED
          BswMModeRequestSource
            BswMEcuMIndication
          BswMModeInitValue
            BswMBswModeInitValue: BswMBswModeInitValueMode=ECUM_STATE_OFF
        3 x BswMLogicalExpression:
          ESH_LE_NoRunAndNoKillAllRequest: BswMLogicalOperator=BSWM_OR, BswMArgumentRef=ESH_LE_NoRunReasons, BswMArgumentRef=ESH_Cond_KillAllRunRequestIsRequested
          ESH_LE_NoRunReasons: BswMLogicalOperator=BSWM_AND, BswMArgumentRef=ESH_LE_AllChannelsNoCom, BswMArgumentRef=ESH_LE_RunReleased, BswMArgumentRef=Cond_ESH_EcuMRequest_RUN_EQ_ECUM_RUNSTATUS_RELEASED, BswMArgumentRef=ESH_Cond_SelfRunReqTimerExpired
          ESH_LE_AllChannelsNoCom: BswMLogicalOperator=BSWM_AND, BswMArgumentRef=ESH_Cond_NoComOn_RBTM_FL_BODY3_8uqv9blm85ehm0msat385m76v_03d5f5f6 if post-build-variant-condition{matching-criterion=SideAllocation, value=0}, BswMArgumentRef=ESH_Cond_NoComOn_RBTM_FR_BODY3_4xwwtd59665s787n6ctawh7k8_23a94727 if post-build-variant-condition{matching-criterion=SideAllocation, value=1}
        ESH_Cond_NoComOn_RBTM_FL_BODY3_8uqv9blm85ehm0msat385m76v_03d5f5f6 (BswMModeCondition):
          BswMConditionType = BSWM_EQUALS
          BswMConditionMode = ESH_ComMIndication_RBTM_FL_BODY3_8uqv9blm85ehm0msat385m76v_03d5f5f6
          variation-point = post-build-variant-condition{matching-criterion=SideAllocation, value=0}
          BswMConditionValue
            BswMBswMode: BswMBswRequestedMode=COMM_NO_COMMUNICATION
        ESH_ComMIndication_RBTM_FL_BODY3_8uqv9blm85ehm0msat385m76v_03d5f5f6 (BswMModeRequestPort):
          BswMArbitrateOnInit = false
          BswMRequestProcessing = BSWM_DEFERRED
          variation-point = post-build-variant-condition{matching-criterion=SideAllocation, value=0}
          BswMModeRequestSource
            BswMComMIndication: BswMComMChannelRef=RBTM_FL_BODY3_8uqv9blm85ehm0msat385m76v_03d5f5f6
          BswMModeInitValue
            BswMBswModeInitValue: BswMBswModeInitValueMode=COMM_NO_COMMUNICATION
        ESH_LE_RunReleased (BswMLogicalExpression): BswMLogicalOperator=BSWM_AND, BswMArgumentRef=ESH_Cond_RunRequest0IsReleased, BswMArgumentRef=ESH_Cond_RunRequest1IsReleased
        ESH_Cond_RunRequest0IsReleased (BswMModeCondition): BswMConditionType=BSWM_EQUALS, BswMConditionMode=ESH_RunRequest_0
          BswMConditionValue
            BswMModeDeclaration: BswMModeValueRef=RELEASED
        ESH_RunRequest_0 (BswMModeRequestPort): BswMArbitrateOnInit=false, BswMRequestProcessing=BSWM_DEFERRED
          BswMModeRequestSource
            BswMSwcModeRequest: BswMModeRequestDataElementPrototypeName=requestedMode, BswMSwcModeRequestModeDeclarationGroupPrototypeRef=BswM_MDGP_ESH_RunRequest
          BswMModeInitValue
            BswMSwcModeInitValue: BswMSwcModeInitValueRef=RELEASED
        ESH_Cond_RunRequest1IsReleased (BswMModeCondition): BswMConditionType=BSWM_EQUALS, BswMConditionMode=ESH_RunRequest_1
          BswMConditionValue
            BswMModeDeclaration: BswMModeValueRef=RELEASED
        ESH_RunRequest_1 (BswMModeRequestPort): BswMArbitrateOnInit=false, BswMRequestProcessing=BSWM_DEFERRED
          BswMModeRequestSource
            BswMSwcModeRequest: BswMModeRequestDataElementPrototypeName=requestedMode, BswMSwcModeRequestModeDeclarationGroupPrototypeRef=BswM_MDGP_ESH_RunRequest
          BswMModeInitValue
            BswMSwcModeInitValue: BswMSwcModeInitValueRef=RELEASED
        Cond_ESH_EcuMRequest_RUN_EQ_ECUM_RUNSTATUS_RELEASED (BswMModeCondition): BswMConditionType=BSWM_EQUALS, BswMConditionMode=ESH_EcuMRequest_RUN
          BswMConditionValue
            BswMBswMode: BswMBswRequestedMode=ECUM_RUNSTATUS_RELEASED
        ESH_EcuMRequest_RUN (BswMModeRequestPort): BswMArbitrateOnInit=false, BswMRequestProcessing=BSWM_DEFERRED
          BswMModeRequestSource
            BswMEcuMRUNRequestIndication: BswMEcuMRUNRequestProtocolPort=RUN
          BswMModeInitValue
            BswMBswModeInitValue: BswMBswModeInitValueMode=ECUM_RUNSTATUS_RELEASED
        ESH_Cond_SelfRunReqTimerExpired (BswMModeCondition): BswMConditionType=BSWM_EQUALS, BswMConditionMode=ESH_SelfRunRequestTimer
          BswMConditionValue
            BswMBswMode: BswMBswRequestedMode=BSWM_TIMER_EXPIRED
        ESH_SelfRunRequestTimer (BswMModeRequestPort): BswMArbitrateOnInit=false, BswMRequestProcessing=BSWM_DEFERRED
          BswMModeRequestSource
            BswMTimer
          BswMModeInitValue
            BswMBswModeInitValue: BswMBswModeInitValueMode=BSWM_TIMER_STOPPED
        ESH_RunToPostRunNested (BswMRule):
          BswMNestedExecutionOnly = true
          BswMRuleId = 8
          BswMRuleInitState = BSWM_FALSE
          BswMRuleExpressionRef = ESH_LE_ComMNoPendingRequests
          BswMRuleTrueActionList = ESH_AL_RunToPostRun
        ESH_LE_ComMNoPendingRequests (BswMLogicalExpression): BswMLogicalOperator=BSWM_OR, BswMArgumentRef=ESH_Cond_ComMNoPendingRequests, BswMArgumentRef=ESH_Cond_KillAllRunRequestIsRequested
        ESH_Cond_ComMNoPendingRequests (BswMModeCondition): BswMConditionType=BSWM_EQUALS, BswMConditionMode=ESH_ComMPendingRequests
          BswMConditionValue
            BswMBswMode: BswMBswRequestedMode=ESH_COMM_NO_REQUEST
        ESH_ComMPendingRequests (BswMModeRequestPort): BswMArbitrateOnInit=false, BswMRequestProcessing=BSWM_DEFERRED
          BswMModeRequestSource
            BswMGenericRequest: BswMModeRequesterId=232, BswMRequestedModeMax=2
              ESH_COMM_NO_REQUEST (BswMGenericRequestMode): BswMGenericRequestModeValue=0
              ESH_COMM_PENDING_REQUEST (BswMGenericRequestMode): BswMGenericRequestModeValue=1
          BswMModeInitValue
            BswMBswModeInitValue: BswMBswModeInitValueMode=ESH_COMM_NO_REQUEST
        ESH_WaitToShutdown (BswMRule):
          BswMNestedExecutionOnly = false
          BswMRuleId = 9
          BswMRuleInitState = BSWM_FALSE
          BswMRuleExpressionRef = ESH_LE_WaitForNvMToShutdown
          BswMRuleTrueActionList = ESH_AL_WaitForNvMToShutdown
        ESH_LE_WaitForNvMToShutdown (BswMLogicalExpression): BswMLogicalOperator=BSWM_AND, BswMArgumentRef=ESH_Cond_StateIsWaitForNvm, BswMArgumentRef=ESH_LE_NoWakeupOrKillAll
        ESH_Cond_StateIsWaitForNvm (BswMModeCondition): BswMConditionType=BSWM_EQUALS, BswMConditionMode=ESH_State
          BswMConditionValue
            BswMBswMode: BswMBswRequestedMode=ESH_WAIT_FOR_NVM
        ESH_LE_NoWakeupOrKillAll (BswMLogicalExpression): BswMLogicalOperator=BSWM_OR, BswMArgumentRef=ESH_Cond_KillAllRunRequestIsRequested, BswMArgumentRef=ESH_LE_NoWakeup
        ESH_LE_NoWakeup (BswMLogicalExpression): BswMLogicalOperator=BSWM_AND, BswMArgumentRef=ESH_Cond_NoValidatedWakeups, BswMArgumentRef=ESH_Cond_ComMNoPendingRequests
        ESH_Cond_NoValidatedWakeups (BswMModeCondition): BswMConditionType=BSWM_EQUALS, BswMConditionMode=ESH_EcuM_GetValidatedWakeupEvents
          BswMConditionValue
            BswMBswMode: BswMBswRequestedMode=0
        ESH_EcuM_GetValidatedWakeupEvents (BswMModeRequestPort): BswMArbitrateOnInit=false, BswMRequestProcessing=BSWM_DEFERRED  # COVERS: PLAIN_TEXT ARCH_SW_MAIN_0004;
          BswMModeRequestSource
            BswMUserConditionRequest: BswMUserCondition=EcuM_GetValidatedWakeupEvents()
        ESH_WakeupToPrep (BswMRule):
          BswMNestedExecutionOnly = false
          BswMRuleId = 11
          BswMRuleInitState = BSWM_FALSE
          BswMRuleExpressionRef = ESH_LE_WakeupToPrepShutdown
          BswMRuleTrueActionList = ESH_AL_WakeupToPrep
        ESH_LE_WakeupToPrepShutdown (BswMLogicalExpression):
          BswMLogicalOperator = BSWM_AND
          BswMArgumentRef = ESH_Cond_StateIsWakeup
          BswMArgumentRef = ESH_Cond_NoPendingWakeups
          BswMArgumentRef = ESH_LE_NoWakeup
          BswMArgumentRef = ESH_Cond_ModeIsWakeup
        ESH_Cond_StateIsWakeup (BswMModeCondition): BswMConditionType=BSWM_EQUALS, BswMConditionMode=ESH_State
          BswMConditionValue
            BswMBswMode: BswMBswRequestedMode=ESH_WAKEUP
        ESH_Cond_NoPendingWakeups (BswMModeCondition): BswMConditionType=BSWM_EQUALS, BswMConditionMode=ESH_EcuM_GetPendingWakeupEvents
          BswMConditionValue
            BswMBswMode: BswMBswRequestedMode=0
        ESH_EcuM_GetPendingWakeupEvents (BswMModeRequestPort): BswMArbitrateOnInit=false, BswMRequestProcessing=BSWM_DEFERRED
          BswMModeRequestSource
            BswMUserConditionRequest: BswMUserCondition=EcuM_GetPendingWakeupEvents()
        ESH_Cond_ModeIsWakeup (BswMModeCondition): BswMConditionType=BSWM_EQUALS, BswMConditionMode=ESH_ModeNotification
          BswMConditionValue
            BswMModeDeclaration: BswMModeValueRef=WAKEUP
        ESH_WaitToWakeup (BswMRule):
          BswMNestedExecutionOnly = false
          BswMRuleId = 10
          BswMRuleInitState = BSWM_FALSE
          BswMRuleExpressionRef = ESH_LE_WaitForNvMToWakeup
          BswMRuleTrueActionList = ESH_AL_WaitForNvMWakeup
        ESH_LE_WaitForNvMToWakeup (BswMLogicalExpression):
          BswMLogicalOperator = BSWM_AND
          BswMArgumentRef = ESH_Cond_StateIsWaitForNvm
          BswMArgumentRef = ESH_LE_ValidWakeup
          BswMArgumentRef = ESH_Cond_KillAllRunRequestIsReleased
        ESH_LE_ValidWakeup (BswMLogicalExpression): BswMLogicalOperator=BSWM_OR, BswMArgumentRef=ESH_Cond_ValidatedWakeups, BswMArgumentRef=ESH_Cond_ComMPendingRequests
        ESH_Cond_ValidatedWakeups (BswMModeCondition): BswMConditionType=BSWM_EQUALS_NOT, BswMConditionMode=ESH_EcuM_GetValidatedWakeupEvents
          BswMConditionValue
            BswMBswMode: BswMBswRequestedMode=0
        ESH_Cond_ComMPendingRequests (BswMModeCondition): BswMConditionType=BSWM_EQUALS, BswMConditionMode=ESH_ComMPendingRequests
          BswMConditionValue
            BswMBswMode: BswMBswRequestedMode=ESH_COMM_PENDING_REQUEST
        ESH_WakeupToRun (BswMRule):  # COVERS: PLAIN_TEXT ARCH_SW_MAIN_0004;
          BswMNestedExecutionOnly = false
          BswMRuleId = 12
          BswMRuleInitState = BSWM_FALSE
          BswMRuleExpressionRef = ESH_LE_WakeupToRun
          BswMRuleTrueActionList = ESH_AL_WakeupToRun
        ESH_LE_WakeupToRun (BswMLogicalExpression): BswMLogicalOperator=BSWM_AND, BswMArgumentRef=ESH_Cond_StateIsWakeup, BswMArgumentRef=ESH_LE_ValidWakeup, BswMArgumentRef=ESH_Cond_ModeIsWakeup
        ESH_DemInit (BswMRule):
          BswMNestedExecutionOnly = true
          BswMRuleId = 1
          BswMRuleInitState = BSWM_FALSE
          BswMRuleExpressionRef = ESH_LE_DemNotInitialized
          BswMRuleTrueActionList = ESH_AL_DemInit
        ESH_LE_DemNotInitialized (BswMLogicalExpression): BswMLogicalOperator=BSWM_OR, BswMArgumentRef=ESH_Cond_DemNotInitialized
        ESH_Cond_DemNotInitialized (BswMModeCondition): BswMConditionType=BSWM_EQUALS, BswMConditionMode=ESH_DemInitStatus
          BswMConditionValue
            BswMBswMode: BswMBswRequestedMode=DEM_NOT_INITIALIZED
        ESH_DemInitStatus (BswMModeRequestPort): BswMArbitrateOnInit=false, BswMRequestProcessing=BSWM_IMMEDIATE
          BswMModeRequestSource
            BswMGenericRequest: BswMModeRequesterId=231, BswMRequestedModeMax=2
              DEM_INITIALIZED (BswMGenericRequestMode): BswMGenericRequestModeValue=0
              DEM_NOT_INITIALIZED (BswMGenericRequestMode): BswMGenericRequestModeValue=1
          BswMModeInitValue
            BswMBswModeInitValue: BswMBswModeInitValueMode=DEM_INITIALIZED
        ESH_InitToWakeup (BswMRule):
          BswMNestedExecutionOnly = false
          BswMRuleId = 2
          BswMRuleInitState = BSWM_FALSE
          BswMRuleExpressionRef = ESH_LE_InitToWakeup
          BswMRuleTrueActionList = ESH_AL_InitToWakeup
        ESH_LE_InitToWakeup (BswMLogicalExpression): BswMLogicalOperator=BSWM_AND, BswMArgumentRef=ESH_Cond_StateIsInit, BswMArgumentRef=Cond_ESH_EcuMState_EQ_ECUM_STATE_STARTUP
        ESH_Cond_StateIsInit (BswMModeCondition): BswMConditionType=BSWM_EQUALS, BswMConditionMode=ESH_State
          BswMConditionValue
            BswMBswMode: BswMBswRequestedMode=ESH_INIT
        Cond_ESH_EcuMState_EQ_ECUM_STATE_STARTUP (BswMModeCondition): BswMConditionType=BSWM_EQUALS, BswMConditionMode=ESH_EcuMState
          BswMConditionValue
            BswMBswMode: BswMBswRequestedMode=ECUM_STATE_STARTUP
        ESH_PostRunToPrepNested (BswMRule):
          BswMNestedExecutionOnly = true
          BswMRuleId = 5
          BswMRuleInitState = BSWM_FALSE
          BswMRuleExpressionRef = ESH_LE_Dem_PostRunRequested
          BswMRuleTrueActionList = ESH_AL_PostRunToPrepShutdown
        3 x BswMLogicalExpression:
          ESH_LE_Dem_PostRunRequested: BswMLogicalOperator=BSWM_AND, BswMArgumentRef=ESH_LE_PostRunToPrep, BswMArgumentRef=ESH_Cond_DemPostRunRequested
          ESH_LE_PostRunToPrep: BswMLogicalOperator=BSWM_OR, BswMArgumentRef=ESH_LE_PostRunReleased, BswMArgumentRef=ESH_Cond_KillAllRunRequestIsRequested
          ESH_LE_PostRunReleased: BswMLogicalOperator=BSWM_AND, BswMArgumentRef=ESH_Cond_PostRunRequest0IsReleased, BswMArgumentRef=ESH_Cond_PostRunRequest1IsReleased, BswMArgumentRef=Cond_ESH_EcuMRequest_POSTRUN_EQ_ECUM_RUNSTATUS_RELEASED
        ESH_Cond_PostRunRequest0IsReleased (BswMModeCondition): BswMConditionType=BSWM_EQUALS, BswMConditionMode=ESH_PostRunRequest_0
          BswMConditionValue
            BswMModeDeclaration: BswMModeValueRef=RELEASED
        ESH_PostRunRequest_0 (BswMModeRequestPort): BswMArbitrateOnInit=false, BswMRequestProcessing=BSWM_DEFERRED
          BswMModeRequestSource
            BswMSwcModeRequest: BswMModeRequestDataElementPrototypeName=requestedMode, BswMSwcModeRequestModeDeclarationGroupPrototypeRef=BswM_MDGP_ESH_RunRequest
          BswMModeInitValue
            BswMSwcModeInitValue: BswMSwcModeInitValueRef=RELEASED
        ESH_Cond_PostRunRequest1IsReleased (BswMModeCondition): BswMConditionType=BSWM_EQUALS, BswMConditionMode=ESH_PostRunRequest_1
          BswMConditionValue
            BswMModeDeclaration: BswMModeValueRef=RELEASED
        ESH_PostRunRequest_1 (BswMModeRequestPort): BswMArbitrateOnInit=false, BswMRequestProcessing=BSWM_DEFERRED
          BswMModeRequestSource
            BswMSwcModeRequest: BswMModeRequestDataElementPrototypeName=requestedMode, BswMSwcModeRequestModeDeclarationGroupPrototypeRef=BswM_MDGP_ESH_RunRequest
          BswMModeInitValue
            BswMSwcModeInitValue: BswMSwcModeInitValueRef=RELEASED
        Cond_ESH_EcuMRequest_POSTRUN_EQ_ECUM_RUNSTATUS_RELEASED (BswMModeCondition): BswMConditionType=BSWM_EQUALS, BswMConditionMode=ESH_EcuMRequest_POSTRUN
          BswMConditionValue
            BswMBswMode: BswMBswRequestedMode=ECUM_RUNSTATUS_RELEASED
        ESH_EcuMRequest_POSTRUN (BswMModeRequestPort): BswMArbitrateOnInit=false, BswMRequestProcessing=BSWM_DEFERRED
          BswMModeRequestSource
            BswMEcuMRUNRequestIndication: BswMEcuMRUNRequestProtocolPort=POST_RUN
          BswMModeInitValue
            BswMBswModeInitValue: BswMBswModeInitValueMode=ECUM_RUNSTATUS_RELEASED
        ESH_Cond_DemPostRunRequested (BswMModeCondition): BswMConditionType=BSWM_EQUALS, BswMConditionMode=ESH_DemPostRunRequested
          BswMConditionValue
            BswMBswMode: BswMBswRequestedMode=FALSE
        ESH_DemPostRunRequested (BswMModeRequestPort): BswMArbitrateOnInit=false, BswMRequestProcessing=BSWM_DEFERRED
          BswMModeRequestSource
            BswMGenericRequest: BswMModeRequesterId=233, BswMRequestedModeMax=2
              TRUE (BswMGenericRequestMode): BswMGenericRequestModeValue=0
              FALSE (BswMGenericRequestMode): BswMGenericRequestModeValue=1
          BswMModeInitValue
            BswMBswModeInitValue: BswMBswModeInitValueMode=TRUE
        ESH_PostRunNested (BswMRule):
          BswMNestedExecutionOnly = true
          BswMRuleId = 4
          BswMRuleInitState = BSWM_FALSE
          BswMRuleExpressionRef = ESH_LE_PostRunToRun
          BswMRuleFalseActionList = ESH_AL_ESH_PostRunToPrepCheck
          BswMRuleTrueActionList = ESH_AL_PostRunToRun
        3 x BswMLogicalExpression:
          ESH_LE_PostRunToRun: BswMLogicalOperator=BSWM_AND, BswMArgumentRef=ESH_LE_RunRequestsOrWakeup, BswMArgumentRef=ESH_Cond_KillAllRunRequestIsReleased
          ESH_LE_RunRequestsOrWakeup: BswMLogicalOperator=BSWM_OR, BswMArgumentRef=ESH_LE_RunRequested, BswMArgumentRef=Cond_ESH_EcuMRequest_RUN_EQ_ECUM_RUNSTATUS_REQUESTED, BswMArgumentRef=ESH_LE_ValidWakeup
          ESH_LE_RunRequested: BswMLogicalOperator=BSWM_OR, BswMArgumentRef=ESH_Cond_RunRequest0IsRequested, BswMArgumentRef=ESH_Cond_RunRequest1IsRequested
        3 x BswMModeCondition, all with BswMConditionType=BSWM_EQUALS:
          ESH_Cond_RunRequest0IsRequested: BswMConditionMode=ESH_RunRequest_0
            BswMConditionValue
              BswMModeDeclaration: BswMModeValueRef=REQUESTED
          ESH_Cond_RunRequest1IsRequested: BswMConditionMode=ESH_RunRequest_1
            BswMConditionValue
              BswMModeDeclaration: BswMModeValueRef=REQUESTED
          Cond_ESH_EcuMRequest_RUN_EQ_ECUM_RUNSTATUS_REQUESTED: BswMConditionMode=ESH_EcuMRequest_RUN
            BswMConditionValue
              BswMBswMode: BswMBswRequestedMode=ECUM_RUNSTATUS_REQUESTED
        ESH_PostRun (BswMRule):
          BswMNestedExecutionOnly = false
          BswMRuleId = 3
          BswMRuleInitState = BSWM_FALSE
          BswMRuleExpressionRef = ESH_LE_PostRun
          BswMRuleTrueActionList = ESH_AL_ExitPostRun
        ESH_LE_PostRun (BswMLogicalExpression):
          BswMLogicalOperator = BSWM_AND
          BswMArgumentRef = ESH_Cond_StateIsPostRun
          BswMArgumentRef = ESH_Cond_ModeIsPostRun
          BswMArgumentRef = Cond_ESH_EcuMState_EQ_ECUM_STATE_APP_POST_RUN
        3 x BswMModeCondition, all with BswMConditionType=BSWM_EQUALS:
          ESH_Cond_StateIsPostRun: BswMConditionMode=ESH_State
            BswMConditionValue
              BswMBswMode: BswMBswRequestedMode=ESH_POST_RUN
          ESH_Cond_ModeIsPostRun: BswMConditionMode=ESH_ModeNotification
            BswMConditionValue
              BswMModeDeclaration: BswMModeValueRef=POSTRUN
          Cond_ESH_EcuMState_EQ_ECUM_STATE_APP_POST_RUN: BswMConditionMode=ESH_EcuMState
            BswMConditionValue
              BswMBswMode: BswMBswRequestedMode=ECUM_STATE_APP_POST_RUN
        ESH_PrepToWait (BswMRule):
          BswMNestedExecutionOnly = false
          BswMRuleId = 6
          BswMRuleInitState = BSWM_FALSE
          BswMRuleExpressionRef = ESH_LE_PrepShutdownToWaitForNvM
          BswMRuleTrueActionList = ESH_AL_PrepShutdownToWaitForNvM
        ESH_LE_PrepShutdownToWaitForNvM (BswMLogicalExpression):
          BswMLogicalOperator = BSWM_AND
          BswMArgumentRef = ESH_Cond_StateIsPrepShutdown
          BswMArgumentRef = ESH_Cond_ModeIsShutdown
          BswMArgumentRef = ESH_LE_EcuMStateSleepOrShutdown
        ESH_Cond_StateIsPrepShutdown (BswMModeCondition): BswMConditionType=BSWM_EQUALS, BswMConditionMode=ESH_State
          BswMConditionValue
            BswMBswMode: BswMBswRequestedMode=ESH_PREP_SHUTDOWN
        ESH_Cond_ModeIsShutdown (BswMModeCondition): BswMConditionType=BSWM_EQUALS, BswMConditionMode=ESH_ModeNotification
          BswMConditionValue
            BswMModeDeclaration: BswMModeValueRef=SHUTDOWN
        ESH_LE_EcuMStateSleepOrShutdown (BswMLogicalExpression): BswMLogicalOperator=BSWM_OR, BswMArgumentRef=Cond_ESH_EcuMState_EQ_ECUM_STATE_SHUTDOWN, BswMArgumentRef=Cond_ESH_EcuMState_EQ_ECUM_STATE_SLEEP
        3 x BswMModeCondition:
          Cond_ESH_EcuMState_EQ_ECUM_STATE_SHUTDOWN: BswMConditionType=BSWM_EQUALS, BswMConditionMode=ESH_EcuMState
            BswMConditionValue
              BswMBswMode: BswMBswRequestedMode=ECUM_STATE_SHUTDOWN
          Cond_ESH_EcuMState_EQ_ECUM_STATE_SLEEP: BswMConditionType=BSWM_EQUALS, BswMConditionMode=ESH_EcuMState
            BswMConditionValue
              BswMBswMode: BswMBswRequestedMode=ECUM_STATE_SLEEP
          CC_Cond_DcmComIndication_RBTM_FL_BODY3_8uqv9blm85ehm0msat385m76v_03d5f5f6_NEQ_DCM_ENABLE_RX_DISABLE_TX_NORM: BswMConditionType=BSWM_EQUALS_NOT, BswMConditionMode=CC_DcmComIndication_RBTM_FL_BODY3_8uqv9blm85ehm0msat385m76v_03d5f5f6, variation-point=post-build-variant-condition{matching-criterion=SideAllocation, value=0}
            BswMConditionValue
              BswMBswMode: BswMBswRequestedMode=DCM_ENABLE_RX_DISABLE_TX_NORM
        CC_DcmComIndication_RBTM_FL_BODY3_8uqv9blm85ehm0msat385m76v_03d5f5f6 (BswMModeRequestPort):
          BswMArbitrateOnInit = false
          BswMRequestProcessing = BSWM_IMMEDIATE
          variation-point = post-build-variant-condition{matching-criterion=SideAllocation, value=0}
          BswMModeRequestSource
            BswMDcmComModeRequest: BswMDcmComMChannelRef=RBTM_FL_BODY3_8uqv9blm85ehm0msat385m76v_03d5f5f6
          BswMModeInitValue
            BswMBswModeInitValue: BswMBswModeInitValueMode=DCM_ENABLE_RX_TX_NORM_NM
        ESH_Cond_KillAllRunRequestIsRequested (BswMModeCondition): BswMConditionType=BSWM_EQUALS, BswMConditionMode=ESH_KillAllRunRequest
          BswMConditionValue
            BswMModeDeclaration: BswMModeValueRef=REQUESTED
        ESH_KillAllRunRequest (BswMModeRequestPort): BswMArbitrateOnInit=false, BswMRequestProcessing=BSWM_DEFERRED
          BswMModeRequestSource
            BswMSwcModeRequest: BswMModeRequestDataElementPrototypeName=requestedMode, BswMSwcModeRequestModeDeclarationGroupPrototypeRef=BswM_MDGP_ESH_KillAllRun
          BswMModeInitValue
            BswMSwcModeInitValue: BswMSwcModeInitValueRef=RELEASED
        ESH_Cond_KillAllRunRequestIsReleased (BswMModeCondition): BswMConditionType=BSWM_EQUALS, BswMConditionMode=ESH_KillAllRunRequest
          BswMConditionValue
            BswMModeDeclaration: BswMModeValueRef=RELEASED
        CC_RBTM_FL_BODY3_8uqv9blm85ehm0msat385m76v_03d5f5f6_PNC_00_MAPPING_b2c42696_RX (BswMRule):
          BswMNestedExecutionOnly = false
          BswMRuleId = 13
          BswMRuleInitState = BSWM_FALSE
          BswMRuleExpressionRef = CC_LE_RBTM_FL_BODY3_8uqv9blm85ehm0msat385m76v_03d5f5f6_PNC_00_MAPPING_b2c42696_RX
          BswMRuleFalseActionList = CC_AL_RBTM_FL_BODY3_8uqv9blm85ehm0msat385m76v_03d5f5f6_PNC_00_MAPPING_b2c42696_RX_Disable
          BswMRuleTrueActionList = CC_AL_RBTM_FL_BODY3_8uqv9blm85ehm0msat385m76v_03d5f5f6_PNC_00_MAPPING_b2c42696_RX_EnableNoinit
          variation-point = post-build-variant-condition{matching-criterion=SideAllocation, value=0}
        CC_LE_RBTM_FL_BODY3_8uqv9blm85ehm0msat385m76v_03d5f5f6_PNC_00_MAPPING_b2c42696_RX (BswMLogicalExpression):
          BswMLogicalOperator = BSWM_AND
          BswMArgumentRef = CC_LE_PNC_RBTM_FL_BODY3_8uqv9blm85ehm0msat385m76v_03d5f5f6_PNC_00_MAPPING_b2c42696_NEQ_NOCOM
          BswMArgumentRef = CC_Cond_CanSMIndication_RBTM_FL_BODY3_8uqv9blm85ehm0msat385m76v_03d5f5f6_NEQ_CANSM_BSWM_NO_COMMUNICATION
          variation-point = post-build-variant-condition{matching-criterion=SideAllocation, value=0}
        CC_LE_PNC_RBTM_FL_BODY3_8uqv9blm85ehm0msat385m76v_03d5f5f6_PNC_00_MAPPING_b2c42696_NEQ_NOCOM (BswMLogicalExpression):
          BswMLogicalOperator = BSWM_OR
          BswMArgumentRef = CC_PNC_PNC_00_MAPPING_b2c42696_RBTM_FL_BODY3_8uqv9blm85ehm0msat385m76v_03d5f5f6_PNC_00_MAPPING_b2c42696_NEQ_NOCOM
          variation-point = post-build-variant-condition{matching-criterion=SideAllocation, value=0}
        CC_PNC_PNC_00_MAPPING_b2c42696_RBTM_FL_BODY3_8uqv9blm85ehm0msat385m76v_03d5f5f6_PNC_00_MAPPING_b2c42696_NEQ_NOCOM (BswMModeCondition):
          BswMConditionType = BSWM_EQUALS_NOT
          BswMConditionMode = CC_PNC_PNC_00_MAPPING_b2c42696
          variation-point = post-build-variant-condition{matching-criterion=SideAllocation, value=0}
          BswMConditionValue
            BswMBswMode: BswMBswRequestedMode=COMM_PNC_NO_COMMUNICATION
        CC_PNC_PNC_00_MAPPING_b2c42696 (BswMModeRequestPort): BswMArbitrateOnInit=false, BswMRequestProcessing=BSWM_IMMEDIATE
          BswMModeRequestSource
            BswMComMPncRequest: BswMComMPncRef=PNC_00_MAPPING_b2c42696
          BswMModeInitValue
            BswMBswModeInitValue: BswMBswModeInitValueMode=COMM_PNC_NO_COMMUNICATION
        CC_Cond_CanSMIndication_RBTM_FL_BODY3_8uqv9blm85ehm0msat385m76v_03d5f5f6_NEQ_CANSM_BSWM_NO_COMMUNICATION (BswMModeCondition):
          BswMConditionType = BSWM_EQUALS_NOT
          BswMConditionMode = CC_CanSMIndication_RBTM_FL_BODY3_8uqv9blm85ehm0msat385m76v_03d5f5f6
          variation-point = post-build-variant-condition{matching-criterion=SideAllocation, value=0}
          BswMConditionValue
            BswMBswMode: BswMBswRequestedMode=CANSM_BSWM_NO_COMMUNICATION
        CC_RBTM_FL_BODY3_8uqv9blm85ehm0msat385m76v_03d5f5f6_PNC_00_MAPPING_b2c42696_RX_DM (BswMRule):
          BswMNestedExecutionOnly = false
          BswMRuleId = 14
          BswMRuleInitState = BSWM_FALSE
          BswMRuleExpressionRef = CC_LE_RBTM_FL_BODY3_8uqv9blm85ehm0msat385m76v_03d5f5f6_PNC_00_MAPPING_b2c42696_RX_DM
          BswMRuleFalseActionList = CC_AL_RBTM_FL_BODY3_8uqv9blm85ehm0msat385m76v_03d5f5f6_PNC_00_MAPPING_b2c42696_Disable_DM
          BswMRuleTrueActionList = CC_AL_RBTM_FL_BODY3_8uqv9blm85ehm0msat385m76v_03d5f5f6_PNC_00_MAPPING_b2c42696_Enable_DM
          variation-point = post-build-variant-condition{matching-criterion=SideAllocation, value=0}
        CC_LE_RBTM_FL_BODY3_8uqv9blm85ehm0msat385m76v_03d5f5f6_PNC_00_MAPPING_b2c42696_RX_DM (BswMLogicalExpression):
          BswMLogicalOperator = BSWM_AND
          BswMArgumentRef = CC_LE_PNC_RBTM_FL_BODY3_8uqv9blm85ehm0msat385m76v_03d5f5f6_PNC_00_MAPPING_b2c42696_NEQ_NOCOM
          BswMArgumentRef = CC_Cond_CanSMIndication_RBTM_FL_BODY3_8uqv9blm85ehm0msat385m76v_03d5f5f6_EQ_CANSM_BSWM_FULL_COMMUNICATION
          variation-point = post-build-variant-condition{matching-criterion=SideAllocation, value=0}
        CC_RBTM_FL_BODY3_8uqv9blm85ehm0msat385m76v_03d5f5f6_PNC_00_MAPPING_b2c42696_TX (BswMRule):
          BswMNestedExecutionOnly = false
          BswMRuleId = 15
          BswMRuleInitState = BSWM_FALSE
          BswMRuleExpressionRef = CC_LE_RBTM_FL_BODY3_8uqv9blm85ehm0msat385m76v_03d5f5f6_PNC_00_MAPPING_b2c42696_TX
          BswMRuleFalseActionList = CC_AL_RBTM_FL_BODY3_8uqv9blm85ehm0msat385m76v_03d5f5f6_PNC_00_MAPPING_b2c42696_TX_Disable
          BswMRuleTrueActionList = CC_AL_RBTM_FL_BODY3_8uqv9blm85ehm0msat385m76v_03d5f5f6_PNC_00_MAPPING_b2c42696_TX_EnableNoinit
          variation-point = post-build-variant-condition{matching-criterion=SideAllocation, value=0}
        CC_LE_RBTM_FL_BODY3_8uqv9blm85ehm0msat385m76v_03d5f5f6_PNC_00_MAPPING_b2c42696_TX (BswMLogicalExpression):
          BswMLogicalOperator = BSWM_AND
          BswMArgumentRef = CC_LE_PNC_RBTM_FL_BODY3_8uqv9blm85ehm0msat385m76v_03d5f5f6_PNC_00_MAPPING_b2c42696_NEQ_NOCOM
          BswMArgumentRef = CC_Cond_CanSMIndication_RBTM_FL_BODY3_8uqv9blm85ehm0msat385m76v_03d5f5f6_EQ_CANSM_BSWM_FULL_COMMUNICATION
          BswMArgumentRef = CC_Cond_DcmComIndication_RBTM_FL_BODY3_8uqv9blm85ehm0msat385m76v_03d5f5f6_NEQ_DCM_ENABLE_RX_DISABLE_TX_NORM
          variation-point = post-build-variant-condition{matching-criterion=SideAllocation, value=0}
        CC_RBTM_FL_BODY3_8uqv9blm85ehm0msat385m76v_03d5f5f6_PNC_20_MAPPING_796df885_RX_DM (BswMRule):
          BswMNestedExecutionOnly = false
          BswMRuleId = 17
          BswMRuleInitState = BSWM_FALSE
          BswMRuleExpressionRef = CC_LE_RBTM_FL_BODY3_8uqv9blm85ehm0msat385m76v_03d5f5f6_PNC_20_MAPPING_796df885_RX_DM
          BswMRuleFalseActionList = CC_AL_RBTM_FL_BODY3_8uqv9blm85ehm0msat385m76v_03d5f5f6_PNC_20_MAPPING_796df885_Disable_DM
          BswMRuleTrueActionList = CC_AL_RBTM_FL_BODY3_8uqv9blm85ehm0msat385m76v_03d5f5f6_PNC_20_MAPPING_796df885_Enable_DM
          variation-point = post-build-variant-condition{matching-criterion=SideAllocation, value=0}
        CC_LE_RBTM_FL_BODY3_8uqv9blm85ehm0msat385m76v_03d5f5f6_PNC_20_MAPPING_796df885_RX_DM (BswMLogicalExpression):
          BswMLogicalOperator = BSWM_AND
          BswMArgumentRef = CC_LE_PNC_RBTM_FL_BODY3_8uqv9blm85ehm0msat385m76v_03d5f5f6_PNC_20_MAPPING_796df885_NEQ_NOCOM
          BswMArgumentRef = CC_Cond_CanSMIndication_RBTM_FL_BODY3_8uqv9blm85ehm0msat385m76v_03d5f5f6_EQ_CANSM_BSWM_FULL_COMMUNICATION
          variation-point = post-build-variant-condition{matching-criterion=SideAllocation, value=0}
        CC_LE_PNC_RBTM_FL_BODY3_8uqv9blm85ehm0msat385m76v_03d5f5f6_PNC_20_MAPPING_796df885_NEQ_NOCOM (BswMLogicalExpression):
          BswMLogicalOperator = BSWM_OR
          BswMArgumentRef = CC_PNC_PNC_20_MAPPING_796df885_RBTM_FL_BODY3_8uqv9blm85ehm0msat385m76v_03d5f5f6_PNC_20_MAPPING_796df885_NEQ_NOCOM
          variation-point = post-build-variant-condition{matching-criterion=SideAllocation, value=0}
        CC_PNC_PNC_20_MAPPING_796df885_RBTM_FL_BODY3_8uqv9blm85ehm0msat385m76v_03d5f5f6_PNC_20_MAPPING_796df885_NEQ_NOCOM (BswMModeCondition):
          BswMConditionType = BSWM_EQUALS_NOT
          BswMConditionMode = CC_PNC_PNC_20_MAPPING_796df885
          variation-point = post-build-variant-condition{matching-criterion=SideAllocation, value=0}
          BswMConditionValue
            BswMBswMode: BswMBswRequestedMode=COMM_PNC_NO_COMMUNICATION
        CC_PNC_PNC_20_MAPPING_796df885 (BswMModeRequestPort): BswMArbitrateOnInit=false, BswMRequestProcessing=BSWM_IMMEDIATE
          BswMModeRequestSource
            BswMComMPncRequest: BswMComMPncRef=PNC_20_MAPPING_796df885
          BswMModeInitValue
            BswMBswModeInitValue: BswMBswModeInitValueMode=COMM_PNC_NO_COMMUNICATION
        CC_RBTM_FL_BODY3_8uqv9blm85ehm0msat385m76v_03d5f5f6_PNC_20_MAPPING_796df885_TX (BswMRule):
          BswMNestedExecutionOnly = false
          BswMRuleId = 18
          BswMRuleInitState = BSWM_FALSE
          BswMRuleExpressionRef = CC_LE_RBTM_FL_BODY3_8uqv9blm85ehm0msat385m76v_03d5f5f6_PNC_20_MAPPING_796df885_TX
          BswMRuleFalseActionList = CC_AL_RBTM_FL_BODY3_8uqv9blm85ehm0msat385m76v_03d5f5f6_PNC_20_MAPPING_796df885_TX_Disable
          BswMRuleTrueActionList = CC_AL_RBTM_FL_BODY3_8uqv9blm85ehm0msat385m76v_03d5f5f6_PNC_20_MAPPING_796df885_TX_EnableNoinit
          variation-point = post-build-variant-condition{matching-criterion=SideAllocation, value=0}
        CC_LE_RBTM_FL_BODY3_8uqv9blm85ehm0msat385m76v_03d5f5f6_PNC_20_MAPPING_796df885_TX (BswMLogicalExpression):
          BswMLogicalOperator = BSWM_AND
          BswMArgumentRef = CC_LE_PNC_RBTM_FL_BODY3_8uqv9blm85ehm0msat385m76v_03d5f5f6_PNC_20_MAPPING_796df885_NEQ_NOCOM
          BswMArgumentRef = CC_Cond_CanSMIndication_RBTM_FL_BODY3_8uqv9blm85ehm0msat385m76v_03d5f5f6_EQ_CANSM_BSWM_FULL_COMMUNICATION
          BswMArgumentRef = CC_Cond_DcmComIndication_RBTM_FL_BODY3_8uqv9blm85ehm0msat385m76v_03d5f5f6_NEQ_DCM_ENABLE_RX_DISABLE_TX_NORM
          variation-point = post-build-variant-condition{matching-criterion=SideAllocation, value=0}
        CC_RBTM_FL_BODY3_8uqv9blm85ehm0msat385m76v_03d5f5f6_PNC_20_MAPPING_796df885_RX (BswMRule):
          BswMNestedExecutionOnly = false
          BswMRuleId = 16
          BswMRuleInitState = BSWM_FALSE
          BswMRuleExpressionRef = CC_LE_RBTM_FL_BODY3_8uqv9blm85ehm0msat385m76v_03d5f5f6_PNC_20_MAPPING_796df885_RX
          BswMRuleFalseActionList = CC_AL_RBTM_FL_BODY3_8uqv9blm85ehm0msat385m76v_03d5f5f6_PNC_20_MAPPING_796df885_RX_Disable
          BswMRuleTrueActionList = CC_AL_RBTM_FL_BODY3_8uqv9blm85ehm0msat385m76v_03d5f5f6_PNC_20_MAPPING_796df885_RX_EnableNoinit
          variation-point = post-build-variant-condition{matching-criterion=SideAllocation, value=0}
        CC_LE_RBTM_FL_BODY3_8uqv9blm85ehm0msat385m76v_03d5f5f6_PNC_20_MAPPING_796df885_RX (BswMLogicalExpression):
          BswMLogicalOperator = BSWM_AND
          BswMArgumentRef = CC_LE_PNC_RBTM_FL_BODY3_8uqv9blm85ehm0msat385m76v_03d5f5f6_PNC_20_MAPPING_796df885_NEQ_NOCOM
          BswMArgumentRef = CC_Cond_CanSMIndication_RBTM_FL_BODY3_8uqv9blm85ehm0msat385m76v_03d5f5f6_NEQ_CANSM_BSWM_NO_COMMUNICATION
          variation-point = post-build-variant-condition{matching-criterion=SideAllocation, value=0}
        ComMInitiateReset (BswMModeRequestPort): BswMArbitrateOnInit=false, BswMRequestProcessing=BSWM_FORCED_IMMEDIATE
          BswMModeRequestSource
            BswMComMInitiateReset
          BswMModeInitValue
            BswMBswModeInitValue: BswMBswModeInitValueMode=FALSE
        CC_RBTM_FR_BODY3_4xwwtd59665s787n6ctawh7k8_23a94727_PNC_00_MAPPING_b2c42696_RX_DM (BswMRule):
          BswMNestedExecutionOnly = false
          BswMRuleId = 14
          BswMRuleInitState = BSWM_FALSE
          BswMRuleExpressionRef = CC_LE_RBTM_FR_BODY3_4xwwtd59665s787n6ctawh7k8_23a94727_PNC_00_MAPPING_b2c42696_RX_DM
          BswMRuleFalseActionList = CC_AL_RBTM_FR_BODY3_4xwwtd59665s787n6ctawh7k8_23a94727_PNC_00_MAPPING_b2c42696_Disable_DM
          BswMRuleTrueActionList = CC_AL_RBTM_FR_BODY3_4xwwtd59665s787n6ctawh7k8_23a94727_PNC_00_MAPPING_b2c42696_Enable_DM
          variation-point = post-build-variant-condition{matching-criterion=SideAllocation, value=1}
        CC_LE_RBTM_FR_BODY3_4xwwtd59665s787n6ctawh7k8_23a94727_PNC_00_MAPPING_b2c42696_RX_DM (BswMLogicalExpression):
          BswMLogicalOperator = BSWM_AND
          BswMArgumentRef = CC_LE_PNC_RBTM_FR_BODY3_4xwwtd59665s787n6ctawh7k8_23a94727_PNC_00_MAPPING_b2c42696_NEQ_NOCOM
          BswMArgumentRef = CC_Cond_CanSMIndication_RBTM_FR_BODY3_4xwwtd59665s787n6ctawh7k8_23a94727_EQ_CANSM_BSWM_FULL_COMMUNICATION
          variation-point = post-build-variant-condition{matching-criterion=SideAllocation, value=1}
        CC_LE_PNC_RBTM_FR_BODY3_4xwwtd59665s787n6ctawh7k8_23a94727_PNC_00_MAPPING_b2c42696_NEQ_NOCOM (BswMLogicalExpression):
          BswMLogicalOperator = BSWM_OR
          BswMArgumentRef = CC_PNC_PNC_00_MAPPING_b2c42696_RBTM_FR_BODY3_4xwwtd59665s787n6ctawh7k8_23a94727_PNC_00_MAPPING_b2c42696_NEQ_NOCOM
          variation-point = post-build-variant-condition{matching-criterion=SideAllocation, value=1}
        CC_PNC_PNC_00_MAPPING_b2c42696_RBTM_FR_BODY3_4xwwtd59665s787n6ctawh7k8_23a94727_PNC_00_MAPPING_b2c42696_NEQ_NOCOM (BswMModeCondition):
          BswMConditionType = BSWM_EQUALS_NOT
          BswMConditionMode = CC_PNC_PNC_00_MAPPING_b2c42696
          variation-point = post-build-variant-condition{matching-criterion=SideAllocation, value=1}
          BswMConditionValue
            BswMBswMode: BswMBswRequestedMode=COMM_PNC_NO_COMMUNICATION
        CC_Cond_CanSMIndication_RBTM_FR_BODY3_4xwwtd59665s787n6ctawh7k8_23a94727_EQ_CANSM_BSWM_FULL_COMMUNICATION (BswMModeCondition):
          BswMConditionType = BSWM_EQUALS
          BswMConditionMode = CC_CanSMIndication_RBTM_FR_BODY3_4xwwtd59665s787n6ctawh7k8_23a94727
          variation-point = post-build-variant-condition{matching-criterion=SideAllocation, value=1}
          BswMConditionValue
            BswMBswMode: BswMBswRequestedMode=CANSM_BSWM_FULL_COMMUNICATION
        CC_CanSMIndication_RBTM_FR_BODY3_4xwwtd59665s787n6ctawh7k8_23a94727 (BswMModeRequestPort):
          BswMArbitrateOnInit = false
          BswMRequestProcessing = BSWM_IMMEDIATE
          variation-point = post-build-variant-condition{matching-criterion=SideAllocation, value=1}
          BswMModeRequestSource
            BswMCanSMIndication: BswMCanSMChannelRef=RBTM_FR_BODY3_4xwwtd59665s787n6ctawh7k8_23a94727
          BswMModeInitValue
            BswMBswModeInitValue: BswMBswModeInitValueMode=CANSM_BSWM_NO_COMMUNICATION
        CC_RBTM_FR_BODY3_4xwwtd59665s787n6ctawh7k8_23a94727_PNC_00_MAPPING_b2c42696_RX (BswMRule):
          BswMNestedExecutionOnly = false
          BswMRuleId = 13
          BswMRuleInitState = BSWM_FALSE
          BswMRuleExpressionRef = CC_LE_RBTM_FR_BODY3_4xwwtd59665s787n6ctawh7k8_23a94727_PNC_00_MAPPING_b2c42696_RX
          BswMRuleFalseActionList = CC_AL_RBTM_FR_BODY3_4xwwtd59665s787n6ctawh7k8_23a94727_PNC_00_MAPPING_b2c42696_RX_Disable
          BswMRuleTrueActionList = CC_AL_RBTM_FR_BODY3_4xwwtd59665s787n6ctawh7k8_23a94727_PNC_00_MAPPING_b2c42696_RX_EnableNoinit
          variation-point = post-build-variant-condition{matching-criterion=SideAllocation, value=1}
        CC_LE_RBTM_FR_BODY3_4xwwtd59665s787n6ctawh7k8_23a94727_PNC_00_MAPPING_b2c42696_RX (BswMLogicalExpression):
          BswMLogicalOperator = BSWM_AND
          BswMArgumentRef = CC_LE_PNC_RBTM_FR_BODY3_4xwwtd59665s787n6ctawh7k8_23a94727_PNC_00_MAPPING_b2c42696_NEQ_NOCOM
          BswMArgumentRef = CC_Cond_CanSMIndication_RBTM_FR_BODY3_4xwwtd59665s787n6ctawh7k8_23a94727_NEQ_CANSM_BSWM_NO_COMMUNICATION
          variation-point = post-build-variant-condition{matching-criterion=SideAllocation, value=1}
        CC_Cond_CanSMIndication_RBTM_FR_BODY3_4xwwtd59665s787n6ctawh7k8_23a94727_NEQ_CANSM_BSWM_NO_COMMUNICATION (BswMModeCondition):
          BswMConditionType = BSWM_EQUALS_NOT
          BswMConditionMode = CC_CanSMIndication_RBTM_FR_BODY3_4xwwtd59665s787n6ctawh7k8_23a94727
          variation-point = post-build-variant-condition{matching-criterion=SideAllocation, value=1}
          BswMConditionValue
            BswMBswMode: BswMBswRequestedMode=CANSM_BSWM_NO_COMMUNICATION
        CC_RBTM_FR_BODY3_4xwwtd59665s787n6ctawh7k8_23a94727_TX (BswMRule):
          BswMNestedExecutionOnly = false
          BswMRuleId = 19
          BswMRuleInitState = BSWM_FALSE
          BswMRuleExpressionRef = CC_LE_RBTM_FR_BODY3_4xwwtd59665s787n6ctawh7k8_23a94727_TX
          BswMRuleFalseActionList = CC_AL_RBTM_FR_BODY3_4xwwtd59665s787n6ctawh7k8_23a94727_TX_Disable
          BswMRuleTrueActionList = CC_AL_RBTM_FR_BODY3_4xwwtd59665s787n6ctawh7k8_23a94727_TX_EnableNoinit
          variation-point = post-build-variant-condition{matching-criterion=SideAllocation, value=1}
        CC_LE_RBTM_FR_BODY3_4xwwtd59665s787n6ctawh7k8_23a94727_TX (BswMLogicalExpression):
          BswMLogicalOperator = BSWM_AND
          BswMArgumentRef = CC_Cond_CanSMIndication_RBTM_FR_BODY3_4xwwtd59665s787n6ctawh7k8_23a94727_EQ_CANSM_BSWM_FULL_COMMUNICATION
          BswMArgumentRef = CC_Cond_DcmComIndication_RBTM_FR_BODY3_4xwwtd59665s787n6ctawh7k8_23a94727_NEQ_DCM_ENABLE_RX_DISABLE_TX_NORM
          variation-point = post-build-variant-condition{matching-criterion=SideAllocation, value=1}
        CC_RBTM_FR_BODY3_4xwwtd59665s787n6ctawh7k8_23a94727_PNC_20_MAPPING_796df885_TX (BswMRule):
          BswMNestedExecutionOnly = false
          BswMRuleId = 18
          BswMRuleInitState = BSWM_FALSE
          BswMRuleExpressionRef = CC_LE_RBTM_FR_BODY3_4xwwtd59665s787n6ctawh7k8_23a94727_PNC_20_MAPPING_796df885_TX
          BswMRuleFalseActionList = CC_AL_RBTM_FR_BODY3_4xwwtd59665s787n6ctawh7k8_23a94727_PNC_20_MAPPING_796df885_TX_Disable
          BswMRuleTrueActionList = CC_AL_RBTM_FR_BODY3_4xwwtd59665s787n6ctawh7k8_23a94727_PNC_20_MAPPING_796df885_TX_EnableNoinit
          variation-point = post-build-variant-condition{matching-criterion=SideAllocation, value=1}
        CC_LE_RBTM_FR_BODY3_4xwwtd59665s787n6ctawh7k8_23a94727_PNC_20_MAPPING_796df885_TX (BswMLogicalExpression):
          BswMLogicalOperator = BSWM_AND
          BswMArgumentRef = CC_LE_PNC_RBTM_FR_BODY3_4xwwtd59665s787n6ctawh7k8_23a94727_PNC_20_MAPPING_796df885_NEQ_NOCOM
          BswMArgumentRef = CC_Cond_CanSMIndication_RBTM_FR_BODY3_4xwwtd59665s787n6ctawh7k8_23a94727_EQ_CANSM_BSWM_FULL_COMMUNICATION
          BswMArgumentRef = CC_Cond_DcmComIndication_RBTM_FR_BODY3_4xwwtd59665s787n6ctawh7k8_23a94727_NEQ_DCM_ENABLE_RX_DISABLE_TX_NORM
          variation-point = post-build-variant-condition{matching-criterion=SideAllocation, value=1}
        CC_LE_PNC_RBTM_FR_BODY3_4xwwtd59665s787n6ctawh7k8_23a94727_PNC_20_MAPPING_796df885_NEQ_NOCOM (BswMLogicalExpression):
          BswMLogicalOperator = BSWM_OR
          BswMArgumentRef = CC_PNC_PNC_20_MAPPING_796df885_RBTM_FR_BODY3_4xwwtd59665s787n6ctawh7k8_23a94727_PNC_20_MAPPING_796df885_NEQ_NOCOM
          variation-point = post-build-variant-condition{matching-criterion=SideAllocation, value=1}
        CC_PNC_PNC_20_MAPPING_796df885_RBTM_FR_BODY3_4xwwtd59665s787n6ctawh7k8_23a94727_PNC_20_MAPPING_796df885_NEQ_NOCOM (BswMModeCondition):
          BswMConditionType = BSWM_EQUALS_NOT
          BswMConditionMode = CC_PNC_PNC_20_MAPPING_796df885
          variation-point = post-build-variant-condition{matching-criterion=SideAllocation, value=1}
          BswMConditionValue
            BswMBswMode: BswMBswRequestedMode=COMM_PNC_NO_COMMUNICATION
        CC_RBTM_FR_BODY3_4xwwtd59665s787n6ctawh7k8_23a94727_PNC_00_MAPPING_b2c42696_TX (BswMRule):
          BswMNestedExecutionOnly = false
          BswMRuleId = 15
          BswMRuleInitState = BSWM_FALSE
          BswMRuleExpressionRef = CC_LE_RBTM_FR_BODY3_4xwwtd59665s787n6ctawh7k8_23a94727_PNC_00_MAPPING_b2c42696_TX
          BswMRuleFalseActionList = CC_AL_RBTM_FR_BODY3_4xwwtd59665s787n6ctawh7k8_23a94727_PNC_00_MAPPING_b2c42696_TX_Disable
          BswMRuleTrueActionList = CC_AL_RBTM_FR_BODY3_4xwwtd59665s787n6ctawh7k8_23a94727_PNC_00_MAPPING_b2c42696_TX_EnableNoinit
          variation-point = post-build-variant-condition{matching-criterion=SideAllocation, value=1}
        CC_LE_RBTM_FR_BODY3_4xwwtd59665s787n6ctawh7k8_23a94727_PNC_00_MAPPING_b2c42696_TX (BswMLogicalExpression):
          BswMLogicalOperator = BSWM_AND
          BswMArgumentRef = CC_LE_PNC_RBTM_FR_BODY3_4xwwtd59665s787n6ctawh7k8_23a94727_PNC_00_MAPPING_b2c42696_NEQ_NOCOM
          BswMArgumentRef = CC_Cond_CanSMIndication_RBTM_FR_BODY3_4xwwtd59665s787n6ctawh7k8_23a94727_EQ_CANSM_BSWM_FULL_COMMUNICATION
          BswMArgumentRef = CC_Cond_DcmComIndication_RBTM_FR_BODY3_4xwwtd59665s787n6ctawh7k8_23a94727_NEQ_DCM_ENABLE_RX_DISABLE_TX_NORM
          variation-point = post-build-variant-condition{matching-criterion=SideAllocation, value=1}
        CC_RBTM_FR_BODY3_4xwwtd59665s787n6ctawh7k8_23a94727_PNC_20_MAPPING_796df885_RX_DM (BswMRule):
          BswMNestedExecutionOnly = false
          BswMRuleId = 17
          BswMRuleInitState = BSWM_FALSE
          BswMRuleExpressionRef = CC_LE_RBTM_FR_BODY3_4xwwtd59665s787n6ctawh7k8_23a94727_PNC_20_MAPPING_796df885_RX_DM
          BswMRuleFalseActionList = CC_AL_RBTM_FR_BODY3_4xwwtd59665s787n6ctawh7k8_23a94727_PNC_20_MAPPING_796df885_Disable_DM
          BswMRuleTrueActionList = CC_AL_RBTM_FR_BODY3_4xwwtd59665s787n6ctawh7k8_23a94727_PNC_20_MAPPING_796df885_Enable_DM
          variation-point = post-build-variant-condition{matching-criterion=SideAllocation, value=1}
        CC_LE_RBTM_FR_BODY3_4xwwtd59665s787n6ctawh7k8_23a94727_PNC_20_MAPPING_796df885_RX_DM (BswMLogicalExpression):
          BswMLogicalOperator = BSWM_AND
          BswMArgumentRef = CC_LE_PNC_RBTM_FR_BODY3_4xwwtd59665s787n6ctawh7k8_23a94727_PNC_20_MAPPING_796df885_NEQ_NOCOM
          BswMArgumentRef = CC_Cond_CanSMIndication_RBTM_FR_BODY3_4xwwtd59665s787n6ctawh7k8_23a94727_EQ_CANSM_BSWM_FULL_COMMUNICATION
          variation-point = post-build-variant-condition{matching-criterion=SideAllocation, value=1}
        CC_RBTM_FR_BODY3_4xwwtd59665s787n6ctawh7k8_23a94727_PNC_20_MAPPING_796df885_RX (BswMRule):
          BswMNestedExecutionOnly = false
          BswMRuleId = 16
          BswMRuleInitState = BSWM_FALSE
          BswMRuleExpressionRef = CC_LE_RBTM_FR_BODY3_4xwwtd59665s787n6ctawh7k8_23a94727_PNC_20_MAPPING_796df885_RX
          BswMRuleFalseActionList = CC_AL_RBTM_FR_BODY3_4xwwtd59665s787n6ctawh7k8_23a94727_PNC_20_MAPPING_796df885_RX_Disable
          BswMRuleTrueActionList = CC_AL_RBTM_FR_BODY3_4xwwtd59665s787n6ctawh7k8_23a94727_PNC_20_MAPPING_796df885_RX_EnableNoinit
          variation-point = post-build-variant-condition{matching-criterion=SideAllocation, value=1}
        CC_LE_RBTM_FR_BODY3_4xwwtd59665s787n6ctawh7k8_23a94727_PNC_20_MAPPING_796df885_RX (BswMLogicalExpression):
          BswMLogicalOperator = BSWM_AND
          BswMArgumentRef = CC_LE_PNC_RBTM_FR_BODY3_4xwwtd59665s787n6ctawh7k8_23a94727_PNC_20_MAPPING_796df885_NEQ_NOCOM
          BswMArgumentRef = CC_Cond_CanSMIndication_RBTM_FR_BODY3_4xwwtd59665s787n6ctawh7k8_23a94727_NEQ_CANSM_BSWM_NO_COMMUNICATION
          variation-point = post-build-variant-condition{matching-criterion=SideAllocation, value=1}
        ESH_Cond_NoComOn_RBTM_FR_BODY3_4xwwtd59665s787n6ctawh7k8_23a94727 (BswMModeCondition):
          BswMConditionType = BSWM_EQUALS
          BswMConditionMode = ESH_ComMIndication_RBTM_FR_BODY3_4xwwtd59665s787n6ctawh7k8_23a94727
          variation-point = post-build-variant-condition{matching-criterion=SideAllocation, value=1}
          BswMConditionValue
            BswMBswMode: BswMBswRequestedMode=COMM_NO_COMMUNICATION
        ESH_ComMIndication_RBTM_FR_BODY3_4xwwtd59665s787n6ctawh7k8_23a94727 (BswMModeRequestPort):
          BswMArbitrateOnInit = false
          BswMRequestProcessing = BSWM_DEFERRED
          variation-point = post-build-variant-condition{matching-criterion=SideAllocation, value=1}
          BswMModeRequestSource
            BswMComMIndication: BswMComMChannelRef=RBTM_FR_BODY3_4xwwtd59665s787n6ctawh7k8_23a94727
          BswMModeInitValue
            BswMBswModeInitValue: BswMBswModeInitValueMode=COMM_NO_COMMUNICATION
        CC_Cond_DcmComIndication_RBTM_FR_BODY3_4xwwtd59665s787n6ctawh7k8_23a94727_NEQ_DCM_ENABLE_RX_DISABLE_TX_NORM (BswMModeCondition):
          BswMConditionType = BSWM_EQUALS_NOT
          BswMConditionMode = CC_DcmComIndication_RBTM_FR_BODY3_4xwwtd59665s787n6ctawh7k8_23a94727
          variation-point = post-build-variant-condition{matching-criterion=SideAllocation, value=1}
          BswMConditionValue
            BswMBswMode: BswMBswRequestedMode=DCM_ENABLE_RX_DISABLE_TX_NORM
        3 x BswMModeRequestPort, all with BswMArbitrateOnInit=false, BswMRequestProcessing=BSWM_IMMEDIATE, variation-point=post-build-variant-condition{matching-criterion=SideAllocation, value=1}:
          CC_DcmComIndication_RBTM_FR_BODY3_4xwwtd59665s787n6ctawh7k8_23a94727
            BswMModeRequestSource
              BswMDcmComModeRequest: BswMDcmComMChannelRef=RBTM_FR_BODY3_4xwwtd59665s787n6ctawh7k8_23a94727
            BswMModeInitValue
              BswMBswModeInitValue: BswMBswModeInitValueMode=DCM_ENABLE_RX_TX_NORM_NM
          NvmReadAll
            BswMModeRequestSource
              BswMNvMJobModeIndication: BswMNvmService=NvmReadAll
            BswMModeInitValue
              BswMBswModeInitValue: BswMBswModeInitValueMode=NVM_REQ_OK
          NvmWriteAll
            BswMModeRequestSource
              BswMNvMJobModeIndication: BswMNvmService=NvmWriteAll
            BswMModeInitValue
              BswMBswModeInitValue: BswMBswModeInitValueMode=NVM_REQ_OK
        BswMRule_SwcDiagComMState (BswMRule):
          BswMNestedExecutionOnly = false
          BswMRuleId = 0
          BswMRuleInitState = BSWM_FALSE
          BswMRuleExpressionRef = LE_BswMRule_SwcDiagComMState if post-build-variant-condition{matching-criterion=SideAllocation, value=0}
          BswMRuleExpressionRef = LE_BswMRule_SwcDiagComMState_001 if post-build-variant-condition{matching-criterion=SideAllocation, value=1}
          BswMRuleTrueActionList = AL_SwcDiag_FullCom
          BswMRuleFalseActionList = AL_SwcDiag_NotFullCom
        ComMIndication_RBTM_FL_BODY3_8uqv9blm85ehm0msat385m76v_03d5f5f6 (BswMModeRequestPort):
          BswMArbitrateOnInit = false
          BswMRequestProcessing = BSWM_IMMEDIATE
          variation-point = post-build-variant-condition{matching-criterion=SideAllocation, value=0}
          BswMModeRequestSource
            BswMComMIndication: BswMComMChannelRef=RBTM_FL_BODY3_8uqv9blm85ehm0msat385m76v_03d5f5f6
          BswMModeInitValue
            BswMBswModeInitValue: BswMBswModeInitValueMode=COMM_NO_COMMUNICATION
        BswMModeCondition:
          BswMConditionType = BSWM_EQUALS
          BswMConditionMode = ComMIndication_RBTM_FL_BODY3_8uqv9blm85ehm0msat385m76v_03d5f5f6
          variation-point = post-build-variant-condition{matching-criterion=SideAllocation, value=0}
          BswMConditionValue
            BswMBswMode: BswMBswRequestedMode=COMM_FULL_COMMUNICATION
        LE_BswMRule_SwcDiagComMState (BswMLogicalExpression):
          BswMArgumentRef = BswMModeCondition if post-build-variant-condition{matching-criterion=SideAllocation, value=0}
          variation-point = post-build-variant-condition{matching-criterion=SideAllocation, value=0}
        ComMIndication_RBTM_FR_BODY3_4xwwtd59665s787n6ctawh7k8_23a94727 (BswMModeRequestPort):
          BswMArbitrateOnInit = false
          BswMRequestProcessing = BSWM_IMMEDIATE
          variation-point = post-build-variant-condition{matching-criterion=SideAllocation, value=1}
          BswMModeRequestSource
            BswMComMIndication: BswMComMChannelRef=RBTM_FR_BODY3_4xwwtd59665s787n6ctawh7k8_23a94727
          BswMModeInitValue
            BswMBswModeInitValue: BswMBswModeInitValueMode=COMM_NO_COMMUNICATION
        BswMModeCondition_001 (BswMModeCondition):
          BswMConditionType = BSWM_EQUALS
          BswMConditionMode = ComMIndication_RBTM_FR_BODY3_4xwwtd59665s787n6ctawh7k8_23a94727
          variation-point = post-build-variant-condition{matching-criterion=SideAllocation, value=1}
          BswMConditionValue
            BswMBswMode: BswMBswRequestedMode=COMM_FULL_COMMUNICATION
        LE_BswMRule_SwcDiagComMState_001 (BswMLogicalExpression):
          BswMArgumentRef = BswMModeCondition_001 if post-build-variant-condition{matching-criterion=SideAllocation, value=1}
          variation-point = post-build-variant-condition{matching-criterion=SideAllocation, value=1}
      BswMModeControl: BswMInitActionListRef=INIT_AL_Initialize
        INIT_Action_SecOC_Init (BswMAction)
          BswMAvailableActions
            BswMUserCallout: BswMUserCalloutFunction=SecOC_Init(SecOC_Config_Ptr), BswMCreateCallout=false, BswMUserIncludeFile=SecOC.h
        CC_AL_RBTM_FL_BODY3_8uqv9blm85ehm0msat385m76v_03d5f5f6_TX_Disable (BswMActionList): BswMActionListExecution=BSWM_TRIGGER, variation-point=post-build-variant-condition{matching-criterion=SideAllocation, value=0}
          CC_DisablePDUGroup_TxMess_RBTM_FL_BODY3_e804245a (BswMActionListItem): BswMAbortOnFail=false, BswMActionListItemIndex=0, BswMActionListItemRef=BswMModeControl/CC_DisablePDUGroup_TxMess_RBTM_FL_BODY3_e804245a
        CC_DisablePDUGroup_TxMess_RBTM_FL_BODY3_e804245a (BswMAction): variation-point=post-build-variant-condition{matching-criterion=SideAllocation, value=0}
          BswMAvailableActions
            BswMPduGroupSwitch: BswMPduGroupSwitchReinit=false, BswMDisabledPduGroupRef=TxMess_RBTM_FL_BODY3_e804245a
        CC_AL_RBTM_FL_BODY3_8uqv9blm85ehm0msat385m76v_03d5f5f6_TX_EnableNoinit (BswMActionList): BswMActionListExecution=BSWM_TRIGGER, variation-point=post-build-variant-condition{matching-criterion=SideAllocation, value=0}
          CC_EnablePDUGroup_TxMess_RBTM_FL_BODY3_e804245a (BswMActionListItem): BswMAbortOnFail=false, BswMActionListItemIndex=0, BswMActionListItemRef=BswMModeControl/CC_EnablePDUGroup_TxMess_RBTM_FL_BODY3_e804245a
        CC_EnablePDUGroup_TxMess_RBTM_FL_BODY3_e804245a (BswMAction): variation-point=post-build-variant-condition{matching-criterion=SideAllocation, value=0}
          BswMAvailableActions
            BswMPduGroupSwitch: BswMPduGroupSwitchReinit=false, BswMEnabledPduGroupRef=TxMess_RBTM_FL_BODY3_e804245a
        ESH_AL_ExitRun (BswMActionList): BswMActionListExecution=BSWM_CONDITION
          5 x BswMActionListItem, all with BswMAbortOnFail=false:
            ESH_Action_EnterExclusiveArea: BswMActionListItemIndex=0, BswMActionListItemRef=BswMModeControl/ESH_Action_EnterExclusiveArea
            ESH_RunToPostRunNested: BswMActionListItemIndex=2, BswMActionListItemRef=BswMArbitration/ESH_RunToPostRunNested
            ESH_Action_ExitExclusiveArea: BswMActionListItemIndex=3, BswMActionListItemRef=BswMModeControl/ESH_Action_ExitExclusiveArea
            ESH_Action_ComMCheckPendingRequests_Left: BswMActionListItemIndex=1, BswMActionListItemRef=BswMModeControl/ESH_Action_ComMCheckPendingRequests_Left, variation-point=post-build-variant-condition{matching-criterion=SideAllocation, value=0}
            ESH_Action_ComMCheckPendingRequests_Right: BswMActionListItemIndex=1, BswMActionListItemRef=BswMModeControl/ESH_Action_ComMCheckPendingRequests_Right, variation-point=post-build-variant-condition{matching-criterion=SideAllocation, value=1}
        ESH_Action_EnterExclusiveArea (BswMAction)
          BswMAvailableActions
            BswMUserCallout: BswMUserCalloutFunction=SchM_Enter_BswM_BSWM_EXCLUSIVE_AREA_0(), BswMCreateCallout=false, BswMUserIncludeFile=SchM_BswM.h
        ESH_AL_RunToPostRun (BswMActionList): BswMActionListExecution=BSWM_CONDITION
          7 x BswMActionListItem, all with BswMAbortOnFail=false:
            ESH_Action_ComMDisallow_RBTM_FL_BODY3_8uqv9blm85ehm0msat385m76v_03d5f5f6: BswMActionListItemIndex=0, BswMActionListItemRef=BswMModeControl/ESH_Action_ComMDisallow_RBTM_FL_BODY3_8uqv9blm85ehm0msat385m76v_03d5f5f6, variation-point=post-build-variant-condition{matching-criterion=SideAllocation, value=0}
            ESH_Action_EcuMClearValidatedWakeupEvents: BswMActionListItemIndex=1, BswMActionListItemRef=BswMModeControl/ESH_Action_EcuMClearValidatedWakeupEvents
            ESH_Action_OnEnterPostRun: BswMActionListItemIndex=2, BswMActionListItemRef=BswMModeControl/ESH_Action_OnEnterPostRun
            SwitchEcuMStateTo_POST_RUN: BswMActionListItemIndex=3, BswMActionListItemRef=BswMModeControl/SwitchEcuMStateTo_POST_RUN
            ESH_Action_SwitchPostRun: BswMActionListItemIndex=4, BswMActionListItemRef=BswMModeControl/ESH_Action_SwitchPostRun
            ESH_Action_ESH_PostRun: BswMActionListItemIndex=5, BswMActionListItemRef=BswMModeControl/ESH_Action_ESH_PostRun
            ESH_Action_ComMDisallow_RBTM_FR_BODY3_4xwwtd59665s787n6ctawh7k8_23a94727: BswMActionListItemIndex=0, BswMActionListItemRef=BswMModeControl/ESH_Action_ComMDisallow_RBTM_FR_BODY3_4xwwtd59665s787n6ctawh7k8_23a94727, variation-point=post-build-variant-condition{matching-criterion=SideAllocation, value=1}
        5 x BswMAction:
          ESH_Action_ComMDisallow_RBTM_FL_BODY3_8uqv9blm85ehm0msat385m76v_03d5f5f6: variation-point=post-build-variant-condition{matching-criterion=SideAllocation, value=0}
            BswMAvailableActions
              BswMComMAllowCom: BswMComAllowed=false, BswMComMAllowChannelRef=RBTM_FL_BODY3_8uqv9blm85ehm0msat385m76v_03d5f5f6
          ESH_Action_EcuMClearValidatedWakeupEvents
            BswMAvailableActions
              BswMUserCallout: BswMUserCalloutFunction=EcuM_ClearValidatedWakeupEvent(ECUM_WKSOURCE_ALL_SOURCES), BswMCreateCallout=false, BswMUserIncludeFile=EcuM.h
          ESH_Action_OnEnterPostRun
            BswMAvailableActions
              BswMUserCallout: BswMUserCalloutFunction=BswM_ESH_OnEnterPostRun(), BswMCreateCallout=true
          SwitchEcuMStateTo_POST_RUN
            BswMAvailableActions
              BswMEcuMStateSwitch: BswMEcuMState=POST_RUN
          ESH_Action_SwitchPostRun
            BswMAvailableActions
              BswMRteSwitch: BswMSwitchedMode=POSTRUN, BswMRteSwitchPortRef=ESH_ModeSwitch
        ESH_ModeSwitch (BswMSwitchPort): BswMModeSwitchInterfaceRef=BswM_MSI_ESH_Mode
        ESH_Action_ESH_PostRun (BswMAction)
          BswMAvailableActions
            BswMGenericModeSwitch: BswMGenericRequestRef=ESH_State, BswMGenericRequestModeRef=ESH_POST_RUN
        ESH_Action_ExitExclusiveArea (BswMAction)
          BswMAvailableActions
            BswMUserCallout: BswMUserCalloutFunction=SchM_Exit_BswM_BSWM_EXCLUSIVE_AREA_0(), BswMCreateCallout=false, BswMUserIncludeFile=SchM_BswM.h
        ESH_AL_WaitForNvMToShutdown (BswMActionList): BswMActionListExecution=BSWM_CONDITION
          ESH_Action_OnEnterShutdown (BswMActionListItem): BswMAbortOnFail=false, BswMActionListItemIndex=0, BswMActionListItemRef=BswMModeControl/ESH_Action_OnEnterShutdown
          ESH_Action_EcuMGoToSelectedShutdownTarget (BswMActionListItem): BswMAbortOnFail=false, BswMActionListItemIndex=1, BswMActionListItemRef=BswMModeControl/ESH_Action_EcuMGoToSelectedShutdownTarget
        ESH_Action_OnEnterShutdown (BswMAction)
          BswMAvailableActions
            BswMUserCallout: BswMUserCalloutFunction=BswM_ESH_OnEnterShutdown(), BswMCreateCallout=true
        ESH_Action_EcuMGoToSelectedShutdownTarget (BswMAction)
          BswMAvailableActions
            BswMUserCallout: BswMUserCalloutFunction=(void)EcuM_GoToSelectedShutdownTarget(), BswMCreateCallout=false, BswMUserIncludeFile=EcuM.h
        ESH_AL_WakeupToPrep (BswMActionList): BswMActionListExecution=BSWM_CONDITION
          4 x BswMActionListItem, all with BswMAbortOnFail=false:
            ESH_Action_OnEnterPrepShutdown: BswMActionListItemIndex=0, BswMActionListItemRef=BswMModeControl/ESH_Action_OnEnterPrepShutdown
            SwitchEcuMStateTo_SHUTDOWN: BswMActionListItemIndex=1, BswMActionListItemRef=BswMModeControl/SwitchEcuMStateTo_SHUTDOWN
            ESH_Action_SwitchShutdown: BswMActionListItemIndex=2, BswMActionListItemRef=BswMModeControl/ESH_Action_SwitchShutdown
            ESH_Action_ESH_PrepShutdown: BswMActionListItemIndex=3, BswMActionListItemRef=BswMModeControl/ESH_Action_ESH_PrepShutdown
        4 x BswMAction:
          ESH_Action_OnEnterPrepShutdown
            BswMAvailableActions
              BswMUserCallout: BswMUserCalloutFunction=BswM_ESH_OnEnterPrepShutdown(), BswMCreateCallout=true
          SwitchEcuMStateTo_SHUTDOWN
            BswMAvailableActions
              BswMEcuMStateSwitch: BswMEcuMState=SHUTDOWN
          ESH_Action_SwitchShutdown
            BswMAvailableActions
              BswMRteSwitch: BswMSwitchedMode=SHUTDOWN, BswMRteSwitchPortRef=ESH_ModeSwitch
          ESH_Action_ESH_PrepShutdown
            BswMAvailableActions
              BswMGenericModeSwitch: BswMGenericRequestRef=ESH_State, BswMGenericRequestModeRef=ESH_PREP_SHUTDOWN
        ESH_AL_WaitForNvMWakeup (BswMActionList): BswMActionListExecution=BSWM_CONDITION
          3 x BswMActionListItem, all with BswMAbortOnFail=false:
            ESH_Action_OnEnterWakeup: BswMActionListItemIndex=0, BswMActionListItemRef=BswMModeControl/ESH_Action_OnEnterWakeup
            ESH_Action_SwitchWakeup: BswMActionListItemIndex=1, BswMActionListItemRef=BswMModeControl/ESH_Action_SwitchWakeup
            ESH_Action_ESH_Wakeup: BswMActionListItemIndex=2, BswMActionListItemRef=BswMModeControl/ESH_Action_ESH_Wakeup
        3 x BswMAction:
          ESH_Action_OnEnterWakeup
            BswMAvailableActions
              BswMUserCallout: BswMUserCalloutFunction=BswM_ESH_OnEnterWakeup(), BswMCreateCallout=true
          ESH_Action_SwitchWakeup
            BswMAvailableActions
              BswMRteSwitch: BswMSwitchedMode=WAKEUP, BswMRteSwitchPortRef=ESH_ModeSwitch
          ESH_Action_ESH_Wakeup
            BswMAvailableActions
              BswMGenericModeSwitch: BswMGenericRequestRef=ESH_State, BswMGenericRequestModeRef=ESH_WAKEUP
        ESH_AL_WakeupToRun (BswMActionList): BswMActionListExecution=BSWM_CONDITION
          8 x BswMActionListItem, all with BswMAbortOnFail=false:
            ESH_DemInit: BswMActionListItemIndex=0, BswMActionListItemRef=BswMArbitration/ESH_DemInit
            ESH_Action_ComMAllow_RBTM_FL_BODY3_8uqv9blm85ehm0msat385m76v_03d5f5f6: BswMActionListItemIndex=1, BswMActionListItemRef=BswMModeControl/ESH_Action_ComMAllow_RBTM_FL_BODY3_8uqv9blm85ehm0msat385m76v_03d5f5f6, variation-point=post-build-variant-condition{matching-criterion=SideAllocation, value=0}
            ESH_Action_SelfRunRequestTimer_Start: BswMActionListItemIndex=2, BswMActionListItemRef=BswMModeControl/ESH_Action_SelfRunRequestTimer_Start
            ESH_Action_OnEnterRun: BswMActionListItemIndex=3, BswMActionListItemRef=BswMModeControl/ESH_Action_OnEnterRun
            SwitchEcuMStateTo_RUN: BswMActionListItemIndex=4, BswMActionListItemRef=BswMModeControl/SwitchEcuMStateTo_RUN
            ESH_Action_SwitchRun: BswMActionListItemIndex=5, BswMActionListItemRef=BswMModeControl/ESH_Action_SwitchRun
            ESH_Action_ESH_Run: BswMActionListItemIndex=6, BswMActionListItemRef=BswMModeControl/ESH_Action_ESH_Run
            ESH_Action_ComMAllow_RBTM_FR_BODY3_4xwwtd59665s787n6ctawh7k8_23a94727: BswMActionListItemIndex=1, BswMActionListItemRef=BswMModeControl/ESH_Action_ComMAllow_RBTM_FR_BODY3_4xwwtd59665s787n6ctawh7k8_23a94727, variation-point=post-build-variant-condition{matching-criterion=SideAllocation, value=1}
        ESH_AL_DemInit (BswMActionList): BswMActionListExecution=BSWM_CONDITION
          ESH_Action_DemInit (BswMActionListItem): BswMAbortOnFail=false, BswMActionListItemIndex=0, BswMActionListItemRef=BswMModeControl/ESH_Action_DemInit
          ESH_Action_DemInitialized (BswMActionListItem): BswMAbortOnFail=false, BswMActionListItemIndex=1, BswMActionListItemRef=BswMModeControl/ESH_Action_DemInitialized
        8 x BswMAction:
          ESH_Action_DemInit
            BswMAvailableActions
              BswMUserCallout: BswMUserCalloutFunction=Dem_Init(Dem_Config_Ptr), BswMCreateCallout=false, BswMUserIncludeFile=Dem.h
          ESH_Action_DemInitialized
            BswMAvailableActions
              BswMGenericModeSwitch: BswMGenericRequestRef=ESH_DemInitStatus, BswMGenericRequestModeRef=DEM_INITIALIZED
          ESH_Action_ComMAllow_RBTM_FL_BODY3_8uqv9blm85ehm0msat385m76v_03d5f5f6: variation-point=post-build-variant-condition{matching-criterion=SideAllocation, value=0}
            BswMAvailableActions
              BswMComMAllowCom: BswMComAllowed=true, BswMComMAllowChannelRef=RBTM_FL_BODY3_8uqv9blm85ehm0msat385m76v_03d5f5f6
          ESH_Action_SelfRunRequestTimer_Start
            BswMAvailableActions
              BswMTimerControl: BswMTimerAction=BSWM_TIMER_START, BswMTimerValue=1, BswMTimerRef=ESH_SelfRunRequestTimer
          ESH_Action_OnEnterRun
            BswMAvailableActions
              BswMUserCallout:
                BswMUserCalloutFunction = BswM_ESH_OnEnterRun()
                BswMCreateCallout = true
                BswMUserCode = ComM_RequestComMode(ComMConf_ComMUser_RBTM_FL_BODY3_8uqv9blm85ehm0msat385m76v_a4eabb6e, COMM_FULL_COMMUNICATION);
          SwitchEcuMStateTo_RUN
            BswMAvailableActions
              BswMEcuMStateSwitch: BswMEcuMState=RUN
          ESH_Action_SwitchRun
            BswMAvailableActions
              BswMRteSwitch: BswMSwitchedMode=RUN, BswMRteSwitchPortRef=ESH_ModeSwitch
          ESH_Action_ESH_Run
            BswMAvailableActions
              BswMGenericModeSwitch: BswMGenericRequestRef=ESH_State, BswMGenericRequestModeRef=ESH_RUN
        ESH_AL_InitToWakeup (BswMActionList): BswMActionListExecution=BSWM_CONDITION
          3 x BswMActionListItem, all with BswMAbortOnFail=false:
            ESH_Action_OnEnterWakeup: BswMActionListItemIndex=0, BswMActionListItemRef=BswMModeControl/ESH_Action_OnEnterWakeup
            ESH_Action_SwitchWakeup: BswMActionListItemIndex=1, BswMActionListItemRef=BswMModeControl/ESH_Action_SwitchWakeup
            ESH_Action_ESH_Wakeup: BswMActionListItemIndex=2, BswMActionListItemRef=BswMModeControl/ESH_Action_ESH_Wakeup
        ESH_AL_PostRunToPrepShutdown (BswMActionList): BswMActionListExecution=BSWM_CONDITION
          7 x BswMActionListItem, all with BswMAbortOnFail=false:
            ESH_Action_DemShutdown: BswMActionListItemIndex=0, BswMActionListItemRef=BswMModeControl/ESH_Action_DemShutdown
            ESH_Action_DemNotInitialized: BswMActionListItemIndex=1, BswMActionListItemRef=BswMModeControl/ESH_Action_DemNotInitialized
            ESH_Action_OnEnterPrepShutdown: BswMActionListItemIndex=2, BswMActionListItemRef=BswMModeControl/ESH_Action_OnEnterPrepShutdown
            SwitchEcuMStateTo_SHUTDOWN: BswMActionListItemIndex=3, BswMActionListItemRef=BswMModeControl/SwitchEcuMStateTo_SHUTDOWN
            ESH_Action_SwitchShutdown: BswMActionListItemIndex=4, BswMActionListItemRef=BswMModeControl/ESH_Action_SwitchShutdown
            ESH_Action_ESH_PrepShutdown: BswMActionListItemIndex=5, BswMActionListItemRef=BswMModeControl/ESH_Action_ESH_PrepShutdown
            Action_Rtm_Shutdown: BswMActionListItemIndex=6, BswMActionListItemRef=BswMModeControl/Action_Rtm_Shutdown
        ESH_Action_DemShutdown (BswMAction)
          BswMAvailableActions
            BswMUserCallout: BswMUserCalloutFunction=Dem_Shutdown(), BswMCreateCallout=false, BswMUserIncludeFile=Dem.h
        ESH_Action_DemNotInitialized (BswMAction)
          BswMAvailableActions
            BswMGenericModeSwitch: BswMGenericRequestRef=ESH_DemInitStatus, BswMGenericRequestModeRef=DEM_NOT_INITIALIZED
        4 x BswMActionList, all with BswMActionListExecution=BSWM_CONDITION:
          ESH_AL_ESH_PostRunToPrepCheck
            ESH_PostRunToPrepNested (BswMActionListItem): BswMAbortOnFail=false, BswMActionListItemIndex=0, BswMActionListItemRef=BswMArbitration/ESH_PostRunToPrepNested
          ESH_AL_PostRunToRun
            7 x BswMActionListItem, all with BswMAbortOnFail=false:
              ESH_Action_ComMAllow_RBTM_FL_BODY3_8uqv9blm85ehm0msat385m76v_03d5f5f6: BswMActionListItemIndex=0, BswMActionListItemRef=BswMModeControl/ESH_Action_ComMAllow_RBTM_FL_BODY3_8uqv9blm85ehm0msat385m76v_03d5f5f6, variation-point=post-build-variant-condition{matching-criterion=SideAllocation, value=0}
              ESH_Action_SelfRunRequestTimer_Start: BswMActionListItemIndex=1, BswMActionListItemRef=BswMModeControl/ESH_Action_SelfRunRequestTimer_Start
              ESH_Action_OnEnterRun: BswMActionListItemIndex=2, BswMActionListItemRef=BswMModeControl/ESH_Action_OnEnterRun
              SwitchEcuMStateTo_RUN: BswMActionListItemIndex=3, BswMActionListItemRef=BswMModeControl/SwitchEcuMStateTo_RUN
              ESH_Action_SwitchRun: BswMActionListItemIndex=4, BswMActionListItemRef=BswMModeControl/ESH_Action_SwitchRun
              ESH_Action_ESH_Run: BswMActionListItemIndex=5, BswMActionListItemRef=BswMModeControl/ESH_Action_ESH_Run
              ESH_Action_ComMAllow_RBTM_FR_BODY3_4xwwtd59665s787n6ctawh7k8_23a94727: BswMActionListItemIndex=0, BswMActionListItemRef=BswMModeControl/ESH_Action_ComMAllow_RBTM_FR_BODY3_4xwwtd59665s787n6ctawh7k8_23a94727, variation-point=post-build-variant-condition{matching-criterion=SideAllocation, value=1}
          ESH_AL_ExitPostRun
            7 x BswMActionListItem, all with BswMAbortOnFail=false:
              ESH_Action_EnterExclusiveArea: BswMActionListItemIndex=0, BswMActionListItemRef=BswMModeControl/ESH_Action_EnterExclusiveArea
              ESH_PostRunNested: BswMActionListItemIndex=3, BswMActionListItemRef=BswMArbitration/ESH_PostRunNested
              ESH_Action_ExitExclusiveArea: BswMActionListItemIndex=4, BswMActionListItemRef=BswMModeControl/ESH_Action_ExitExclusiveArea
              ESH_Action_ComMCheckPendingRequests_Left: BswMActionListItemIndex=1, BswMActionListItemRef=BswMModeControl/ESH_Action_ComMCheckPendingRequests_Left, variation-point=post-build-variant-condition{matching-criterion=SideAllocation, value=0}
              ESH_Action_DemPostRunRequested_Left: BswMActionListItemIndex=2, BswMActionListItemRef=BswMModeControl/ESH_Action_DemPostRunRequested_Left, variation-point=post-build-variant-condition{matching-criterion=SideAllocation, value=0}
              ESH_Action_ComMCheckPendingRequests_Right: BswMActionListItemIndex=1, BswMActionListItemRef=BswMModeControl/ESH_Action_ComMCheckPendingRequests_Right, variation-point=post-build-variant-condition{matching-criterion=SideAllocation, value=1}
              ESH_Action_DemPostRunRequested_Right: BswMActionListItemIndex=2, BswMActionListItemRef=BswMModeControl/ESH_Action_DemPostRunRequested_Right, variation-point=post-build-variant-condition{matching-criterion=SideAllocation, value=1}
          ESH_AL_PrepShutdownToWaitForNvM
            4 x BswMActionListItem, all with BswMAbortOnFail=false:
              ESH_Action_OnEnterWaitForNvm: BswMActionListItemIndex=1, BswMActionListItemRef=BswMModeControl/ESH_Action_OnEnterWaitForNvm
              ESH_Action_ESH_WaitForNvm: BswMActionListItemIndex=2, BswMActionListItemRef=BswMModeControl/ESH_Action_ESH_WaitForNvm
              ESH_Action_ComMCheckPendingRequests_Left: BswMActionListItemIndex=0, BswMActionListItemRef=BswMModeControl/ESH_Action_ComMCheckPendingRequests_Left, variation-point=post-build-variant-condition{matching-criterion=SideAllocation, value=0}
              ESH_Action_ComMCheckPendingRequests_Right: BswMActionListItemIndex=0, BswMActionListItemRef=BswMModeControl/ESH_Action_ComMCheckPendingRequests_Right, variation-point=post-build-variant-condition{matching-criterion=SideAllocation, value=1}
        ESH_Action_OnEnterWaitForNvm (BswMAction)
          BswMAvailableActions
            BswMUserCallout: BswMUserCalloutFunction=BswM_ESH_OnEnterWaitForNvm(), BswMCreateCallout=true
        ESH_Action_ESH_WaitForNvm (BswMAction)
          BswMAvailableActions
            BswMGenericModeSwitch: BswMGenericRequestRef=ESH_State, BswMGenericRequestModeRef=ESH_WAIT_FOR_NVM
        INIT_AL_Initialize (BswMActionList): BswMActionListExecution=BSWM_CONDITION
          46 x BswMActionListItem, all with BswMAbortOnFail=false:
            INIT_Action_SecOC_Init: BswMActionListItemIndex=22 if post-build-variant-condition{matching-criterion=SideAllocation, value=0}, BswMActionListItemIndex=22 if post-build-variant-condition{matching-criterion=SideAllocation, value=1}, BswMActionListItemRef=BswMModeControl/INIT_Action_SecOC_Init
            INIT_Action_Can_Init: BswMActionListItemIndex=13 if post-build-variant-condition{matching-criterion=SideAllocation, value=0}, BswMActionListItemIndex=13 if post-build-variant-condition{matching-criterion=SideAllocation, value=1}, BswMActionListItemRef=BswMModeControl/INIT_Action_Can_Init
            INIT_Action_CanIf_Init: BswMActionListItemIndex=16 if post-build-variant-condition{matching-criterion=SideAllocation, value=0}, BswMActionListItemIndex=16 if post-build-variant-condition{matching-criterion=SideAllocation, value=1}, BswMActionListItemRef=BswMModeControl/INIT_Action_CanIf_Init
            INIT_Action_Com_Init: BswMActionListItemIndex=19 if post-build-variant-condition{matching-criterion=SideAllocation, value=0}, BswMActionListItemIndex=19 if post-build-variant-condition{matching-criterion=SideAllocation, value=1}, BswMActionListItemRef=BswMModeControl/INIT_Action_Com_Init
            INIT_Action_IpduM_Init: BswMActionListItemIndex=20 if post-build-variant-condition{matching-criterion=SideAllocation, value=0}, BswMActionListItemIndex=20 if post-build-variant-condition{matching-criterion=SideAllocation, value=1}, BswMActionListItemRef=BswMModeControl/INIT_Action_IpduM_Init
            INIT_Action_PduR_Init: BswMActionListItemIndex=21 if post-build-variant-condition{matching-criterion=SideAllocation, value=0}, BswMActionListItemIndex=21 if post-build-variant-condition{matching-criterion=SideAllocation, value=1}, BswMActionListItemRef=BswMModeControl/INIT_Action_PduR_Init
            INIT_Action_CanSM_Init: BswMActionListItemIndex=23 if post-build-variant-condition{matching-criterion=SideAllocation, value=0}, BswMActionListItemIndex=23 if post-build-variant-condition{matching-criterion=SideAllocation, value=1}, BswMActionListItemRef=BswMModeControl/INIT_Action_CanSM_Init
            INIT_Action_CanNm_Init: BswMActionListItemIndex=24 if post-build-variant-condition{matching-criterion=SideAllocation, value=0}, BswMActionListItemIndex=24 if post-build-variant-condition{matching-criterion=SideAllocation, value=1}, BswMActionListItemRef=BswMModeControl/INIT_Action_CanNm_Init
            INIT_Action_Nm_Init: BswMActionListItemIndex=25 if post-build-variant-condition{matching-criterion=SideAllocation, value=0}, BswMActionListItemIndex=25 if post-build-variant-condition{matching-criterion=SideAllocation, value=1}, BswMActionListItemRef=BswMModeControl/INIT_Action_Nm_Init
            INIT_Action_CanTp_Init: BswMActionListItemIndex=26 if post-build-variant-condition{matching-criterion=SideAllocation, value=0}, BswMActionListItemIndex=26 if post-build-variant-condition{matching-criterion=SideAllocation, value=1}, BswMActionListItemRef=BswMModeControl/INIT_Action_CanTp_Init
            INIT_Action_EnableInterrupts: BswMActionListItemIndex=32 if post-build-variant-condition{matching-criterion=SideAllocation, value=0}, BswMActionListItemIndex=32 if post-build-variant-condition{matching-criterion=SideAllocation, value=1}, BswMActionListItemRef=BswMModeControl/INIT_Action_EnableInterrupts
            INIT_Action_ComM_Init: BswMActionListItemIndex=33 if post-build-variant-condition{matching-criterion=SideAllocation, value=0}, BswMActionListItemIndex=33 if post-build-variant-condition{matching-criterion=SideAllocation, value=1}, BswMActionListItemRef=BswMModeControl/INIT_Action_ComM_Init
            INIT_Action_Dcm_Init: BswMActionListItemIndex=34 if post-build-variant-condition{matching-criterion=SideAllocation, value=0}, BswMActionListItemIndex=34 if post-build-variant-condition{matching-criterion=SideAllocation, value=1}, BswMActionListItemRef=BswMModeControl/INIT_Action_Dcm_Init
            INIT_Action_Dem_Init: BswMActionListItemIndex=35 if post-build-variant-condition{matching-criterion=SideAllocation, value=0}, BswMActionListItemIndex=35 if post-build-variant-condition{matching-criterion=SideAllocation, value=1}, BswMActionListItemRef=BswMModeControl/INIT_Action_Dem_Init
            INIT_Action_Rte_Start: BswMActionListItemIndex=40 if post-build-variant-condition{matching-criterion=SideAllocation, value=0}, BswMActionListItemIndex=40 if post-build-variant-condition{matching-criterion=SideAllocation, value=1}, BswMActionListItemRef=BswMModeControl/INIT_Action_Rte_Start
            INIT_Action_Port_Init: BswMActionListItemIndex=0 if post-build-variant-condition{matching-criterion=SideAllocation, value=0}, BswMActionListItemIndex=0 if post-build-variant-condition{matching-criterion=SideAllocation, value=1}, BswMActionListItemRef=BswMModeControl/INIT_Action_Port_Init
            INIT_Action_Dma_Init: BswMActionListItemIndex=3 if post-build-variant-condition{matching-criterion=SideAllocation, value=0}, BswMActionListItemIndex=3 if post-build-variant-condition{matching-criterion=SideAllocation, value=1}, BswMActionListItemRef=BswMModeControl/INIT_Action_Dma_Init
            INIT_Action_Spi_Init: BswMActionListItemIndex=8 if post-build-variant-condition{matching-criterion=SideAllocation, value=0}, BswMActionListItemIndex=8 if post-build-variant-condition{matching-criterion=SideAllocation, value=1}, BswMActionListItemRef=BswMModeControl/INIT_Action_Spi_Init
            INIT_Action_Wdg_17_Scu_Init: BswMActionListItemIndex=10 if post-build-variant-condition{matching-criterion=SideAllocation, value=0}, BswMActionListItemIndex=10 if post-build-variant-condition{matching-criterion=SideAllocation, value=1}, BswMActionListItemRef=BswMModeControl/INIT_Action_Wdg_17_Scu_Init
            INIT_Action_Icu_17_TimerIp_Init: BswMActionListItemIndex=12 if post-build-variant-condition{matching-criterion=SideAllocation, value=0}, BswMActionListItemIndex=12 if post-build-variant-condition{matching-criterion=SideAllocation, value=1}, BswMActionListItemRef=BswMModeControl/INIT_Action_Icu_17_TimerIp_Init
            INIT_Action_WdgM_Init: BswMActionListItemIndex=18 if post-build-variant-condition{matching-criterion=SideAllocation, value=0}, BswMActionListItemIndex=18 if post-build-variant-condition{matching-criterion=SideAllocation, value=1}, BswMActionListItemRef=BswMModeControl/INIT_Action_WdgM_Init
            INIT_Action_Csm_Init: BswMActionListItemIndex=28 if post-build-variant-condition{matching-criterion=SideAllocation, value=0}, BswMActionListItemIndex=28 if post-build-variant-condition{matching-criterion=SideAllocation, value=1}, BswMActionListItemRef=BswMModeControl/INIT_Action_Csm_Init
            INIT_Action_Crypto_30_LibCv_Init: BswMActionListItemIndex=14 if post-build-variant-condition{matching-criterion=SideAllocation, value=0}, BswMActionListItemIndex=14 if post-build-variant-condition{matching-criterion=SideAllocation, value=1}, BswMActionListItemRef=BswMModeControl/INIT_Action_Crypto_30_LibCv_Init
            INIT_Action_Crypto_30_vHsm_Init: BswMActionListItemIndex=15 if post-build-variant-condition{matching-criterion=SideAllocation, value=0}, BswMActionListItemIndex=15 if post-build-variant-condition{matching-criterion=SideAllocation, value=1}, BswMActionListItemRef=BswMModeControl/INIT_Action_Crypto_30_vHsm_Init
            INIT_Action_CryIf_Init: BswMActionListItemIndex=17 if post-build-variant-condition{matching-criterion=SideAllocation, value=0}, BswMActionListItemIndex=17 if post-build-variant-condition{matching-criterion=SideAllocation, value=1}, BswMActionListItemRef=BswMModeControl/INIT_Action_CryIf_Init
            INIT_Action_KeyM_Init: BswMActionListItemIndex=29 if post-build-variant-condition{matching-criterion=SideAllocation, value=0}, BswMActionListItemIndex=29 if post-build-variant-condition{matching-criterion=SideAllocation, value=1}, BswMActionListItemRef=BswMModeControl/INIT_Action_KeyM_Init
            INIT_Action_NvMReadAll: BswMActionListItemIndex=31 if post-build-variant-condition{matching-criterion=SideAllocation, value=0}, BswMActionListItemIndex=31 if post-build-variant-condition{matching-criterion=SideAllocation, value=1}, BswMActionListItemRef=BswMModeControl/INIT_Action_NvMReadAll
            INIT_Action_SBC_Init: BswMActionListItemIndex=43 if post-build-variant-condition{matching-criterion=SideAllocation, value=0}, BswMActionListItemIndex=43 if post-build-variant-condition{matching-criterion=SideAllocation, value=1}, BswMActionListItemRef=BswMModeControl/INIT_Action_SBC_Init
            INIT_Action_Adc_Init: BswMActionListItemIndex=11 if post-build-variant-condition{matching-criterion=SideAllocation, value=0}, BswMActionListItemIndex=11 if post-build-variant-condition{matching-criterion=SideAllocation, value=1}, BswMActionListItemRef=BswMModeControl/INIT_Action_Adc_Init
            INIT_Action_AdcIf_Init: BswMActionListItemIndex=42 if post-build-variant-condition{matching-criterion=SideAllocation, value=0}, BswMActionListItemIndex=42 if post-build-variant-condition{matching-criterion=SideAllocation, value=1}, BswMActionListItemRef=BswMModeControl/INIT_Action_AdcIf_Init
            INIT_Action_Gpt_Init: BswMActionListItemIndex=4 if post-build-variant-condition{matching-criterion=SideAllocation, value=0}, BswMActionListItemIndex=4 if post-build-variant-condition{matching-criterion=SideAllocation, value=1}, BswMActionListItemRef=BswMModeControl/INIT_Action_Gpt_Init
            INIT_Action_Pwm_17_GtmCcu6_Init: BswMActionListItemIndex=6 if post-build-variant-condition{matching-criterion=SideAllocation, value=0}, BswMActionListItemIndex=6 if post-build-variant-condition{matching-criterion=SideAllocation, value=1}, BswMActionListItemRef=BswMModeControl/INIT_Action_Pwm_17_GtmCcu6_Init
            INIT_Action_ComM_PreInit: BswMActionListItemIndex=2 if post-build-variant-condition{matching-criterion=SideAllocation, value=0}, BswMActionListItemIndex=2 if post-build-variant-condition{matching-criterion=SideAllocation, value=1}, BswMActionListItemRef=BswMModeControl/INIT_Action_ComM_PreInit
            INIT_Action_Nm_PreInit: BswMActionListItemIndex=5 if post-build-variant-condition{matching-criterion=SideAllocation, value=0}, BswMActionListItemIndex=5 if post-build-variant-condition{matching-criterion=SideAllocation, value=1}, BswMActionListItemRef=BswMModeControl/INIT_Action_Nm_PreInit
            INIT_Action_ComM_PostInit: BswMActionListItemIndex=38 if post-build-variant-condition{matching-criterion=SideAllocation, value=0}, BswMActionListItemIndex=38 if post-build-variant-condition{matching-criterion=SideAllocation, value=1}, BswMActionListItemRef=BswMModeControl/INIT_Action_ComM_PostInit
            INIT_Action_Nm_PostInit: BswMActionListItemIndex=39 if post-build-variant-condition{matching-criterion=SideAllocation, value=0}, BswMActionListItemIndex=39 if post-build-variant-condition{matching-criterion=SideAllocation, value=1}, BswMActionListItemRef=BswMModeControl/INIT_Action_Nm_PostInit
            INIT_Action_StbM_Init: BswMActionListItemIndex=30 if post-build-variant-condition{matching-criterion=SideAllocation, value=0}, BswMActionListItemIndex=30 if post-build-variant-condition{matching-criterion=SideAllocation, value=1}, BswMActionListItemRef=BswMModeControl/INIT_Action_StbM_Init
            INIT_Action_CanTSyn_Init: BswMActionListItemIndex=27 if post-build-variant-condition{matching-criterion=SideAllocation, value=0}, BswMActionListItemIndex=27 if post-build-variant-condition{matching-criterion=SideAllocation, value=1}, BswMActionListItemRef=BswMModeControl/INIT_Action_CanTSyn_Init
            INIT_Action_Smu_Init: BswMActionListItemIndex=7 if post-build-variant-condition{matching-criterion=SideAllocation, value=0}, BswMActionListItemIndex=7 if post-build-variant-condition{matching-criterion=SideAllocation, value=1}, BswMActionListItemRef=BswMModeControl/INIT_Action_Smu_Init
            INIT_Action_RCM_Init: BswMActionListItemIndex=44 if post-build-variant-condition{matching-criterion=SideAllocation, value=0}, BswMActionListItemIndex=44 if post-build-variant-condition{matching-criterion=SideAllocation, value=1}, BswMActionListItemRef=BswMModeControl/INIT_Action_RCM_Init
            INIT_Action_StbM_PreInit: BswMActionListItemIndex=9 if post-build-variant-condition{matching-criterion=SideAllocation, value=0}, BswMActionListItemIndex=9 if post-build-variant-condition{matching-criterion=SideAllocation, value=1}, BswMActionListItemRef=BswMModeControl/INIT_Action_StbM_PreInit
            INIT_Action_StbM_PostInit: BswMActionListItemIndex=41 if post-build-variant-condition{matching-criterion=SideAllocation, value=0}, BswMActionListItemIndex=41 if post-build-variant-condition{matching-criterion=SideAllocation, value=1}, BswMActionListItemRef=BswMModeControl/INIT_Action_StbM_PostInit
            INIT_Action_Rtm_Init: BswMActionListItemIndex=37 if post-build-variant-condition{matching-criterion=SideAllocation, value=0}, BswMActionListItemIndex=37 if post-build-variant-condition{matching-criterion=SideAllocation, value=1}, BswMActionListItemRef=BswMModeControl/INIT_Action_Rtm_Init
            Rtm_CpuLoadMeasurementStart: BswMActionListItemIndex=36 if post-build-variant-condition{matching-criterion=SideAllocation, value=0}, BswMActionListItemIndex=36 if post-build-variant-condition{matching-criterion=SideAllocation, value=1}, BswMActionListItemRef=BswMModeControl/Rtm_CpuLoadMeasurementStart
            INIT_Action_CanTSyn_PreInit: BswMActionListItemIndex=1, BswMActionListItemRef=BswMModeControl/INIT_Action_CanTSyn_PreInit, variation-point=post-build-variant-condition{matching-criterion=SideAllocation, value=0}
            INIT_Action_CanTSyn_PreInit: BswMActionListItemIndex=1, BswMActionListItemRef=BswMModeControl/INIT_Action_CanTSyn_PreInit, variation-point=post-build-variant-condition{matching-criterion=SideAllocation, value=1}
        26 x BswMAction:
          INIT_Action_Can_Init
            BswMAvailableActions
              BswMUserCallout: BswMUserCalloutFunction=Can_Init(EcuM_GlobalPCConfig_Ptr->CfgPtr_Can_Init), BswMCreateCallout=false, BswMUserIncludeFile=Can.h
          INIT_Action_CanIf_Init
            BswMAvailableActions
              BswMUserCallout: BswMUserCalloutFunction=CanIf_Init(EcuM_GlobalPCConfig_Ptr->CfgPtr_CanIf_Init), BswMCreateCallout=false, BswMUserIncludeFile=CanIf.h
          INIT_Action_Com_Init
            BswMAvailableActions
              BswMUserCallout: BswMUserCalloutFunction=Com_Init(EcuM_GlobalPCConfig_Ptr->CfgPtr_Com_Init), BswMCreateCallout=false, BswMUserIncludeFile=Com.h
          INIT_Action_IpduM_Init
            BswMAvailableActions
              BswMUserCallout: BswMUserCalloutFunction=IpduM_Init(IpduM_Config_Ptr), BswMCreateCallout=false, BswMUserIncludeFile=IpduM.h
          INIT_Action_PduR_Init
            BswMAvailableActions
              BswMUserCallout: BswMUserCalloutFunction=PduR_Init(EcuM_GlobalPCConfig_Ptr->CfgPtr_PduR_Init), BswMCreateCallout=false, BswMUserIncludeFile=PduR.h
          INIT_Action_CanSM_Init
            BswMAvailableActions
              BswMUserCallout: BswMUserCalloutFunction=CanSM_Init(EcuM_GlobalPCConfig_Ptr->CfgPtr_CanSM_Init), BswMCreateCallout=false, BswMUserIncludeFile=CanSM_EcuM.h
          INIT_Action_CanNm_Init
            BswMAvailableActions
              BswMUserCallout: BswMUserCalloutFunction=CanNm_Init(EcuM_GlobalPCConfig_Ptr->CfgPtr_CanNm_Init), BswMCreateCallout=false, BswMUserIncludeFile=CanNm.h
          INIT_Action_Nm_Init
            BswMAvailableActions
              BswMUserCallout: BswMUserCalloutFunction=Nm_Init(EcuM_GlobalPCConfig_Ptr->CfgPtr_Nm_Init), BswMCreateCallout=false, BswMUserIncludeFile=Nm.h
          INIT_Action_CanTp_Init
            BswMAvailableActions
              BswMUserCallout: BswMUserCalloutFunction=CanTp_Init(EcuM_GlobalPCConfig_Ptr->CfgPtr_CanTp_Init), BswMCreateCallout=false, BswMUserIncludeFile=CanTp.h
          INIT_Action_EnableInterrupts
            BswMAvailableActions
              BswMUserCallout: BswMUserCalloutFunction=BswM_AL_SetProgrammableInterrupts(), BswMCreateCallout=true
          INIT_Action_ComM_Init
            BswMAvailableActions
              BswMUserCallout: BswMUserCalloutFunction=ComM_Init(EcuM_GlobalPCConfig_Ptr->CfgPtr_ComM_Init), BswMCreateCallout=false, BswMUserIncludeFile=ComM.h
          INIT_Action_Dcm_Init
            BswMAvailableActions
              BswMUserCallout: BswMUserCalloutFunction=Dcm_Init(EcuM_GlobalPCConfig_Ptr->CfgPtr_Dcm_Init), BswMCreateCallout=false, BswMUserIncludeFile=Dcm.h
          INIT_Action_Dem_Init
            BswMAvailableActions
              BswMUserCallout: BswMUserCalloutFunction=Dem_Init(Dem_Config_Ptr), BswMCreateCallout=false, BswMUserIncludeFile=Dem.h
          INIT_Action_Rte_Start
            BswMAvailableActions
              BswMUserCallout: BswMUserCalloutFunction=Rte_Start(), BswMCreateCallout=false, BswMUserIncludeFile=Rte_Main.h
          INIT_Action_Port_Init
            BswMAvailableActions
              BswMUserCallout: BswMUserCalloutFunction=Port_Init(&Port_Config), BswMCreateCallout=false, BswMUserIncludeFile=Port.h
          INIT_Action_Dma_Init
            BswMAvailableActions
              BswMUserCallout: BswMUserCalloutFunction=Dma_Init(&Dma_Config), BswMCreateCallout=false, BswMUserIncludeFile=Dma.h
          INIT_Action_Spi_Init
            BswMAvailableActions
              BswMUserCallout: BswMUserCalloutFunction=Spi_Init(&Spi_Config), BswMCreateCallout=false, BswMUserIncludeFile=Spi.h
          INIT_Action_Wdg_17_Scu_Init
            BswMAvailableActions
              BswMUserCallout: BswMUserCalloutFunction=Wdg_17_Scu_Init(&Wdg_17_Scu_Config_0), BswMCreateCallout=false, BswMUserIncludeFile=Wdg_17_Scu.h
          INIT_Action_Icu_17_TimerIp_Init
            BswMAvailableActions
              BswMUserCallout: BswMUserCalloutFunction=Icu_17_TimerIp_Init(&Icu_17_TimerIp_Config), BswMCreateCallout=false, BswMUserIncludeFile=Icu_17_TimerIp.h
          INIT_Action_WdgM_Init
            BswMAvailableActions
              BswMUserCallout: BswMUserCalloutFunction=WdgM_Init(&WdgMConfig_Mode0_core0), BswMCreateCallout=false, BswMUserIncludeFile=WdgM.h
          INIT_Action_Csm_Init
            BswMAvailableActions
              BswMUserCallout: BswMUserCalloutFunction=Csm_Init(), BswMCreateCallout=false, BswMUserIncludeFile=Csm.h
          INIT_Action_Crypto_30_LibCv_Init
            BswMAvailableActions
              BswMUserCallout: BswMUserCalloutFunction=Crypto_30_LibCv_Init(), BswMCreateCallout=false, BswMUserIncludeFile=Crypto_30_LibCv.h
          INIT_Action_Crypto_30_vHsm_Init
            BswMAvailableActions
              BswMUserCallout: BswMUserCalloutFunction=Crypto_30_vHsm_Init(), BswMCreateCallout=false, BswMUserIncludeFile=Crypto_30_vHsm.h
          INIT_Action_CryIf_Init
            BswMAvailableActions
              BswMUserCallout: BswMUserCalloutFunction=CryIf_Init(), BswMCreateCallout=false, BswMUserIncludeFile=CryIf.h
          INIT_Action_KeyM_Init
            BswMAvailableActions
              BswMUserCallout: BswMUserCalloutFunction=KeyM_Init(NULL_PTR), BswMCreateCallout=false, BswMUserIncludeFile=KeyM.h
          INIT_Action_NvMReadAll
            BswMAvailableActions
              BswMUserCallout: BswMUserCalloutFunction=BswM_INIT_NvMReadAll(), BswMCreateCallout=true
        CC_AL_RBTM_FL_BODY3_8uqv9blm85ehm0msat385m76v_03d5f5f6_PNC_00_MAPPING_b2c42696_RX_Disable (BswMActionList): BswMActionListExecution=BSWM_TRIGGER, variation-point=post-build-variant-condition{matching-criterion=SideAllocation, value=0}
          CC_DisablePDUGroup_RBTM_FL_BODY3_Rx_PNC_All_Active_46e8c3b2 (BswMActionListItem):
            BswMAbortOnFail = false
            BswMActionListItemIndex = 0
            BswMActionListItemRef = BswMModeControl/CC_DisablePDUGroup_RBTM_FL_BODY3_Rx_PNC_All_Active_46e8c3b2
        CC_DisablePDUGroup_RBTM_FL_BODY3_Rx_PNC_All_Active_46e8c3b2 (BswMAction): variation-point=post-build-variant-condition{matching-criterion=SideAllocation, value=0}
          BswMAvailableActions
            BswMPduGroupSwitch: BswMPduGroupSwitchReinit=false, BswMDisabledPduGroupRef=RBTM_FL_BODY3_Rx_PNC_All_Active_46e8c3b2
        CC_AL_RBTM_FL_BODY3_8uqv9blm85ehm0msat385m76v_03d5f5f6_PNC_00_MAPPING_b2c42696_RX_EnableNoinit (BswMActionList): BswMActionListExecution=BSWM_TRIGGER, variation-point=post-build-variant-condition{matching-criterion=SideAllocation, value=0}
          CC_EnablePDUGroup_RBTM_FL_BODY3_Rx_PNC_All_Active_46e8c3b2 (BswMActionListItem):
            BswMAbortOnFail = false
            BswMActionListItemIndex = 0
            BswMActionListItemRef = BswMModeControl/CC_EnablePDUGroup_RBTM_FL_BODY3_Rx_PNC_All_Active_46e8c3b2
        CC_EnablePDUGroup_RBTM_FL_BODY3_Rx_PNC_All_Active_46e8c3b2 (BswMAction): variation-point=post-build-variant-condition{matching-criterion=SideAllocation, value=0}
          BswMAvailableActions
            BswMPduGroupSwitch: BswMPduGroupSwitchReinit=false, BswMEnabledPduGroupRef=RBTM_FL_BODY3_Rx_PNC_All_Active_46e8c3b2
        CC_AL_RBTM_FL_BODY3_8uqv9blm85ehm0msat385m76v_03d5f5f6_PNC_00_MAPPING_b2c42696_Disable_DM (BswMActionList): BswMActionListExecution=BSWM_TRIGGER, variation-point=post-build-variant-condition{matching-criterion=SideAllocation, value=0}
          CC_DisableDM_RBTM_FL_BODY3_Rx_PNC_All_Active_46e8c3b2 (BswMActionListItem): BswMAbortOnFail=false, BswMActionListItemIndex=0, BswMActionListItemRef=BswMModeControl/CC_DisableDM_RBTM_FL_BODY3_Rx_PNC_All_Active_46e8c3b2
        CC_DisableDM_RBTM_FL_BODY3_Rx_PNC_All_Active_46e8c3b2 (BswMAction): variation-point=post-build-variant-condition{matching-criterion=SideAllocation, value=0}
          BswMAvailableActions
            BswMDeadlineMonitoringControl: BswMDisabledDMPduGroupRef=RBTM_FL_BODY3_Rx_PNC_All_Active_46e8c3b2
        CC_AL_RBTM_FL_BODY3_8uqv9blm85ehm0msat385m76v_03d5f5f6_PNC_00_MAPPING_b2c42696_Enable_DM (BswMActionList): BswMActionListExecution=BSWM_TRIGGER, variation-point=post-build-variant-condition{matching-criterion=SideAllocation, value=0}
          CC_EnableDM_RBTM_FL_BODY3_Rx_PNC_All_Active_46e8c3b2 (BswMActionListItem): BswMAbortOnFail=false, BswMActionListItemIndex=0, BswMActionListItemRef=BswMModeControl/CC_EnableDM_RBTM_FL_BODY3_Rx_PNC_All_Active_46e8c3b2
        CC_EnableDM_RBTM_FL_BODY3_Rx_PNC_All_Active_46e8c3b2 (BswMAction): variation-point=post-build-variant-condition{matching-criterion=SideAllocation, value=0}
          BswMAvailableActions
            BswMDeadlineMonitoringControl: BswMEnabledDMPduGroupRef=RBTM_FL_BODY3_Rx_PNC_All_Active_46e8c3b2
        CC_AL_RBTM_FL_BODY3_8uqv9blm85ehm0msat385m76v_03d5f5f6_PNC_00_MAPPING_b2c42696_TX_Disable (BswMActionList): BswMActionListExecution=BSWM_TRIGGER, variation-point=post-build-variant-condition{matching-criterion=SideAllocation, value=0}
          CC_DisablePDUGroup_RBTM_FL_BODY3_Tx_PNC_All_Active_e1dc74ba (BswMActionListItem):
            BswMAbortOnFail = false
            BswMActionListItemIndex = 0
            BswMActionListItemRef = BswMModeControl/CC_DisablePDUGroup_RBTM_FL_BODY3_Tx_PNC_All_Active_e1dc74ba
        CC_DisablePDUGroup_RBTM_FL_BODY3_Tx_PNC_All_Active_e1dc74ba (BswMAction): variation-point=post-build-variant-condition{matching-criterion=SideAllocation, value=0}
          BswMAvailableActions
            BswMPduGroupSwitch: BswMPduGroupSwitchReinit=false, BswMDisabledPduGroupRef=RBTM_FL_BODY3_Tx_PNC_All_Active_e1dc74ba
        CC_AL_RBTM_FL_BODY3_8uqv9blm85ehm0msat385m76v_03d5f5f6_PNC_00_MAPPING_b2c42696_TX_EnableNoinit (BswMActionList): BswMActionListExecution=BSWM_TRIGGER, variation-point=post-build-variant-condition{matching-criterion=SideAllocation, value=0}
          CC_EnablePDUGroup_RBTM_FL_BODY3_Tx_PNC_All_Active_e1dc74ba (BswMActionListItem):
            BswMAbortOnFail = false
            BswMActionListItemIndex = 0
            BswMActionListItemRef = BswMModeControl/CC_EnablePDUGroup_RBTM_FL_BODY3_Tx_PNC_All_Active_e1dc74ba
        3 x BswMAction:
          CC_EnablePDUGroup_RBTM_FL_BODY3_Tx_PNC_All_Active_e1dc74ba: variation-point=post-build-variant-condition{matching-criterion=SideAllocation, value=0}
            BswMAvailableActions
              BswMPduGroupSwitch: BswMPduGroupSwitchReinit=false, BswMEnabledPduGroupRef=RBTM_FL_BODY3_Tx_PNC_All_Active_e1dc74ba
          INIT_Action_SBC_Init
            BswMAvailableActions
              BswMUserCallout: BswMUserCalloutFunction=SBC_Init(), BswMCreateCallout=false, BswMUserIncludeFile=SBC.h
          INIT_Action_Adc_Init
            BswMAvailableActions
              BswMUserCallout: BswMUserCalloutFunction=Adc_Init(&Adc_Config), BswMCreateCallout=false, BswMUserIncludeFile=Adc.h
        CC_AL_RBTM_FL_BODY3_8uqv9blm85ehm0msat385m76v_03d5f5f6_PNC_20_MAPPING_796df885_Disable_DM (BswMActionList): BswMActionListExecution=BSWM_TRIGGER, variation-point=post-build-variant-condition{matching-criterion=SideAllocation, value=0}
          CC_DisableDM_RBTM_FL_BODY3_Rx_PNC_20_54c591d6 (BswMActionListItem): BswMAbortOnFail=false, BswMActionListItemIndex=0, BswMActionListItemRef=BswMModeControl/CC_DisableDM_RBTM_FL_BODY3_Rx_PNC_20_54c591d6
        CC_DisableDM_RBTM_FL_BODY3_Rx_PNC_20_54c591d6 (BswMAction): variation-point=post-build-variant-condition{matching-criterion=SideAllocation, value=0}
          BswMAvailableActions
            BswMDeadlineMonitoringControl: BswMDisabledDMPduGroupRef=RBTM_FL_BODY3_Rx_PNC_20_54c591d6
        CC_AL_RBTM_FL_BODY3_8uqv9blm85ehm0msat385m76v_03d5f5f6_PNC_20_MAPPING_796df885_Enable_DM (BswMActionList): BswMActionListExecution=BSWM_TRIGGER, variation-point=post-build-variant-condition{matching-criterion=SideAllocation, value=0}
          CC_EnableDM_RBTM_FL_BODY3_Rx_PNC_20_54c591d6 (BswMActionListItem): BswMAbortOnFail=false, BswMActionListItemIndex=0, BswMActionListItemRef=BswMModeControl/CC_EnableDM_RBTM_FL_BODY3_Rx_PNC_20_54c591d6
        CC_EnableDM_RBTM_FL_BODY3_Rx_PNC_20_54c591d6 (BswMAction): variation-point=post-build-variant-condition{matching-criterion=SideAllocation, value=0}
          BswMAvailableActions
            BswMDeadlineMonitoringControl: BswMEnabledDMPduGroupRef=RBTM_FL_BODY3_Rx_PNC_20_54c591d6
        CC_AL_RBTM_FL_BODY3_8uqv9blm85ehm0msat385m76v_03d5f5f6_PNC_20_MAPPING_796df885_TX_Disable (BswMActionList): BswMActionListExecution=BSWM_TRIGGER, variation-point=post-build-variant-condition{matching-criterion=SideAllocation, value=0}
          CC_DisablePDUGroup_RBTM_FL_BODY3_Tx_PNC_20_27dfe85c (BswMActionListItem): BswMAbortOnFail=false, BswMActionListItemIndex=0, BswMActionListItemRef=BswMModeControl/CC_DisablePDUGroup_RBTM_FL_BODY3_Tx_PNC_20_27dfe85c
        CC_DisablePDUGroup_RBTM_FL_BODY3_Tx_PNC_20_27dfe85c (BswMAction): variation-point=post-build-variant-condition{matching-criterion=SideAllocation, value=0}
          BswMAvailableActions
            BswMPduGroupSwitch: BswMPduGroupSwitchReinit=false, BswMDisabledPduGroupRef=RBTM_FL_BODY3_Tx_PNC_20_27dfe85c
        CC_AL_RBTM_FL_BODY3_8uqv9blm85ehm0msat385m76v_03d5f5f6_PNC_20_MAPPING_796df885_TX_EnableNoinit (BswMActionList): BswMActionListExecution=BSWM_TRIGGER, variation-point=post-build-variant-condition{matching-criterion=SideAllocation, value=0}
          CC_EnablePDUGroup_RBTM_FL_BODY3_Tx_PNC_20_27dfe85c (BswMActionListItem): BswMAbortOnFail=false, BswMActionListItemIndex=0, BswMActionListItemRef=BswMModeControl/CC_EnablePDUGroup_RBTM_FL_BODY3_Tx_PNC_20_27dfe85c
        CC_EnablePDUGroup_RBTM_FL_BODY3_Tx_PNC_20_27dfe85c (BswMAction): variation-point=post-build-variant-condition{matching-criterion=SideAllocation, value=0}
          BswMAvailableActions
            BswMPduGroupSwitch: BswMPduGroupSwitchReinit=false, BswMEnabledPduGroupRef=RBTM_FL_BODY3_Tx_PNC_20_27dfe85c
        CC_AL_RBTM_FL_BODY3_8uqv9blm85ehm0msat385m76v_03d5f5f6_PNC_20_MAPPING_796df885_RX_Disable (BswMActionList): BswMActionListExecution=BSWM_TRIGGER, variation-point=post-build-variant-condition{matching-criterion=SideAllocation, value=0}
          CC_DisablePDUGroup_RBTM_FL_BODY3_Rx_PNC_20_54c591d6 (BswMActionListItem): BswMAbortOnFail=false, BswMActionListItemIndex=0, BswMActionListItemRef=BswMModeControl/CC_DisablePDUGroup_RBTM_FL_BODY3_Rx_PNC_20_54c591d6
        CC_DisablePDUGroup_RBTM_FL_BODY3_Rx_PNC_20_54c591d6 (BswMAction): variation-point=post-build-variant-condition{matching-criterion=SideAllocation, value=0}
          BswMAvailableActions
            BswMPduGroupSwitch: BswMPduGroupSwitchReinit=false, BswMDisabledPduGroupRef=RBTM_FL_BODY3_Rx_PNC_20_54c591d6
        CC_AL_RBTM_FL_BODY3_8uqv9blm85ehm0msat385m76v_03d5f5f6_PNC_20_MAPPING_796df885_RX_EnableNoinit (BswMActionList): BswMActionListExecution=BSWM_TRIGGER, variation-point=post-build-variant-condition{matching-criterion=SideAllocation, value=0}
          CC_EnablePDUGroup_RBTM_FL_BODY3_Rx_PNC_20_54c591d6 (BswMActionListItem): BswMAbortOnFail=false, BswMActionListItemIndex=0, BswMActionListItemRef=BswMModeControl/CC_EnablePDUGroup_RBTM_FL_BODY3_Rx_PNC_20_54c591d6
        19 x BswMAction:
          CC_EnablePDUGroup_RBTM_FL_BODY3_Rx_PNC_20_54c591d6: variation-point=post-build-variant-condition{matching-criterion=SideAllocation, value=0}
            BswMAvailableActions
              BswMPduGroupSwitch: BswMPduGroupSwitchReinit=false, BswMEnabledPduGroupRef=RBTM_FL_BODY3_Rx_PNC_20_54c591d6
          INIT_Action_AdcIf_Init
            BswMAvailableActions
              BswMUserCallout: BswMUserCalloutFunction=AdcIf_Init(), BswMCreateCallout=false, BswMUserIncludeFile=AdcIf.h
          INIT_Action_Gpt_Init
            BswMAvailableActions
              BswMUserCallout: BswMUserCalloutFunction=Gpt_Init(&Gpt_Config), BswMCreateCallout=false, BswMUserIncludeFile=Gpt.h
          INIT_Action_Pwm_17_GtmCcu6_Init
            BswMAvailableActions
              BswMUserCallout: BswMUserCalloutFunction=Pwm_17_GtmCcu6_Init(&Pwm_17_GtmCcu6_Config), BswMCreateCallout=false, BswMUserIncludeFile=Pwm_17_GtmCcu6.h
          ESH_Action_ComMCheckPendingRequests_Left: variation-point=post-build-variant-condition{matching-criterion=SideAllocation, value=0}
            BswMAvailableActions
              BswMUserCallout:
                BswMUserCalloutFunction = ESH_ComM_CheckPendingRequests_Left()
                BswMCreateCallout = true
                BswMUserCode = ComM_StateType RBTM_FL_BODY3_8uqv9blm85ehm0msat385m76v_03d5f5f6 = COMM_NO_COM_NO_PENDING_REQUEST; (void)ComM_GetState(ComMConf_ComMChannel_RBTM_FL_BODY3_8uqv9blm85ehm0msat385m76v_03d5f5f6, &RBTM_FL_BODY3_8uqv9blm85ehm0msat385m76v_03d5f5f6); /* SBSW_BSWM_FCTCALL_LOCALVAR */ if(RBTM_FL_BODY3_8uqv9blm85ehm0msat385m76v_03d5f5f6 != COMM_NO_COM_NO_PENDING_REQUEST) { BswM_RequestMode(BSWM_GENERIC_ESH_ComMPendingRequests, BSWM_GENERICVALUE_ESH_ComMPendingRequests_ESH_COMM_PENDING_REQUEST); } else { BswM_RequestMode(BSWM_GENERIC_ESH_ComMPendingRequests, BSWM_GENERICVALUE_ESH_ComMPendingRequests_ESH_COMM_NO_REQUEST); }
          ESH_Action_DemPostRunRequested_Left: variation-point=post-build-variant-condition{matching-criterion=SideAllocation, value=0}
            BswMAvailableActions
              BswMUserCallout:
                BswMUserCalloutFunction = ESH_Dem_PostRunRequested_Left()
                BswMCreateCallout = true
                BswMUserIncludeFile = Dem.h
                BswMUserCode = boolean isRequested = FALSE; (void)Dem_PostRunRequested(&isRequested); /* SBSW_BSWM_FCTCALL_LOCALVAR */ if (isRequested == TRUE) { BswM_RequestMode(BSWM_GENERIC_ESH_DemPostRunRequested, BSWM_GENERICVALUE_ESH_DemPostRunRequested_TRUE); } else { BswM_RequestMode(BSWM_GENERIC_ESH_DemPostRunRequested, BSWM_GENERICVALUE_ESH_DemPostRunRequested_FALSE); }
          INIT_Action_ComM_PreInit
            BswMAvailableActions
              BswMUserCallout: BswMUserCalloutFunction=ComM_PreInit(EcuM_GlobalPCConfig_Ptr->CfgPtr_ComM_PreInit), BswMCreateCallout=false, BswMUserIncludeFile=ComM.h
          INIT_Action_Nm_PreInit
            BswMAvailableActions
              BswMUserCallout: BswMUserCalloutFunction=Nm_PreInit(EcuM_GlobalPCConfig_Ptr->CfgPtr_Nm_PreInit), BswMCreateCallout=false, BswMUserIncludeFile=Nm.h
          INIT_Action_ComM_PostInit
            BswMAvailableActions
              BswMUserCallout: BswMUserCalloutFunction=ComM_PostInit(), BswMCreateCallout=false, BswMUserIncludeFile=ComM.h
          INIT_Action_Nm_PostInit
            BswMAvailableActions
              BswMUserCallout: BswMUserCalloutFunction=Nm_PostInit(), BswMCreateCallout=false, BswMUserIncludeFile=Nm.h
          INIT_Action_StbM_Init
            BswMAvailableActions
              BswMUserCallout: BswMUserCalloutFunction=StbM_Init(StbM_Config_Ptr), BswMCreateCallout=false, BswMUserIncludeFile=StbM.h
          INIT_Action_CanTSyn_Init
            BswMAvailableActions
              BswMUserCallout:
                BswMUserCalloutFunction = CanTSyn_Init(NULL_PTR) if post-build-variant-condition{matching-criterion=SideAllocation, value=0}
                BswMCreateCallout = false
                BswMUserIncludeFile = CanTSyn.h
                BswMUserCalloutFunction = CanTSyn_Init(CanTSyn_Config_Ptr) if post-build-variant-condition{matching-criterion=SideAllocation, value=1}
          INIT_Action_Smu_Init
            BswMAvailableActions
              BswMUserCallout: BswMUserCalloutFunction=RCM_PreInit(), BswMCreateCallout=false, BswMUserIncludeFile=Rcm.h
          INIT_Action_RCM_Init
            BswMAvailableActions
              BswMUserCallout: BswMUserCalloutFunction=RCM_runDetermineResetCause(), BswMCreateCallout=false, BswMUserIncludeFile=RCM_Public.h
          INIT_Action_StbM_PreInit
            BswMAvailableActions
              BswMUserCallout: BswMUserCalloutFunction=StbM_PreInit(StbM_Config_Ptr), BswMCreateCallout=false, BswMUserIncludeFile=StbM.h
          INIT_Action_StbM_PostInit
            BswMAvailableActions
              BswMUserCallout: BswMUserCalloutFunction=StbM_PostInit(), BswMCreateCallout=false, BswMUserIncludeFile=StbM.h
          INIT_Action_Rtm_Init
            BswMAvailableActions
              BswMUserCallout: BswMUserCalloutFunction=Rtm_Init(), BswMCreateCallout=false, BswMUserIncludeFile=Rtm.h
          Rtm_CpuLoadMeasurementStart
            BswMAvailableActions
              BswMUserCallout: BswMUserCalloutFunction=Rtm_CpuLoadMeasurementStart(), BswMCreateCallout=true, BswMUserCode=Rtm_Start_CpuLoadMeasurement();
          Action_Rtm_Shutdown
            BswMAvailableActions
              BswMUserCallout: BswMUserCalloutFunction=Rtm_Shutdown(), BswMCreateCallout=false, BswMUserIncludeFile=Rtm.h
        CC_AL_RBTM_FR_BODY3_4xwwtd59665s787n6ctawh7k8_23a94727_PNC_00_MAPPING_b2c42696_Disable_DM (BswMActionList): BswMActionListExecution=BSWM_TRIGGER, variation-point=post-build-variant-condition{matching-criterion=SideAllocation, value=1}
          CC_DisableDM_RBTM_FR_BODY3_Rx_PNC_All_Active_592f1bcd (BswMActionListItem): BswMAbortOnFail=false, BswMActionListItemIndex=0, BswMActionListItemRef=BswMModeControl/CC_DisableDM_RBTM_FR_BODY3_Rx_PNC_All_Active_592f1bcd
        CC_DisableDM_RBTM_FR_BODY3_Rx_PNC_All_Active_592f1bcd (BswMAction): variation-point=post-build-variant-condition{matching-criterion=SideAllocation, value=1}
          BswMAvailableActions
            BswMDeadlineMonitoringControl: BswMDisabledDMPduGroupRef=RBTM_FR_BODY3_Rx_PNC_All_Active_592f1bcd
        CC_AL_RBTM_FR_BODY3_4xwwtd59665s787n6ctawh7k8_23a94727_PNC_00_MAPPING_b2c42696_Enable_DM (BswMActionList): BswMActionListExecution=BSWM_TRIGGER, variation-point=post-build-variant-condition{matching-criterion=SideAllocation, value=1}
          CC_EnableDM_RBTM_FR_BODY3_Rx_PNC_All_Active_592f1bcd (BswMActionListItem): BswMAbortOnFail=false, BswMActionListItemIndex=0, BswMActionListItemRef=BswMModeControl/CC_EnableDM_RBTM_FR_BODY3_Rx_PNC_All_Active_592f1bcd
        CC_EnableDM_RBTM_FR_BODY3_Rx_PNC_All_Active_592f1bcd (BswMAction): variation-point=post-build-variant-condition{matching-criterion=SideAllocation, value=1}
          BswMAvailableActions
            BswMDeadlineMonitoringControl: BswMEnabledDMPduGroupRef=RBTM_FR_BODY3_Rx_PNC_All_Active_592f1bcd
        CC_AL_RBTM_FR_BODY3_4xwwtd59665s787n6ctawh7k8_23a94727_PNC_00_MAPPING_b2c42696_RX_Disable (BswMActionList): BswMActionListExecution=BSWM_TRIGGER, variation-point=post-build-variant-condition{matching-criterion=SideAllocation, value=1}
          CC_DisablePDUGroup_RBTM_FR_BODY3_Rx_PNC_All_Active_592f1bcd (BswMActionListItem):
            BswMAbortOnFail = false
            BswMActionListItemIndex = 0
            BswMActionListItemRef = BswMModeControl/CC_DisablePDUGroup_RBTM_FR_BODY3_Rx_PNC_All_Active_592f1bcd
        CC_DisablePDUGroup_RBTM_FR_BODY3_Rx_PNC_All_Active_592f1bcd (BswMAction): variation-point=post-build-variant-condition{matching-criterion=SideAllocation, value=1}
          BswMAvailableActions
            BswMPduGroupSwitch: BswMPduGroupSwitchReinit=false, BswMDisabledPduGroupRef=RBTM_FR_BODY3_Rx_PNC_All_Active_592f1bcd
        CC_AL_RBTM_FR_BODY3_4xwwtd59665s787n6ctawh7k8_23a94727_PNC_00_MAPPING_b2c42696_RX_EnableNoinit (BswMActionList): BswMActionListExecution=BSWM_TRIGGER, variation-point=post-build-variant-condition{matching-criterion=SideAllocation, value=1}
          CC_EnablePDUGroup_RBTM_FR_BODY3_Rx_PNC_All_Active_592f1bcd (BswMActionListItem):
            BswMAbortOnFail = false
            BswMActionListItemIndex = 0
            BswMActionListItemRef = BswMModeControl/CC_EnablePDUGroup_RBTM_FR_BODY3_Rx_PNC_All_Active_592f1bcd
        CC_EnablePDUGroup_RBTM_FR_BODY3_Rx_PNC_All_Active_592f1bcd (BswMAction): variation-point=post-build-variant-condition{matching-criterion=SideAllocation, value=1}
          BswMAvailableActions
            BswMPduGroupSwitch: BswMPduGroupSwitchReinit=false, BswMEnabledPduGroupRef=RBTM_FR_BODY3_Rx_PNC_All_Active_592f1bcd
        CC_AL_RBTM_FR_BODY3_4xwwtd59665s787n6ctawh7k8_23a94727_TX_Disable (BswMActionList): BswMActionListExecution=BSWM_TRIGGER, variation-point=post-build-variant-condition{matching-criterion=SideAllocation, value=1}
          CC_DisablePDUGroup_TxMess_RBTM_FR_BODY3_dfe5c3c9 (BswMActionListItem): BswMAbortOnFail=false, BswMActionListItemIndex=0, BswMActionListItemRef=BswMModeControl/CC_DisablePDUGroup_TxMess_RBTM_FR_BODY3_dfe5c3c9
        CC_DisablePDUGroup_TxMess_RBTM_FR_BODY3_dfe5c3c9 (BswMAction): variation-point=post-build-variant-condition{matching-criterion=SideAllocation, value=1}
          BswMAvailableActions
            BswMPduGroupSwitch: BswMPduGroupSwitchReinit=false, BswMDisabledPduGroupRef=TxMess_RBTM_FR_BODY3_dfe5c3c9
        CC_AL_RBTM_FR_BODY3_4xwwtd59665s787n6ctawh7k8_23a94727_TX_EnableNoinit (BswMActionList): BswMActionListExecution=BSWM_TRIGGER, variation-point=post-build-variant-condition{matching-criterion=SideAllocation, value=1}
          CC_EnablePDUGroup_TxMess_RBTM_FR_BODY3_dfe5c3c9 (BswMActionListItem): BswMAbortOnFail=false, BswMActionListItemIndex=0, BswMActionListItemRef=BswMModeControl/CC_EnablePDUGroup_TxMess_RBTM_FR_BODY3_dfe5c3c9
        CC_EnablePDUGroup_TxMess_RBTM_FR_BODY3_dfe5c3c9 (BswMAction): variation-point=post-build-variant-condition{matching-criterion=SideAllocation, value=1}
          BswMAvailableActions
            BswMPduGroupSwitch: BswMPduGroupSwitchReinit=false, BswMEnabledPduGroupRef=TxMess_RBTM_FR_BODY3_dfe5c3c9
        CC_AL_RBTM_FR_BODY3_4xwwtd59665s787n6ctawh7k8_23a94727_PNC_20_MAPPING_796df885_TX_Disable (BswMActionList): BswMActionListExecution=BSWM_TRIGGER, variation-point=post-build-variant-condition{matching-criterion=SideAllocation, value=1}
          CC_DisablePDUGroup_RBTM_FR_BODY3_Tx_PNC_20_71aa89b7 (BswMActionListItem): BswMAbortOnFail=false, BswMActionListItemIndex=0, BswMActionListItemRef=BswMModeControl/CC_DisablePDUGroup_RBTM_FR_BODY3_Tx_PNC_20_71aa89b7
        CC_DisablePDUGroup_RBTM_FR_BODY3_Tx_PNC_20_71aa89b7 (BswMAction): variation-point=post-build-variant-condition{matching-criterion=SideAllocation, value=1}
          BswMAvailableActions
            BswMPduGroupSwitch: BswMPduGroupSwitchReinit=false, BswMDisabledPduGroupRef=RBTM_FR_BODY3_Tx_PNC_20_71aa89b7
        CC_AL_RBTM_FR_BODY3_4xwwtd59665s787n6ctawh7k8_23a94727_PNC_20_MAPPING_796df885_TX_EnableNoinit (BswMActionList): BswMActionListExecution=BSWM_TRIGGER, variation-point=post-build-variant-condition{matching-criterion=SideAllocation, value=1}
          CC_EnablePDUGroup_RBTM_FR_BODY3_Tx_PNC_20_71aa89b7 (BswMActionListItem): BswMAbortOnFail=false, BswMActionListItemIndex=0, BswMActionListItemRef=BswMModeControl/CC_EnablePDUGroup_RBTM_FR_BODY3_Tx_PNC_20_71aa89b7
        CC_EnablePDUGroup_RBTM_FR_BODY3_Tx_PNC_20_71aa89b7 (BswMAction): variation-point=post-build-variant-condition{matching-criterion=SideAllocation, value=1}
          BswMAvailableActions
            BswMPduGroupSwitch: BswMPduGroupSwitchReinit=false, BswMEnabledPduGroupRef=RBTM_FR_BODY3_Tx_PNC_20_71aa89b7
        CC_AL_RBTM_FR_BODY3_4xwwtd59665s787n6ctawh7k8_23a94727_PNC_00_MAPPING_b2c42696_TX_Disable (BswMActionList): BswMActionListExecution=BSWM_TRIGGER, variation-point=post-build-variant-condition{matching-criterion=SideAllocation, value=1}
          CC_DisablePDUGroup_RBTM_FR_BODY3_Tx_PNC_All_Active_fe1bacc5 (BswMActionListItem):
            BswMAbortOnFail = false
            BswMActionListItemIndex = 0
            BswMActionListItemRef = BswMModeControl/CC_DisablePDUGroup_RBTM_FR_BODY3_Tx_PNC_All_Active_fe1bacc5
        CC_DisablePDUGroup_RBTM_FR_BODY3_Tx_PNC_All_Active_fe1bacc5 (BswMAction): variation-point=post-build-variant-condition{matching-criterion=SideAllocation, value=1}
          BswMAvailableActions
            BswMPduGroupSwitch: BswMPduGroupSwitchReinit=false, BswMDisabledPduGroupRef=RBTM_FR_BODY3_Tx_PNC_All_Active_fe1bacc5
        CC_AL_RBTM_FR_BODY3_4xwwtd59665s787n6ctawh7k8_23a94727_PNC_00_MAPPING_b2c42696_TX_EnableNoinit (BswMActionList): BswMActionListExecution=BSWM_TRIGGER, variation-point=post-build-variant-condition{matching-criterion=SideAllocation, value=1}
          CC_EnablePDUGroup_RBTM_FR_BODY3_Tx_PNC_All_Active_fe1bacc5 (BswMActionListItem):
            BswMAbortOnFail = false
            BswMActionListItemIndex = 0
            BswMActionListItemRef = BswMModeControl/CC_EnablePDUGroup_RBTM_FR_BODY3_Tx_PNC_All_Active_fe1bacc5
        CC_EnablePDUGroup_RBTM_FR_BODY3_Tx_PNC_All_Active_fe1bacc5 (BswMAction): variation-point=post-build-variant-condition{matching-criterion=SideAllocation, value=1}
          BswMAvailableActions
            BswMPduGroupSwitch: BswMPduGroupSwitchReinit=false, BswMEnabledPduGroupRef=RBTM_FR_BODY3_Tx_PNC_All_Active_fe1bacc5
        CC_AL_RBTM_FR_BODY3_4xwwtd59665s787n6ctawh7k8_23a94727_PNC_20_MAPPING_796df885_Disable_DM (BswMActionList): BswMActionListExecution=BSWM_TRIGGER, variation-point=post-build-variant-condition{matching-criterion=SideAllocation, value=1}
          CC_DisableDM_RBTM_FR_BODY3_Rx_PNC_20_02b0f03d (BswMActionListItem): BswMAbortOnFail=false, BswMActionListItemIndex=0, BswMActionListItemRef=BswMModeControl/CC_DisableDM_RBTM_FR_BODY3_Rx_PNC_20_02b0f03d
        CC_DisableDM_RBTM_FR_BODY3_Rx_PNC_20_02b0f03d (BswMAction): variation-point=post-build-variant-condition{matching-criterion=SideAllocation, value=1}
          BswMAvailableActions
            BswMDeadlineMonitoringControl: BswMDisabledDMPduGroupRef=RBTM_FR_BODY3_Rx_PNC_20_02b0f03d
        CC_AL_RBTM_FR_BODY3_4xwwtd59665s787n6ctawh7k8_23a94727_PNC_20_MAPPING_796df885_Enable_DM (BswMActionList): BswMActionListExecution=BSWM_TRIGGER, variation-point=post-build-variant-condition{matching-criterion=SideAllocation, value=1}
          CC_EnableDM_RBTM_FR_BODY3_Rx_PNC_20_02b0f03d (BswMActionListItem): BswMAbortOnFail=false, BswMActionListItemIndex=0, BswMActionListItemRef=BswMModeControl/CC_EnableDM_RBTM_FR_BODY3_Rx_PNC_20_02b0f03d
        CC_EnableDM_RBTM_FR_BODY3_Rx_PNC_20_02b0f03d (BswMAction): variation-point=post-build-variant-condition{matching-criterion=SideAllocation, value=1}
          BswMAvailableActions
            BswMDeadlineMonitoringControl: BswMEnabledDMPduGroupRef=RBTM_FR_BODY3_Rx_PNC_20_02b0f03d
        CC_AL_RBTM_FR_BODY3_4xwwtd59665s787n6ctawh7k8_23a94727_PNC_20_MAPPING_796df885_RX_Disable (BswMActionList): BswMActionListExecution=BSWM_TRIGGER, variation-point=post-build-variant-condition{matching-criterion=SideAllocation, value=1}
          CC_DisablePDUGroup_RBTM_FR_BODY3_Rx_PNC_20_02b0f03d (BswMActionListItem): BswMAbortOnFail=false, BswMActionListItemIndex=0, BswMActionListItemRef=BswMModeControl/CC_DisablePDUGroup_RBTM_FR_BODY3_Rx_PNC_20_02b0f03d
        CC_DisablePDUGroup_RBTM_FR_BODY3_Rx_PNC_20_02b0f03d (BswMAction): variation-point=post-build-variant-condition{matching-criterion=SideAllocation, value=1}
          BswMAvailableActions
            BswMPduGroupSwitch: BswMPduGroupSwitchReinit=false, BswMDisabledPduGroupRef=RBTM_FR_BODY3_Rx_PNC_20_02b0f03d
        CC_AL_RBTM_FR_BODY3_4xwwtd59665s787n6ctawh7k8_23a94727_PNC_20_MAPPING_796df885_RX_EnableNoinit (BswMActionList): BswMActionListExecution=BSWM_TRIGGER, variation-point=post-build-variant-condition{matching-criterion=SideAllocation, value=1}
          CC_EnablePDUGroup_RBTM_FR_BODY3_Rx_PNC_20_02b0f03d (BswMActionListItem): BswMAbortOnFail=false, BswMActionListItemIndex=0, BswMActionListItemRef=BswMModeControl/CC_EnablePDUGroup_RBTM_FR_BODY3_Rx_PNC_20_02b0f03d
        7 x BswMAction:
          CC_EnablePDUGroup_RBTM_FR_BODY3_Rx_PNC_20_02b0f03d: variation-point=post-build-variant-condition{matching-criterion=SideAllocation, value=1}
            BswMAvailableActions
              BswMPduGroupSwitch: BswMPduGroupSwitchReinit=false, BswMEnabledPduGroupRef=RBTM_FR_BODY3_Rx_PNC_20_02b0f03d
          ESH_Action_ComMCheckPendingRequests_Right: variation-point=post-build-variant-condition{matching-criterion=SideAllocation, value=1}
            BswMAvailableActions
              BswMUserCallout:
                BswMUserCalloutFunction = ESH_ComM_CheckPendingRequests_Right()
                BswMCreateCallout = true
                BswMUserCode = ComM_StateType RBTM_FR_BODY3_4xwwtd59665s787n6ctawh7k8_23a94727 = COMM_NO_COM_NO_PENDING_REQUEST; (void)ComM_GetState(ComMConf_ComMChannel_RBTM_FR_BODY3_4xwwtd59665s787n6ctawh7k8_23a94727, &RBTM_FR_BODY3_4xwwtd59665s787n6ctawh7k8_23a94727); /* SBSW_BSWM_FCTCALL_LOCALVAR */ if(RBTM_FR_BODY3_4xwwtd59665s787n6ctawh7k8_23a94727 != COMM_NO_COM_NO_PENDING_REQUEST) { BswM_RequestMode(BSWM_GENERIC_ESH_ComMPendingRequests, BSWM_GENERICVALUE_ESH_ComMPendingRequests_ESH_COMM_PENDING_REQUEST); } else { BswM_RequestMode(BSWM_GENERIC_ESH_ComMPendingRequests, BSWM_GENERICVALUE_ESH_ComMPendingRequests_ESH_COMM_NO_REQUEST); }
          ESH_Action_ComMDisallow_RBTM_FR_BODY3_4xwwtd59665s787n6ctawh7k8_23a94727: variation-point=post-build-variant-condition{matching-criterion=SideAllocation, value=1}
            BswMAvailableActions
              BswMComMAllowCom: BswMComAllowed=false, BswMComMAllowChannelRef=RBTM_FR_BODY3_4xwwtd59665s787n6ctawh7k8_23a94727
          ESH_Action_ComMAllow_RBTM_FR_BODY3_4xwwtd59665s787n6ctawh7k8_23a94727: variation-point=post-build-variant-condition{matching-criterion=SideAllocation, value=1}
            BswMAvailableActions
              BswMComMAllowCom: BswMComAllowed=true, BswMComMAllowChannelRef=RBTM_FR_BODY3_4xwwtd59665s787n6ctawh7k8_23a94727
          ESH_Action_DemPostRunRequested_Right: variation-point=post-build-variant-condition{matching-criterion=SideAllocation, value=1}
            BswMAvailableActions
              BswMUserCallout:
                BswMUserCalloutFunction = ESH_Dem_PostRunRequested_Right()
                BswMCreateCallout = true
                BswMUserIncludeFile = Dem.h
                BswMUserCode = boolean isRequested = FALSE; (void)Dem_PostRunRequested(&isRequested); /* SBSW_BSWM_FCTCALL_LOCALVAR */ if (isRequested == TRUE) { BswM_RequestMode(BSWM_GENERIC_ESH_DemPostRunRequested, BSWM_GENERICVALUE_ESH_DemPostRunRequested_TRUE); } else { BswM_RequestMode(BSWM_GENERIC_ESH_DemPostRunRequested, BSWM_GENERICVALUE_ESH_DemPostRunRequested_FALSE); }
          INIT_Action_CanTSyn_PreInit: variation-point=post-build-variant-condition{matching-criterion=SideAllocation, value=0}
            BswMAvailableActions
              BswMUserCallout: BswMUserCalloutFunction=CanTSyn_PreInit(CanTSyn_Config_Ptr), BswMCreateCallout=false, BswMUserIncludeFile=CanTSyn.h
          INIT_Action_CanTSyn_PreInit: variation-point=post-build-variant-condition{matching-criterion=SideAllocation, value=1}
            BswMAvailableActions
              BswMUserCallout: BswMUserCalloutFunction=CanTSyn_PreInit(CanTSyn_Config_Ptr), BswMCreateCallout=false, BswMUserIncludeFile=CanTSyn.h
        BswMSwitchPort_SwcDiagCommunicationMode (BswMSwitchPort): BswMModeSwitchInterfaceRef=CommunicationModeMSI
        Action_RTE_SWITCH_BswMSwitchPort_SwcDiagCommunicationMode_COMM_FULL_COMMUNICATION (BswMAction)
          BswMAvailableActions
            BswMRteSwitch: BswMSwitchedMode=COMM_FULL_COMMUNICATION, BswMRteSwitchPortRef=BswMSwitchPort_SwcDiagCommunicationMode
        Action_RTE_SWITCH_BswMSwitchPort_SwcDiagCommunicationMode_COMM_NO_COMMUNICATION (BswMAction)
          BswMAvailableActions
            BswMRteSwitch: BswMSwitchedMode=COMM_NO_COMMUNICATION, BswMRteSwitchPortRef=BswMSwitchPort_SwcDiagCommunicationMode
        AL_SwcDiag_FullCom (BswMActionList): BswMActionListExecution=BSWM_TRIGGER
          Action_RTE_SWITCH_BswMSwitchPort_SwcDiagCommunicationMode_COMM_FULL_COMMUNICATION (BswMActionListItem):
            BswMAbortOnFail = false
            BswMActionListItemIndex = 0
            BswMActionListItemRef = BswMModeControl/Action_RTE_SWITCH_BswMSwitchPort_SwcDiagCommunicationMode_COMM_FULL_COMMUNICATION
        AL_SwcDiag_NotFullCom (BswMActionList): BswMActionListExecution=BSWM_TRIGGER
          Action_RTE_SWITCH_BswMSwitchPort_SwcDiagCommunicationMode_COMM_NO_COMMUNICATION (BswMActionListItem):
            BswMAbortOnFail = false
            BswMActionListItemIndex = 0
            BswMActionListItemRef = BswMModeControl/Action_RTE_SWITCH_BswMSwitchPort_SwcDiagCommunicationMode_COMM_NO_COMMUNICATION
      ESH_Mode (BswMRteModeDclGroup): BswMInitMode=STARTUP
        5 x BswMRteMode:
          STARTUP: BswMModePhysicalValue=0
          RUN: BswMModePhysicalValue=1
          POSTRUN: BswMModePhysicalValue=2
          WAKEUP: BswMModePhysicalValue=3
          SHUTDOWN: BswMModePhysicalValue=4
      ESH_RunRequest (BswMRteModeDclGroup): BswMInitMode=ESH_RunRequest/RELEASED
        RELEASED (BswMRteMode): BswMModePhysicalValue=0
        REQUESTED (BswMRteMode): BswMModePhysicalValue=1
      BswMDataTypeMappingSets: BswMDataTypeMappingSetRef=BswMMappingSet
      ESH_KillAllRun (BswMRteModeDclGroup): BswMInitMode=ESH_KillAllRun/RELEASED
        RELEASED (BswMRteMode): BswMModePhysicalValue=0
        REQUESTED (BswMRteMode): BswMModePhysicalValue=1
