AUTOSAR XML (schema 00049)
package /VariantDefinition
  evaluated variant set EvaluatedVariantSet: approval-status=APPROVED, evaluated-variant=[Left, Right]
package /VariantDefinition/Variant
  predefined variant Left: post-build-variant-criterion-value-set=Left
  predefined variant Right: post-build-variant-criterion-value-set=Right
package /VariantDefinition/Variant/CriterionValueSet
  post build variant criterion value set Left: post-build-variant-criterion-value{variant-criterion=SideAllocation, value=0}
  post build variant criterion value set Right: post-build-variant-criterion-value{variant-criterion=SideAllocation, value=1}
package /VariantDefinition/Criterion
  post build variant criterion SideAllocation: compu {0=Left, 1=Right}
