[part 1 of 2: package /InitialEcuC]
AUTOSAR XML (schema 00049)
package /InitialEcuC
  ecuc value collection InitialEcuC: ecuc-values=[Dcm, Dem]
  module config Dcm: module-description=Dcm_Impl
    DcmConfigSet
      DcmGeneral: DcmResetToFblAfterSessionFinalResponseEnabled=false
      DcmDsd
        DcmDsdServiceTable
          13 x DcmDsdService:
            DiagSessionControl: DcmDsdSidTabServiceId=16, DcmDsdSidTabSubfuncAvail=true
              4 x DcmDsdSubService:
                Default: DcmDsdSubServiceId=1
                Programming: DcmDsdSubServiceId=2, DcmDsdSubServiceRoleRef=Supplier, DcmDsdSubServiceRoleRef=Development_ENHANCED, DcmDsdSubServiceRoleRef=Production, DcmDsdSubServiceRoleRef=After_Sales_ENHANCED
                Extended: DcmDsdSubServiceId=3, DcmDsdSubServiceRoleRef=Supplier, DcmDsdSubServiceRoleRef=Development_ENHANCED, DcmDsdSubServiceRoleRef=Production, DcmDsdSubServiceRoleRef=After_Sales_ENHANCED, DcmDsdSubServiceRoleRef=After_Sales_STANDARD, DcmDsdSubServiceRoleRef=After_Sales_BASIC, DcmDsdSubServiceRoleRef=Internal_Diagnostic_Test_Tool, DcmDsdSubServiceRoleRef=ePTI_Test_Tool
                Development_Start: DcmDsdSubServiceId=126, DcmDsdSubServiceSessionLevelRef=DcmDspSession/Default, DcmDsdSubServiceSessionLevelRef=DcmDspSession/Extended, DcmDsdSubServiceSessionLevelRef=Development, DcmDsdSubServiceRoleRef=Supplier, DcmDsdSubServiceRoleRef=Development_ENHANCED, DcmDsdSubServiceRoleRef=Production
            EcuReset: DcmDsdSidTabServiceId=17, DcmDsdSidTabSubfuncAvail=true, DcmDsdServiceRoleRef=Supplier, DcmDsdServiceRoleRef=Development_ENHANCED, DcmDsdServiceRoleRef=Production, DcmDsdServiceRoleRef=After_Sales_ENHANCED, DcmDsdServiceRoleRef=After_Sales_STANDARD
              Hard (DcmDsdSubService):
                DcmDsdSubServiceId = 1
                DcmDsdSubServiceRoleRef = Supplier
                DcmDsdSubServiceRoleRef = Development_ENHANCED
                DcmDsdSubServiceRoleRef = Production
                DcmDsdSubServiceRoleRef = After_Sales_ENHANCED
                DcmDsdSubServiceRoleRef = After_Sales_STANDARD
              Soft (DcmDsdSubService):
                DcmDsdSubServiceId = 3
                DcmDsdSubServiceRoleRef = Supplier
                DcmDsdSubServiceRoleRef = Development_ENHANCED
                DcmDsdSubServiceRoleRef = Production
                DcmDsdSubServiceRoleRef = After_Sales_ENHANCED
                DcmDsdSubServiceRoleRef = After_Sales_STANDARD
            ClearDiagInfo: DcmDsdSidTabServiceId=20, DcmDsdSidTabSubfuncAvail=false, DcmDsdSidTabSessionLevelRef=DcmDspSession/Default, DcmDsdSidTabSessionLevelRef=DcmDspSession/Extended, DcmDsdSidTabSessionLevelRef=Development
            ReadDtcInfo: DcmDsdSidTabServiceId=25, DcmDsdSidTabSubfuncAvail=true, DcmDsdSidTabSessionLevelRef=DcmDspSession/Default, DcmDsdSidTabSessionLevelRef=DcmDspSession/Extended, DcmDsdSidTabSessionLevelRef=Development
              6 x DcmDsdSubService, all with DcmDsdSubServiceSessionLevelRef=DcmDspSession/Default, DcmDsdSubServiceSessionLevelRef=DcmDspSession/Extended, DcmDsdSubServiceSessionLevelRef=Development:
                RNODTCBSM: DcmDsdSubServiceId=1
                RDTCBSM: DcmDsdSubServiceId=2
                RDTCSSBDTC: DcmDsdSubServiceId=4
                RDTCEDRBDN: DcmDsdSubServiceId=6
                RSUPDTC: DcmDsdSubServiceId=10, DcmDsdSubServiceRoleRef=Supplier, DcmDsdSubServiceRoleRef=Development_ENHANCED, DcmDsdSubServiceRoleRef=Production, DcmDsdSubServiceRoleRef=After_Sales_ENHANCED, DcmDsdSubServiceRoleRef=After_Sales_STANDARD, DcmDsdSubServiceRoleRef=Internal_Diagnostic_Test_Tool, DcmDsdSubServiceRoleRef=ePTI_Test_Tool
                RDTCFDC: DcmDsdSubServiceId=20, DcmDsdSubServiceRoleRef=Supplier, DcmDsdSubServiceRoleRef=Development_ENHANCED, DcmDsdSubServiceRoleRef=Production, DcmDsdSubServiceRoleRef=After_Sales_ENHANCED, DcmDsdSubServiceRoleRef=After_Sales_STANDARD, DcmDsdSubServiceRoleRef=Internal_Diagnostic_Test_Tool, DcmDsdSubServiceRoleRef=ePTI_Test_Tool
            ReadDataById: DcmDsdSidTabServiceId=34, DcmDsdSidTabSubfuncAvail=false
            ReadMemoryByAddress: DcmDsdSidTabServiceId=35, DcmDsdSidTabSubfuncAvail=false, DcmDsdServiceRoleRef=Supplier, DcmDsdServiceRoleRef=Development_ENHANCED
            CommunicationControl: DcmDsdSidTabServiceId=40, DcmDsdSidTabSubfuncAvail=true, DcmDsdSidTabSessionLevelRef=DcmDspSession/Extended, DcmDsdSidTabSessionLevelRef=Development, DcmDsdServiceRoleRef=Supplier, DcmDsdServiceRoleRef=Development_ENHANCED, DcmDsdServiceRoleRef=Production, DcmDsdServiceRoleRef=After_Sales_ENHANCED
              EnableRxAndTx (DcmDsdSubService):
                DcmDsdSubServiceId = 0
                DcmDsdSubServiceSessionLevelRef = DcmDspSession/Extended
                DcmDsdSubServiceSessionLevelRef = Development
                DcmDsdSubServiceRoleRef = Supplier
                DcmDsdSubServiceRoleRef = Development_ENHANCED
                DcmDsdSubServiceRoleRef = Production
                DcmDsdSubServiceRoleRef = After_Sales_ENHANCED
              EnableRxAndDisableTx (DcmDsdSubService):
                DcmDsdSubServiceId = 1
                DcmDsdSubServiceSessionLevelRef = DcmDspSession/Extended
                DcmDsdSubServiceSessionLevelRef = Development
                DcmDsdSubServiceRoleRef = Supplier
                DcmDsdSubServiceRoleRef = Development_ENHANCED
                DcmDsdSubServiceRoleRef = Production
                DcmDsdSubServiceRoleRef = After_Sales_ENHANCED
            Authentication_Deauthenticate: DcmDsdSidTabServiceId=41, DcmDsdSidTabSubfuncAvail=true
              5 x DcmDsdSubService:
                Authentication_Deauthenticate: DcmDsdSubServiceId=0
                Authentication_Verify_Certificate_Unidirectional: DcmDsdSubServiceId=1
                Authentication_Proof_Of_Ownership: DcmDsdSubServiceId=3
                Authentication_Transmit_Certificate: DcmDsdSubServiceId=4
                Authentication_Authentication_Configuration: DcmDsdSubServiceId=8
            WriteDataById: DcmDsdSidTabServiceId=46, DcmDsdSidTabSubfuncAvail=false, DcmDsdServiceRoleRef=Supplier, DcmDsdServiceRoleRef=Development_ENHANCED, DcmDsdServiceRoleRef=Production, DcmDsdServiceRoleRef=After_Sales_ENHANCED, DcmDsdServiceRoleRef=After_Sales_STANDARD, DcmDsdServiceRoleRef=Internal_Diagnostic_Test_Tool
            RoutineControl: DcmDsdSidTabServiceId=49, DcmDsdSidTabSubfuncAvail=true
            WriteMemoryByAddress: DcmDsdSidTabServiceId=61, DcmDsdSidTabSubfuncAvail=false, DcmDsdSidTabSessionLevelRef=DcmDspSession/Extended, DcmDsdSidTabSessionLevelRef=Development, DcmDsdServiceRoleRef=Supplier, DcmDsdServiceRoleRef=Development_ENHANCED
            TesterPresent: DcmDsdSidTabServiceId=62, DcmDsdSidTabSubfuncAvail=true
              TesterPresent (DcmDsdSubService): DcmDsdSubServiceId=0
            ControlDtcSetting: DcmDsdSidTabServiceId=133, DcmDsdSidTabSubfuncAvail=true, DcmDsdSidTabSessionLevelRef=DcmDspSession/Extended, DcmDsdSidTabSessionLevelRef=Development, DcmDsdServiceRoleRef=Supplier, DcmDsdServiceRoleRef=Development_ENHANCED, DcmDsdServiceRoleRef=Production, DcmDsdServiceRoleRef=After_Sales_ENHANCED
              Enable (DcmDsdSubService):
                DcmDsdSubServiceId = 1
                DcmDsdSubServiceSessionLevelRef = DcmDspSession/Extended
                DcmDsdSubServiceSessionLevelRef = Development
                DcmDsdSubServiceRoleRef = Supplier
                DcmDsdSubServiceRoleRef = Development_ENHANCED
                DcmDsdSubServiceRoleRef = Production
                DcmDsdSubServiceRoleRef = After_Sales_ENHANCED
              Disable (DcmDsdSubService):
                DcmDsdSubServiceId = 2
                DcmDsdSubServiceSessionLevelRef = DcmDspSession/Extended
                DcmDsdSubServiceSessionLevelRef = Development
                DcmDsdSubServiceRoleRef = Supplier
                DcmDsdSubServiceRoleRef = Development_ENHANCED
                DcmDsdSubServiceRoleRef = Production
                DcmDsdSubServiceRoleRef = After_Sales_ENHANCED
      DcmDsl
        DcmDslDiagResp: DcmDslDiagRespMaxNumRespPend=30
      DcmDsp: DcmDspMaxDidToRead=1
        Reprogramming_Attempt_Counter_Read_Reprogramming_Attempts (DcmDspData): DcmDspDataSize=4064, DcmDspDataType=UINT8_N, DcmDspDataInfoRef=Info_Reprogramming_Attempt_Counter_Read_Reprogramming_Attempts
        Info_Reprogramming_Attempt_Counter_Read_Reprogramming_Attempts (DcmDspDataInfo): DcmDspDataFixedLength=false
        Diagnostic_Trace_Memory_Read_Diagnostic_Trace_Memory (DcmDspData): DcmDspDataSize=96, DcmDspDataType=UINT8_N, DcmDspDataInfoRef=Info_Diagnostic_Trace_Memory_Read_Diagnostic_Trace_Memory
        Info_Diagnostic_Trace_Memory_Read_Diagnostic_Trace_Memory (DcmDspDataInfo): DcmDspDataFixedLength=true
        Global_Time_Sync_Measured_Values_Read_GTSM (DcmDspData): DcmDspDataSize=20904, DcmDspDataType=UINT8_N, DcmDspDataInfoRef=Info_Global_Time_Sync_Measured_Values_Read_GTSM
        Info_Global_Time_Sync_Measured_Values_Read_GTSM (DcmDspDataInfo): DcmDspDataFixedLength=false
        Vehicle_Odometer_in_Low_Resolution_Read_Vehicle_Odometer_in_Low_Resolution (DcmDspData): DcmDspDataSize=16, DcmDspDataType=UINT16, DcmDspDataInfoRef=Info_Vehicle_Odometer_in_Low_Resolution_Read_Vehicle_Odometer_in_Low_Resolution
        Info_Vehicle_Odometer_in_Low_Resolution_Read_Vehicle_Odometer_in_Low_Resolution (DcmDspDataInfo): DcmDspDataFixedLength=true
        Adjust_ISO_15765_2_Block_Size_and_STmin_Parameter_Read_Block_Size_Value_as_defined_in_ISO_15765_2 (DcmDspData):
          DcmDspDataSize = 8
          DcmDspDataType = UINT8
          DcmDspDataInfoRef = Info_Adjust_ISO_15765_2_Block_Size_and_STmin_Parameter_Read_Block_Size_Value_as_defined_in_ISO_15765_2
        Info_Adjust_ISO_15765_2_Block_Size_and_STmin_Parameter_Read_Block_Size_Value_as_defined_in_ISO_15765_2 (DcmDspDataInfo): DcmDspDataFixedLength=true
        Adjust_ISO_15765_2_Block_Size_and_STmin_Parameter_Read_STmin_Value_as_defined_in_ISO_15765_2 (DcmDspData):
          DcmDspDataSize = 8
          DcmDspDataType = UINT8
          DcmDspDataInfoRef = Info_Adjust_ISO_15765_2_Block_Size_and_STmin_Parameter_Read_STmin_Value_as_defined_in_ISO_15765_2
        Info_Adjust_ISO_15765_2_Block_Size_and_STmin_Parameter_Read_STmin_Value_as_defined_in_ISO_15765_2 (DcmDspDataInfo): DcmDspDataFixedLength=true
        Current_Operating_Time_Read_Current_Operating_Time (DcmDspData): DcmDspDataSize=32, DcmDspDataType=UINT32, DcmDspDataInfoRef=Info_Current_Operating_Time_Read_Current_Operating_Time
        Info_Current_Operating_Time_Read_Current_Operating_Time (DcmDspDataInfo): DcmDspDataFixedLength=true
        Current_Operating_Time_Read_Operating_Time_Status (DcmDspData): DcmDspDataSize=8, DcmDspDataType=UINT8, DcmDspDataInfoRef=Info_Current_Operating_Time_Read_Operating_Time_Status
        Info_Current_Operating_Time_Read_Operating_Time_Status (DcmDspDataInfo): DcmDspDataFixedLength=true
        Customer_Settings_Read_BltSlckDec_Md_Stat (DcmDspData): DcmDspDataSize=8, DcmDspDataType=UINT8, DcmDspDataInfoRef=Info_Customer_Settings_Read_BltSlckDec_Md_Stat
        Info_Customer_Settings_Read_BltSlckDec_Md_Stat (DcmDspDataInfo): DcmDspDataFixedLength=true
        Customer_Settings_Read_PS_Curve_Stat (DcmDspData): DcmDspDataSize=8, DcmDspDataType=UINT8, DcmDspDataInfoRef=Info_Customer_Settings_Read_PS_Curve_Stat
        Info_Customer_Settings_Read_PS_Curve_Stat (DcmDspDataInfo): DcmDspDataFixedLength=true
        Obsolescence_Data_Read_Obsolescence_Data_BSR_Current_Value (DcmDspData): DcmDspDataSize=16, DcmDspDataType=UINT16, DcmDspDataInfoRef=Info_Obsolescence_Data_Read_Obsolescence_Data_BSR_Current_Value
        Info_Obsolescence_Data_Read_Obsolescence_Data_BSR_Current_Value (DcmDspDataInfo): DcmDspDataFixedLength=true
        Obsolescence_Data_Read_Obsolescence_Data_BSR_Threshold_Green_to_Yellow (DcmDspData): DcmDspDataSize=16, DcmDspDataType=UINT16, DcmDspDataInfoRef=Info_Obsolescence_Data_Read_Obsolescence_Data_BSR_Threshold_Green_to_Yellow
        Info_Obsolescence_Data_Read_Obsolescence_Data_BSR_Threshold_Green_to_Yellow (DcmDspDataInfo): DcmDspDataFixedLength=true
        Obsolescence_Data_Read_Obsolescence_Data_BSR_Threshold_Yellow_to_Red (DcmDspData): DcmDspDataSize=16, DcmDspDataType=UINT16, DcmDspDataInfoRef=Info_Obsolescence_Data_Read_Obsolescence_Data_BSR_Threshold_Yellow_to_Red
        Info_Obsolescence_Data_Read_Obsolescence_Data_BSR_Threshold_Yellow_to_Red (DcmDspDataInfo): DcmDspDataFixedLength=true
        Obsolescence_Data_Read_Obsolescence_Data_haptic_Warning_Current_Value (DcmDspData): DcmDspDataSize=16, DcmDspDataType=UINT16, DcmDspDataInfoRef=Info_Obsolescence_Data_Read_Obsolescence_Data_haptic_Warning_Current_Value
        Info_Obsolescence_Data_Read_Obsolescence_Data_haptic_Warning_Current_Value (DcmDspDataInfo): DcmDspDataFixedLength=true
        Obsolescence_Data_Read_Obsolescence_Data_haptic_Warning_Threshold_Green_to_Yellow (DcmDspData):
          DcmDspDataSize = 16
          DcmDspDataType = UINT16
          DcmDspDataInfoRef = Info_Obsolescence_Data_Read_Obsolescence_Data_haptic_Warning_Threshold_Green_to_Yellow
        Info_Obsolescence_Data_Read_Obsolescence_Data_haptic_Warning_Threshold_Green_to_Yellow (DcmDspDataInfo): DcmDspDataFixedLength=true
        Obsolescence_Data_Read_Obsolescence_Data_haptic_Warning_Threshold_Yellow_to_Red (DcmDspData): DcmDspDataSize=16, DcmDspDataType=UINT16, DcmDspDataInfoRef=Info_Obsolescence_Data_Read_Obsolescence_Data_haptic_Warning_Threshold_Yellow_to_Red
        Info_Obsolescence_Data_Read_Obsolescence_Data_haptic_Warning_Threshold_Yellow_to_Red (DcmDspDataInfo): DcmDspDataFixedLength=true
        Obsolescence_Data_Read_Obsolescence_Data_PRE_SAFE_Lvl_4_5_Current_Value (DcmDspData): DcmDspDataSize=16, DcmDspDataType=UINT16, DcmDspDataInfoRef=Info_Obsolescence_Data_Read_Obsolescence_Data_PRE_SAFE_Lvl_4_5_Current_Value
        Info_Obsolescence_Data_Read_Obsolescence_Data_PRE_SAFE_Lvl_4_5_Current_Value (DcmDspDataInfo): DcmDspDataFixedLength=true
        Obsolescence_Data_Read_Obsolescence_Data_PRE_SAFE_Lvl_4_5_Threshold_Green_to_Yellow (DcmDspData):
          DcmDspDataSize = 16
          DcmDspDataType = UINT16
          DcmDspDataInfoRef = Info_Obsolescence_Data_Read_Obsolescence_Data_PRE_SAFE_Lvl_4_5_Threshold_Green_to_Yellow
        Info_Obsolescence_Data_Read_Obsolescence_Data_PRE_SAFE_Lvl_4_5_Threshold_Green_to_Yellow (DcmDspDataInfo): DcmDspDataFixedLength=true
        Obsolescence_Data_Read_Obsolescence_Data_PRE_SAFE_Lvl_4_5_Threshold_Yellow_to_Red (DcmDspData):
          DcmDspDataSize = 16
          DcmDspDataType = UINT16
          DcmDspDataInfoRef = Info_Obsolescence_Data_Read_Obsolescence_Data_PRE_SAFE_Lvl_4_5_Threshold_Yellow_to_Red
        Info_Obsolescence_Data_Read_Obsolescence_Data_PRE_SAFE_Lvl_4_5_Threshold_Yellow_to_Red (DcmDspDataInfo): DcmDspDataFixedLength=true
        Obsolescence_Data_Read_Obsolescence_Data_PRE_CRASH_Current_Value (DcmDspData): DcmDspDataSize=16, DcmDspDataType=UINT16, DcmDspDataInfoRef=Info_Obsolescence_Data_Read_Obsolescence_Data_PRE_CRASH_Current_Value
        Info_Obsolescence_Data_Read_Obsolescence_Data_PRE_CRASH_Current_Value (DcmDspDataInfo): DcmDspDataFixedLength=true
        Obsolescence_Data_Read_Obsolescence_Data_PRE_CRASH_Threshold_Green_to_Yellow (DcmDspData): DcmDspDataSize=16, DcmDspDataType=UINT16, DcmDspDataInfoRef=Info_Obsolescence_Data_Read_Obsolescence_Data_PRE_CRASH_Threshold_Green_to_Yellow
        Info_Obsolescence_Data_Read_Obsolescence_Data_PRE_CRASH_Threshold_Green_to_Yellow (DcmDspDataInfo): DcmDspDataFixedLength=true
        Obsolescence_Data_Read_Obsolescence_Data_PRE_CRASH_Threshold_Yellow_to_Red (DcmDspData): DcmDspDataSize=16, DcmDspDataType=UINT16, DcmDspDataInfoRef=Info_Obsolescence_Data_Read_Obsolescence_Data_PRE_CRASH_Threshold_Yellow_to_Red
        Info_Obsolescence_Data_Read_Obsolescence_Data_PRE_CRASH_Threshold_Yellow_to_Red (DcmDspDataInfo): DcmDspDataFixedLength=true
        Availability_Data_Read_Availability_Data_PRE_SAFE_haptic_warning (DcmDspData): DcmDspDataSize=8, DcmDspDataType=UINT8, DcmDspDataInfoRef=Info_Availability_Data_Read_Availability_Data_PRE_SAFE_haptic_warning
        Info_Availability_Data_Read_Availability_Data_PRE_SAFE_haptic_warning (DcmDspDataInfo): DcmDspDataFixedLength=true
        Root_CA_Certificate_Read_Root_CA_Certificate (DcmDspData): DcmDspDataSize=8016, DcmDspDataType=UINT8_N, DcmDspDataInfoRef=Info_Root_CA_Certificate_Read_Root_CA_Certificate
        Info_Root_CA_Certificate_Read_Root_CA_Certificate (DcmDspDataInfo): DcmDspDataFixedLength=false
        Backend_CA_Certificate_Read_Backend_CA_Certificate (DcmDspData): DcmDspDataSize=8016, DcmDspDataType=UINT8_N, DcmDspDataInfoRef=Info_Backend_CA_Certificate_Read_Backend_CA_Certificate
        Info_Backend_CA_Certificate_Read_Backend_CA_Certificate (DcmDspDataInfo): DcmDspDataFixedLength=false
        Backend_CA_Certificate_Identification_Read_Backend_CA_SubjectKeyIdentifier (DcmDspData): DcmDspDataSize=160, DcmDspDataType=UINT8_N, DcmDspDataInfoRef=Info_Backend_CA_Certificate_Identification_Read_Backend_CA_SubjectKeyIdentifier
        Info_Backend_CA_Certificate_Identification_Read_Backend_CA_SubjectKeyIdentifier (DcmDspDataInfo): DcmDspDataFixedLength=true
        Diagnostic_Authentication_Certificate_Identification_Read_Diagnostic_Authentication_Certificate_Issuer (DcmDspData):
          DcmDspDataSize = 120
          DcmDspDataType = UINT8_N
          DcmDspDataInfoRef = Info_Diagnostic_Authentication_Certificate_Identification_Read_Diagnostic_Authentication_Certificate_Issuer
        Info_Diagnostic_Authentication_Certificate_Identification_Read_Diagnostic_Authentication_Certificate_Issuer (DcmDspDataInfo): DcmDspDataFixedLength=true
        Diagnostic_Authentication_Certificate_Identification_Read_Diagnostic_Authentication_Certificate_Serial_Number (DcmDspData):
          DcmDspDataSize = 128
          DcmDspDataType = UINT8_N
          DcmDspDataInfoRef = Info_Diagnostic_Authentication_Certificate_Identification_Read_Diagnostic_Authentication_Certificate_Serial_Number
        Info_Diagnostic_Authentication_Certificate_Identification_Read_Diagnostic_Authentication_Certificate_Serial_Number (DcmDspDataInfo): DcmDspDataFixedLength=false
        Access_Control_List_Version_Read_Basic_ACL_Version_Generation_Time_GTC (DcmDspData): DcmDspDataSize=120, DcmDspDataType=UINT8_N, DcmDspDataInfoRef=Info_Access_Control_List_Version_Read_Basic_ACL_Version_Generation_Time_GTC
        Info_Access_Control_List_Version_Read_Basic_ACL_Version_Generation_Time_GTC (DcmDspDataInfo): DcmDspDataFixedLength=true
        Access_Control_List_Version_Read_Basic_ACL_Version_Candela_File_Version_Major (DcmDspData): DcmDspDataSize=8, DcmDspDataType=UINT8, DcmDspDataInfoRef=Info_Access_Control_List_Version_Read_Basic_ACL_Version_Candela_File_Version_Major
        Info_Access_Control_List_Version_Read_Basic_ACL_Version_Candela_File_Version_Major (DcmDspDataInfo): DcmDspDataFixedLength=true
        Access_Control_List_Version_Read_Basic_ACL_Version_Candela_File_Version_Minor (DcmDspData): DcmDspDataSize=8, DcmDspDataType=UINT8, DcmDspDataInfoRef=Info_Access_Control_List_Version_Read_Basic_ACL_Version_Candela_File_Version_Minor
        Info_Access_Control_List_Version_Read_Basic_ACL_Version_Candela_File_Version_Minor (DcmDspDataInfo): DcmDspDataFixedLength=true
        Access_Control_List_Version_Read_Basic_ACL_Version_Candela_File_Version_Patch (DcmDspData): DcmDspDataSize=8, DcmDspDataType=UINT8, DcmDspDataInfoRef=Info_Access_Control_List_Version_Read_Basic_ACL_Version_Candela_File_Version_Patch
        Info_Access_Control_List_Version_Read_Basic_ACL_Version_Candela_File_Version_Patch (DcmDspDataInfo): DcmDspDataFixedLength=true
        Access_Control_List_Version_Read_Basic_ACL_Hash (DcmDspData): DcmDspDataSize=512, DcmDspDataType=UINT8_N, DcmDspDataInfoRef=Info_Access_Control_List_Version_Read_Basic_ACL_Hash
        Info_Access_Control_List_Version_Read_Basic_ACL_Hash (DcmDspDataInfo): DcmDspDataFixedLength=true
        Access_Control_List_Version_Read_ECU_indvidual_ACL_Version_Generation_Time_GTC (DcmDspData):
          DcmDspDataSize = 120
          DcmDspDataType = UINT8_N
          DcmDspDataInfoRef = Info_Access_Control_List_Version_Read_ECU_indvidual_ACL_Version_Generation_Time_GTC
        Info_Access_Control_List_Version_Read_ECU_indvidual_ACL_Version_Generation_Time_GTC (DcmDspDataInfo): DcmDspDataFixedLength=true
        Access_Control_List_Version_Read_ECU_indvidual_ACL_Version_Candela_File_Version_Major (DcmDspData):
          DcmDspDataSize = 8
          DcmDspDataType = UINT8
          DcmDspDataInfoRef = Info_Access_Control_List_Version_Read_ECU_indvidual_ACL_Version_Candela_File_Version_Major
        Info_Access_Control_List_Version_Read_ECU_indvidual_ACL_Version_Candela_File_Version_Major (DcmDspDataInfo): DcmDspDataFixedLength=true
        Access_Control_List_Version_Read_ECU_indvidual_ACL_Version_Candela_File_Version_Minor (DcmDspData):
          DcmDspDataSize = 8
          DcmDspDataType = UINT8
          DcmDspDataInfoRef = Info_Access_Control_List_Version_Read_ECU_indvidual_ACL_Version_Candela_File_Version_Minor
        Info_Access_Control_List_Version_Read_ECU_indvidual_ACL_Version_Candela_File_Version_Minor (DcmDspDataInfo): DcmDspDataFixedLength=true
        Access_Control_List_Version_Read_ECU_indvidual_ACL_Version_Candela_File_Version_Patch (DcmDspData):
          DcmDspDataSize = 8
          DcmDspDataType = UINT8
          DcmDspDataInfoRef = Info_Access_Control_List_Version_Read_ECU_indvidual_ACL_Version_Candela_File_Version_Patch
        Info_Access_Control_List_Version_Read_ECU_indvidual_ACL_Version_Candela_File_Version_Patch (DcmDspDataInfo): DcmDspDataFixedLength=true
        Access_Control_List_Version_Read_ECU_indvidual_ACL_Hash (DcmDspData): DcmDspDataSize=512, DcmDspDataType=UINT8_N, DcmDspDataInfoRef=Info_Access_Control_List_Version_Read_ECU_indvidual_ACL_Hash
        Info_Access_Control_List_Version_Read_ECU_indvidual_ACL_Hash (DcmDspDataInfo): DcmDspDataFixedLength=true
        Secured_System_Date_and_Time_Read_GeneralizedTime (DcmDspData): DcmDspDataSize=120, DcmDspDataType=UINT8_N, DcmDspDataInfoRef=Info_Secured_System_Date_and_Time_Read_GeneralizedTime
        Info_Secured_System_Date_and_Time_Read_GeneralizedTime (DcmDspDataInfo): DcmDspDataFixedLength=true
        Security_Event_Log_Read_Security_Event_Log (DcmDspData): DcmDspDataSize=32736, DcmDspDataType=UINT8_N, DcmDspDataInfoRef=Info_Security_Event_Log_Read_Security_Event_Log
        Info_Security_Event_Log_Read_Security_Event_Log (DcmDspDataInfo): DcmDspDataFixedLength=false
        SecOC_PDU_Data_IDs_and_Key_Checksum_Read_Secured_PDU_Data_IDs_and_Key_Checksum (DcmDspData):
          DcmDspDataSize = 32736
          DcmDspDataType = UINT8_N
          DcmDspDataInfoRef = Info_SecOC_PDU_Data_IDs_and_Key_Checksum_Read_Secured_PDU_Data_IDs_and_Key_Checksum
        Info_SecOC_PDU_Data_IDs_and_Key_Checksum_Read_Secured_PDU_Data_IDs_and_Key_Checksum (DcmDspDataInfo): DcmDspDataFixedLength=false
        SecOC_Vehicle_Shared_Secret_Hash_Read_SecOC_Vehicle_Shared_Secret_Hash (DcmDspData): DcmDspDataSize=32, DcmDspDataType=UINT8_N, DcmDspDataInfoRef=Info_SecOC_Vehicle_Shared_Secret_Hash_Read_SecOC_Vehicle_Shared_Secret_Hash
        Info_SecOC_Vehicle_Shared_Secret_Hash_Read_SecOC_Vehicle_Shared_Secret_Hash (DcmDspDataInfo): DcmDspDataFixedLength=true
        SecOC_Local_TickCount_Read_TickCount (DcmDspData): DcmDspDataSize=48, DcmDspDataType=UINT8_N, DcmDspDataInfoRef=Info_SecOC_Local_TickCount_Read_TickCount
        Info_SecOC_Local_TickCount_Read_TickCount (DcmDspDataInfo): DcmDspDataFixedLength=true
        Diagnostic_User_Role_Read_Cebas_UserRole (DcmDspData): DcmDspDataSize=8, DcmDspDataType=UINT8, DcmDspDataInfoRef=Info_Diagnostic_User_Role_Read_Cebas_UserRole
        Info_Diagnostic_User_Role_Read_Cebas_UserRole (DcmDspDataInfo): DcmDspDataFixedLength=true
        Real_Time_Offset_Read_Real_Time_Offset (DcmDspData): DcmDspDataSize=120, DcmDspDataType=UINT8_N, DcmDspDataInfoRef=Info_Real_Time_Offset_Read_Real_Time_Offset
        Info_Real_Time_Offset_Read_Real_Time_Offset (DcmDspDataInfo): DcmDspDataFixedLength=true
        Real_Time_Offset_Read_TickCount (DcmDspData): DcmDspDataSize=40, DcmDspDataType=UINT8_N, DcmDspDataInfoRef=Info_Real_Time_Offset_Read_TickCount
        Info_Real_Time_Offset_Read_TickCount (DcmDspDataInfo): DcmDspDataFixedLength=true
        VIN_Status_Read_VIN_Status (DcmDspData): DcmDspDataSize=8, DcmDspDataType=UINT8, DcmDspDataInfoRef=Info_VIN_Status_Read_VIN_Status
        Info_VIN_Status_Read_VIN_Status (DcmDspDataInfo): DcmDspDataFixedLength=true
        VIN_Status_Read_VIN_Lock_Status (DcmDspData): DcmDspDataSize=8, DcmDspDataType=UINT8, DcmDspDataInfoRef=Info_VIN_Status_Read_VIN_Lock_Status
        Info_VIN_Status_Read_VIN_Lock_Status (DcmDspDataInfo): DcmDspDataFixedLength=true
        SecOC_PDU_Data_IDs_and_Key_CMACs_Read_Secured_PDU_Data_IDs_and_Key_CMACs (DcmDspData): DcmDspDataSize=32736, DcmDspDataType=UINT8_N, DcmDspDataInfoRef=Info_SecOC_PDU_Data_IDs_and_Key_CMACs_Read_Secured_PDU_Data_IDs_and_Key_CMACs
        Info_SecOC_PDU_Data_IDs_and_Key_CMACs_Read_Secured_PDU_Data_IDs_and_Key_CMACs (DcmDspDataInfo): DcmDspDataFixedLength=false
        Security_Event_Log_Current_Counter_Values_Read_Security_Event_Log_Current_Counter_Values (DcmDspData):
          DcmDspDataSize = 8192
          DcmDspDataType = UINT8_N
          DcmDspDataInfoRef = Info_Security_Event_Log_Current_Counter_Values_Read_Security_Event_Log_Current_Counter_Values
        Info_Security_Event_Log_Current_Counter_Values_Read_Security_Event_Log_Current_Counter_Values (DcmDspDataInfo): DcmDspDataFixedLength=false
        RandomNumber_Read_Generated_Random_Number_Result (DcmDspData): DcmDspDataSize=8, DcmDspDataType=UINT8, DcmDspDataInfoRef=Info_RandomNumber_Read_Generated_Random_Number_Result
        Info_RandomNumber_Read_Generated_Random_Number_Result (DcmDspDataInfo): DcmDspDataFixedLength=true
        RandomNumber_Read_Generated_Random_Number (DcmDspData): DcmDspDataSize=256, DcmDspDataType=UINT8_N, DcmDspDataInfoRef=Info_RandomNumber_Read_Generated_Random_Number
        Info_RandomNumber_Read_Generated_Random_Number (DcmDspDataInfo): DcmDspDataFixedLength=true
        Status_SSA_Pre_Compile_Switches_Read_Precompile_switch (DcmDspData): DcmDspDataSize=32, DcmDspDataType=UINT8_N, DcmDspDataInfoRef=Info_Status_SSA_Pre_Compile_Switches_Read_Precompile_switch
        Info_Status_SSA_Pre_Compile_Switches_Read_Precompile_switch (DcmDspDataInfo): DcmDspDataFixedLength=true
        Trust_Model_Root_Replacement_Key_Read_Root_Replacement_Key (DcmDspData): DcmDspDataSize=256, DcmDspDataType=UINT8_N, DcmDspDataInfoRef=Info_Trust_Model_Root_Replacement_Key_Read_Root_Replacement_Key
        Info_Trust_Model_Root_Replacement_Key_Read_Root_Replacement_Key (DcmDspDataInfo): DcmDspDataFixedLength=true
        Trust_Model_Request_ephemeral_public_key_Read_Nonce (DcmDspData): DcmDspDataSize=256, DcmDspDataType=UINT8_N, DcmDspDataInfoRef=Info_Trust_Model_Request_ephemeral_public_key_Read_Nonce
        Info_Trust_Model_Request_ephemeral_public_key_Read_Nonce (DcmDspDataInfo): DcmDspDataFixedLength=true
        Trust_Model_Request_ephemeral_public_key_Read_Ephemeral_ECU_Public_Key (DcmDspData): DcmDspDataSize=256, DcmDspDataType=UINT8_N, DcmDspDataInfoRef=Info_Trust_Model_Request_ephemeral_public_key_Read_Ephemeral_ECU_Public_Key
        Info_Trust_Model_Request_ephemeral_public_key_Read_Ephemeral_ECU_Public_Key (DcmDspDataInfo): DcmDspDataFixedLength=true
        Trust_Model_Request_ephemeral_public_key_Read_Data_Signature (DcmDspData): DcmDspDataSize=512, DcmDspDataType=UINT8_N, DcmDspDataInfoRef=Info_Trust_Model_Request_ephemeral_public_key_Read_Data_Signature
        Info_Trust_Model_Request_ephemeral_public_key_Read_Data_Signature (DcmDspDataInfo): DcmDspDataFixedLength=true
        Trust_Model_Request_ephemeral_public_key_Read_Certificates (DcmDspData): DcmDspDataSize=24048, DcmDspDataType=UINT8_N, DcmDspDataInfoRef=Info_Trust_Model_Request_ephemeral_public_key_Read_Certificates
        Info_Trust_Model_Request_ephemeral_public_key_Read_Certificates (DcmDspDataInfo): DcmDspDataFixedLength=false
        Trust_model_ECU_CSR_Read_Trust_model_ECU_CSR (DcmDspData): DcmDspDataSize=8016, DcmDspDataType=UINT8_N, DcmDspDataInfoRef=Info_Trust_model_ECU_CSR_Read_Trust_model_ECU_CSR
        Info_Trust_model_ECU_CSR_Read_Trust_model_ECU_CSR (DcmDspDataInfo): DcmDspDataFixedLength=false
        Trust_model_ECU_certificate_Read_Trust_model_ECU_Certificate (DcmDspData): DcmDspDataSize=8016, DcmDspDataType=UINT8_N, DcmDspDataInfoRef=Info_Trust_model_ECU_certificate_Read_Trust_model_ECU_Certificate
        Info_Trust_model_ECU_certificate_Read_Trust_model_ECU_Certificate (DcmDspDataInfo): DcmDspDataFixedLength=false
        Trust_model_Intermediate_CA_certificate_Read_Trust_model_Intermediate_CA_Certificate (DcmDspData):
          DcmDspDataSize = 8016
          DcmDspDataType = UINT8_N
          DcmDspDataInfoRef = Info_Trust_model_Intermediate_CA_certificate_Read_Trust_model_Intermediate_CA_Certificate
        Info_Trust_model_Intermediate_CA_certificate_Read_Trust_model_Intermediate_CA_Certificate (DcmDspDataInfo): DcmDspDataFixedLength=false
        Trust_model_Backend_CA_certificate_Read_Trust_model_Backend_CA_certificate (DcmDspData): DcmDspDataSize=8016, DcmDspDataType=UINT8_N, DcmDspDataInfoRef=Info_Trust_model_Backend_CA_certificate_Read_Trust_model_Backend_CA_certificate
        Info_Trust_model_Backend_CA_certificate_Read_Trust_model_Backend_CA_certificate (DcmDspDataInfo): DcmDspDataFixedLength=false
        Trust_model_Root_CA_certificate_Read_Trust_model_Root_CA_certificate (DcmDspData): DcmDspDataSize=8016, DcmDspDataType=UINT8_N, DcmDspDataInfoRef=Info_Trust_model_Root_CA_certificate_Read_Trust_model_Root_CA_certificate
        Info_Trust_model_Root_CA_certificate_Read_Trust_model_Root_CA_certificate (DcmDspDataInfo): DcmDspDataFixedLength=false
        Trust_model_full_chain_of_trust_certificates_Read_Trust_model_certificates (DcmDspData): DcmDspDataSize=32064, DcmDspDataType=UINT8_N, DcmDspDataInfoRef=Info_Trust_model_full_chain_of_trust_certificates_Read_Trust_model_certificates
        Info_Trust_model_full_chain_of_trust_certificates_Read_Trust_model_certificates (DcmDspDataInfo): DcmDspDataFixedLength=false
        Trust_Model_CSR_Supplier_Signature_Read_Trust_Model_CSR_Supplier_Signature (DcmDspData): DcmDspDataSize=2064, DcmDspDataType=UINT8_N, DcmDspDataInfoRef=Info_Trust_Model_CSR_Supplier_Signature_Read_Trust_Model_CSR_Supplier_Signature
        Info_Trust_Model_CSR_Supplier_Signature_Read_Trust_Model_CSR_Supplier_Signature (DcmDspDataInfo): DcmDspDataFixedLength=false
        Task_Response_Time_Read_Task_histograms (DcmDspData): DcmDspDataSize=32640, DcmDspDataType=UINT8_N, DcmDspDataInfoRef=Info_Task_Response_Time_Read_Task_histograms
        Info_Task_Response_Time_Read_Task_histograms (DcmDspDataInfo): DcmDspDataFixedLength=false
        CPU_Load_Read_CPU_load_histograms (DcmDspData): DcmDspDataSize=24480, DcmDspDataType=UINT8_N, DcmDspDataInfoRef=Info_CPU_Load_Read_CPU_load_histograms
        Info_CPU_Load_Read_CPU_load_histograms (DcmDspDataInfo): DcmDspDataFixedLength=false
        Stack_Load_Read_Maximum (DcmDspData): DcmDspDataSize=4080, DcmDspDataType=UINT8_N, DcmDspDataInfoRef=Info_Stack_Load_Read_Maximum
        Info_Stack_Load_Read_Maximum (DcmDspDataInfo): DcmDspDataFixedLength=false
        Memory_Usage_Cycles_Read_Memory_Usage_Cycles (DcmDspData): DcmDspDataSize=10200, DcmDspDataType=UINT8_N, DcmDspDataInfoRef=Info_Memory_Usage_Cycles_Read_Memory_Usage_Cycles
        Info_Memory_Usage_Cycles_Read_Memory_Usage_Cycles (DcmDspDataInfo): DcmDspDataFixedLength=false
        CAN_input_Read_Neues_Bitfeld_1 (DcmDspData): DcmDspDataSize=8, DcmDspDataType=UINT8, DcmDspDataInfoRef=Info_CAN_input_Read_Neues_Bitfeld_1
        Info_CAN_input_Read_Neues_Bitfeld_1 (DcmDspDataInfo): DcmDspDataFixedLength=true
        CAN_input_Read_Neues_Bitfeld_2 (DcmDspData): DcmDspDataSize=8, DcmDspDataType=UINT8, DcmDspDataInfoRef=Info_CAN_input_Read_Neues_Bitfeld_2
        Info_CAN_input_Read_Neues_Bitfeld_2 (DcmDspDataInfo): DcmDspDataFixedLength=true
        CAN_input_Read_Neues_Bitfeld_3 (DcmDspData): DcmDspDataSize=8, DcmDspDataType=UINT8, DcmDspDataInfoRef=Info_CAN_input_Read_Neues_Bitfeld_3
        Info_CAN_input_Read_Neues_Bitfeld_3 (DcmDspDataInfo): DcmDspDataFixedLength=true
        CAN_input_Read_Neues_Bitfeld_4 (DcmDspData): DcmDspDataSize=8, DcmDspDataType=UINT8, DcmDspDataInfoRef=Info_CAN_input_Read_Neues_Bitfeld_4
        Info_CAN_input_Read_Neues_Bitfeld_4 (DcmDspDataInfo): DcmDspDataFixedLength=true
        CAN_input_Read_Supply_battery_voltage (DcmDspData): DcmDspDataSize=8, DcmDspDataType=UINT8, DcmDspDataInfoRef=Info_CAN_input_Read_Supply_battery_voltage
        Info_CAN_input_Read_Supply_battery_voltage (DcmDspDataInfo): DcmDspDataFixedLength=true
        CAN_input_Read_Neues_Bitfeld_5 (DcmDspData): DcmDspDataSize=8, DcmDspDataType=UINT8, DcmDspDataInfoRef=Info_CAN_input_Read_Neues_Bitfeld_5
        Info_CAN_input_Read_Neues_Bitfeld_5 (DcmDspDataInfo): DcmDspDataFixedLength=true
        CAN_input_Read_Neues_Bitfeld_6 (DcmDspData): DcmDspDataSize=8, DcmDspDataType=UINT8, DcmDspDataInfoRef=Info_CAN_input_Read_Neues_Bitfeld_6
        Info_CAN_input_Read_Neues_Bitfeld_6 (DcmDspDataInfo): DcmDspDataFixedLength=true
        CAN_input_Read_Neues_Bitfeld_7 (DcmDspData): DcmDspDataSize=8, DcmDspDataType=UINT8, DcmDspDataInfoRef=Info_CAN_input_Read_Neues_Bitfeld_7
        Info_CAN_input_Read_Neues_Bitfeld_7 (DcmDspDataInfo): DcmDspDataFixedLength=true
        CAN_input_Read_Neues_Bitfeld_8 (DcmDspData): DcmDspDataSize=8, DcmDspDataType=UINT8, DcmDspDataInfoRef=Info_CAN_input_Read_Neues_Bitfeld_8
        Info_CAN_input_Read_Neues_Bitfeld_8 (DcmDspDataInfo): DcmDspDataFixedLength=true
        CAN_output_Read_CANoutput1 (DcmDspData): DcmDspDataSize=8, DcmDspDataType=UINT8, DcmDspDataInfoRef=Info_CAN_output_Read_CANoutput1
        Info_CAN_output_Read_CANoutput1 (DcmDspDataInfo): DcmDspDataFixedLength=true
        CAN_output_Read_RBTMxx_SP_FctPrecond_Stat_ST35 (DcmDspData): DcmDspDataSize=16, DcmDspDataType=UINT8_N, DcmDspDataInfoRef=Info_CAN_output_Read_RBTMxx_SP_FctPrecond_Stat_ST35
        Info_CAN_output_Read_RBTMxx_SP_FctPrecond_Stat_ST35 (DcmDspDataInfo): DcmDspDataFixedLength=true
        CAN_output_Read_RBTMxx_Actv_Lvl_ST35 (DcmDspData): DcmDspDataSize=8, DcmDspDataType=UINT8, DcmDspDataInfoRef=Info_CAN_output_Read_RBTMxx_Actv_Lvl_ST35
        Info_CAN_output_Read_RBTMxx_Actv_Lvl_ST35 (DcmDspDataInfo): DcmDspDataFixedLength=true
        CAN_output_Read_RBTMxx_SP_ActvClient_ST35 (DcmDspData): DcmDspDataSize=8, DcmDspDataType=UINT8, DcmDspDataInfoRef=Info_CAN_output_Read_RBTMxx_SP_ActvClient_ST35
        Info_CAN_output_Read_RBTMxx_SP_ActvClient_ST35 (DcmDspDataInfo): DcmDspDataFixedLength=true
        CAN_output_Read_PS_Curve_XX_Stat_ST3 (DcmDspData): DcmDspDataSize=8, DcmDspDataType=UINT8, DcmDspDataInfoRef=Info_CAN_output_Read_PS_Curve_XX_Stat_ST3
        Info_CAN_output_Read_PS_Curve_XX_Stat_ST3 (DcmDspDataInfo): DcmDspDataFixedLength=true
        HW_input_Read_Voltage_KL30t (DcmDspData): DcmDspDataSize=8, DcmDspDataType=UINT8, DcmDspDataInfoRef=Info_HW_input_Read_Voltage_KL30t
        Info_HW_input_Read_Voltage_KL30t (DcmDspDataInfo): DcmDspDataFixedLength=true
        HW_input_Read_Voltage_Motor (DcmDspData): DcmDspDataSize=8, DcmDspDataType=UINT8, DcmDspDataInfoRef=Info_HW_input_Read_Voltage_Motor
        Info_HW_input_Read_Voltage_Motor (DcmDspDataInfo): DcmDspDataFixedLength=true
        Internal_ECU_information_Read_Autosar_System_State_EcuM_State (DcmDspData): DcmDspDataSize=8, DcmDspDataType=UINT8, DcmDspDataInfoRef=Info_Internal_ECU_information_Read_Autosar_System_State_EcuM_State
        Info_Internal_ECU_information_Read_Autosar_System_State_EcuM_State (DcmDspDataInfo): DcmDspDataFixedLength=true
        Internal_ECU_information_Read_ECU_Temperature (DcmDspData): DcmDspDataSize=16, DcmDspDataType=UINT16, DcmDspDataInfoRef=Info_Internal_ECU_information_Read_ECU_Temperature
        Info_Internal_ECU_information_Read_ECU_Temperature (DcmDspDataInfo): DcmDspDataFixedLength=true
        Internal_ECU_information_Read_MOTOR_Current (DcmDspData): DcmDspDataSize=16, DcmDspDataType=UINT16, DcmDspDataInfoRef=Info_Internal_ECU_information_Read_MOTOR_Current
        Info_Internal_ECU_information_Read_MOTOR_Current (DcmDspDataInfo): DcmDspDataFixedLength=true
        PRE_SAFE_Recorder_1_read_Read_CombinedDataElement (DcmDspData): DcmDspDataSize=176, DcmDspDataType=UINT8_N, DcmDspDataInfoRef=Info_PRE_SAFE_Recorder_1_read_Read_CombinedDataElement
        Info_PRE_SAFE_Recorder_1_read_Read_CombinedDataElement (DcmDspDataInfo): DcmDspDataFixedLength=false
        PRE_SAFE_Recorder_2_read_Read_CombinedDataElement (DcmDspData): DcmDspDataSize=176, DcmDspDataType=UINT8_N, DcmDspDataInfoRef=Info_PRE_SAFE_Recorder_2_read_Read_CombinedDataElement
        Info_PRE_SAFE_Recorder_2_read_Read_CombinedDataElement (DcmDspDataInfo): DcmDspDataFixedLength=false
        BSR_Counter_read_Read_BSR_Counter (DcmDspData): DcmDspDataSize=24, DcmDspDataType=UINT8_N, DcmDspDataInfoRef=Info_BSR_Counter_read_Read_BSR_Counter
        Info_BSR_Counter_read_Read_BSR_Counter (DcmDspDataInfo): DcmDspDataFixedLength=true
        PRE_SAFE_Counter_read_Read_CombinedDataElement (DcmDspData): DcmDspDataSize=64, DcmDspDataType=UINT8_N, DcmDspDataInfoRef=Info_PRE_SAFE_Counter_read_Read_CombinedDataElement
        Info_PRE_SAFE_Counter_read_Read_CombinedDataElement (DcmDspDataInfo): DcmDspDataFixedLength=false
        System_Time_read_Read_System_time (DcmDspData): DcmDspDataSize=32, DcmDspDataType=UINT32, DcmDspDataInfoRef=Info_System_Time_read_Read_System_time
        Info_System_Time_read_Read_System_time (DcmDspDataInfo): DcmDspDataFixedLength=true
        PreSafe_Cycles_Level_1_8_Read_CombinedSignal (DcmDspData): DcmDspDataSize=8584, DcmDspDataType=UINT8_N, DcmDspDataInfoRef=Info_PreSafe_Cycles_Level_1_8_Read_CombinedSignal
        Info_PreSafe_Cycles_Level_1_8_Read_CombinedSignal (DcmDspDataInfo): DcmDspDataFixedLength=true
        Release_Cycles_BSR_and_PreSafe_Read_CombinedSignal (DcmDspData): DcmDspDataSize=1152, DcmDspDataType=UINT8_N, DcmDspDataInfoRef=Info_Release_Cycles_BSR_and_PreSafe_Read_CombinedSignal
        Info_Release_Cycles_BSR_and_PreSafe_Read_CombinedSignal (DcmDspDataInfo): DcmDspDataFixedLength=true
        Tensioning_Cycle_BSR_Read_CombinedSignal (DcmDspData): DcmDspDataSize=1864, DcmDspDataType=UINT8_N, DcmDspDataInfoRef=Info_Tensioning_Cycle_BSR_Read_CombinedSignal
        Info_Tensioning_Cycle_BSR_Read_CombinedSignal (DcmDspDataInfo): DcmDspDataFixedLength=true
        Vehicle_Equipment_Read_Equipment_1 (DcmDspData): DcmDspDataSize=8, DcmDspDataType=UINT8, DcmDspDataInfoRef=Info_Vehicle_Equipment_Read_Equipment_1
        Info_Vehicle_Equipment_Read_Equipment_1 (DcmDspDataInfo): DcmDspDataFixedLength=true
        Vehicle_Equipment_Read_Equipment_2 (DcmDspData): DcmDspDataSize=8, DcmDspDataType=UINT8, DcmDspDataInfoRef=Info_Vehicle_Equipment_Read_Equipment_2
        Info_Vehicle_Equipment_Read_Equipment_2 (DcmDspDataInfo): DcmDspDataFixedLength=true
        Vehicle_Equipment_Read_Equipment_3 (DcmDspData): DcmDspDataSize=8, DcmDspDataType=UINT8, DcmDspDataInfoRef=Info_Vehicle_Equipment_Read_Equipment_3
        Info_Vehicle_Equipment_Read_Equipment_3 (DcmDspDataInfo): DcmDspDataFixedLength=true
        Vehicle_Equipment_Read_Equipment_4 (DcmDspData): DcmDspDataSize=8, DcmDspDataType=UINT8, DcmDspDataInfoRef=Info_Vehicle_Equipment_Read_Equipment_4
        Info_Vehicle_Equipment_Read_Equipment_4 (DcmDspDataInfo): DcmDspDataFixedLength=true
        Vehicle_Equipment_Read_Equipment_5 (DcmDspData): DcmDspDataSize=8, DcmDspDataType=UINT8, DcmDspDataInfoRef=Info_Vehicle_Equipment_Read_Equipment_5
        Info_Vehicle_Equipment_Read_Equipment_5 (DcmDspDataInfo): DcmDspDataFixedLength=true
        Vehicle_Equipment_Read_Equipment_6 (DcmDspData): DcmDspDataSize=8, DcmDspDataType=UINT8, DcmDspDataInfoRef=Info_Vehicle_Equipment_Read_Equipment_6
        Info_Vehicle_Equipment_Read_Equipment_6 (DcmDspDataInfo): DcmDspDataFixedLength=true
        Vehicle_Equipment_Read_Reserved (DcmDspData): DcmDspDataUsePort=USE_NO_DATA, DcmDspDataSize=8, DcmDspDataType=UINT8, DcmDspDataInfoRef=Info_Vehicle_Equipment_Read_Reserved
        Info_Vehicle_Equipment_Read_Reserved (DcmDspDataInfo): DcmDspDataFixedLength=true
        Vehicle_Equipment_Read_Reserved_1 (DcmDspData): DcmDspDataUsePort=USE_NO_DATA, DcmDspDataSize=8, DcmDspDataType=UINT8, DcmDspDataInfoRef=Info_Vehicle_Equipment_Read_Reserved_1
        Info_Vehicle_Equipment_Read_Reserved_1 (DcmDspDataInfo): DcmDspDataFixedLength=true
        Vehicle_Equipment_Read_Unterspannungsabbruchschwelle (DcmDspData): DcmDspDataSize=16, DcmDspDataType=UINT16, DcmDspDataInfoRef=Info_Vehicle_Equipment_Read_Unterspannungsabbruchschwelle
        Info_Vehicle_Equipment_Read_Unterspannungsabbruchschwelle (DcmDspDataInfo): DcmDspDataFixedLength=true
        Vehicle_Equipment_Read_Unterspannungsbereichsschwelle (DcmDspData): DcmDspDataSize=16, DcmDspDataType=UINT16, DcmDspDataInfoRef=Info_Vehicle_Equipment_Read_Unterspannungsbereichsschwelle
        Info_Vehicle_Equipment_Read_Unterspannungsbereichsschwelle (DcmDspDataInfo): DcmDspDataFixedLength=true
        Vehicle_Equipment_Read_Ueberspannungsbereichsschwelle (DcmDspData): DcmDspDataSize=16, DcmDspDataType=UINT16, DcmDspDataInfoRef=Info_Vehicle_Equipment_Read_Ueberspannungsbereichsschwelle
        Info_Vehicle_Equipment_Read_Ueberspannungsbereichsschwelle (DcmDspDataInfo): DcmDspDataFixedLength=true
        Vehicle_Equipment_Read_Ueberspannungsabbruchschwelle (DcmDspData): DcmDspDataSize=16, DcmDspDataType=UINT16, DcmDspDataInfoRef=Info_Vehicle_Equipment_Read_Ueberspannungsabbruchschwelle
        Info_Vehicle_Equipment_Read_Ueberspannungsabbruchschwelle (DcmDspDataInfo): DcmDspDataFixedLength=true
        ZZZ_Vehicle_Equipment_Development_Read_Bitfield (DcmDspData): DcmDspDataSize=16, DcmDspDataType=UINT8_N, DcmDspDataInfoRef=Info_ZZZ_Vehicle_Equipment_Development_Read_Bitfield
        Info_ZZZ_Vehicle_Equipment_Development_Read_Bitfield (DcmDspDataInfo): DcmDspDataFixedLength=true
        ZZZ_Vehicle_Equipment_Development_Read_Zykluszeit_Messtechnik (DcmDspData): DcmDspDataSize=8, DcmDspDataType=UINT8, DcmDspDataInfoRef=Info_ZZZ_Vehicle_Equipment_Development_Read_Zykluszeit_Messtechnik
        Info_ZZZ_Vehicle_Equipment_Development_Read_Zykluszeit_Messtechnik (DcmDspDataInfo): DcmDspDataFixedLength=true
        Seatbelt_Serial_Number_Read_Unique_Seatbelt_Serialnumber (DcmDspData): DcmDspDataSize=224, DcmDspDataType=UINT8_N, DcmDspDataInfoRef=Info_Seatbelt_Serial_Number_Read_Unique_Seatbelt_Serialnumber
        Info_Seatbelt_Serial_Number_Read_Unique_Seatbelt_Serialnumber (DcmDspDataInfo): DcmDspDataFixedLength=true
        Calibration_Identifications_CAL_ID_Read_Calibration_Identification (DcmDspData): DcmDspDataSize=2560, DcmDspDataType=UINT8_N, DcmDspDataInfoRef=Info_Calibration_Identifications_CAL_ID_Read_Calibration_Identification
        Info_Calibration_Identifications_CAL_ID_Read_Calibration_Identification (DcmDspDataInfo): DcmDspDataFixedLength=false
        ECU_Extract_Version_Read_ECU_Extract_Major_Version (DcmDspData): DcmDspDataSize=8, DcmDspDataType=UINT8, DcmDspDataInfoRef=Info_ECU_Extract_Version_Read_ECU_Extract_Major_Version
        Info_ECU_Extract_Version_Read_ECU_Extract_Major_Version (DcmDspDataInfo): DcmDspDataFixedLength=true
        ECU_Extract_Version_Read_ECU_Extract_Minor_Version (DcmDspData): DcmDspDataSize=8, DcmDspDataType=UINT8, DcmDspDataInfoRef=Info_ECU_Extract_Version_Read_ECU_Extract_Minor_Version
        Info_ECU_Extract_Version_Read_ECU_Extract_Minor_Version (DcmDspDataInfo): DcmDspDataFixedLength=true
        ECU_Extract_Version_Read_ECU_Extract_Patch_Version (DcmDspData): DcmDspDataSize=8, DcmDspDataType=UINT8, DcmDspDataInfoRef=Info_ECU_Extract_Version_Read_ECU_Extract_Patch_Version
        Info_ECU_Extract_Version_Read_ECU_Extract_Patch_Version (DcmDspDataInfo): DcmDspDataFixedLength=true
        ECU_Extract_Version_Read_ECU_Extract_Information_Identification_Type (DcmDspData): DcmDspDataSize=8, DcmDspDataType=UINT8, DcmDspDataInfoRef=Info_ECU_Extract_Version_Read_ECU_Extract_Information_Identification_Type
        Info_ECU_Extract_Version_Read_ECU_Extract_Information_Identification_Type (DcmDspDataInfo): DcmDspDataFixedLength=true
        ECU_Extract_Version_Read_ECU_Extract_Information_XDIS_Version (DcmDspData): DcmDspDataSize=80, DcmDspDataType=UINT8_N, DcmDspDataInfoRef=Info_ECU_Extract_Version_Read_ECU_Extract_Information_XDIS_Version
        Info_ECU_Extract_Version_Read_ECU_Extract_Information_XDIS_Version (DcmDspDataInfo): DcmDspDataFixedLength=true
        ECU_Extract_Version_Read_ECU_Extract_Information_Export_Date (DcmDspData): DcmDspDataSize=80, DcmDspDataType=UINT8_N, DcmDspDataInfoRef=Info_ECU_Extract_Version_Read_ECU_Extract_Information_Export_Date
        Info_ECU_Extract_Version_Read_ECU_Extract_Information_Export_Date (DcmDspDataInfo): DcmDspDataFixedLength=true
        ECU_Extract_Version_Read_ECU_Extract_Information_ECU_Name (DcmDspData): DcmDspDataSize=240, DcmDspDataType=UINT8_N, DcmDspDataInfoRef=Info_ECU_Extract_Version_Read_ECU_Extract_Information_ECU_Name
        Info_ECU_Extract_Version_Read_ECU_Extract_Information_ECU_Name (DcmDspDataInfo): DcmDspDataFixedLength=true
        ECU_Extract_Version_Read_ECU_Extract_Information_Checksum (DcmDspData): DcmDspDataSize=320, DcmDspDataType=UINT8_N, DcmDspDataInfoRef=Info_ECU_Extract_Version_Read_ECU_Extract_Information_Checksum
        Info_ECU_Extract_Version_Read_ECU_Extract_Information_Checksum (DcmDspDataInfo): DcmDspDataFixedLength=true
        Diagnostic_Extract_Version_Read_Diagnostic_Extract_Major_Version (DcmDspData): DcmDspDataSize=8, DcmDspDataType=UINT8, DcmDspDataInfoRef=Info_Diagnostic_Extract_Version_Read_Diagnostic_Extract_Major_Version
        Info_Diagnostic_Extract_Version_Read_Diagnostic_Extract_Major_Version (DcmDspDataInfo): DcmDspDataFixedLength=true
        Diagnostic_Extract_Version_Read_Diagnostic_Extract_Minor_Version (DcmDspData): DcmDspDataSize=8, DcmDspDataType=UINT8, DcmDspDataInfoRef=Info_Diagnostic_Extract_Version_Read_Diagnostic_Extract_Minor_Version
        Info_Diagnostic_Extract_Version_Read_Diagnostic_Extract_Minor_Version (DcmDspDataInfo): DcmDspDataFixedLength=true
        Diagnostic_Extract_Version_Read_Diagnostic_Extract_Patch_Version (DcmDspData): DcmDspDataSize=8, DcmDspDataType=UINT8, DcmDspDataInfoRef=Info_Diagnostic_Extract_Version_Read_Diagnostic_Extract_Patch_Version
        Info_Diagnostic_Extract_Version_Read_Diagnostic_Extract_Patch_Version (DcmDspDataInfo): DcmDspDataFixedLength=true
        Diagnostic_Extract_Version_Read_CANdela_Version (DcmDspData): DcmDspDataSize=80, DcmDspDataType=UINT8_N, DcmDspDataInfoRef=Info_Diagnostic_Extract_Version_Read_CANdela_Version
        Info_Diagnostic_Extract_Version_Read_CANdela_Version (DcmDspDataInfo): DcmDspDataFixedLength=true
        Diagnostic_Extract_Version_Read_DDM_Version (DcmDspData): DcmDspDataSize=80, DcmDspDataType=UINT8_N, DcmDspDataInfoRef=Info_Diagnostic_Extract_Version_Read_DDM_Version
        Info_Diagnostic_Extract_Version_Read_DDM_Version (DcmDspDataInfo): DcmDspDataFixedLength=true
        Diagnostic_Extract_Version_Read_Exported_Diagnostic_Variant (DcmDspData): DcmDspDataSize=240, DcmDspDataType=UINT8_N, DcmDspDataInfoRef=Info_Diagnostic_Extract_Version_Read_Exported_Diagnostic_Variant
        Info_Diagnostic_Extract_Version_Read_Exported_Diagnostic_Variant (DcmDspDataInfo): DcmDspDataFixedLength=true
        Standard_Application_SW_Package_Information_Read_Standard_Application_SW_Package_Major_Version (DcmDspData):
          DcmDspDataSize = 8
          DcmDspDataType = UINT8
          DcmDspDataInfoRef = Info_Standard_Application_SW_Package_Information_Read_Standard_Application_SW_Package_Major_Version
        Info_Standard_Application_SW_Package_Information_Read_Standard_Application_SW_Package_Major_Version (DcmDspDataInfo): DcmDspDataFixedLength=true
        Standard_Application_SW_Package_Information_Read_Standard_Application_SW_Package_Minor_Version (DcmDspData):
          DcmDspDataSize = 8
          DcmDspDataType = UINT8
          DcmDspDataInfoRef = Info_Standard_Application_SW_Package_Information_Read_Standard_Application_SW_Package_Minor_Version
        Info_Standard_Application_SW_Package_Information_Read_Standard_Application_SW_Package_Minor_Version (DcmDspDataInfo): DcmDspDataFixedLength=true
        Standard_Application_SW_Package_Information_Read_Standard_Application_SW_Package_Patch_Level (DcmDspData):
          DcmDspDataSize = 8
          DcmDspDataType = UINT8
          DcmDspDataInfoRef = Info_Standard_Application_SW_Package_Information_Read_Standard_Application_SW_Package_Patch_Level
        Info_Standard_Application_SW_Package_Information_Read_Standard_Application_SW_Package_Patch_Level (DcmDspDataInfo): DcmDspDataFixedLength=true
        Standard_Application_SW_Package_Information_Read_Standard_Application_SW_Package_Build_Version (DcmDspData):
          DcmDspDataSize = 8
          DcmDspDataType = UINT8
          DcmDspDataInfoRef = Info_Standard_Application_SW_Package_Information_Read_Standard_Application_SW_Package_Build_Version
        Info_Standard_Application_SW_Package_Information_Read_Standard_Application_SW_Package_Build_Version (DcmDspDataInfo): DcmDspDataFixedLength=true
        Standard_Application_SW_Package_Information_Read_C_P_Identification (DcmDspData): DcmDspDataSize=160, DcmDspDataType=UINT8_N, DcmDspDataInfoRef=Info_Standard_Application_SW_Package_Information_Read_C_P_Identification
        Info_Standard_Application_SW_Package_Information_Read_C_P_Identification (DcmDspDataInfo): DcmDspDataFixedLength=true
        Standard_Application_SW_Package_Information_Read_Supplier_Identification (DcmDspData): DcmDspDataSize=16, DcmDspDataType=UINT16, DcmDspDataInfoRef=Info_Standard_Application_SW_Package_Information_Read_Supplier_Identification
        Info_Standard_Application_SW_Package_Information_Read_Supplier_Identification (DcmDspDataInfo): DcmDspDataFixedLength=true
        Standard_Application_SW_Package_Information_Read_AUTOSAR_Platform (DcmDspData): DcmDspDataSize=8, DcmDspDataType=UINT8, DcmDspDataInfoRef=Info_Standard_Application_SW_Package_Information_Read_AUTOSAR_Platform
        Info_Standard_Application_SW_Package_Information_Read_AUTOSAR_Platform (DcmDspDataInfo): DcmDspDataFixedLength=true
        SSA_Version_Information_Read_SSA_Major_Version (DcmDspData): DcmDspDataSize=8, DcmDspDataType=UINT8, DcmDspDataInfoRef=Info_SSA_Version_Information_Read_SSA_Major_Version
        Info_SSA_Version_Information_Read_SSA_Major_Version (DcmDspDataInfo): DcmDspDataFixedLength=true
        SSA_Version_Information_Read_SSA_Minor_Version (DcmDspData): DcmDspDataSize=8, DcmDspDataType=UINT8, DcmDspDataInfoRef=Info_SSA_Version_Information_Read_SSA_Minor_Version
        Info_SSA_Version_Information_Read_SSA_Minor_Version (DcmDspDataInfo): DcmDspDataFixedLength=true
        SSA_Version_Information_Read_SSA_Patch_Level (DcmDspData): DcmDspDataSize=8, DcmDspDataType=UINT8, DcmDspDataInfoRef=Info_SSA_Version_Information_Read_SSA_Patch_Level
        Info_SSA_Version_Information_Read_SSA_Patch_Level (DcmDspDataInfo): DcmDspDataFixedLength=true
        Minimum_Software_Version_Read_Minimum_Software_Version (DcmDspData): DcmDspDataSize=3048, DcmDspDataType=UINT8_N, DcmDspDataInfoRef=Info_Minimum_Software_Version_Read_Minimum_Software_Version
        Info_Minimum_Software_Version_Read_Minimum_Software_Version (DcmDspDataInfo): DcmDspDataFixedLength=false
        ActiveDiagnosticInformation_Read_Identification (DcmDspData): DcmDspDataSize=24, DcmDspDataType=UINT8_N, DcmDspDataInfoRef=Info_ActiveDiagnosticInformation_Read_Identification
        Info_ActiveDiagnosticInformation_Read_Identification (DcmDspDataInfo): DcmDspDataFixedLength=true
        ActiveDiagnosticInformation_Read_Session (DcmDspData): DcmDspDataSize=8, DcmDspDataType=UINT8, DcmDspDataInfoRef=Info_ActiveDiagnosticInformation_Read_Session
        Info_ActiveDiagnosticInformation_Read_Session (DcmDspDataInfo): DcmDspDataFixedLength=true
        Dump_of_Vedoc_Relevant_Information_Read_PatchedObject (DcmDspData): DcmDspDataSize=384, DcmDspDataType=UINT8_N, DcmDspDataInfoRef=Info_Dump_of_Vedoc_Relevant_Information_Read_PatchedObject
        Info_Dump_of_Vedoc_Relevant_Information_Read_PatchedObject (DcmDspDataInfo): DcmDspDataFixedLength=false
        ECU_Name_Read_Diagnostic_ECU_Name (DcmDspData): DcmDspDataSize=8000, DcmDspDataType=UINT8_N, DcmDspDataInfoRef=Info_ECU_Name_Read_Diagnostic_ECU_Name
        Info_ECU_Name_Read_Diagnostic_ECU_Name (DcmDspDataInfo): DcmDspDataFixedLength=false
        DDS_Package_Release_Read_DDS_Package_Release_of_Application_Software_Year_Appl (DcmDspData): DcmDspDataSize=8, DcmDspDataType=UINT8, DcmDspDataInfoRef=Info_DDS_Package_Release_Read_DDS_Package_Release_of_Application_Software_Year_Appl
        Info_DDS_Package_Release_Read_DDS_Package_Release_of_Application_Software_Year_Appl (DcmDspDataInfo): DcmDspDataFixedLength=true
        DDS_Package_Release_Read_DDS_Package_Release_of_Application_Software_Month_Appl (DcmDspData): DcmDspDataSize=8, DcmDspDataType=UINT8, DcmDspDataInfoRef=Info_DDS_Package_Release_Read_DDS_Package_Release_of_Application_Software_Month_Appl
        Info_DDS_Package_Release_Read_DDS_Package_Release_of_Application_Software_Month_Appl (DcmDspDataInfo): DcmDspDataFixedLength=true
        DDS_Package_Release_Read_DDS_Package_Release_of_Boot_Software_Year_Boot (DcmDspData): DcmDspDataSize=8, DcmDspDataType=UINT8, DcmDspDataInfoRef=Info_DDS_Package_Release_Read_DDS_Package_Release_of_Boot_Software_Year_Boot
        Info_DDS_Package_Release_Read_DDS_Package_Release_of_Boot_Software_Year_Boot (DcmDspDataInfo): DcmDspDataFixedLength=true
        DDS_Package_Release_Read_DDS_Package_Release_of_Boot_Software_Month_Boot (DcmDspData): DcmDspDataSize=8, DcmDspDataType=UINT8, DcmDspDataInfoRef=Info_DDS_Package_Release_Read_DDS_Package_Release_of_Boot_Software_Month_Boot
        Info_DDS_Package_Release_Read_DDS_Package_Release_of_Boot_Software_Month_Boot (DcmDspDataInfo): DcmDspDataFixedLength=true
        MercedesCarGroupHardware_Read_Hardware_Part_Number (DcmDspData): DcmDspDataSize=80, DcmDspDataType=UINT8_N, DcmDspDataInfoRef=Info_MercedesCarGroupHardware_Read_Hardware_Part_Number
        Info_MercedesCarGroupHardware_Read_Hardware_Part_Number (DcmDspDataInfo): DcmDspDataFixedLength=true
        MercedesCarGroupSoftware_Read_Software_Logical_Block_Numbers (DcmDspData): DcmDspDataSize=10160, DcmDspDataType=UINT8_N, DcmDspDataInfoRef=Info_MercedesCarGroupSoftware_Read_Software_Logical_Block_Numbers
        Info_MercedesCarGroupSoftware_Read_Software_Logical_Block_Numbers (DcmDspDataInfo): DcmDspDataFixedLength=false
        Supported_configuration_mechanisms_Read_Config_mechanisms (DcmDspData): DcmDspDataSize=8, DcmDspDataType=UINT8, DcmDspDataInfoRef=Info_Supported_configuration_mechanisms_Read_Config_mechanisms
        Info_Supported_configuration_mechanisms_Read_Config_mechanisms (DcmDspDataInfo): DcmDspDataFixedLength=true
        HardwareVersion_Read_HW_year (DcmDspData): DcmDspDataSize=8, DcmDspDataType=UINT8, DcmDspDataInfoRef=Info_HardwareVersion_Read_HW_year
        Info_HardwareVersion_Read_HW_year (DcmDspDataInfo): DcmDspDataFixedLength=true
        HardwareVersion_Read_HW_week (DcmDspData): DcmDspDataSize=8, DcmDspDataType=UINT8, DcmDspDataInfoRef=Info_HardwareVersion_Read_HW_week
        Info_HardwareVersion_Read_HW_week (DcmDspDataInfo): DcmDspDataFixedLength=true
        HardwareVersion_Read_HW_patch_level (DcmDspData): DcmDspDataSize=8, DcmDspDataType=UINT8, DcmDspDataInfoRef=Info_HardwareVersion_Read_HW_patch_level
        Info_HardwareVersion_Read_HW_patch_level (DcmDspDataInfo): DcmDspDataFixedLength=true
        SoftwareVersion_Read_Software_Logical_Block_Version_Information (DcmDspData): DcmDspDataSize=3048, DcmDspDataType=UINT8_N, DcmDspDataInfoRef=Info_SoftwareVersion_Read_Software_Logical_Block_Version_Information
        Info_SoftwareVersion_Read_Software_Logical_Block_Version_Information (DcmDspDataInfo): DcmDspDataFixedLength=false
        BootSoftwareVersion_Read_Boot_SW_year (DcmDspData): DcmDspDataSize=8, DcmDspDataType=UINT8, DcmDspDataInfoRef=Info_BootSoftwareVersion_Read_Boot_SW_year
        Info_BootSoftwareVersion_Read_Boot_SW_year (DcmDspDataInfo): DcmDspDataFixedLength=true
        BootSoftwareVersion_Read_Boot_SW_week (DcmDspData): DcmDspDataSize=8, DcmDspDataType=UINT8, DcmDspDataInfoRef=Info_BootSoftwareVersion_Read_Boot_SW_week
        Info_BootSoftwareVersion_Read_Boot_SW_week (DcmDspDataInfo): DcmDspDataFixedLength=true
        BootSoftwareVersion_Read_Boot_SW_patch_level (DcmDspData): DcmDspDataSize=8, DcmDspDataType=UINT8, DcmDspDataInfoRef=Info_BootSoftwareVersion_Read_Boot_SW_patch_level
        Info_BootSoftwareVersion_Read_Boot_SW_patch_level (DcmDspDataInfo): DcmDspDataFixedLength=true
        HardwareSupplier_Read_Hardware_Supplier_Identification (DcmDspData): DcmDspDataSize=16, DcmDspDataType=UINT16, DcmDspDataInfoRef=Info_HardwareSupplier_Read_Hardware_Supplier_Identification
        Info_HardwareSupplier_Read_Hardware_Supplier_Identification (DcmDspDataInfo): DcmDspDataFixedLength=true
        SoftwareSupplier_Read_Software_Logical_Block_Supplier_Identification (DcmDspData): DcmDspDataSize=2032, DcmDspDataType=UINT8_N, DcmDspDataInfoRef=Info_SoftwareSupplier_Read_Software_Logical_Block_Supplier_Identification
        Info_SoftwareSupplier_Read_Software_Logical_Block_Supplier_Identification (DcmDspDataInfo): DcmDspDataFixedLength=false
        ReadFingerprint_Read_Software_Fingerprint_s (DcmDspData): DcmDspDataSize=20320, DcmDspDataType=UINT8_N, DcmDspDataInfoRef=Info_ReadFingerprint_Read_Software_Fingerprint_s
        Info_ReadFingerprint_Read_Software_Fingerprint_s (DcmDspDataInfo): DcmDspDataFixedLength=false
        ECUSerialNumberDataIdentifier_Read_ECU_Serial_Number (DcmDspData): DcmDspDataSize=264, DcmDspDataType=UINT8_N, DcmDspDataInfoRef=Info_ECUSerialNumberDataIdentifier_Read_ECU_Serial_Number
        Info_ECUSerialNumberDataIdentifier_Read_ECU_Serial_Number (DcmDspDataInfo): DcmDspDataFixedLength=false
        VINDataIdentifier_Read_VINDataIdentifier (DcmDspData): DcmDspDataSize=136, DcmDspDataType=UINT8_N, DcmDspDataInfoRef=Info_VINDataIdentifier_Read_VINDataIdentifier
        Info_VINDataIdentifier_Read_VINDataIdentifier (DcmDspDataInfo): DcmDspDataFixedLength=true
        Calibration_Identifications_CAL_ID_Write_Number_of_data_items (DcmDspData): DcmDspDataSize=8, DcmDspDataType=UINT8, DcmDspDataInfoRef=Info_Calibration_Identifications_CAL_ID_Write_Number_of_data_items
        Info_Calibration_Identifications_CAL_ID_Write_Number_of_data_items (DcmDspDataInfo): DcmDspDataFixedLength=true
        Calibration_Identifications_CAL_ID_Write_Calibration_Identification (DcmDspData): DcmDspDataSize=2560, DcmDspDataType=UINT8_N, DcmDspDataInfoRef=Info_Calibration_Identifications_CAL_ID_Write_Calibration_Identification
        Info_Calibration_Identifications_CAL_ID_Write_Calibration_Identification (DcmDspDataInfo): DcmDspDataFixedLength=false
        SW_Version_Read_SW_Version (DcmDspData): DcmDspDataSize=96, DcmDspDataType=UINT8_N, DcmDspDataInfoRef=Info_SW_Version_Read_SW_Version
        Info_SW_Version_Read_SW_Version (DcmDspDataInfo): DcmDspDataFixedLength=true
        ECU_serial_number_Read_ECU_traceability_number (DcmDspData): DcmDspDataSize=96, DcmDspDataType=UINT8_N, DcmDspDataInfoRef=Info_ECU_serial_number_Read_ECU_traceability_number
        Info_ECU_serial_number_Read_ECU_traceability_number (DcmDspDataInfo): DcmDspDataFixedLength=true
        ECU_serial_number_Read_PCBA_Programmed_Part_number (DcmDspData): DcmDspDataSize=80, DcmDspDataType=UINT8_N, DcmDspDataInfoRef=Info_ECU_serial_number_Read_PCBA_Programmed_Part_number
        Info_ECU_serial_number_Read_PCBA_Programmed_Part_number (DcmDspDataInfo): DcmDspDataFixedLength=true
        HSM_Identification_Read_HSM_MB_Partnumber (DcmDspData): DcmDspDataSize=80, DcmDspDataType=UINT8_N, DcmDspDataInfoRef=Info_HSM_Identification_Read_HSM_MB_Partnumber
        Info_HSM_Identification_Read_HSM_MB_Partnumber (DcmDspDataInfo): DcmDspDataFixedLength=true
        HSM_Identification_Read_HSM_MB_Version_HW_patch_level (DcmDspData): DcmDspDataSize=8, DcmDspDataType=UINT8, DcmDspDataInfoRef=Info_HSM_Identification_Read_HSM_MB_Version_HW_patch_level
        Info_HSM_Identification_Read_HSM_MB_Version_HW_patch_level (DcmDspDataInfo): DcmDspDataFixedLength=true
        HSM_Identification_Read_HSM_MB_Version_HW_week (DcmDspData): DcmDspDataSize=8, DcmDspDataType=UINT8, DcmDspDataInfoRef=Info_HSM_Identification_Read_HSM_MB_Version_HW_week
        Info_HSM_Identification_Read_HSM_MB_Version_HW_week (DcmDspDataInfo): DcmDspDataFixedLength=true
        HSM_Identification_Read_HSM_MB_Version_HW_year (DcmDspData): DcmDspDataSize=8, DcmDspDataType=UINT8, DcmDspDataInfoRef=Info_HSM_Identification_Read_HSM_MB_Version_HW_year
        Info_HSM_Identification_Read_HSM_MB_Version_HW_year (DcmDspDataInfo): DcmDspDataFixedLength=true
        HSM_Identification_Read_HSM_MB_Supplier_Version_HW_patch_level (DcmDspData): DcmDspDataSize=8, DcmDspDataType=UINT8, DcmDspDataInfoRef=Info_HSM_Identification_Read_HSM_MB_Supplier_Version_HW_patch_level
        Info_HSM_Identification_Read_HSM_MB_Supplier_Version_HW_patch_level (DcmDspDataInfo): DcmDspDataFixedLength=true
        HSM_Identification_Read_HSM_MB_Supplier_Version_HW_week (DcmDspData): DcmDspDataSize=8, DcmDspDataType=UINT8, DcmDspDataInfoRef=Info_HSM_Identification_Read_HSM_MB_Supplier_Version_HW_week
        Info_HSM_Identification_Read_HSM_MB_Supplier_Version_HW_week (DcmDspDataInfo): DcmDspDataFixedLength=true
        HSM_Identification_Read_HSM_MB_Supplier_Version_HW_year (DcmDspData): DcmDspDataSize=8, DcmDspDataType=UINT8, DcmDspDataInfoRef=Info_HSM_Identification_Read_HSM_MB_Supplier_Version_HW_year
        Info_HSM_Identification_Read_HSM_MB_Supplier_Version_HW_year (DcmDspDataInfo): DcmDspDataFixedLength=true
        Reset_Cause_Management_Read_Reset_Cause (DcmDspData): DcmDspDataSize=8, DcmDspDataType=UINT8, DcmDspDataInfoRef=Info_Reset_Cause_Management_Read_Reset_Cause
        Info_Reset_Cause_Management_Read_Reset_Cause (DcmDspDataInfo): DcmDspDataFixedLength=true
        Last_Warm_Reset_Parameters_Read_Last_Detected_Warm_Reset_Cause (DcmDspData): DcmDspDataSize=32, DcmDspDataType=UINT8_N, DcmDspDataInfoRef=Info_Last_Warm_Reset_Parameters_Read_Last_Detected_Warm_Reset_Cause
        Info_Last_Warm_Reset_Parameters_Read_Last_Detected_Warm_Reset_Cause (DcmDspDataInfo): DcmDspDataFixedLength=true
        Last_Warm_Reset_Parameters_Read_Reset_Cause_Counter (DcmDspData): DcmDspDataSize=32, DcmDspDataType=UINT8_N, DcmDspDataInfoRef=Info_Last_Warm_Reset_Parameters_Read_Reset_Cause_Counter
        Info_Last_Warm_Reset_Parameters_Read_Reset_Cause_Counter (DcmDspDataInfo): DcmDspDataFixedLength=true
        Cycle_configuration_Read_Cycles (DcmDspData): DcmDspDataSize=3360, DcmDspDataType=UINT8_N, DcmDspDataInfoRef=Info_Cycle_configuration_Read_Cycles
        Info_Cycle_configuration_Read_Cycles (DcmDspDataInfo): DcmDspDataFixedLength=true
        Steps_library_Read_Steps (DcmDspData): DcmDspDataSize=9280, DcmDspDataType=UINT8_N, DcmDspDataInfoRef=Info_Steps_library_Read_Steps
        Info_Steps_library_Read_Steps (DcmDspDataInfo): DcmDspDataFixedLength=true
        ECU_Location_Read_Side_Allocation (DcmDspData): DcmDspDataSize=8, DcmDspDataType=UINT8, DcmDspDataInfoRef=Info_ECU_Location_Read_Side_Allocation
        Info_ECU_Location_Read_Side_Allocation (DcmDspDataInfo): DcmDspDataFixedLength=true
        Temperature_Sensor_Calibration_Point_Read_Offset_Point (DcmDspData): DcmDspDataSize=8, DcmDspDataType=SINT8, DcmDspDataInfoRef=Info_Temperature_Sensor_Calibration_Point_Read_Offset_Point
        Info_Temperature_Sensor_Calibration_Point_Read_Offset_Point (DcmDspDataInfo): DcmDspDataFixedLength=true
        HB_Calibration_Read_CombinedSignal (DcmDspData): DcmDspDataSize=320, DcmDspDataType=UINT8_N, DcmDspDataInfoRef=Info_HB_Calibration_Read_CombinedSignal
        Info_HB_Calibration_Read_CombinedSignal (DcmDspDataInfo): DcmDspDataFixedLength=true
        Hardware_Version_Information_Write_HW_year (DcmDspData): DcmDspDataSize=8, DcmDspDataType=UINT8, DcmDspDataInfoRef=Info_Hardware_Version_Information_Write_HW_year
        Info_Hardware_Version_Information_Write_HW_year (DcmDspDataInfo): DcmDspDataFixedLength=true
        Hardware_Version_Information_Write_HW_week (DcmDspData): DcmDspDataSize=8, DcmDspDataType=UINT8, DcmDspDataInfoRef=Info_Hardware_Version_Information_Write_HW_week
        Info_Hardware_Version_Information_Write_HW_week (DcmDspDataInfo): DcmDspDataFixedLength=true
        Hardware_Version_Information_Write_HW_patch_level (DcmDspData): DcmDspDataSize=8, DcmDspDataType=UINT8, DcmDspDataInfoRef=Info_Hardware_Version_Information_Write_HW_patch_level
        Info_Hardware_Version_Information_Write_HW_patch_level (DcmDspDataInfo): DcmDspDataFixedLength=true
        Velocity_PI_Regulation_Coefficient_Read_Input_Velocity_Coefficient (DcmDspData): DcmDspDataSize=240, DcmDspDataType=UINT8_N, DcmDspDataInfoRef=Info_Velocity_PI_Regulation_Coefficient_Read_Input_Velocity_Coefficient
        Info_Velocity_PI_Regulation_Coefficient_Read_Input_Velocity_Coefficient (DcmDspDataInfo): DcmDspDataFixedLength=true
        Measurement_Frame_Block_12_Config_Read_CombinedSignal (DcmDspData): DcmDspDataSize=40, DcmDspDataType=UINT8_N, DcmDspDataInfoRef=Info_Measurement_Frame_Block_12_Config_Read_CombinedSignal
        Info_Measurement_Frame_Block_12_Config_Read_CombinedSignal (DcmDspDataInfo): DcmDspDataFixedLength=true
        AEC_Status_Read_AEC_Status (DcmDspData): DcmDspDataSize=1920, DcmDspDataType=UINT8_N, DcmDspDataInfoRef=Info_AEC_Status_Read_AEC_Status
        Info_AEC_Status_Read_AEC_Status (DcmDspDataInfo): DcmDspDataFixedLength=false
        Measurement_Frames_Configuration_Read_CombinedSignal (DcmDspData): DcmDspDataSize=32, DcmDspDataType=UINT8_N, DcmDspDataInfoRef=Info_Measurement_Frames_Configuration_Read_CombinedSignal
        Info_Measurement_Frames_Configuration_Read_CombinedSignal (DcmDspDataInfo): DcmDspDataFixedLength=true
        91 x DcmDspDid:
          DID_Reprogramming_Attempt_Counter_Read: DcmDspDidIdentifier=256, DcmDspDidInfoRef=DidInfo_Reprogramming_Attempt_Counter_Read
            Reprogramming_Attempts (DcmDspDidSignal): DcmDspDidDataPos=0, DcmDspDidDataRef=Reprogramming_Attempt_Counter_Read_Reprogramming_Attempts
          DID_Diagnostic_Trace_Memory_Read: DcmDspDidIdentifier=258, DcmDspDidInfoRef=DidInfo_Diagnostic_Trace_Memory_Read
            Diagnostic_Trace_Memory (DcmDspDidSignal): DcmDspDidDataPos=0, DcmDspDidDataRef=Diagnostic_Trace_Memory_Read_Diagnostic_Trace_Memory
          DID_Global_Time_Sync_Measured_Values_Read: DcmDspDidIdentifier=263, DcmDspDidInfoRef=DidInfo_Global_Time_Sync_Measured_Values_Read
            GTSM (DcmDspDidSignal): DcmDspDidDataPos=0, DcmDspDidDataRef=Global_Time_Sync_Measured_Values_Read_GTSM
          DID_Vehicle_Odometer_in_Low_Resolution_Read: DcmDspDidIdentifier=266, DcmDspDidInfoRef=DidInfo_Vehicle_Odometer_in_Low_Resolution_Read
            Vehicle_Odometer_in_Low_Resolution (DcmDspDidSignal): DcmDspDidDataPos=0, DcmDspDidDataRef=Vehicle_Odometer_in_Low_Resolution_Read_Vehicle_Odometer_in_Low_Resolution
          DID_Adjust_ISO_15765_2_Block_Size_and_STmin_Parameter_Read: DcmDspDidIdentifier=267, DcmDspDidInfoRef=DidInfo_Adjust_ISO_15765_2_Block_Size_and_STmin_Parameter_Read
            Block_Size_Value_as_defined_in_ISO_15765_2 (DcmDspDidSignal): DcmDspDidDataPos=0, DcmDspDidDataRef=Adjust_ISO_15765_2_Block_Size_and_STmin_Parameter_Read_Block_Size_Value_as_defined_in_ISO_15765_2
            STmin_Value_as_defined_in_ISO_15765_2 (DcmDspDidSignal): DcmDspDidDataPos=8, DcmDspDidDataRef=Adjust_ISO_15765_2_Block_Size_and_STmin_Parameter_Read_STmin_Value_as_defined_in_ISO_15765_2
          DID_Current_Operating_Time_Read: DcmDspDidIdentifier=307, DcmDspDidInfoRef=DidInfo_Current_Operating_Time_Read
            Current_Operating_Time (DcmDspDidSignal): DcmDspDidDataPos=0, DcmDspDidDataRef=Current_Operating_Time_Read_Current_Operating_Time
            Operating_Time_Status (DcmDspDidSignal): DcmDspDidDataPos=32, DcmDspDidDataRef=Current_Operating_Time_Read_Operating_Time_Status
          DID_Customer_Settings_Read: DcmDspDidIdentifier=312, DcmDspDidInfoRef=DidInfo_Customer_Settings_Read
            BltSlckDec_Md_Stat (DcmDspDidSignal): DcmDspDidDataPos=0, DcmDspDidDataRef=Customer_Settings_Read_BltSlckDec_Md_Stat
            PS_Curve_Stat (DcmDspDidSignal): DcmDspDidDataPos=8, DcmDspDidDataRef=Customer_Settings_Read_PS_Curve_Stat
          DID_Obsolescence_Data_Read: DcmDspDidIdentifier=320, DcmDspDidInfoRef=DidInfo_Obsolescence_Data_Read
            12 x DcmDspDidSignal:
              Obsolescence_Data_BSR_Current_Value: DcmDspDidDataPos=0, DcmDspDidDataRef=Obsolescence_Data_Read_Obsolescence_Data_BSR_Current_Value
              Obsolescence_Data_BSR_Threshold_Green_to_Yellow: DcmDspDidDataPos=16, DcmDspDidDataRef=Obsolescence_Data_Read_Obsolescence_Data_BSR_Threshold_Green_to_Yellow
              Obsolescence_Data_BSR_Threshold_Yellow_to_Red: DcmDspDidDataPos=32, DcmDspDidDataRef=Obsolescence_Data_Read_Obsolescence_Data_BSR_Threshold_Yellow_to_Red
              Obsolescence_Data_haptic_Warning_Current_Value: DcmDspDidDataPos=48, DcmDspDidDataRef=Obsolescence_Data_Read_Obsolescence_Data_haptic_Warning_Current_Value
              Obsolescence_Data_haptic_Warning_Threshold_Green_to_Yellow: DcmDspDidDataPos=64, DcmDspDidDataRef=Obsolescence_Data_Read_Obsolescence_Data_haptic_Warning_Threshold_Green_to_Yellow
              Obsolescence_Data_haptic_Warning_Threshold_Yellow_to_Red: DcmDspDidDataPos=80, DcmDspDidDataRef=Obsolescence_Data_Read_Obsolescence_Data_haptic_Warning_Threshold_Yellow_to_Red
              Obsolescence_Data_PRE_SAFE_Lvl_4_5_Current_Value: DcmDspDidDataPos=96, DcmDspDidDataRef=Obsolescence_Data_Read_Obsolescence_Data_PRE_SAFE_Lvl_4_5_Current_Value
              Obsolescence_Data_PRE_SAFE_Lvl_4_5_Threshold_Green_to_Yellow: DcmDspDidDataPos=112, DcmDspDidDataRef=Obsolescence_Data_Read_Obsolescence_Data_PRE_SAFE_Lvl_4_5_Threshold_Green_to_Yellow
              Obsolescence_Data_PRE_SAFE_Lvl_4_5_Threshold_Yellow_to_Red: DcmDspDidDataPos=128, DcmDspDidDataRef=Obsolescence_Data_Read_Obsolescence_Data_PRE_SAFE_Lvl_4_5_Threshold_Yellow_to_Red
              Obsolescence_Data_PRE_CRASH_Current_Value: DcmDspDidDataPos=144, DcmDspDidDataRef=Obsolescence_Data_Read_Obsolescence_Data_PRE_CRASH_Current_Value
              Obsolescence_Data_PRE_CRASH_Threshold_Green_to_Yellow: DcmDspDidDataPos=160, DcmDspDidDataRef=Obsolescence_Data_Read_Obsolescence_Data_PRE_CRASH_Threshold_Green_to_Yellow
              Obsolescence_Data_PRE_CRASH_Threshold_Yellow_to_Red: DcmDspDidDataPos=176, DcmDspDidDataRef=Obsolescence_Data_Read_Obsolescence_Data_PRE_CRASH_Threshold_Yellow_to_Red
          DID_Availability_Data_Read: DcmDspDidIdentifier=322, DcmDspDidInfoRef=DidInfo_Availability_Data_Read
            Availability_Data_PRE_SAFE_haptic_warning (DcmDspDidSignal): DcmDspDidDataPos=0, DcmDspDidDataRef=Availability_Data_Read_Availability_Data_PRE_SAFE_haptic_warning
          DID_Root_CA_Certificate_Read: DcmDspDidIdentifier=384, DcmDspDidInfoRef=DidInfo_Root_CA_Certificate_Read
            Root_CA_Certificate (DcmDspDidSignal): DcmDspDidDataPos=0, DcmDspDidDataRef=Root_CA_Certificate_Read_Root_CA_Certificate
          DID_Backend_CA_Certificate_Read: DcmDspDidIdentifier=385, DcmDspDidInfoRef=DidInfo_Backend_CA_Certificate_Read
            Backend_CA_Certificate (DcmDspDidSignal): DcmDspDidDataPos=0, DcmDspDidDataRef=Backend_CA_Certificate_Read_Backend_CA_Certificate
          DID_Backend_CA_Certificate_Identification_Read: DcmDspDidIdentifier=386, DcmDspDidInfoRef=DidInfo_Backend_CA_Certificate_Identification_Read
            Backend_CA_SubjectKeyIdentifier (DcmDspDidSignal): DcmDspDidDataPos=0, DcmDspDidDataRef=Backend_CA_Certificate_Identification_Read_Backend_CA_SubjectKeyIdentifier
          DID_Diagnostic_Authentication_Certificate_Identification_Read: DcmDspDidIdentifier=388, DcmDspDidInfoRef=DidInfo_Diagnostic_Authentication_Certificate_Identification_Read
            Diagnostic_Authentication_Certificate_Issuer (DcmDspDidSignal): DcmDspDidDataPos=0, DcmDspDidDataRef=Diagnostic_Authentication_Certificate_Identification_Read_Diagnostic_Authentication_Certificate_Issuer
            Diagnostic_Authentication_Certificate_Serial_Number (DcmDspDidSignal):
              DcmDspDidDataPos = 120
              DcmDspDidDataRef = Diagnostic_Authentication_Certificate_Identification_Read_Diagnostic_Authentication_Certificate_Serial_Number
          DID_Access_Control_List_Version_Read: DcmDspDidIdentifier=389, DcmDspDidInfoRef=DidInfo_Access_Control_List_Version_Read
            10 x DcmDspDidSignal:
              Basic_ACL_Version_Generation_Time_GTC: DcmDspDidDataPos=0, DcmDspDidDataRef=Access_Control_List_Version_Read_Basic_ACL_Version_Generation_Time_GTC
              Basic_ACL_Version_Candela_File_Version_Major: DcmDspDidDataPos=120, DcmDspDidDataRef=Access_Control_List_Version_Read_Basic_ACL_Version_Candela_File_Version_Major
              Basic_ACL_Version_Candela_File_Version_Minor: DcmDspDidDataPos=128, DcmDspDidDataRef=Access_Control_List_Version_Read_Basic_ACL_Version_Candela_File_Version_Minor
              Basic_ACL_Version_Candela_File_Version_Patch: DcmDspDidDataPos=136, DcmDspDidDataRef=Access_Control_List_Version_Read_Basic_ACL_Version_Candela_File_Version_Patch
              Basic_ACL_Hash: DcmDspDidDataPos=144, DcmDspDidDataRef=Access_Control_List_Version_Read_Basic_ACL_Hash
              ECU_indvidual_ACL_Version_Generation_Time_GTC: DcmDspDidDataPos=656, DcmDspDidDataRef=Access_Control_List_Version_Read_ECU_indvidual_ACL_Version_Generation_Time_GTC
              ECU_indvidual_ACL_Version_Candela_File_Version_Major: DcmDspDidDataPos=776, DcmDspDidDataRef=Access_Control_List_Version_Read_ECU_indvidual_ACL_Version_Candela_File_Version_Major
              ECU_indvidual_ACL_Version_Candela_File_Version_Minor: DcmDspDidDataPos=784, DcmDspDidDataRef=Access_Control_List_Version_Read_ECU_indvidual_ACL_Version_Candela_File_Version_Minor
              ECU_indvidual_ACL_Version_Candela_File_Version_Patch: DcmDspDidDataPos=792, DcmDspDidDataRef=Access_Control_List_Version_Read_ECU_indvidual_ACL_Version_Candela_File_Version_Patch
              ECU_indvidual_ACL_Hash: DcmDspDidDataPos=800, DcmDspDidDataRef=Access_Control_List_Version_Read_ECU_indvidual_ACL_Hash
          DID_Secured_System_Date_and_Time_Read: DcmDspDidIdentifier=390, DcmDspDidInfoRef=DidInfo_Secured_System_Date_and_Time_Read
            GeneralizedTime (DcmDspDidSignal): DcmDspDidDataPos=0, DcmDspDidDataRef=Secured_System_Date_and_Time_Read_GeneralizedTime
          DID_Security_Event_Log_Read: DcmDspDidIdentifier=391, DcmDspDidInfoRef=DidInfo_Security_Event_Log_Read
            Security_Event_Log (DcmDspDidSignal): DcmDspDidDataPos=0, DcmDspDidDataRef=Security_Event_Log_Read_Security_Event_Log
          DID_SecOC_PDU_Data_IDs_and_Key_Checksum_Read: DcmDspDidIdentifier=392, DcmDspDidInfoRef=DidInfo_SecOC_PDU_Data_IDs_and_Key_Checksum_Read
            Secured_PDU_Data_IDs_and_Key_Checksum (DcmDspDidSignal): DcmDspDidDataPos=0, DcmDspDidDataRef=SecOC_PDU_Data_IDs_and_Key_Checksum_Read_Secured_PDU_Data_IDs_and_Key_Checksum
          DID_SecOC_Vehicle_Shared_Secret_Hash_Read: DcmDspDidIdentifier=393, DcmDspDidInfoRef=DidInfo_SecOC_Vehicle_Shared_Secret_Hash_Read
            SecOC_Vehicle_Shared_Secret_Hash (DcmDspDidSignal): DcmDspDidDataPos=0, DcmDspDidDataRef=SecOC_Vehicle_Shared_Secret_Hash_Read_SecOC_Vehicle_Shared_Secret_Hash
          DID_SecOC_Local_TickCount_Read: DcmDspDidIdentifier=394, DcmDspDidInfoRef=DidInfo_SecOC_Local_TickCount_Read
            TickCount (DcmDspDidSignal): DcmDspDidDataPos=0, DcmDspDidDataRef=SecOC_Local_TickCount_Read_TickCount
          DID_Diagnostic_User_Role_Read: DcmDspDidIdentifier=396, DcmDspDidInfoRef=DidInfo_Diagnostic_User_Role_Read
            Cebas_UserRole (DcmDspDidSignal): DcmDspDidDataPos=0, DcmDspDidDataRef=Diagnostic_User_Role_Read_Cebas_UserRole
          DID_Real_Time_Offset_Read: DcmDspDidIdentifier=397, DcmDspDidInfoRef=DidInfo_Real_Time_Offset_Read
            Real_Time_Offset (DcmDspDidSignal): DcmDspDidDataPos=0, DcmDspDidDataRef=Real_Time_Offset_Read_Real_Time_Offset
            TickCount (DcmDspDidSignal): DcmDspDidDataPos=120, DcmDspDidDataRef=Real_Time_Offset_Read_TickCount
          DID_VIN_Status_Read: DcmDspDidIdentifier=398, DcmDspDidInfoRef=DidInfo_VIN_Status_Read
            VIN_Status (DcmDspDidSignal): DcmDspDidDataPos=0, DcmDspDidDataRef=VIN_Status_Read_VIN_Status
            VIN_Lock_Status (DcmDspDidSignal): DcmDspDidDataPos=8, DcmDspDidDataRef=VIN_Status_Read_VIN_Lock_Status
          DID_SecOC_PDU_Data_IDs_and_Key_CMACs_Read: DcmDspDidIdentifier=399, DcmDspDidInfoRef=DidInfo_SecOC_PDU_Data_IDs_and_Key_CMACs_Read
            Secured_PDU_Data_IDs_and_Key_CMACs (DcmDspDidSignal): DcmDspDidDataPos=0, DcmDspDidDataRef=SecOC_PDU_Data_IDs_and_Key_CMACs_Read_Secured_PDU_Data_IDs_and_Key_CMACs
          DID_Security_Event_Log_Current_Counter_Values_Read: DcmDspDidIdentifier=400, DcmDspDidInfoRef=DidInfo_Security_Event_Log_Current_Counter_Values_Read
            Security_Event_Log_Current_Counter_Values (DcmDspDidSignal): DcmDspDidDataPos=0, DcmDspDidDataRef=Security_Event_Log_Current_Counter_Values_Read_Security_Event_Log_Current_Counter_Values
          DID_RandomNumber_Read: DcmDspDidIdentifier=401, DcmDspDidInfoRef=DidInfo_RandomNumber_Read
            Generated_Random_Number_Result (DcmDspDidSignal): DcmDspDidDataPos=0, DcmDspDidDataRef=RandomNumber_Read_Generated_Random_Number_Result
            Generated_Random_Number (DcmDspDidSignal): DcmDspDidDataPos=8, DcmDspDidDataRef=RandomNumber_Read_Generated_Random_Number
          DID_Status_SSA_Pre_Compile_Switches_Read: DcmDspDidIdentifier=407, DcmDspDidInfoRef=DidInfo_Status_SSA_Pre_Compile_Switches_Read
            Precompile_switch (DcmDspDidSignal): DcmDspDidDataPos=0, DcmDspDidDataRef=Status_SSA_Pre_Compile_Switches_Read_Precompile_switch
          DID_Trust_Model_Root_Replacement_Key_Read: DcmDspDidIdentifier=408, DcmDspDidInfoRef=DidInfo_Trust_Model_Root_Replacement_Key_Read
            Root_Replacement_Key (DcmDspDidSignal): DcmDspDidDataPos=0, DcmDspDidDataRef=Trust_Model_Root_Replacement_Key_Read_Root_Replacement_Key
          DID_Trust_Model_Request_ephemeral_public_key_Read: DcmDspDidIdentifier=409, DcmDspDidInfoRef=DidInfo_Trust_Model_Request_ephemeral_public_key_Read
            4 x DcmDspDidSignal:
              Nonce: DcmDspDidDataPos=0, DcmDspDidDataRef=Trust_Model_Request_ephemeral_public_key_Read_Nonce
              Ephemeral_ECU_Public_Key: DcmDspDidDataPos=256, DcmDspDidDataRef=Trust_Model_Request_ephemeral_public_key_Read_Ephemeral_ECU_Public_Key
              Data_Signature: DcmDspDidDataPos=512, DcmDspDidDataRef=Trust_Model_Request_ephemeral_public_key_Read_Data_Signature
              Certificates: DcmDspDidDataPos=1024, DcmDspDidDataRef=Trust_Model_Request_ephemeral_public_key_Read_Certificates
          DID_Trust_model_ECU_CSR_Read: DcmDspDidIdentifier=410, DcmDspDidInfoRef=DidInfo_Trust_model_ECU_CSR_Read
            Trust_model_ECU_CSR (DcmDspDidSignal): DcmDspDidDataPos=0, DcmDspDidDataRef=Trust_model_ECU_CSR_Read_Trust_model_ECU_CSR
          DID_Trust_model_ECU_certificate_Read: DcmDspDidIdentifier=411, DcmDspDidInfoRef=DidInfo_Trust_model_ECU_certificate_Read
            Trust_model_ECU_Certificate (DcmDspDidSignal): DcmDspDidDataPos=0, DcmDspDidDataRef=Trust_model_ECU_certificate_Read_Trust_model_ECU_Certificate
          DID_Trust_model_Intermediate_CA_certificate_Read: DcmDspDidIdentifier=412, DcmDspDidInfoRef=DidInfo_Trust_model_Intermediate_CA_certificate_Read
            Trust_model_Intermediate_CA_Certificate (DcmDspDidSignal): DcmDspDidDataPos=0, DcmDspDidDataRef=Trust_model_Intermediate_CA_certificate_Read_Trust_model_Intermediate_CA_Certificate
          DID_Trust_model_Backend_CA_certificate_Read: DcmDspDidIdentifier=413, DcmDspDidInfoRef=DidInfo_Trust_model_Backend_CA_certificate_Read
            Trust_model_Backend_CA_certificate (DcmDspDidSignal): DcmDspDidDataPos=0, DcmDspDidDataRef=Trust_model_Backend_CA_certificate_Read_Trust_model_Backend_CA_certificate
          DID_Trust_model_Root_CA_certificate_Read: DcmDspDidIdentifier=414, DcmDspDidInfoRef=DidInfo_Trust_model_Root_CA_certificate_Read
            Trust_model_Root_CA_certificate (DcmDspDidSignal): DcmDspDidDataPos=0, DcmDspDidDataRef=Trust_model_Root_CA_certificate_Read_Trust_model_Root_CA_certificate
          DID_Trust_model_full_chain_of_trust_certificates_Read: DcmDspDidIdentifier=415, DcmDspDidInfoRef=DidInfo_Trust_model_full_chain_of_trust_certificates_Read
            Trust_model_certificates (DcmDspDidSignal): DcmDspDidDataPos=0, DcmDspDidDataRef=Trust_model_full_chain_of_trust_certificates_Read_Trust_model_certificates
          DID_Trust_Model_CSR_Supplier_Signature_Read: DcmDspDidIdentifier=418, DcmDspDidInfoRef=DidInfo_Trust_Model_CSR_Supplier_Signature_Read
            Trust_Model_CSR_Supplier_Signature (DcmDspDidSignal): DcmDspDidDataPos=0, DcmDspDidDataRef=Trust_Model_CSR_Supplier_Signature_Read_Trust_Model_CSR_Supplier_Signature
          DID_Task_Response_Time_Read: DcmDspDidIdentifier=480, DcmDspDidInfoRef=DidInfo_Task_Response_Time_Read
            Task_histograms (DcmDspDidSignal): DcmDspDidDataPos=0, DcmDspDidDataRef=Task_Response_Time_Read_Task_histograms
          DID_CPU_Load_Read: DcmDspDidIdentifier=481, DcmDspDidInfoRef=DidInfo_CPU_Load_Read
            CPU_load_histograms (DcmDspDidSignal): DcmDspDidDataPos=0, DcmDspDidDataRef=CPU_Load_Read_CPU_load_histograms
          DID_Stack_Load_Read: DcmDspDidIdentifier=483, DcmDspDidInfoRef=DidInfo_Stack_Load_Read
            Maximum (DcmDspDidSignal): DcmDspDidDataPos=0, DcmDspDidDataRef=Stack_Load_Read_Maximum
          DID_Memory_Usage_Cycles_Read: DcmDspDidIdentifier=484, DcmDspDidInfoRef=DidInfo_Memory_Usage_Cycles_Read
            Memory_Usage_Cycles (DcmDspDidSignal): DcmDspDidDataPos=0, DcmDspDidDataRef=Memory_Usage_Cycles_Read_Memory_Usage_Cycles
          DID_CAN_input_Read: DcmDspDidIdentifier=512, DcmDspDidInfoRef=DidInfo_CAN_input_Read
            9 x DcmDspDidSignal:
              Neues_Bitfeld_1: DcmDspDidDataPos=0, DcmDspDidDataRef=CAN_input_Read_Neues_Bitfeld_1
              Neues_Bitfeld_2: DcmDspDidDataPos=8, DcmDspDidDataRef=CAN_input_Read_Neues_Bitfeld_2
              Neues_Bitfeld_3: DcmDspDidDataPos=16, DcmDspDidDataRef=CAN_input_Read_Neues_Bitfeld_3
              Neues_Bitfeld_4: DcmDspDidDataPos=24, DcmDspDidDataRef=CAN_input_Read_Neues_Bitfeld_4
              Supply_battery_voltage: DcmDspDidDataPos=32, DcmDspDidDataRef=CAN_input_Read_Supply_battery_voltage
              Neues_Bitfeld_5: DcmDspDidDataPos=40, DcmDspDidDataRef=CAN_input_Read_Neues_Bitfeld_5
              Neues_Bitfeld_6: DcmDspDidDataPos=48, DcmDspDidDataRef=CAN_input_Read_Neues_Bitfeld_6
              Neues_Bitfeld_7: DcmDspDidDataPos=56, DcmDspDidDataRef=CAN_input_Read_Neues_Bitfeld_7
              Neues_Bitfeld_8: DcmDspDidDataPos=64, DcmDspDidDataRef=CAN_input_Read_Neues_Bitfeld_8
          DID_CAN_output_Read: DcmDspDidIdentifier=528, DcmDspDidInfoRef=DidInfo_CAN_output_Read
            5 x DcmDspDidSignal:
              CANoutput1: DcmDspDidDataPos=0, DcmDspDidDataRef=CAN_output_Read_CANoutput1
              RBTMxx_SP_FctPrecond_Stat_ST35: DcmDspDidDataPos=8, DcmDspDidDataRef=CAN_output_Read_RBTMxx_SP_FctPrecond_Stat_ST35
              RBTMxx_Actv_Lvl_ST35: DcmDspDidDataPos=24, DcmDspDidDataRef=CAN_output_Read_RBTMxx_Actv_Lvl_ST35
              RBTMxx_SP_ActvClient_ST35: DcmDspDidDataPos=32, DcmDspDidDataRef=CAN_output_Read_RBTMxx_SP_ActvClient_ST35
              PS_Curve_XX_Stat_ST3: DcmDspDidDataPos=40, DcmDspDidDataRef=CAN_output_Read_PS_Curve_XX_Stat_ST3
          DID_HW_input_Read: DcmDspDidIdentifier=544, DcmDspDidInfoRef=DidInfo_HW_input_Read
            Voltage_KL30t (DcmDspDidSignal): DcmDspDidDataPos=0, DcmDspDidDataRef=HW_input_Read_Voltage_KL30t
            Voltage_Motor (DcmDspDidSignal): DcmDspDidDataPos=8, DcmDspDidDataRef=HW_input_Read_Voltage_Motor
          DID_Internal_ECU_information_Read: DcmDspDidIdentifier=576, DcmDspDidInfoRef=DidInfo_Internal_ECU_information_Read
            3 x DcmDspDidSignal:
              Autosar_System_State_EcuM_State: DcmDspDidDataPos=0, DcmDspDidDataRef=Internal_ECU_information_Read_Autosar_System_State_EcuM_State
              ECU_Temperature: DcmDspDidDataPos=8, DcmDspDidDataRef=Internal_ECU_information_Read_ECU_Temperature
              MOTOR_Current: DcmDspDidDataPos=24, DcmDspDidDataRef=Internal_ECU_information_Read_MOTOR_Current
          DID_PRE_SAFE_Recorder_1_read_Read: DcmDspDidIdentifier=577, DcmDspDidInfoRef=DidInfo_PRE_SAFE_Recorder_1_read_Read
            CombinedDataElement (DcmDspDidSignal): DcmDspDidDataPos=0, DcmDspDidDataRef=PRE_SAFE_Recorder_1_read_Read_CombinedDataElement
          DID_PRE_SAFE_Recorder_2_read_Read: DcmDspDidIdentifier=578, DcmDspDidInfoRef=DidInfo_PRE_SAFE_Recorder_2_read_Read
            CombinedDataElement (DcmDspDidSignal): DcmDspDidDataPos=0, DcmDspDidDataRef=PRE_SAFE_Recorder_2_read_Read_CombinedDataElement
          DID_BSR_Counter_read_Read: DcmDspDidIdentifier=579, DcmDspDidInfoRef=DidInfo_BSR_Counter_read_Read
            BSR_Counter (DcmDspDidSignal): DcmDspDidDataPos=0, DcmDspDidDataRef=BSR_Counter_read_Read_BSR_Counter
          DID_PRE_SAFE_Counter_read_Read: DcmDspDidIdentifier=580, DcmDspDidInfoRef=DidInfo_PRE_SAFE_Counter_read_Read
            CombinedDataElement (DcmDspDidSignal): DcmDspDidDataPos=0, DcmDspDidDataRef=PRE_SAFE_Counter_read_Read_CombinedDataElement
          DID_System_Time_read_Read: DcmDspDidIdentifier=746, DcmDspDidInfoRef=DidInfo_System_Time_read_Read
            System_time (DcmDspDidSignal): DcmDspDidDataPos=0, DcmDspDidDataRef=System_Time_read_Read_System_time
          DID_PreSafe_Cycles_Level_1_8_Read: DcmDspDidIdentifier=768, DcmDspDidInfoRef=DidInfo_PreSafe_Cycles_Level_1_8_Read
            CombinedSignal (DcmDspDidSignal): DcmDspDidDataPos=0, DcmDspDidDataRef=PreSafe_Cycles_Level_1_8_Read_CombinedSignal
          DID_Release_Cycles_BSR_and_PreSafe_Read: DcmDspDidIdentifier=769, DcmDspDidInfoRef=DidInfo_Release_Cycles_BSR_and_PreSafe_Read
            CombinedSignal (DcmDspDidSignal): DcmDspDidDataPos=0, DcmDspDidDataRef=Release_Cycles_BSR_and_PreSafe_Read_CombinedSignal
          DID_Tensioning_Cycle_BSR_Read: DcmDspDidIdentifier=770, DcmDspDidInfoRef=DidInfo_Tensioning_Cycle_BSR_Read
            CombinedSignal (DcmDspDidSignal): DcmDspDidDataPos=0, DcmDspDidDataRef=Tensioning_Cycle_BSR_Read_CombinedSignal
          DID_Vehicle_Equipment_Read: DcmDspDidIdentifier=784, DcmDspDidInfoRef=DidInfo_Vehicle_Equipment_Read
            12 x DcmDspDidSignal:
              Equipment_1: DcmDspDidDataPos=0, DcmDspDidDataRef=Vehicle_Equipment_Read_Equipment_1
              Equipment_2: DcmDspDidDataPos=8, DcmDspDidDataRef=Vehicle_Equipment_Read_Equipment_2
              Equipment_3: DcmDspDidDataPos=16, DcmDspDidDataRef=Vehicle_Equipment_Read_Equipment_3
              Equipment_4: DcmDspDidDataPos=24, DcmDspDidDataRef=Vehicle_Equipment_Read_Equipment_4
              Equipment_5: DcmDspDidDataPos=32, DcmDspDidDataRef=Vehicle_Equipment_Read_Equipment_5
              Equipment_6: DcmDspDidDataPos=40, DcmDspDidDataRef=Vehicle_Equipment_Read_Equipment_6
              Reserved: DcmDspDidDataPos=48, DcmDspDidDataRef=Vehicle_Equipment_Read_Reserved
              Reserved_1: DcmDspDidDataPos=56, DcmDspDidDataRef=Vehicle_Equipment_Read_Reserved_1
              Unterspannungsabbruchschwelle: DcmDspDidDataPos=64, DcmDspDidDataRef=Vehicle_Equipment_Read_Unterspannungsabbruchschwelle
              Unterspannungsbereichsschwelle: DcmDspDidDataPos=80, DcmDspDidDataRef=Vehicle_Equipment_Read_Unterspannungsbereichsschwelle
              Ueberspannungsbereichsschwelle: DcmDspDidDataPos=96, DcmDspDidDataRef=Vehicle_Equipment_Read_Ueberspannungsbereichsschwelle
              Ueberspannungsabbruchschwelle: DcmDspDidDataPos=112, DcmDspDidDataRef=Vehicle_Equipment_Read_Ueberspannungsabbruchschwelle
          DID_ZZZ_Vehicle_Equipment_Development_Read: DcmDspDidIdentifier=785, DcmDspDidInfoRef=DidInfo_ZZZ_Vehicle_Equipment_Development_Read
            Bitfield (DcmDspDidSignal): DcmDspDidDataPos=0, DcmDspDidDataRef=ZZZ_Vehicle_Equipment_Development_Read_Bitfield
            Zykluszeit_Messtechnik (DcmDspDidSignal): DcmDspDidDataPos=16, DcmDspDidDataRef=ZZZ_Vehicle_Equipment_Development_Read_Zykluszeit_Messtechnik
          DID_Seatbelt_Serial_Number_Read: DcmDspDidIdentifier=832, DcmDspDidInfoRef=DidInfo_Seatbelt_Serial_Number_Read
            Unique_Seatbelt_Serialnumber (DcmDspDidSignal): DcmDspDidDataPos=0, DcmDspDidDataRef=Seatbelt_Serial_Number_Read_Unique_Seatbelt_Serialnumber
          DID_Calibration_Identifications_CAL_ID_Read: DcmDspDidIdentifier=57604, DcmDspDidInfoRef=DidInfo_Calibration_Identifications_CAL_ID_Read
            Calibration_Identification (DcmDspDidSignal): DcmDspDidDataPos=0, DcmDspDidDataRef=Calibration_Identifications_CAL_ID_Read_Calibration_Identification
          DID_ECU_Extract_Version_Read: DcmDspDidIdentifier=61184, DcmDspDidInfoRef=DidInfo_ECU_Extract_Version_Read
            8 x DcmDspDidSignal:
              ECU_Extract_Major_Version: DcmDspDidDataPos=0, DcmDspDidDataRef=ECU_Extract_Version_Read_ECU_Extract_Major_Version
              ECU_Extract_Minor_Version: DcmDspDidDataPos=8, DcmDspDidDataRef=ECU_Extract_Version_Read_ECU_Extract_Minor_Version
              ECU_Extract_Patch_Version: DcmDspDidDataPos=16, DcmDspDidDataRef=ECU_Extract_Version_Read_ECU_Extract_Patch_Version
              ECU_Extract_Information_Identification_Type: DcmDspDidDataPos=24, DcmDspDidDataRef=ECU_Extract_Version_Read_ECU_Extract_Information_Identification_Type
              ECU_Extract_Information_XDIS_Version: DcmDspDidDataPos=32, DcmDspDidDataRef=ECU_Extract_Version_Read_ECU_Extract_Information_XDIS_Version
              ECU_Extract_Information_Export_Date: DcmDspDidDataPos=112, DcmDspDidDataRef=ECU_Extract_Version_Read_ECU_Extract_Information_Export_Date
              ECU_Extract_Information_ECU_Name: DcmDspDidDataPos=192, DcmDspDidDataRef=ECU_Extract_Version_Read_ECU_Extract_Information_ECU_Name
              ECU_Extract_Information_Checksum: DcmDspDidDataPos=432, DcmDspDidDataRef=ECU_Extract_Version_Read_ECU_Extract_Information_Checksum
          DID_Diagnostic_Extract_Version_Read: DcmDspDidIdentifier=61185, DcmDspDidInfoRef=DidInfo_Diagnostic_Extract_Version_Read
            6 x DcmDspDidSignal:
              Diagnostic_Extract_Major_Version: DcmDspDidDataPos=0, DcmDspDidDataRef=Diagnostic_Extract_Version_Read_Diagnostic_Extract_Major_Version
              Diagnostic_Extract_Minor_Version: DcmDspDidDataPos=8, DcmDspDidDataRef=Diagnostic_Extract_Version_Read_Diagnostic_Extract_Minor_Version
              Diagnostic_Extract_Patch_Version: DcmDspDidDataPos=16, DcmDspDidDataRef=Diagnostic_Extract_Version_Read_Diagnostic_Extract_Patch_Version
              CANdela_Version: DcmDspDidDataPos=24, DcmDspDidDataRef=Diagnostic_Extract_Version_Read_CANdela_Version
              DDM_Version: DcmDspDidDataPos=104, DcmDspDidDataRef=Diagnostic_Extract_Version_Read_DDM_Version
              Exported_Diagnostic_Variant: DcmDspDidDataPos=184, DcmDspDidDataRef=Diagnostic_Extract_Version_Read_Exported_Diagnostic_Variant
          DID_Standard_Application_SW_Package_Information_Read: DcmDspDidIdentifier=61187, DcmDspDidInfoRef=DidInfo_Standard_Application_SW_Package_Information_Read
            7 x DcmDspDidSignal:
              Standard_Application_SW_Package_Major_Version: DcmDspDidDataPos=0, DcmDspDidDataRef=Standard_Application_SW_Package_Information_Read_Standard_Application_SW_Package_Major_Version
              Standard_Application_SW_Package_Minor_Version: DcmDspDidDataPos=8, DcmDspDidDataRef=Standard_Application_SW_Package_Information_Read_Standard_Application_SW_Package_Minor_Version
              Standard_Application_SW_Package_Patch_Level: DcmDspDidDataPos=16, DcmDspDidDataRef=Standard_Application_SW_Package_Information_Read_Standard_Application_SW_Package_Patch_Level
              Standard_Application_SW_Package_Build_Version: DcmDspDidDataPos=24, DcmDspDidDataRef=Standard_Application_SW_Package_Information_Read_Standard_Application_SW_Package_Build_Version
              INVALID_SHORTNAME_C_P_Identification: DcmDspDidDataPos=32, DcmDspDidDataRef=Standard_Application_SW_Package_Information_Read_C_P_Identification
              Supplier_Identification: DcmDspDidDataPos=192, DcmDspDidDataRef=Standard_Application_SW_Package_Information_Read_Supplier_Identification
              AUTOSAR_Platform: DcmDspDidDataPos=208, DcmDspDidDataRef=Standard_Application_SW_Package_Information_Read_AUTOSAR_Platform
          DID_SSA_Version_Information_Read: DcmDspDidIdentifier=61188, DcmDspDidInfoRef=DidInfo_SSA_Version_Information_Read
            3 x DcmDspDidSignal:
              SSA_Major_Version: DcmDspDidDataPos=0, DcmDspDidDataRef=SSA_Version_Information_Read_SSA_Major_Version
              SSA_Minor_Version: DcmDspDidDataPos=8, DcmDspDidDataRef=SSA_Version_Information_Read_SSA_Minor_Version
              SSA_Patch_Level: DcmDspDidDataPos=16, DcmDspDidDataRef=SSA_Version_Information_Read_SSA_Patch_Level
          DID_Minimum_Software_Version_Read: DcmDspDidIdentifier=61189, DcmDspDidInfoRef=DidInfo_Minimum_Software_Version_Read
            Minimum_Software_Version (DcmDspDidSignal): DcmDspDidDataPos=0, DcmDspDidDataRef=Minimum_Software_Version_Read_Minimum_Software_Version
          DID_ActiveDiagnosticInformation_Read: DcmDspDidIdentifier=61696, DcmDspDidInfoRef=DidInfo_ActiveDiagnosticInformation_Read
            Identification (DcmDspDidSignal): DcmDspDidDataPos=0, DcmDspDidDataRef=ActiveDiagnosticInformation_Read_Identification
            Session (DcmDspDidSignal): DcmDspDidDataPos=24, DcmDspDidDataRef=ActiveDiagnosticInformation_Read_Session
          DID_Dump_of_Vedoc_Relevant_Information_Read: DcmDspDidIdentifier=61699, DcmDspDidInfoRef=DidInfo_Dump_of_Vedoc_Relevant_Information_Read
            PatchedObject (DcmDspDidSignal): DcmDspDidDataPos=0, DcmDspDidDataRef=Dump_of_Vedoc_Relevant_Information_Read_PatchedObject
          DID_ECU_Name_Read: DcmDspDidIdentifier=61700, DcmDspDidInfoRef=DidInfo_ECU_Name_Read
            Diagnostic_ECU_Name (DcmDspDidSignal): DcmDspDidDataPos=0, DcmDspDidDataRef=ECU_Name_Read_Diagnostic_ECU_Name
          DID_DDS_Package_Release_Read: DcmDspDidIdentifier=61709, DcmDspDidInfoRef=DidInfo_DDS_Package_Release_Read
            4 x DcmDspDidSignal:
              DDS_Package_Release_of_Application_Software_Year_Appl: DcmDspDidDataPos=0, DcmDspDidDataRef=DDS_Package_Release_Read_DDS_Package_Release_of_Application_Software_Year_Appl
              DDS_Package_Release_of_Application_Software_Month_Appl: DcmDspDidDataPos=8, DcmDspDidDataRef=DDS_Package_Release_Read_DDS_Package_Release_of_Application_Software_Month_Appl
              DDS_Package_Release_of_Boot_Software_Year_Boot: DcmDspDidDataPos=16, DcmDspDidDataRef=DDS_Package_Release_Read_DDS_Package_Release_of_Boot_Software_Year_Boot
              DDS_Package_Release_of_Boot_Software_Month_Boot: DcmDspDidDataPos=24, DcmDspDidDataRef=DDS_Package_Release_Read_DDS_Package_Release_of_Boot_Software_Month_Boot
          DID_MercedesCarGroupHardware_Read: DcmDspDidIdentifier=61713, DcmDspDidInfoRef=DidInfo_MercedesCarGroupHardware_Read
            Hardware_Part_Number (DcmDspDidSignal): DcmDspDidDataPos=0, DcmDspDidDataRef=MercedesCarGroupHardware_Read_Hardware_Part_Number
          DID_MercedesCarGroupSoftware_Read: DcmDspDidIdentifier=61729, DcmDspDidInfoRef=DidInfo_MercedesCarGroupSoftware_Read
            Software_Logical_Block_Numbers (DcmDspDidSignal): DcmDspDidDataPos=0, DcmDspDidDataRef=MercedesCarGroupSoftware_Read_Software_Logical_Block_Numbers
          DID_Supported_configuration_mechanisms_Read: DcmDspDidIdentifier=61745, DcmDspDidInfoRef=DidInfo_Supported_configuration_mechanisms_Read
            Config_mechanisms (DcmDspDidSignal): DcmDspDidDataPos=0, DcmDspDidDataRef=Supported_configuration_mechanisms_Read_Config_mechanisms
          DID_HardwareVersion_Read: DcmDspDidIdentifier=61776, DcmDspDidInfoRef=DidInfo_HardwareVersion_Read
            3 x DcmDspDidSignal:
              HW_year: DcmDspDidDataPos=0, DcmDspDidDataRef=HardwareVersion_Read_HW_year
              HW_week: DcmDspDidDataPos=8, DcmDspDidDataRef=HardwareVersion_Read_HW_week
              HW_patch_level: DcmDspDidDataPos=16, DcmDspDidDataRef=HardwareVersion_Read_HW_patch_level
          DID_SoftwareVersion_Read: DcmDspDidIdentifier=61777, DcmDspDidInfoRef=DidInfo_SoftwareVersion_Read
            Software_Logical_Block_Version_Information (DcmDspDidSignal): DcmDspDidDataPos=0, DcmDspDidDataRef=SoftwareVersion_Read_Software_Logical_Block_Version_Information
          DID_BootSoftwareVersion_Read: DcmDspDidIdentifier=61779, DcmDspDidInfoRef=DidInfo_BootSoftwareVersion_Read
            3 x DcmDspDidSignal:
              Boot_SW_year: DcmDspDidDataPos=0, DcmDspDidDataRef=BootSoftwareVersion_Read_Boot_SW_year
              Boot_SW_week: DcmDspDidDataPos=8, DcmDspDidDataRef=BootSoftwareVersion_Read_Boot_SW_week
              Boot_SW_patch_level: DcmDspDidDataPos=16, DcmDspDidDataRef=BootSoftwareVersion_Read_Boot_SW_patch_level
          DID_HardwareSupplier_Read: DcmDspDidIdentifier=61780, DcmDspDidInfoRef=DidInfo_HardwareSupplier_Read
            Hardware_Supplier_Identification (DcmDspDidSignal): DcmDspDidDataPos=0, DcmDspDidDataRef=HardwareSupplier_Read_Hardware_Supplier_Identification
          DID_SoftwareSupplier_Read: DcmDspDidIdentifier=61781, DcmDspDidInfoRef=DidInfo_SoftwareSupplier_Read
            Software_Logical_Block_Supplier_Identification (DcmDspDidSignal): DcmDspDidDataPos=0, DcmDspDidDataRef=SoftwareSupplier_Read_Software_Logical_Block_Supplier_Identification
          DID_ReadFingerprint_Read: DcmDspDidIdentifier=61787, DcmDspDidInfoRef=DidInfo_ReadFingerprint_Read
            Software_Fingerprint_s (DcmDspDidSignal): DcmDspDidDataPos=0, DcmDspDidDataRef=ReadFingerprint_Read_Software_Fingerprint_s
          DID_ECUSerialNumberDataIdentifier_Read: DcmDspDidIdentifier=61836, DcmDspDidInfoRef=DidInfo_ECUSerialNumberDataIdentifier_Read
            ECU_Serial_Number (DcmDspDidSignal): DcmDspDidDataPos=0, DcmDspDidDataRef=ECUSerialNumberDataIdentifier_Read_ECU_Serial_Number
          DID_VINDataIdentifier_Read: DcmDspDidIdentifier=61840, DcmDspDidInfoRef=DidInfo_VINDataIdentifier_Read
            VINDataIdentifier (DcmDspDidSignal): DcmDspDidDataPos=0, DcmDspDidDataRef=VINDataIdentifier_Read_VINDataIdentifier
          DID_Calibration_Identifications_CAL_ID_Write: DcmDspDidIdentifier=63492, DcmDspDidInfoRef=DidInfo_Calibration_Identifications_CAL_ID_Write
            Number_of_data_items (DcmDspDidSignal): DcmDspDidDataPos=0, DcmDspDidDataRef=Calibration_Identifications_CAL_ID_Write_Number_of_data_items
            Calibration_Identification (DcmDspDidSignal): DcmDspDidDataPos=8, DcmDspDidDataRef=Calibration_Identifications_CAL_ID_Write_Calibration_Identification
          DID_SW_Version_Read: DcmDspDidIdentifier=64769, DcmDspDidInfoRef=DidInfo_SW_Version_Read
            SW_Version (DcmDspDidSignal): DcmDspDidDataPos=0, DcmDspDidDataRef=SW_Version_Read_SW_Version
          DID_ECU_serial_number_Read: DcmDspDidIdentifier=64771, DcmDspDidInfoRef=DidInfo_ECU_serial_number_Read
            ECU_traceability_number (DcmDspDidSignal): DcmDspDidDataPos=0, DcmDspDidDataRef=ECU_serial_number_Read_ECU_traceability_number
            PCBA_Programmed_Part_number (DcmDspDidSignal): DcmDspDidDataPos=96, DcmDspDidDataRef=ECU_serial_number_Read_PCBA_Programmed_Part_number
          DID_HSM_Identification_Read: DcmDspDidIdentifier=64772, DcmDspDidInfoRef=DidInfo_HSM_Identification_Read
            7 x DcmDspDidSignal:
              HSM_MB_Partnumber: DcmDspDidDataPos=0, DcmDspDidDataRef=HSM_Identification_Read_HSM_MB_Partnumber
              HSM_MB_Version_HW_patch_level: DcmDspDidDataPos=80, DcmDspDidDataRef=HSM_Identification_Read_HSM_MB_Version_HW_patch_level
              HSM_MB_Version_HW_week: DcmDspDidDataPos=88, DcmDspDidDataRef=HSM_Identification_Read_HSM_MB_Version_HW_week
              HSM_MB_Version_HW_year: DcmDspDidDataPos=96, DcmDspDidDataRef=HSM_Identification_Read_HSM_MB_Version_HW_year
              HSM_MB_Supplier_Version_HW_patch_level: DcmDspDidDataPos=104, DcmDspDidDataRef=HSM_Identification_Read_HSM_MB_Supplier_Version_HW_patch_level
              HSM_MB_Supplier_Version_HW_week: DcmDspDidDataPos=112, DcmDspDidDataRef=HSM_Identification_Read_HSM_MB_Supplier_Version_HW_week
              HSM_MB_Supplier_Version_HW_year: DcmDspDidDataPos=120, DcmDspDidDataRef=HSM_Identification_Read_HSM_MB_Supplier_Version_HW_year
          DID_Reset_Cause_Management_Read: DcmDspDidIdentifier=64776, DcmDspDidInfoRef=DidInfo_Reset_Cause_Management_Read
            Reset_Cause (DcmDspDidSignal): DcmDspDidDataPos=0, DcmDspDidDataRef=Reset_Cause_Management_Read_Reset_Cause
          DID_Last_Warm_Reset_Parameters_Read: DcmDspDidIdentifier=64777, DcmDspDidInfoRef=DidInfo_Last_Warm_Reset_Parameters_Read
            Last_Detected_Warm_Reset_Cause (DcmDspDidSignal): DcmDspDidDataPos=0, DcmDspDidDataRef=Last_Warm_Reset_Parameters_Read_Last_Detected_Warm_Reset_Cause
            Reset_Cause_Counter (DcmDspDidSignal): DcmDspDidDataPos=32, DcmDspDidDataRef=Last_Warm_Reset_Parameters_Read_Reset_Cause_Counter
          DID_Cycle_configuration_Read: DcmDspDidIdentifier=64784, DcmDspDidInfoRef=DidInfo_Cycle_configuration_Read
            Cycles (DcmDspDidSignal): DcmDspDidDataPos=0, DcmDspDidDataRef=Cycle_configuration_Read_Cycles
          DID_Steps_library_Read: DcmDspDidIdentifier=64810, DcmDspDidInfoRef=DidInfo_Steps_library_Read
            Steps (DcmDspDidSignal): DcmDspDidDataPos=0, DcmDspDidDataRef=Steps_library_Read_Steps
          DID_ECU_Location_Read: DcmDspDidIdentifier=64815, DcmDspDidInfoRef=DidInfo_ECU_Location_Read
            Side_Allocation (DcmDspDidSignal): DcmDspDidDataPos=0, DcmDspDidDataRef=ECU_Location_Read_Side_Allocation
          DID_Temperature_Sensor_Calibration_Point_Read: DcmDspDidIdentifier=64816, DcmDspDidInfoRef=DidInfo_Temperature_Sensor_Calibration_Point_Read
            Offset_Point (DcmDspDidSignal): DcmDspDidDataPos=0, DcmDspDidDataRef=Temperature_Sensor_Calibration_Point_Read_Offset_Point
          DID_HB_Calibration_Read: DcmDspDidIdentifier=64817, DcmDspDidInfoRef=DidInfo_HB_Calibration_Read
            CombinedSignal (DcmDspDidSignal): DcmDspDidDataPos=0, DcmDspDidDataRef=HB_Calibration_Read_CombinedSignal
          DID_Hardware_Version_Information_Write: DcmDspDidIdentifier=64848, DcmDspDidInfoRef=DidInfo_Hardware_Version_Information_Write
            3 x DcmDspDidSignal:
              HW_year: DcmDspDidDataPos=0, DcmDspDidDataRef=Hardware_Version_Information_Write_HW_year
              HW_week: DcmDspDidDataPos=8, DcmDspDidDataRef=Hardware_Version_Information_Write_HW_week
              HW_patch_level: DcmDspDidDataPos=16, DcmDspDidDataRef=Hardware_Version_Information_Write_HW_patch_level
          DID_Velocity_PI_Regulation_Coefficient_Read: DcmDspDidIdentifier=64991, DcmDspDidInfoRef=DidInfo_Velocity_PI_Regulation_Coefficient_Read
            Input_Velocity_Coefficient (DcmDspDidSignal): DcmDspDidDataPos=0, DcmDspDidDataRef=Velocity_PI_Regulation_Coefficient_Read_Input_Velocity_Coefficient
          DID_Measurement_Frame_Block_12_Config_Read: DcmDspDidIdentifier=65023, DcmDspDidInfoRef=DidInfo_Measurement_Frame_Block_12_Config_Read
            CombinedSignal (DcmDspDidSignal): DcmDspDidDataPos=0, DcmDspDidDataRef=Measurement_Frame_Block_12_Config_Read_CombinedSignal
          DID_AEC_Status_Read: DcmDspDidIdentifier=65024, DcmDspDidInfoRef=DidInfo_AEC_Status_Read
            AEC_Status (DcmDspDidSignal): DcmDspDidDataPos=0, DcmDspDidDataRef=AEC_Status_Read_AEC_Status
          DID_Measurement_Frames_Configuration_Read: DcmDspDidIdentifier=65279, DcmDspDidInfoRef=DidInfo_Measurement_Frames_Configuration_Read
            CombinedSignal (DcmDspDidSignal): DcmDspDidDataPos=0, DcmDspDidDataRef=Measurement_Frames_Configuration_Read_CombinedSignal
        91 x DcmDspDidInfo:
          DidInfo_Reprogramming_Attempt_Counter_Read
            DcmDspDidAccess
              DcmDspDidRead:
                DcmDspDidReadRoleRef = Supplier
                DcmDspDidReadRoleRef = Development_ENHANCED
                DcmDspDidReadRoleRef = Production
                DcmDspDidReadRoleRef = After_Sales_ENHANCED
                DcmDspDidReadRoleRef = After_Sales_STANDARD
                DcmDspDidReadRoleRef = After_Sales_BASIC
                DcmDspDidReadRoleRef = Internal_Diagnostic_Test_Tool
                DcmDspDidReadRoleRef = ePTI_Test_Tool
          DidInfo_Diagnostic_Trace_Memory_Read
            DcmDspDidAccess
              DcmDspDidRead:
                DcmDspDidReadSessionRef = DcmDspSession/Default
                DcmDspDidReadSessionRef = DcmDspSession/Extended
                DcmDspDidReadSessionRef = Development
                DcmDspDidReadRoleRef = Supplier
                DcmDspDidReadRoleRef = Development_ENHANCED
                DcmDspDidReadRoleRef = Production
                DcmDspDidReadRoleRef = After_Sales_ENHANCED
                DcmDspDidReadRoleRef = After_Sales_STANDARD
                DcmDspDidReadRoleRef = After_Sales_BASIC
                DcmDspDidReadRoleRef = Internal_Diagnostic_Test_Tool
                DcmDspDidReadRoleRef = ePTI_Test_Tool
              DcmDspDidWrite:
                DcmDspDidWriteSessionRef = DcmDspSession/Extended
                DcmDspDidWriteSessionRef = Development
                DcmDspDidWriteRoleRef = Supplier
                DcmDspDidWriteRoleRef = Development_ENHANCED
                DcmDspDidWriteRoleRef = Production
                DcmDspDidWriteRoleRef = After_Sales_ENHANCED
                DcmDspDidWriteRoleRef = After_Sales_STANDARD
          DidInfo_Global_Time_Sync_Measured_Values_Read
            DcmDspDidAccess
              DcmDspDidRead
          DidInfo_Vehicle_Odometer_in_Low_Resolution_Read
            DcmDspDidAccess
              DcmDspDidRead:
                DcmDspDidReadRoleRef = Supplier
                DcmDspDidReadRoleRef = Development_ENHANCED
                DcmDspDidReadRoleRef = Production
                DcmDspDidReadRoleRef = After_Sales_ENHANCED
                DcmDspDidReadRoleRef = After_Sales_STANDARD
                DcmDspDidReadRoleRef = After_Sales_BASIC
                DcmDspDidReadRoleRef = Internal_Diagnostic_Test_Tool
                DcmDspDidReadRoleRef = ePTI_Test_Tool
          DidInfo_Adjust_ISO_15765_2_Block_Size_and_STmin_Parameter_Read
            DcmDspDidAccess
              DcmDspDidRead:
                DcmDspDidReadRoleRef = Supplier
                DcmDspDidReadRoleRef = Development_ENHANCED
                DcmDspDidReadRoleRef = Production
                DcmDspDidReadRoleRef = After_Sales_ENHANCED
                DcmDspDidReadRoleRef = After_Sales_STANDARD
                DcmDspDidReadRoleRef = After_Sales_BASIC
                DcmDspDidReadRoleRef = Internal_Diagnostic_Test_Tool
                DcmDspDidReadRoleRef = ePTI_Test_Tool
              DcmDspDidWrite:
                DcmDspDidWriteSessionRef = DcmDspSession/Programming
                DcmDspDidWriteSessionRef = DcmDspSession/Extended
                DcmDspDidWriteSessionRef = Development
                DcmDspDidWriteRoleRef = Supplier
                DcmDspDidWriteRoleRef = Development_ENHANCED
                DcmDspDidWriteRoleRef = Production
                DcmDspDidWriteRoleRef = After_Sales_ENHANCED
                DcmDspDidWriteRoleRef = After_Sales_STANDARD
                DcmDspDidWriteRoleRef = Internal_Diagnostic_Test_Tool
          DidInfo_Current_Operating_Time_Read
            DcmDspDidAccess
              DcmDspDidRead:
                DcmDspDidReadRoleRef = Supplier
                DcmDspDidReadRoleRef = Development_ENHANCED
                DcmDspDidReadRoleRef = Production
                DcmDspDidReadRoleRef = After_Sales_ENHANCED
                DcmDspDidReadRoleRef = After_Sales_STANDARD
                DcmDspDidReadRoleRef = Internal_Diagnostic_Test_Tool
          DidInfo_Customer_Settings_Read
            DcmDspDidAccess
              DcmDspDidRead:
                DcmDspDidReadRoleRef = Supplier
                DcmDspDidReadRoleRef = Development_ENHANCED
                DcmDspDidReadRoleRef = Production
                DcmDspDidReadRoleRef = After_Sales_ENHANCED
                DcmDspDidReadRoleRef = After_Sales_STANDARD
                DcmDspDidReadRoleRef = After_Sales_BASIC
                DcmDspDidReadRoleRef = Internal_Diagnostic_Test_Tool
                DcmDspDidReadRoleRef = ePTI_Test_Tool
          DidInfo_Obsolescence_Data_Read
            DcmDspDidAccess
              DcmDspDidRead:
                DcmDspDidReadRoleRef = Supplier
                DcmDspDidReadRoleRef = Development_ENHANCED
                DcmDspDidReadRoleRef = Production
                DcmDspDidReadRoleRef = After_Sales_ENHANCED
                DcmDspDidReadRoleRef = After_Sales_STANDARD
                DcmDspDidReadRoleRef = After_Sales_BASIC
                DcmDspDidReadRoleRef = Internal_Diagnostic_Test_Tool
                DcmDspDidReadRoleRef = ePTI_Test_Tool
          DidInfo_Availability_Data_Read
            DcmDspDidAccess
              DcmDspDidRead:
                DcmDspDidReadRoleRef = Supplier
                DcmDspDidReadRoleRef = Development_ENHANCED
                DcmDspDidReadRoleRef = Production
                DcmDspDidReadRoleRef = After_Sales_ENHANCED
                DcmDspDidReadRoleRef = After_Sales_STANDARD
                DcmDspDidReadRoleRef = After_Sales_BASIC
                DcmDspDidReadRoleRef = Internal_Diagnostic_Test_Tool
                DcmDspDidReadRoleRef = ePTI_Test_Tool
          DidInfo_Root_CA_Certificate_Read
            DcmDspDidAccess
              DcmDspDidRead:
                DcmDspDidReadRoleRef = Supplier
                DcmDspDidReadRoleRef = Development_ENHANCED
                DcmDspDidReadRoleRef = Production
                DcmDspDidReadRoleRef = After_Sales_ENHANCED
                DcmDspDidReadRoleRef = After_Sales_STANDARD
                DcmDspDidReadRoleRef = After_Sales_BASIC
                DcmDspDidReadRoleRef = Internal_Diagnostic_Test_Tool
                DcmDspDidReadRoleRef = ePTI_Test_Tool
          DidInfo_Backend_CA_Certificate_Read
            DcmDspDidAccess
              DcmDspDidRead:
                DcmDspDidReadRoleRef = Supplier
                DcmDspDidReadRoleRef = Development_ENHANCED
                DcmDspDidReadRoleRef = Production
                DcmDspDidReadRoleRef = After_Sales_ENHANCED
                DcmDspDidReadRoleRef = After_Sales_STANDARD
                DcmDspDidReadRoleRef = After_Sales_BASIC
                DcmDspDidReadRoleRef = Internal_Diagnostic_Test_Tool
                DcmDspDidReadRoleRef = ePTI_Test_Tool
          DidInfo_Backend_CA_Certificate_Identification_Read
            DcmDspDidAccess
              DcmDspDidRead
          DidInfo_Diagnostic_Authentication_Certificate_Identification_Read
            DcmDspDidAccess
              DcmDspDidRead
          DidInfo_Access_Control_List_Version_Read
            DcmDspDidAccess
              DcmDspDidRead:
                DcmDspDidReadRoleRef = Supplier
                DcmDspDidReadRoleRef = Development_ENHANCED
                DcmDspDidReadRoleRef = Production
                DcmDspDidReadRoleRef = After_Sales_ENHANCED
                DcmDspDidReadRoleRef = After_Sales_STANDARD
                DcmDspDidReadRoleRef = After_Sales_BASIC
                DcmDspDidReadRoleRef = Internal_Diagnostic_Test_Tool
                DcmDspDidReadRoleRef = ePTI_Test_Tool
          DidInfo_Secured_System_Date_and_Time_Read
            DcmDspDidAccess
              DcmDspDidRead
          DidInfo_Security_Event_Log_Read
            DcmDspDidAccess
              DcmDspDidRead: DcmDspDidReadRoleRef=Supplier, DcmDspDidReadRoleRef=Development_ENHANCED, DcmDspDidReadRoleRef=Internal_Diagnostic_Test_Tool
          DidInfo_SecOC_PDU_Data_IDs_and_Key_Checksum_Read
            DcmDspDidAccess
              DcmDspDidRead
          DidInfo_SecOC_Vehicle_Shared_Secret_Hash_Read
            DcmDspDidAccess
              DcmDspDidRead
          DidInfo_SecOC_Local_TickCount_Read
            DcmDspDidAccess
              DcmDspDidRead
          DidInfo_Diagnostic_User_Role_Read
            DcmDspDidAccess
              DcmDspDidRead
          DidInfo_Real_Time_Offset_Read
            DcmDspDidAccess
              DcmDspDidRead
          DidInfo_VIN_Status_Read
            DcmDspDidAccess
              DcmDspDidRead:
                DcmDspDidReadRoleRef = Supplier
                DcmDspDidReadRoleRef = Development_ENHANCED
                DcmDspDidReadRoleRef = Production
                DcmDspDidReadRoleRef = After_Sales_ENHANCED
          DidInfo_SecOC_PDU_Data_IDs_and_Key_CMACs_Read
            DcmDspDidAccess
              DcmDspDidRead: DcmDspDidReadSessionRef=DcmDspSession/Default, DcmDspDidReadSessionRef=DcmDspSession/Extended, DcmDspDidReadSessionRef=Development
          DidInfo_Security_Event_Log_Current_Counter_Values_Read
            DcmDspDidAccess
              DcmDspDidRead: DcmDspDidReadRoleRef=Supplier, DcmDspDidReadRoleRef=Development_ENHANCED, DcmDspDidReadRoleRef=Internal_Diagnostic_Test_Tool
          DidInfo_RandomNumber_Read
            DcmDspDidAccess
              DcmDspDidRead:
                DcmDspDidReadSessionRef = DcmDspSession/Default
                DcmDspDidReadSessionRef = DcmDspSession/Extended
                DcmDspDidReadSessionRef = Development
                DcmDspDidReadRoleRef = Supplier
                DcmDspDidReadRoleRef = Development_ENHANCED
                DcmDspDidReadRoleRef = Production
          DidInfo_Status_SSA_Pre_Compile_Switches_Read
            DcmDspDidAccess
              DcmDspDidRead:
                DcmDspDidReadSessionRef = DcmDspSession/Default
                DcmDspDidReadSessionRef = DcmDspSession/Extended
                DcmDspDidReadSessionRef = Development
                DcmDspDidReadRoleRef = Supplier
                DcmDspDidReadRoleRef = Development_ENHANCED
                DcmDspDidReadRoleRef = Production
          DidInfo_Trust_Model_Root_Replacement_Key_Read
            DcmDspDidAccess
              DcmDspDidRead:
                DcmDspDidReadSessionRef = DcmDspSession/Default
                DcmDspDidReadSessionRef = DcmDspSession/Extended
                DcmDspDidReadSessionRef = Development
                DcmDspDidReadRoleRef = Supplier
                DcmDspDidReadRoleRef = Development_ENHANCED
                DcmDspDidReadRoleRef = Production
                DcmDspDidReadRoleRef = After_Sales_ENHANCED
                DcmDspDidReadRoleRef = After_Sales_STANDARD
                DcmDspDidReadRoleRef = After_Sales_BASIC
                DcmDspDidReadRoleRef = Internal_Diagnostic_Test_Tool
                DcmDspDidReadRoleRef = ePTI_Test_Tool
          DidInfo_Trust_Model_Request_ephemeral_public_key_Read
            DcmDspDidAccess
              DcmDspDidRead:
                DcmDspDidReadSessionRef = DcmDspSession/Default
                DcmDspDidReadSessionRef = DcmDspSession/Extended
                DcmDspDidReadSessionRef = Development
                DcmDspDidReadRoleRef = Supplier
                DcmDspDidReadRoleRef = Development_ENHANCED
                DcmDspDidReadRoleRef = Production
                DcmDspDidReadRoleRef = After_Sales_ENHANCED
          DidInfo_Trust_model_ECU_CSR_Read
            DcmDspDidAccess
              DcmDspDidRead: DcmDspDidReadSessionRef=DcmDspSession/Default, DcmDspDidReadSessionRef=DcmDspSession/Extended, DcmDspDidReadSessionRef=Development
          DidInfo_Trust_model_ECU_certificate_Read
            DcmDspDidAccess
              DcmDspDidRead
          DidInfo_Trust_model_Intermediate_CA_certificate_Read
            DcmDspDidAccess
              DcmDspDidRead:
                DcmDspDidReadSessionRef = DcmDspSession/Default
                DcmDspDidReadSessionRef = DcmDspSession/Extended
                DcmDspDidReadSessionRef = Development
                DcmDspDidReadRoleRef = Supplier
                DcmDspDidReadRoleRef = Development_ENHANCED
                DcmDspDidReadRoleRef = Production
                DcmDspDidReadRoleRef = After_Sales_ENHANCED
                DcmDspDidReadRoleRef = After_Sales_STANDARD
                DcmDspDidReadRoleRef = After_Sales_BASIC
                DcmDspDidReadRoleRef = Internal_Diagnostic_Test_Tool
                DcmDspDidReadRoleRef = ePTI_Test_Tool
          DidInfo_Trust_model_Backend_CA_certificate_Read
            DcmDspDidAccess
              DcmDspDidRead:
                DcmDspDidReadSessionRef = DcmDspSession/Default
                DcmDspDidReadSessionRef = DcmDspSession/Extended
                DcmDspDidReadSessionRef = Development
                DcmDspDidReadRoleRef = Supplier
                DcmDspDidReadRoleRef = Development_ENHANCED
                DcmDspDidReadRoleRef = Production
                DcmDspDidReadRoleRef = After_Sales_ENHANCED
                DcmDspDidReadRoleRef = After_Sales_STANDARD
                DcmDspDidReadRoleRef = After_Sales_BASIC
                DcmDspDidReadRoleRef = Internal_Diagnostic_Test_Tool
                DcmDspDidReadRoleRef = ePTI_Test_Tool
          DidInfo_Trust_model_Root_CA_certificate_Read
            DcmDspDidAccess
              DcmDspDidRead:
                DcmDspDidReadSessionRef = DcmDspSession/Default
                DcmDspDidReadSessionRef = DcmDspSession/Extended
                DcmDspDidReadSessionRef = Development
                DcmDspDidReadRoleRef = Supplier
                DcmDspDidReadRoleRef = Development_ENHANCED
                DcmDspDidReadRoleRef = Production
                DcmDspDidReadRoleRef = After_Sales_ENHANCED
                DcmDspDidReadRoleRef = After_Sales_STANDARD
                DcmDspDidReadRoleRef = After_Sales_BASIC
                DcmDspDidReadRoleRef = Internal_Diagnostic_Test_Tool
                DcmDspDidReadRoleRef = ePTI_Test_Tool
          DidInfo_Trust_model_full_chain_of_trust_certificates_Read
            DcmDspDidAccess
              DcmDspDidRead:
                DcmDspDidReadSessionRef = DcmDspSession/Default
                DcmDspDidReadSessionRef = DcmDspSession/Extended
                DcmDspDidReadSessionRef = Development
                DcmDspDidReadRoleRef = Supplier
                DcmDspDidReadRoleRef = Development_ENHANCED
                DcmDspDidReadRoleRef = Production
                DcmDspDidReadRoleRef = After_Sales_ENHANCED
                DcmDspDidReadRoleRef = After_Sales_STANDARD
                DcmDspDidReadRoleRef = After_Sales_BASIC
                DcmDspDidReadRoleRef = Internal_Diagnostic_Test_Tool
                DcmDspDidReadRoleRef = ePTI_Test_Tool
          DidInfo_Trust_Model_CSR_Supplier_Signature_Read
            DcmDspDidAccess
              DcmDspDidRead:
                DcmDspDidReadSessionRef = DcmDspSession/Default
                DcmDspDidReadSessionRef = DcmDspSession/Extended
                DcmDspDidReadSessionRef = Development
                DcmDspDidReadRoleRef = Supplier
                DcmDspDidReadRoleRef = Development_ENHANCED
                DcmDspDidReadRoleRef = Production
                DcmDspDidReadRoleRef = After_Sales_ENHANCED
              DcmDspDidWrite:
                DcmDspDidWriteSessionRef = DcmDspSession/Default
                DcmDspDidWriteSessionRef = DcmDspSession/Extended
                DcmDspDidWriteSessionRef = Development
                DcmDspDidWriteRoleRef = Supplier
          DidInfo_Task_Response_Time_Read
            DcmDspDidAccess
              DcmDspDidRead:
                DcmDspDidReadRoleRef = Supplier
                DcmDspDidReadRoleRef = Development_ENHANCED
                DcmDspDidReadRoleRef = Production
                DcmDspDidReadRoleRef = Internal_Diagnostic_Test_Tool
          DidInfo_CPU_Load_Read
            DcmDspDidAccess
              DcmDspDidRead:
                DcmDspDidReadRoleRef = Supplier
                DcmDspDidReadRoleRef = Development_ENHANCED
                DcmDspDidReadRoleRef = Production
                DcmDspDidReadRoleRef = Internal_Diagnostic_Test_Tool
          DidInfo_Stack_Load_Read
            DcmDspDidAccess
              DcmDspDidRead:
                DcmDspDidReadRoleRef = Supplier
                DcmDspDidReadRoleRef = Development_ENHANCED
                DcmDspDidReadRoleRef = Production
                DcmDspDidReadRoleRef = Internal_Diagnostic_Test_Tool
          DidInfo_Memory_Usage_Cycles_Read
            DcmDspDidAccess
              DcmDspDidRead:
                DcmDspDidReadRoleRef = Supplier
                DcmDspDidReadRoleRef = Development_ENHANCED
                DcmDspDidReadRoleRef = Production
                DcmDspDidReadRoleRef = Internal_Diagnostic_Test_Tool
          DidInfo_CAN_input_Read
            DcmDspDidAccess
              DcmDspDidRead:
                DcmDspDidReadSessionRef = DcmDspSession/Default
                DcmDspDidReadSessionRef = DcmDspSession/Extended
                DcmDspDidReadSessionRef = Development
                DcmDspDidReadRoleRef = Supplier
                DcmDspDidReadRoleRef = Development_ENHANCED
                DcmDspDidReadRoleRef = Production
                DcmDspDidReadRoleRef = After_Sales_ENHANCED
                DcmDspDidReadRoleRef = After_Sales_STANDARD
                DcmDspDidReadRoleRef = After_Sales_BASIC
                DcmDspDidReadRoleRef = Internal_Diagnostic_Test_Tool
                DcmDspDidReadRoleRef = ePTI_Test_Tool
          DidInfo_CAN_output_Read
            DcmDspDidAccess
              DcmDspDidRead:
                DcmDspDidReadSessionRef = DcmDspSession/Default
                DcmDspDidReadSessionRef = DcmDspSession/Extended
                DcmDspDidReadSessionRef = Development
                DcmDspDidReadRoleRef = Supplier
                DcmDspDidReadRoleRef = Development_ENHANCED
                DcmDspDidReadRoleRef = Production
                DcmDspDidReadRoleRef = After_Sales_ENHANCED
                DcmDspDidReadRoleRef = After_Sales_STANDARD
                DcmDspDidReadRoleRef = After_Sales_BASIC
                DcmDspDidReadRoleRef = Internal_Diagnostic_Test_Tool
                DcmDspDidReadRoleRef = ePTI_Test_Tool
          DidInfo_HW_input_Read
            DcmDspDidAccess
              DcmDspDidRead:
                DcmDspDidReadSessionRef = DcmDspSession/Default
                DcmDspDidReadSessionRef = DcmDspSession/Extended
                DcmDspDidReadSessionRef = Development
                DcmDspDidReadRoleRef = Supplier
                DcmDspDidReadRoleRef = Development_ENHANCED
                DcmDspDidReadRoleRef = Production
                DcmDspDidReadRoleRef = After_Sales_ENHANCED
                DcmDspDidReadRoleRef = After_Sales_STANDARD
                DcmDspDidReadRoleRef = After_Sales_BASIC
                DcmDspDidReadRoleRef = Internal_Diagnostic_Test_Tool
                DcmDspDidReadRoleRef = ePTI_Test_Tool
          DidInfo_Internal_ECU_information_Read
            DcmDspDidAccess
              DcmDspDidRead:
                DcmDspDidReadSessionRef = DcmDspSession/Default
                DcmDspDidReadSessionRef = DcmDspSession/Extended
                DcmDspDidReadSessionRef = Development
                DcmDspDidReadRoleRef = Supplier
                DcmDspDidReadRoleRef = Development_ENHANCED
                DcmDspDidReadRoleRef = Production
                DcmDspDidReadRoleRef = After_Sales_ENHANCED
                DcmDspDidReadRoleRef = After_Sales_STANDARD
                DcmDspDidReadRoleRef = After_Sales_BASIC
                DcmDspDidReadRoleRef = Internal_Diagnostic_Test_Tool
                DcmDspDidReadRoleRef = ePTI_Test_Tool
          DidInfo_PRE_SAFE_Recorder_1_read_Read
            DcmDspDidAccess
              DcmDspDidRead:
                DcmDspDidReadSessionRef = DcmDspSession/Default
                DcmDspDidReadSessionRef = DcmDspSession/Extended
                DcmDspDidReadSessionRef = Development
                DcmDspDidReadRoleRef = Supplier
                DcmDspDidReadRoleRef = Development_ENHANCED
                DcmDspDidReadRoleRef = Production
                DcmDspDidReadRoleRef = After_Sales_ENHANCED
                DcmDspDidReadRoleRef = After_Sales_STANDARD
                DcmDspDidReadRoleRef = After_Sales_BASIC
                DcmDspDidReadRoleRef = Internal_Diagnostic_Test_Tool
                DcmDspDidReadRoleRef = ePTI_Test_Tool
              DcmDspDidWrite:
                DcmDspDidWriteSessionRef = DcmDspSession/Extended
                DcmDspDidWriteSessionRef = Development
                DcmDspDidWriteRoleRef = Supplier
                DcmDspDidWriteRoleRef = Development_ENHANCED
                DcmDspDidWriteRoleRef = Production
                DcmDspDidWriteRoleRef = After_Sales_ENHANCED
                DcmDspDidWriteRoleRef = After_Sales_STANDARD
          DidInfo_PRE_SAFE_Recorder_2_read_Read
            DcmDspDidAccess
              DcmDspDidRead:
                DcmDspDidReadSessionRef = DcmDspSession/Default
                DcmDspDidReadSessionRef = DcmDspSession/Extended
                DcmDspDidReadSessionRef = Development
                DcmDspDidReadRoleRef = Supplier
                DcmDspDidReadRoleRef = Development_ENHANCED
                DcmDspDidReadRoleRef = Production
                DcmDspDidReadRoleRef = After_Sales_ENHANCED
                DcmDspDidReadRoleRef = After_Sales_STANDARD
                DcmDspDidReadRoleRef = After_Sales_BASIC
                DcmDspDidReadRoleRef = Internal_Diagnostic_Test_Tool
                DcmDspDidReadRoleRef = ePTI_Test_Tool
              DcmDspDidWrite:
                DcmDspDidWriteSessionRef = DcmDspSession/Extended
                DcmDspDidWriteSessionRef = Development
                DcmDspDidWriteRoleRef = Supplier
                DcmDspDidWriteRoleRef = Development_ENHANCED
                DcmDspDidWriteRoleRef = Production
                DcmDspDidWriteRoleRef = After_Sales_ENHANCED
                DcmDspDidWriteRoleRef = After_Sales_STANDARD
          DidInfo_BSR_Counter_read_Read
            DcmDspDidAccess
              DcmDspDidRead:
                DcmDspDidReadSessionRef = DcmDspSession/Default
                DcmDspDidReadSessionRef = DcmDspSession/Extended
                DcmDspDidReadSessionRef = Development
                DcmDspDidReadRoleRef = Supplier
                DcmDspDidReadRoleRef = Development_ENHANCED
                DcmDspDidReadRoleRef = Production
                DcmDspDidReadRoleRef = After_Sales_ENHANCED
                DcmDspDidReadRoleRef = After_Sales_STANDARD
                DcmDspDidReadRoleRef = After_Sales_BASIC
                DcmDspDidReadRoleRef = Internal_Diagnostic_Test_Tool
                DcmDspDidReadRoleRef = ePTI_Test_Tool
          DidInfo_PRE_SAFE_Counter_read_Read
            DcmDspDidAccess
              DcmDspDidRead:
                DcmDspDidReadSessionRef = DcmDspSession/Default
                DcmDspDidReadSessionRef = DcmDspSession/Extended
                DcmDspDidReadSessionRef = Development
                DcmDspDidReadRoleRef = Supplier
                DcmDspDidReadRoleRef = Development_ENHANCED
                DcmDspDidReadRoleRef = Production
                DcmDspDidReadRoleRef = After_Sales_ENHANCED
                DcmDspDidReadRoleRef = After_Sales_STANDARD
                DcmDspDidReadRoleRef = After_Sales_BASIC
                DcmDspDidReadRoleRef = Internal_Diagnostic_Test_Tool
                DcmDspDidReadRoleRef = ePTI_Test_Tool
              DcmDspDidWrite:
                DcmDspDidWriteSessionRef = DcmDspSession/Extended
                DcmDspDidWriteSessionRef = Development
                DcmDspDidWriteRoleRef = Supplier
                DcmDspDidWriteRoleRef = Development_ENHANCED
                DcmDspDidWriteRoleRef = Production
                DcmDspDidWriteRoleRef = After_Sales_ENHANCED
                DcmDspDidWriteRoleRef = After_Sales_STANDARD
          DidInfo_System_Time_read_Read
            DcmDspDidAccess
              DcmDspDidRead:
                DcmDspDidReadSessionRef = DcmDspSession/Default
                DcmDspDidReadSessionRef = DcmDspSession/Extended
                DcmDspDidReadSessionRef = Development
                DcmDspDidReadRoleRef = Supplier
                DcmDspDidReadRoleRef = Development_ENHANCED
                DcmDspDidReadRoleRef = Production
                DcmDspDidReadRoleRef = After_Sales_ENHANCED
                DcmDspDidReadRoleRef = After_Sales_STANDARD
                DcmDspDidReadRoleRef = After_Sales_BASIC
                DcmDspDidReadRoleRef = Internal_Diagnostic_Test_Tool
                DcmDspDidReadRoleRef = ePTI_Test_Tool
          DidInfo_PreSafe_Cycles_Level_1_8_Read
            DcmDspDidAccess
              DcmDspDidRead:
                DcmDspDidReadSessionRef = DcmDspSession/Default
                DcmDspDidReadSessionRef = DcmDspSession/Extended
                DcmDspDidReadSessionRef = Development
                DcmDspDidReadRoleRef = Supplier
                DcmDspDidReadRoleRef = Development_ENHANCED
                DcmDspDidReadRoleRef = Production
                DcmDspDidReadRoleRef = After_Sales_ENHANCED
                DcmDspDidReadRoleRef = After_Sales_STANDARD
                DcmDspDidReadRoleRef = After_Sales_BASIC
                DcmDspDidReadRoleRef = Internal_Diagnostic_Test_Tool
                DcmDspDidReadRoleRef = ePTI_Test_Tool
              DcmDspDidWrite:
                DcmDspDidWriteRoleRef = Supplier
                DcmDspDidWriteRoleRef = Development_ENHANCED
                DcmDspDidWriteRoleRef = Production
                DcmDspDidWriteRoleRef = After_Sales_ENHANCED
          DidInfo_Release_Cycles_BSR_and_PreSafe_Read
            DcmDspDidAccess
              DcmDspDidRead:
                DcmDspDidReadSessionRef = DcmDspSession/Default
                DcmDspDidReadSessionRef = DcmDspSession/Extended
                DcmDspDidReadSessionRef = Development
                DcmDspDidReadRoleRef = Supplier
                DcmDspDidReadRoleRef = Development_ENHANCED
                DcmDspDidReadRoleRef = Production
                DcmDspDidReadRoleRef = After_Sales_ENHANCED
                DcmDspDidReadRoleRef = After_Sales_STANDARD
                DcmDspDidReadRoleRef = After_Sales_BASIC
                DcmDspDidReadRoleRef = Internal_Diagnostic_Test_Tool
                DcmDspDidReadRoleRef = ePTI_Test_Tool
              DcmDspDidWrite:
                DcmDspDidWriteRoleRef = Supplier
                DcmDspDidWriteRoleRef = Development_ENHANCED
                DcmDspDidWriteRoleRef = Production
                DcmDspDidWriteRoleRef = After_Sales_ENHANCED
          DidInfo_Tensioning_Cycle_BSR_Read
            DcmDspDidAccess
              DcmDspDidRead:
                DcmDspDidReadSessionRef = DcmDspSession/Default
                DcmDspDidReadSessionRef = DcmDspSession/Extended
                DcmDspDidReadSessionRef = Development
                DcmDspDidReadRoleRef = Supplier
                DcmDspDidReadRoleRef = Development_ENHANCED
                DcmDspDidReadRoleRef = Production
                DcmDspDidReadRoleRef = After_Sales_ENHANCED
                DcmDspDidReadRoleRef = After_Sales_STANDARD
                DcmDspDidReadRoleRef = After_Sales_BASIC
                DcmDspDidReadRoleRef = Internal_Diagnostic_Test_Tool
                DcmDspDidReadRoleRef = ePTI_Test_Tool
              DcmDspDidWrite:
                DcmDspDidWriteRoleRef = Supplier
                DcmDspDidWriteRoleRef = Development_ENHANCED
                DcmDspDidWriteRoleRef = Production
                DcmDspDidWriteRoleRef = After_Sales_ENHANCED
          DidInfo_Vehicle_Equipment_Read
            DcmDspDidAccess
              DcmDspDidRead:
                DcmDspDidReadSessionRef = DcmDspSession/Default
                DcmDspDidReadSessionRef = DcmDspSession/Extended
                DcmDspDidReadSessionRef = Development
                DcmDspDidReadRoleRef = Supplier
                DcmDspDidReadRoleRef = Development_ENHANCED
                DcmDspDidReadRoleRef = Production
                DcmDspDidReadRoleRef = After_Sales_ENHANCED
                DcmDspDidReadRoleRef = After_Sales_STANDARD
                DcmDspDidReadRoleRef = After_Sales_BASIC
                DcmDspDidReadRoleRef = Internal_Diagnostic_Test_Tool
                DcmDspDidReadRoleRef = ePTI_Test_Tool
              DcmDspDidWrite:
                DcmDspDidWriteSessionRef = DcmDspSession/Default
                DcmDspDidWriteSessionRef = DcmDspSession/Extended
                DcmDspDidWriteSessionRef = Development
                DcmDspDidWriteRoleRef = Supplier
                DcmDspDidWriteRoleRef = Development_ENHANCED
                DcmDspDidWriteRoleRef = Production
                DcmDspDidWriteRoleRef = After_Sales_ENHANCED
          DidInfo_ZZZ_Vehicle_Equipment_Development_Read
            DcmDspDidAccess
              DcmDspDidRead:
                DcmDspDidReadSessionRef = DcmDspSession/Default
                DcmDspDidReadSessionRef = DcmDspSession/Extended
                DcmDspDidReadSessionRef = Development
                DcmDspDidReadRoleRef = Supplier
                DcmDspDidReadRoleRef = Development_ENHANCED
                DcmDspDidReadRoleRef = Production
                DcmDspDidReadRoleRef = After_Sales_ENHANCED
                DcmDspDidReadRoleRef = After_Sales_STANDARD
                DcmDspDidReadRoleRef = After_Sales_BASIC
                DcmDspDidReadRoleRef = Internal_Diagnostic_Test_Tool
                DcmDspDidReadRoleRef = ePTI_Test_Tool
              DcmDspDidWrite:
                DcmDspDidWriteSessionRef = DcmDspSession/Default
                DcmDspDidWriteSessionRef = DcmDspSession/Extended
                DcmDspDidWriteSessionRef = Development
                DcmDspDidWriteRoleRef = Supplier
                DcmDspDidWriteRoleRef = Development_ENHANCED
                DcmDspDidWriteRoleRef = Production
                DcmDspDidWriteRoleRef = After_Sales_ENHANCED
          DidInfo_Seatbelt_Serial_Number_Read
            DcmDspDidAccess
              DcmDspDidRead:
                DcmDspDidReadRoleRef = Supplier
                DcmDspDidReadRoleRef = Development_ENHANCED
                DcmDspDidReadRoleRef = Production
                DcmDspDidReadRoleRef = After_Sales_ENHANCED
                DcmDspDidReadRoleRef = After_Sales_STANDARD
                DcmDspDidReadRoleRef = After_Sales_BASIC
                DcmDspDidReadRoleRef = Internal_Diagnostic_Test_Tool
                DcmDspDidReadRoleRef = ePTI_Test_Tool
              DcmDspDidWrite: DcmDspDidWriteSessionRef=Development, DcmDspDidWriteRoleRef=Supplier, DcmDspDidWriteRoleRef=Development_ENHANCED, DcmDspDidWriteRoleRef=Production
          DidInfo_Calibration_Identifications_CAL_ID_Read
            DcmDspDidAccess
              DcmDspDidRead
          DidInfo_ECU_Extract_Version_Read
            DcmDspDidAccess
              DcmDspDidRead
          DidInfo_Diagnostic_Extract_Version_Read
            DcmDspDidAccess
              DcmDspDidRead: DcmDspDidReadSessionRef=DcmDspSession/Default, DcmDspDidReadSessionRef=DcmDspSession/Extended, DcmDspDidReadSessionRef=Development
          DidInfo_Standard_Application_SW_Package_Information_Read
            DcmDspDidAccess
              DcmDspDidRead:
                DcmDspDidReadRoleRef = Supplier
                DcmDspDidReadRoleRef = Development_ENHANCED
                DcmDspDidReadRoleRef = Production
                DcmDspDidReadRoleRef = Internal_Diagnostic_Test_Tool
          DidInfo_SSA_Version_Information_Read
            DcmDspDidAccess
              DcmDspDidRead:
                DcmDspDidReadRoleRef = Supplier
                DcmDspDidReadRoleRef = Development_ENHANCED
                DcmDspDidReadRoleRef = Production
                DcmDspDidReadRoleRef = Internal_Diagnostic_Test_Tool
          DidInfo_Minimum_Software_Version_Read
            DcmDspDidAccess
              DcmDspDidRead:
                DcmDspDidReadRoleRef = Supplier
                DcmDspDidReadRoleRef = Development_ENHANCED
                DcmDspDidReadRoleRef = Production
                DcmDspDidReadRoleRef = After_Sales_ENHANCED
                DcmDspDidReadRoleRef = Internal_Diagnostic_Test_Tool
          DidInfo_ActiveDiagnosticInformation_Read
            DcmDspDidAccess
              DcmDspDidRead
          DidInfo_Dump_of_Vedoc_Relevant_Information_Read
            DcmDspDidAccess
              DcmDspDidRead:
                DcmDspDidReadRoleRef = Supplier
                DcmDspDidReadRoleRef = Development_ENHANCED
                DcmDspDidReadRoleRef = Production
                DcmDspDidReadRoleRef = After_Sales_ENHANCED
                DcmDspDidReadRoleRef = After_Sales_STANDARD
                DcmDspDidReadRoleRef = After_Sales_BASIC
                DcmDspDidReadRoleRef = Internal_Diagnostic_Test_Tool
                DcmDspDidReadRoleRef = ePTI_Test_Tool
          DidInfo_ECU_Name_Read
            DcmDspDidAccess
              DcmDspDidRead
          DidInfo_DDS_Package_Release_Read
            DcmDspDidAccess
              DcmDspDidRead: DcmDspDidReadRoleRef=Supplier, DcmDspDidReadRoleRef=Development_ENHANCED, DcmDspDidReadRoleRef=Internal_Diagnostic_Test_Tool
          DidInfo_MercedesCarGroupHardware_Read
            DcmDspDidAccess
              DcmDspDidRead
          DidInfo_MercedesCarGroupSoftware_Read
            DcmDspDidAccess
              DcmDspDidRead
          DidInfo_Supported_configuration_mechanisms_Read
            DcmDspDidAccess
              DcmDspDidRead: DcmDspDidReadSessionRef=DcmDspSession/Default, DcmDspDidReadSessionRef=DcmDspSession/Extended, DcmDspDidReadSessionRef=Development
          DidInfo_HardwareVersion_Read
            DcmDspDidAccess
              DcmDspDidRead
          DidInfo_SoftwareVersion_Read
            DcmDspDidAccess
              DcmDspDidRead
          DidInfo_BootSoftwareVersion_Read
            DcmDspDidAccess
              DcmDspDidRead:
                DcmDspDidReadRoleRef = Supplier
                DcmDspDidReadRoleRef = Development_ENHANCED
                DcmDspDidReadRoleRef = Production
                DcmDspDidReadRoleRef = After_Sales_ENHANCED
                DcmDspDidReadRoleRef = After_Sales_STANDARD
                DcmDspDidReadRoleRef = After_Sales_BASIC
                DcmDspDidReadRoleRef = Internal_Diagnostic_Test_Tool
                DcmDspDidReadRoleRef = ePTI_Test_Tool
          DidInfo_HardwareSupplier_Read
            DcmDspDidAccess
              DcmDspDidRead
          DidInfo_SoftwareSupplier_Read
            DcmDspDidAccess
              DcmDspDidRead
          DidInfo_ReadFingerprint_Read
            DcmDspDidAccess
              DcmDspDidRead:
                DcmDspDidReadRoleRef = Supplier
                DcmDspDidReadRoleRef = Development_ENHANCED
                DcmDspDidReadRoleRef = Production
                DcmDspDidReadRoleRef = After_Sales_ENHANCED
                DcmDspDidReadRoleRef = After_Sales_STANDARD
                DcmDspDidReadRoleRef = After_Sales_BASIC
                DcmDspDidReadRoleRef = Internal_Diagnostic_Test_Tool
                DcmDspDidReadRoleRef = ePTI_Test_Tool
          DidInfo_ECUSerialNumberDataIdentifier_Read
            DcmDspDidAccess
              DcmDspDidRead:
                DcmDspDidReadRoleRef = Supplier
                DcmDspDidReadRoleRef = Development_ENHANCED
                DcmDspDidReadRoleRef = Production
                DcmDspDidReadRoleRef = After_Sales_ENHANCED
                DcmDspDidReadRoleRef = After_Sales_STANDARD
                DcmDspDidReadRoleRef = After_Sales_BASIC
                DcmDspDidReadRoleRef = Internal_Diagnostic_Test_Tool
                DcmDspDidReadRoleRef = ePTI_Test_Tool
          DidInfo_VINDataIdentifier_Read
            DcmDspDidAccess
              DcmDspDidRead
              DcmDspDidWrite:
                DcmDspDidWriteSessionRef = DcmDspSession/Programming
                DcmDspDidWriteSessionRef = DcmDspSession/Extended
                DcmDspDidWriteSessionRef = Development
                DcmDspDidWriteRoleRef = Supplier
                DcmDspDidWriteRoleRef = Development_ENHANCED
                DcmDspDidWriteRoleRef = Production
          DidInfo_Calibration_Identifications_CAL_ID_Write
            DcmDspDidAccess
              DcmDspDidWrite:
                DcmDspDidWriteSessionRef = DcmDspSession/Programming
                DcmDspDidWriteSessionRef = DcmDspSession/Extended
                DcmDspDidWriteSessionRef = Development
                DcmDspDidWriteRoleRef = Supplier
                DcmDspDidWriteRoleRef = Development_ENHANCED
                DcmDspDidWriteRoleRef = Production
                DcmDspDidWriteRoleRef = After_Sales_ENHANCED
                DcmDspDidWriteRoleRef = After_Sales_STANDARD
          DidInfo_SW_Version_Read
            DcmDspDidAccess
              DcmDspDidRead: DcmDspDidReadSessionRef=Development
          DidInfo_ECU_serial_number_Read
            DcmDspDidAccess
              DcmDspDidRead
              DcmDspDidWrite: DcmDspDidWriteSessionRef=Development, DcmDspDidWriteRoleRef=Supplier, DcmDspDidWriteRoleRef=Development_ENHANCED, DcmDspDidWriteRoleRef=Production
          DidInfo_HSM_Identification_Read
            DcmDspDidAccess
              DcmDspDidRead:
                DcmDspDidReadRoleRef = Supplier
                DcmDspDidReadRoleRef = Development_ENHANCED
                DcmDspDidReadRoleRef = Production
                DcmDspDidReadRoleRef = After_Sales_ENHANCED
                DcmDspDidReadRoleRef = After_Sales_STANDARD
                DcmDspDidReadRoleRef = After_Sales_BASIC
                DcmDspDidReadRoleRef = Internal_Diagnostic_Test_Tool
                DcmDspDidReadRoleRef = ePTI_Test_Tool
              DcmDspDidWrite:
                DcmDspDidWriteSessionRef = DcmDspSession/Programming
                DcmDspDidWriteSessionRef = DcmDspSession/Extended
                DcmDspDidWriteSessionRef = Development
                DcmDspDidWriteRoleRef = Supplier
                DcmDspDidWriteRoleRef = Development_ENHANCED
                DcmDspDidWriteRoleRef = Production
                DcmDspDidWriteRoleRef = After_Sales_ENHANCED
                DcmDspDidWriteRoleRef = After_Sales_STANDARD
          DidInfo_Reset_Cause_Management_Read
            DcmDspDidAccess
              DcmDspDidRead: DcmDspDidReadSessionRef=Development
          DidInfo_Last_Warm_Reset_Parameters_Read
            DcmDspDidAccess
              DcmDspDidRead: DcmDspDidReadSessionRef=Development
          DidInfo_Cycle_configuration_Read
            DcmDspDidAccess
              DcmDspDidRead: DcmDspDidReadSessionRef=Development
              DcmDspDidWrite: DcmDspDidWriteSessionRef=Development, DcmDspDidWriteRoleRef=Supplier, DcmDspDidWriteRoleRef=Development_ENHANCED, DcmDspDidWriteRoleRef=Production
          DidInfo_Steps_library_Read
            DcmDspDidAccess
              DcmDspDidRead: DcmDspDidReadSessionRef=Development
              DcmDspDidWrite: DcmDspDidWriteSessionRef=Development, DcmDspDidWriteRoleRef=Supplier, DcmDspDidWriteRoleRef=Development_ENHANCED, DcmDspDidWriteRoleRef=Production
          DidInfo_ECU_Location_Read
            DcmDspDidAccess
              DcmDspDidRead: DcmDspDidReadSessionRef=Development
              DcmDspDidWrite: DcmDspDidWriteSessionRef=Development, DcmDspDidWriteRoleRef=Supplier, DcmDspDidWriteRoleRef=Development_ENHANCED, DcmDspDidWriteRoleRef=Production
          DidInfo_Temperature_Sensor_Calibration_Point_Read
            DcmDspDidAccess
              DcmDspDidRead:
                DcmDspDidReadSessionRef = DcmDspSession/Default
                DcmDspDidReadSessionRef = DcmDspSession/Extended
                DcmDspDidReadSessionRef = Development
                DcmDspDidReadRoleRef = Supplier
                DcmDspDidReadRoleRef = Development_ENHANCED
                DcmDspDidReadRoleRef = Production
                DcmDspDidReadRoleRef = After_Sales_ENHANCED
                DcmDspDidReadRoleRef = After_Sales_STANDARD
                DcmDspDidReadRoleRef = After_Sales_BASIC
                DcmDspDidReadRoleRef = Internal_Diagnostic_Test_Tool
                DcmDspDidReadRoleRef = ePTI_Test_Tool
              DcmDspDidWrite:
                DcmDspDidWriteSessionRef = Development
                DcmDspDidWriteRoleRef = Supplier
                DcmDspDidWriteRoleRef = Development_ENHANCED
                DcmDspDidWriteRoleRef = Production
                DcmDspDidWriteRoleRef = After_Sales_ENHANCED
                DcmDspDidWriteRoleRef = After_Sales_STANDARD
          DidInfo_HB_Calibration_Read
            DcmDspDidAccess
              DcmDspDidRead: DcmDspDidReadSessionRef=Development
              DcmDspDidWrite:
                DcmDspDidWriteSessionRef = Development
                DcmDspDidWriteRoleRef = Supplier
                DcmDspDidWriteRoleRef = Development_ENHANCED
                DcmDspDidWriteRoleRef = Production
                DcmDspDidWriteRoleRef = After_Sales_ENHANCED
                DcmDspDidWriteRoleRef = After_Sales_STANDARD
          DidInfo_Hardware_Version_Information_Write
            DcmDspDidAccess
              DcmDspDidWrite:
                DcmDspDidWriteSessionRef = Development
                DcmDspDidWriteRoleRef = Supplier
                DcmDspDidWriteRoleRef = Development_ENHANCED
                DcmDspDidWriteRoleRef = Production
                DcmDspDidWriteRoleRef = After_Sales_ENHANCED
                DcmDspDidWriteRoleRef = After_Sales_STANDARD
          DidInfo_Velocity_PI_Regulation_Coefficient_Read
            DcmDspDidAccess
              DcmDspDidRead:
                DcmDspDidReadSessionRef = DcmDspSession/Default
                DcmDspDidReadSessionRef = DcmDspSession/Extended
                DcmDspDidReadSessionRef = Development
                DcmDspDidReadRoleRef = Supplier
                DcmDspDidReadRoleRef = Development_ENHANCED
                DcmDspDidReadRoleRef = Production
                DcmDspDidReadRoleRef = After_Sales_ENHANCED
                DcmDspDidReadRoleRef = After_Sales_STANDARD
                DcmDspDidReadRoleRef = After_Sales_BASIC
                DcmDspDidReadRoleRef = Internal_Diagnostic_Test_Tool
                DcmDspDidReadRoleRef = ePTI_Test_Tool
              DcmDspDidWrite:
                DcmDspDidWriteSessionRef = Development
                DcmDspDidWriteRoleRef = Supplier
                DcmDspDidWriteRoleRef = Development_ENHANCED
                DcmDspDidWriteRoleRef = Production
                DcmDspDidWriteRoleRef = After_Sales_ENHANCED
                DcmDspDidWriteRoleRef = After_Sales_STANDARD
          DidInfo_Measurement_Frame_Block_12_Config_Read
            DcmDspDidAccess
              DcmDspDidRead: DcmDspDidReadSessionRef=Development
              DcmDspDidWrite:
                DcmDspDidWriteSessionRef = Development
                DcmDspDidWriteRoleRef = Supplier
                DcmDspDidWriteRoleRef = Development_ENHANCED
                DcmDspDidWriteRoleRef = Production
                DcmDspDidWriteRoleRef = After_Sales_ENHANCED
                DcmDspDidWriteRoleRef = After_Sales_STANDARD
          DidInfo_AEC_Status_Read
            DcmDspDidAccess
              DcmDspDidRead: DcmDspDidReadSessionRef=Development
          DidInfo_Measurement_Frames_Configuration_Read
            DcmDspDidAccess
              DcmDspDidRead: DcmDspDidReadSessionRef=Development
              DcmDspDidWrite: DcmDspDidWriteSessionRef=Development, DcmDspDidWriteRoleRef=Supplier, DcmDspDidWriteRoleRef=Development_ENHANCED, DcmDspDidWriteRoleRef=Production
        24 x DcmDspRoutine:
          Routine_Check_Reprogramming_Preconditions_Start: DcmDspRequestResultsRoutineSupported=false, DcmDspStopRoutineSupported=false, DcmDspRoutineIdentifier=515, DcmDspRoutineInfoRef=RoutineInfo_Check_Reprogramming_Preconditions_Start
          Routine_PreCheckProgrammingDependencies_Start: DcmDspRequestResultsRoutineSupported=false, DcmDspStopRoutineSupported=false, DcmDspRoutineIdentifier=519, DcmDspRoutineInfoRef=RoutineInfo_PreCheckProgrammingDependencies_Start
          Routine_Clear_Resource_Consumption_Data_Start: DcmDspRequestResultsRoutineSupported=false, DcmDspStopRoutineSupported=false, DcmDspRoutineIdentifier=529, DcmDspRoutineInfoRef=RoutineInfo_Clear_Resource_Consumption_Data_Start
          Routine_Reset_VINDataIdentifier_Start: DcmDspRequestResultsRoutineSupported=false, DcmDspStopRoutineSupported=false, DcmDspRoutineIdentifier=530, DcmDspRoutineInfoRef=RoutineInfo_Reset_VINDataIdentifier_Start
          Routine_Synchronize_to_Non_volatile_Memory_Start: DcmDspRequestResultsRoutineSupported=true, DcmDspStopRoutineSupported=true, DcmDspRoutineIdentifier=581, DcmDspRoutineInfoRef=RoutineInfo_Synchronize_to_Non_volatile_Memory_Start
          Routine_Authenticate_Diagnostic_User_or_Tester_Start: DcmDspRequestResultsRoutineSupported=false, DcmDspStopRoutineSupported=false, DcmDspRoutineIdentifier=608, DcmDspRoutineInfoRef=RoutineInfo_Authenticate_Diagnostic_User_or_Tester_Start
          Routine_Enhance_Access_Rights_Start: DcmDspRequestResultsRoutineSupported=false, DcmDspStopRoutineSupported=false, DcmDspRoutineIdentifier=609, DcmDspRoutineInfoRef=RoutineInfo_Enhance_Access_Rights_Start
          Routine_Evaluate_Data_Verification_Certificate_Start: DcmDspRequestResultsRoutineSupported=false, DcmDspStopRoutineSupported=false, DcmDspRoutineIdentifier=610, DcmDspRoutineInfoRef=RoutineInfo_Evaluate_Data_Verification_Certificate_Start
          Routine_Verify_Signature_Start: DcmDspRequestResultsRoutineSupported=false, DcmDspStopRoutineSupported=false, DcmDspRoutineIdentifier=611, DcmDspRoutineInfoRef=RoutineInfo_Verify_Signature_Start
          Routine_Replace_Certificates_Start: DcmDspRequestResultsRoutineSupported=false, DcmDspStopRoutineSupported=false, DcmDspRoutineIdentifier=612, DcmDspRoutineInfoRef=RoutineInfo_Replace_Certificates_Start
          Routine_Synchronize_Secured_System_Date_and_Time_Start: DcmDspRequestResultsRoutineSupported=false, DcmDspStopRoutineSupported=false, DcmDspRoutineIdentifier=614, DcmDspRoutineInfoRef=RoutineInfo_Synchronize_Secured_System_Date_and_Time_Start
          Routine_Certificate_Self_Check_Start: DcmDspRequestResultsRoutineSupported=false, DcmDspStopRoutineSupported=false, DcmDspRoutineIdentifier=615, DcmDspRoutineInfoRef=RoutineInfo_Certificate_Self_Check_Start
          Routine_Status_of_Post_Production_Flag_Start: DcmDspRequestResultsRoutineSupported=true, DcmDspStopRoutineSupported=true, DcmDspRoutineIdentifier=616, DcmDspRoutineInfoRef=RoutineInfo_Status_of_Post_Production_Flag_Start
          Routine_Replace_Trust_model_Certificates_Start: DcmDspRequestResultsRoutineSupported=false, DcmDspStopRoutineSupported=false, DcmDspRoutineIdentifier=628, DcmDspRoutineInfoRef=RoutineInfo_Replace_Trust_model_Certificates_Start
          Routine_Replace_Trust_model_Root_Certificate_Start: DcmDspRequestResultsRoutineSupported=false, DcmDspStopRoutineSupported=false, DcmDspRoutineIdentifier=631, DcmDspRoutineInfoRef=RoutineInfo_Replace_Trust_model_Root_Certificate_Start
          Routine_Trust_Model_SecOC_ECU_Shared_Secret_Distribution_Start: DcmDspRequestResultsRoutineSupported=false, DcmDspStopRoutineSupported=false, DcmDspRoutineIdentifier=633, DcmDspRoutineInfoRef=RoutineInfo_Trust_Model_SecOC_ECU_Shared_Secret_Distribution_Start
          Routine_Trust_Model_Generate_Key_Pair_Start: DcmDspRequestResultsRoutineSupported=false, DcmDspStopRoutineSupported=false, DcmDspRoutineIdentifier=635, DcmDspRoutineInfoRef=RoutineInfo_Trust_Model_Generate_Key_Pair_Start
          Routine_Get_Certificate_Entry_Start: DcmDspRequestResultsRoutineSupported=false, DcmDspStopRoutineSupported=false, DcmDspRoutineIdentifier=637, DcmDspRoutineInfoRef=RoutineInfo_Get_Certificate_Entry_Start
          Routine_Trigger_Presafe_Display_Request_Start: DcmDspRequestResultsRoutineSupported=true, DcmDspStopRoutineSupported=true, DcmDspRoutineIdentifier=770, DcmDspRoutineInfoRef=RoutineInfo_Trigger_Presafe_Display_Request_Start
          Routine_Trigger_BSR_Start: DcmDspRequestResultsRoutineSupported=true, DcmDspStopRoutineSupported=true, DcmDspRoutineIdentifier=809, DcmDspRoutineInfoRef=RoutineInfo_Trigger_BSR_Start
          Routine_Trigger_Tensioning_Cycle_Start: DcmDspRequestResultsRoutineSupported=true, DcmDspStopRoutineSupported=true, DcmDspRoutineIdentifier=816, DcmDspRoutineInfoRef=RoutineInfo_Trigger_Tensioning_Cycle_Start
          Routine_Cycle_Execution_Start: DcmDspRequestResultsRoutineSupported=true, DcmDspStopRoutineSupported=true, DcmDspRoutineIdentifier=63235, DcmDspRoutineInfoRef=RoutineInfo_Cycle_Execution_Start
          Routine_Erase_All_Start: DcmDspRequestResultsRoutineSupported=false, DcmDspStopRoutineSupported=false, DcmDspRoutineIdentifier=63362, DcmDspRoutineInfoRef=RoutineInfo_Erase_All_Start
          Routine_Force_External_WDG_Start: DcmDspRequestResultsRoutineSupported=false, DcmDspStopRoutineSupported=false, DcmDspRoutineIdentifier=63377, DcmDspRoutineInfoRef=RoutineInfo_Force_External_WDG_Start
        24 x DcmDspRoutineInfo:
          RoutineInfo_Check_Reprogramming_Preconditions_Start
            DcmDspRoutineAuthorization:
              DcmDspRoutineSessionRef = DcmDspSession/Programming
              DcmDspRoutineSessionRef = DcmDspSession/Extended
              DcmDspRoutineSessionRef = Development
              DcmDspRoutineRoleRef = Supplier
              DcmDspRoutineRoleRef = Development_ENHANCED
              DcmDspRoutineRoleRef = Production
              DcmDspRoutineRoleRef = After_Sales_ENHANCED
            DcmDspStartRoutineOut
              3 x DcmDspStartRoutineOutSignal:
                routineInfo: DcmDspRoutineSignalLength=8, DcmDspRoutineSignalType=UINT8, DcmDspRoutineSignalPos=0
                Number_of_Unfulfilled_Preconditions: DcmDspRoutineSignalLength=8, DcmDspRoutineSignalType=UINT8, DcmDspRoutineSignalPos=8
                List_of_Preconditions: DcmDspRoutineSignalLength=800, DcmDspRoutineSignalType=VARIABLE_LENGTH, DcmDspRoutineSignalEndianness=opaque, DcmDspRoutineSignalPos=16
          RoutineInfo_PreCheckProgrammingDependencies_Start
            DcmDspRoutineAuthorization:
              DcmDspRoutineSessionRef = DcmDspSession/Programming
              DcmDspRoutineSessionRef = DcmDspSession/Extended
              DcmDspRoutineSessionRef = Development
              DcmDspRoutineRoleRef = Supplier
              DcmDspRoutineRoleRef = Development_ENHANCED
              DcmDspRoutineRoleRef = Production
              DcmDspRoutineRoleRef = After_Sales_ENHANCED
            DcmDspStartRoutineIn
              Pre_Check_Informations (DcmDspStartRoutineInSignal): DcmDspRoutineSignalLength=32512, DcmDspRoutineSignalType=VARIABLE_LENGTH, DcmDspRoutineSignalEndianness=opaque, DcmDspRoutineSignalPos=0
            DcmDspStartRoutineOut
              routineInfo (DcmDspStartRoutineOutSignal): DcmDspRoutineSignalLength=8, DcmDspRoutineSignalType=UINT8, DcmDspRoutineSignalPos=0
              Dependencies_Verification_Check_Result (DcmDspStartRoutineOutSignal): DcmDspRoutineSignalLength=8, DcmDspRoutineSignalType=UINT8, DcmDspRoutineSignalPos=8
          RoutineInfo_Clear_Resource_Consumption_Data_Start
            DcmDspRoutineAuthorization:
              DcmDspRoutineSessionRef = DcmDspSession/Extended
              DcmDspRoutineSessionRef = Development
              DcmDspRoutineRoleRef = Supplier
              DcmDspRoutineRoleRef = Development_ENHANCED
            DcmDspStartRoutineOut
              routineInfo (DcmDspStartRoutineOutSignal): DcmDspRoutineSignalLength=8, DcmDspRoutineSignalType=UINT8, DcmDspRoutineSignalPos=0
          RoutineInfo_Reset_VINDataIdentifier_Start
            DcmDspRoutineAuthorization:
              DcmDspRoutineSessionRef = DcmDspSession/Extended
              DcmDspRoutineSessionRef = Development
              DcmDspRoutineRoleRef = Supplier
              DcmDspRoutineRoleRef = Development_ENHANCED
            DcmDspStartRoutineOut
              routineInfo (DcmDspStartRoutineOutSignal): DcmDspRoutineSignalLength=8, DcmDspRoutineSignalType=UINT8, DcmDspRoutineSignalPos=0
          RoutineInfo_Synchronize_to_Non_volatile_Memory_Start
            DcmDspRoutineAuthorization:
              DcmDspRoutineSessionRef = DcmDspSession/Extended
              DcmDspRoutineSessionRef = Development
              DcmDspRoutineRoleRef = Supplier
              DcmDspRoutineRoleRef = Development_ENHANCED
              DcmDspRoutineRoleRef = Production
              DcmDspRoutineRoleRef = After_Sales_ENHANCED
              DcmDspRoutineRoleRef = After_Sales_STANDARD
            DcmDspStartRoutineOut
              routineInfo (DcmDspStartRoutineOutSignal): DcmDspRoutineSignalLength=8, DcmDspRoutineSignalType=UINT8, DcmDspRoutineSignalPos=0
            DcmDspRoutineStopOut
              routineInfo (DcmDspRoutineStopOutSignal): DcmDspRoutineSignalLength=8, DcmDspRoutineSignalType=UINT8, DcmDspRoutineSignalPos=0
            DcmDspRoutineRequestResOut
              routineInfo (DcmDspRoutineRequestResOutSignal): DcmDspRoutineSignalLength=8, DcmDspRoutineSignalType=UINT8, DcmDspRoutineSignalPos=0
          RoutineInfo_Authenticate_Diagnostic_User_or_Tester_Start
            DcmDspRoutineAuthorization
            DcmDspStartRoutineIn
              3 x DcmDspStartRoutineInSignal:
                Configuration: DcmDspRoutineSignalLength=8, DcmDspRoutineSignalType=UINT8, DcmDspRoutineSignalPos=0
                Task: DcmDspRoutineSignalLength=8, DcmDspRoutineSignalType=UINT8, DcmDspRoutineSignalPos=8
                Tester_Authentication: DcmDspRoutineSignalLength=32032, DcmDspRoutineSignalType=VARIABLE_LENGTH, DcmDspRoutineSignalEndianness=opaque, DcmDspRoutineSignalPos=16
            DcmDspStartRoutineOut
              3 x DcmDspStartRoutineOutSignal:
                routineInfo: DcmDspRoutineSignalLength=8, DcmDspRoutineSignalType=UINT8, DcmDspRoutineSignalPos=0
                Verification_Result: DcmDspRoutineSignalLength=8, DcmDspRoutineSignalType=UINT8, DcmDspRoutineSignalPos=8
                Authentication_Result: DcmDspRoutineSignalLength=24048, DcmDspRoutineSignalType=VARIABLE_LENGTH, DcmDspRoutineSignalEndianness=opaque, DcmDspRoutineSignalPos=16
          RoutineInfo_Enhance_Access_Rights_Start
            DcmDspRoutineAuthorization:
              DcmDspRoutineRoleRef = Supplier
              DcmDspRoutineRoleRef = Development_ENHANCED
              DcmDspRoutineRoleRef = Production
              DcmDspRoutineRoleRef = After_Sales_ENHANCED
              DcmDspRoutineRoleRef = After_Sales_STANDARD
              DcmDspRoutineRoleRef = After_Sales_BASIC
              DcmDspRoutineRoleRef = Internal_Diagnostic_Test_Tool
              DcmDspRoutineRoleRef = ePTI_Test_Tool
            DcmDspStartRoutineIn
              Enhanced_Rights_Certificate (DcmDspStartRoutineInSignal): DcmDspRoutineSignalLength=16016, DcmDspRoutineSignalType=VARIABLE_LENGTH, DcmDspRoutineSignalEndianness=opaque, DcmDspRoutineSignalPos=0
            DcmDspStartRoutineOut
              routineInfo (DcmDspStartRoutineOutSignal): DcmDspRoutineSignalLength=8, DcmDspRoutineSignalType=UINT8, DcmDspRoutineSignalPos=0
              Verification_Result (DcmDspStartRoutineOutSignal): DcmDspRoutineSignalLength=8, DcmDspRoutineSignalType=UINT8, DcmDspRoutineSignalPos=8
          RoutineInfo_Evaluate_Data_Verification_Certificate_Start
            DcmDspRoutineAuthorization:
              DcmDspRoutineSessionRef = DcmDspSession/Programming
              DcmDspRoutineSessionRef = DcmDspSession/Extended
              DcmDspRoutineSessionRef = Development
              DcmDspRoutineRoleRef = Supplier
              DcmDspRoutineRoleRef = Development_ENHANCED
              DcmDspRoutineRoleRef = Production
              DcmDspRoutineRoleRef = After_Sales_ENHANCED
            DcmDspStartRoutineIn
              Data_Verification_Certificate (DcmDspStartRoutineInSignal): DcmDspRoutineSignalLength=16016, DcmDspRoutineSignalType=VARIABLE_LENGTH, DcmDspRoutineSignalEndianness=opaque, DcmDspRoutineSignalPos=0
            DcmDspStartRoutineOut
              routineInfo (DcmDspStartRoutineOutSignal): DcmDspRoutineSignalLength=8, DcmDspRoutineSignalType=UINT8, DcmDspRoutineSignalPos=0
              Verification_Result (DcmDspStartRoutineOutSignal): DcmDspRoutineSignalLength=8, DcmDspRoutineSignalType=UINT8, DcmDspRoutineSignalPos=8
          RoutineInfo_Verify_Signature_Start
            DcmDspRoutineAuthorization:
              DcmDspRoutineSessionRef = DcmDspSession/Programming
              DcmDspRoutineSessionRef = DcmDspSession/Extended
              DcmDspRoutineSessionRef = Development
              DcmDspRoutineRoleRef = Supplier
              DcmDspRoutineRoleRef = Development_ENHANCED
              DcmDspRoutineRoleRef = Production
              DcmDspRoutineRoleRef = After_Sales_ENHANCED
            DcmDspStartRoutineIn
              Data_to_be_checked (DcmDspStartRoutineInSignal): DcmDspRoutineSignalLength=8, DcmDspRoutineSignalType=UINT8, DcmDspRoutineSignalPos=0
              Signature_Value (DcmDspStartRoutineInSignal): DcmDspRoutineSignalLength=512, DcmDspRoutineSignalType=UINT8_N, DcmDspRoutineSignalEndianness=opaque, DcmDspRoutineSignalPos=8
            DcmDspStartRoutineOut
              routineInfo (DcmDspStartRoutineOutSignal): DcmDspRoutineSignalLength=8, DcmDspRoutineSignalType=UINT8, DcmDspRoutineSignalPos=0
              Verification_Result (DcmDspStartRoutineOutSignal): DcmDspRoutineSignalLength=8, DcmDspRoutineSignalType=UINT8, DcmDspRoutineSignalPos=8
          RoutineInfo_Replace_Certificates_Start
            DcmDspRoutineAuthorization:
              DcmDspRoutineSessionRef = DcmDspSession/Programming
              DcmDspRoutineSessionRef = DcmDspSession/Extended
              DcmDspRoutineSessionRef = Development
              DcmDspRoutineRoleRef = Production
            DcmDspStartRoutineIn
              Certificates (DcmDspStartRoutineInSignal): DcmDspRoutineSignalLength=32064, DcmDspRoutineSignalType=VARIABLE_LENGTH, DcmDspRoutineSignalEndianness=opaque, DcmDspRoutineSignalPos=0
            DcmDspStartRoutineOut
              routineInfo (DcmDspStartRoutineOutSignal): DcmDspRoutineSignalLength=8, DcmDspRoutineSignalType=UINT8, DcmDspRoutineSignalPos=0
              Verification_Result (DcmDspStartRoutineOutSignal): DcmDspRoutineSignalLength=8, DcmDspRoutineSignalType=UINT8, DcmDspRoutineSignalPos=8
          RoutineInfo_Synchronize_Secured_System_Date_and_Time_Start
            DcmDspRoutineAuthorization
            DcmDspStartRoutineOut
              routineInfo (DcmDspStartRoutineOutSignal): DcmDspRoutineSignalLength=8, DcmDspRoutineSignalType=UINT8, DcmDspRoutineSignalPos=0
              Nonce (DcmDspStartRoutineOutSignal): DcmDspRoutineSignalLength=256, DcmDspRoutineSignalType=UINT8_N, DcmDspRoutineSignalEndianness=opaque, DcmDspRoutineSignalPos=8
          RoutineInfo_Certificate_Self_Check_Start
            DcmDspRoutineAuthorization
            DcmDspStartRoutineOut
              routineInfo (DcmDspStartRoutineOutSignal): DcmDspRoutineSignalLength=8, DcmDspRoutineSignalType=UINT8, DcmDspRoutineSignalPos=0
              Verification_Result (DcmDspStartRoutineOutSignal): DcmDspRoutineSignalLength=144, DcmDspRoutineSignalType=VARIABLE_LENGTH, DcmDspRoutineSignalEndianness=opaque, DcmDspRoutineSignalPos=8
          RoutineInfo_Status_of_Post_Production_Flag_Start
            DcmDspRoutineAuthorization: DcmDspRoutineSessionRef=DcmDspSession/Default, DcmDspRoutineSessionRef=DcmDspSession/Extended, DcmDspRoutineSessionRef=Development
            DcmDspStartRoutineIn
              In_Post_Production_Flag (DcmDspStartRoutineInSignal): DcmDspRoutineSignalLength=8, DcmDspRoutineSignalType=UINT8, DcmDspRoutineSignalPos=0
            DcmDspStartRoutineOut
              routineInfo (DcmDspStartRoutineOutSignal): DcmDspRoutineSignalLength=8, DcmDspRoutineSignalType=UINT8, DcmDspRoutineSignalPos=0
              Out_Post_Production_Flag (DcmDspStartRoutineOutSignal): DcmDspRoutineSignalLength=8, DcmDspRoutineSignalType=UINT8, DcmDspRoutineSignalPos=8
            DcmDspRoutineStopIn
              In_Post_Production_Flag (DcmDspRoutineStopInSignal): DcmDspRoutineSignalLength=8, DcmDspRoutineSignalType=UINT8, DcmDspRoutineSignalPos=0
            DcmDspRoutineStopOut
              routineInfo (DcmDspRoutineStopOutSignal): DcmDspRoutineSignalLength=8, DcmDspRoutineSignalType=UINT8, DcmDspRoutineSignalPos=0
              Out_Post_Production_Flag (DcmDspRoutineStopOutSignal): DcmDspRoutineSignalLength=8, DcmDspRoutineSignalType=UINT8, DcmDspRoutineSignalPos=8
            DcmDspRoutineRequestResOut
              routineInfo (DcmDspRoutineRequestResOutSignal): DcmDspRoutineSignalLength=8, DcmDspRoutineSignalType=UINT8, DcmDspRoutineSignalPos=0
              Post_Production_Flag (DcmDspRoutineRequestResOutSignal): DcmDspRoutineSignalLength=8, DcmDspRoutineSignalType=UINT8, DcmDspRoutineSignalPos=8
          RoutineInfo_Replace_Trust_model_Certificates_Start
            DcmDspRoutineAuthorization:
              DcmDspRoutineSessionRef = DcmDspSession/Programming
              DcmDspRoutineSessionRef = DcmDspSession/Extended
              DcmDspRoutineSessionRef = Development
              DcmDspRoutineRoleRef = Supplier
              DcmDspRoutineRoleRef = Development_ENHANCED
              DcmDspRoutineRoleRef = Production
              DcmDspRoutineRoleRef = After_Sales_ENHANCED
            DcmDspStartRoutineIn
              Trust_Certificates (DcmDspStartRoutineInSignal): DcmDspRoutineSignalLength=24048, DcmDspRoutineSignalType=VARIABLE_LENGTH, DcmDspRoutineSignalEndianness=opaque, DcmDspRoutineSignalPos=0
            DcmDspStartRoutineOut
              routineInfo (DcmDspStartRoutineOutSignal): DcmDspRoutineSignalLength=8, DcmDspRoutineSignalType=UINT8, DcmDspRoutineSignalPos=0
              Verification_Result (DcmDspStartRoutineOutSignal): DcmDspRoutineSignalLength=8, DcmDspRoutineSignalType=UINT8, DcmDspRoutineSignalPos=8
          RoutineInfo_Replace_Trust_model_Root_Certificate_Start
            DcmDspRoutineAuthorization:
              DcmDspRoutineSessionRef = DcmDspSession/Default
              DcmDspRoutineSessionRef = DcmDspSession/Extended
              DcmDspRoutineSessionRef = Development
              DcmDspRoutineRoleRef = Production
            DcmDspStartRoutineIn
              3 x DcmDspStartRoutineInSignal, all with DcmDspRoutineSignalEndianness=opaque:
                signature_new_Root: DcmDspRoutineSignalLength=512, DcmDspRoutineSignalType=UINT8_N, DcmDspRoutineSignalPos=0
                signature: DcmDspRoutineSignalLength=512, DcmDspRoutineSignalType=UINT8_N, DcmDspRoutineSignalPos=512
                Certificates: DcmDspRoutineSignalLength=16032, DcmDspRoutineSignalType=VARIABLE_LENGTH, DcmDspRoutineSignalPos=1024
            DcmDspStartRoutineOut
              routineInfo (DcmDspStartRoutineOutSignal): DcmDspRoutineSignalLength=8, DcmDspRoutineSignalType=UINT8, DcmDspRoutineSignalPos=0
              Verification_Result (DcmDspStartRoutineOutSignal): DcmDspRoutineSignalLength=8, DcmDspRoutineSignalType=UINT8, DcmDspRoutineSignalPos=8
          RoutineInfo_Trust_Model_SecOC_ECU_Shared_Secret_Distribution_Start
            DcmDspRoutineAuthorization:
              DcmDspRoutineSessionRef = DcmDspSession/Default
              DcmDspRoutineSessionRef = DcmDspSession/Extended
              DcmDspRoutineSessionRef = Development
              DcmDspRoutineRoleRef = Production
            DcmDspStartRoutineIn
              7 x DcmDspStartRoutineInSignal, all with DcmDspRoutineSignalEndianness=opaque:
                Date_and_Time: DcmDspRoutineSignalLength=56, DcmDspRoutineSignalType=UINT8_N, DcmDspRoutineSignalPos=0
                Tick_Count: DcmDspRoutineSignalLength=40, DcmDspRoutineSignalType=UINT8_N, DcmDspRoutineSignalPos=56
                Tick_Count_Offset: DcmDspRoutineSignalLength=40, DcmDspRoutineSignalType=UINT8_N, DcmDspRoutineSignalPos=96
                Encrypted_Nonce_and_Shared_Secret: DcmDspRoutineSignalLength=640, DcmDspRoutineSignalType=UINT8_N, DcmDspRoutineSignalPos=136
                Ephemeral_VSM_Public_Key: DcmDspRoutineSignalLength=256, DcmDspRoutineSignalType=UINT8_N, DcmDspRoutineSignalPos=776
                Data_Signature: DcmDspRoutineSignalLength=512, DcmDspRoutineSignalType=UINT8_N, DcmDspRoutineSignalPos=1032
                Certificates: DcmDspRoutineSignalLength=24048, DcmDspRoutineSignalType=VARIABLE_LENGTH, DcmDspRoutineSignalPos=1544
            DcmDspStartRoutineOut
              routineInfo (DcmDspStartRoutineOutSignal): DcmDspRoutineSignalLength=8, DcmDspRoutineSignalType=UINT8, DcmDspRoutineSignalPos=0
              Verification_Result (DcmDspStartRoutineOutSignal): DcmDspRoutineSignalLength=8, DcmDspRoutineSignalType=UINT8, DcmDspRoutineSignalPos=8
          RoutineInfo_Trust_Model_Generate_Key_Pair_Start
            DcmDspRoutineAuthorization: DcmDspRoutineSessionRef=DcmDspSession/Default, DcmDspRoutineSessionRef=DcmDspSession/Extended, DcmDspRoutineSessionRef=Development
            DcmDspStartRoutineOut
              4 x DcmDspStartRoutineOutSignal:
                routineInfo: DcmDspRoutineSignalLength=8, DcmDspRoutineSignalType=UINT8, DcmDspRoutineSignalPos=0
                Verification_Result: DcmDspRoutineSignalLength=8, DcmDspRoutineSignalType=UINT8, DcmDspRoutineSignalPos=8
                CSR_Signature: DcmDspRoutineSignalLength=512, DcmDspRoutineSignalType=UINT8_N, DcmDspRoutineSignalEndianness=opaque, DcmDspRoutineSignalPos=16
                Trust_Model_ECU_CSR: DcmDspRoutineSignalLength=8016, DcmDspRoutineSignalType=VARIABLE_LENGTH, DcmDspRoutineSignalEndianness=opaque, DcmDspRoutineSignalPos=528
          RoutineInfo_Get_Certificate_Entry_Start
            DcmDspRoutineAuthorization:
              DcmDspRoutineSessionRef = DcmDspSession/Extended
              DcmDspRoutineSessionRef = Development
              DcmDspRoutineRoleRef = Supplier
              DcmDspRoutineRoleRef = Development_ENHANCED
              DcmDspRoutineRoleRef = Production
              DcmDspRoutineRoleRef = After_Sales_ENHANCED
              DcmDspRoutineRoleRef = After_Sales_STANDARD
              DcmDspRoutineRoleRef = After_Sales_BASIC
              DcmDspRoutineRoleRef = Internal_Diagnostic_Test_Tool
              DcmDspRoutineRoleRef = ePTI_Test_Tool
            DcmDspStartRoutineIn
              In_Certificate_Identification (DcmDspStartRoutineInSignal): DcmDspRoutineSignalLength=8, DcmDspRoutineSignalType=UINT8, DcmDspRoutineSignalPos=0
              In_Certificate_Entry (DcmDspStartRoutineInSignal): DcmDspRoutineSignalLength=8, DcmDspRoutineSignalType=UINT8, DcmDspRoutineSignalPos=8
            DcmDspStartRoutineOut
              5 x DcmDspStartRoutineOutSignal:
                routineInfo: DcmDspRoutineSignalLength=8, DcmDspRoutineSignalType=UINT8, DcmDspRoutineSignalPos=0
                Verification_Result: DcmDspRoutineSignalLength=8, DcmDspRoutineSignalType=UINT8, DcmDspRoutineSignalPos=8
                Out_Certificate_Identification: DcmDspRoutineSignalLength=8, DcmDspRoutineSignalType=UINT8, DcmDspRoutineSignalPos=16
                Out_Certificate_Entry: DcmDspRoutineSignalLength=8, DcmDspRoutineSignalType=UINT8, DcmDspRoutineSignalPos=24
                Certificate_Content: DcmDspRoutineSignalLength=512, DcmDspRoutineSignalType=VARIABLE_LENGTH, DcmDspRoutineSignalEndianness=opaque, DcmDspRoutineSignalPos=32
          RoutineInfo_Trigger_Presafe_Display_Request_Start
            DcmDspRoutineAuthorization:
              DcmDspRoutineSessionRef = DcmDspSession/Extended
              DcmDspRoutineSessionRef = Development
              DcmDspRoutineRoleRef = Supplier
              DcmDspRoutineRoleRef = Development_ENHANCED
              DcmDspRoutineRoleRef = Production
              DcmDspRoutineRoleRef = After_Sales_ENHANCED
              DcmDspRoutineRoleRef = After_Sales_STANDARD
            DcmDspStartRoutineOut
              routineInfo (DcmDspStartRoutineOutSignal): DcmDspRoutineSignalLength=8, DcmDspRoutineSignalType=UINT8, DcmDspRoutineSignalPos=0
              Result (DcmDspStartRoutineOutSignal): DcmDspRoutineSignalLength=8, DcmDspRoutineSignalType=UINT8, DcmDspRoutineSignalPos=8
            DcmDspRoutineStopOut
              routineInfo (DcmDspRoutineStopOutSignal): DcmDspRoutineSignalLength=8, DcmDspRoutineSignalType=UINT8, DcmDspRoutineSignalPos=0
            DcmDspRoutineRequestResOut
              routineInfo (DcmDspRoutineRequestResOutSignal): DcmDspRoutineSignalLength=8, DcmDspRoutineSignalType=UINT8, DcmDspRoutineSignalPos=0
              Result (DcmDspRoutineRequestResOutSignal): DcmDspRoutineSignalLength=8, DcmDspRoutineSignalType=UINT8, DcmDspRoutineSignalPos=8
          RoutineInfo_Trigger_BSR_Start
            DcmDspRoutineAuthorization:
              DcmDspRoutineSessionRef = DcmDspSession/Extended
              DcmDspRoutineSessionRef = Development
              DcmDspRoutineRoleRef = Supplier
              DcmDspRoutineRoleRef = Development_ENHANCED
              DcmDspRoutineRoleRef = Production
              DcmDspRoutineRoleRef = After_Sales_ENHANCED
              DcmDspRoutineRoleRef = After_Sales_STANDARD
            DcmDspStartRoutineOut
              routineInfo (DcmDspStartRoutineOutSignal): DcmDspRoutineSignalLength=8, DcmDspRoutineSignalType=UINT8, DcmDspRoutineSignalPos=0
              Result (DcmDspStartRoutineOutSignal): DcmDspRoutineSignalLength=8, DcmDspRoutineSignalType=UINT8, DcmDspRoutineSignalPos=8
            DcmDspRoutineStopOut
              routineInfo (DcmDspRoutineStopOutSignal): DcmDspRoutineSignalLength=8, DcmDspRoutineSignalType=UINT8, DcmDspRoutineSignalPos=0
            DcmDspRoutineRequestResOut
              routineInfo (DcmDspRoutineRequestResOutSignal): DcmDspRoutineSignalLength=8, DcmDspRoutineSignalType=UINT8, DcmDspRoutineSignalPos=0
              Result (DcmDspRoutineRequestResOutSignal): DcmDspRoutineSignalLength=8, DcmDspRoutineSignalType=UINT8, DcmDspRoutineSignalPos=8
          RoutineInfo_Trigger_Tensioning_Cycle_Start
            DcmDspRoutineAuthorization:
              DcmDspRoutineSessionRef = DcmDspSession/Extended
              DcmDspRoutineSessionRef = Development
              DcmDspRoutineRoleRef = Supplier
              DcmDspRoutineRoleRef = Development_ENHANCED
              DcmDspRoutineRoleRef = Production
              DcmDspRoutineRoleRef = After_Sales_ENHANCED
              DcmDspRoutineRoleRef = After_Sales_STANDARD
            DcmDspStartRoutineIn
              Type_of_tensioning_cycle (DcmDspStartRoutineInSignal): DcmDspRoutineSignalLength=8, DcmDspRoutineSignalType=UINT8, DcmDspRoutineSignalPos=0
              PreSafe_Duration (DcmDspStartRoutineInSignal): DcmDspRoutineSignalLength=8, DcmDspRoutineSignalType=UINT8, DcmDspRoutineSignalPos=8
            DcmDspStartRoutineOut
              routineInfo (DcmDspStartRoutineOutSignal): DcmDspRoutineSignalLength=8, DcmDspRoutineSignalType=UINT8, DcmDspRoutineSignalPos=0
              Result (DcmDspStartRoutineOutSignal): DcmDspRoutineSignalLength=8, DcmDspRoutineSignalType=UINT8, DcmDspRoutineSignalPos=8
            DcmDspRoutineStopOut
              routineInfo (DcmDspRoutineStopOutSignal): DcmDspRoutineSignalLength=8, DcmDspRoutineSignalType=UINT8, DcmDspRoutineSignalPos=0
            DcmDspRoutineRequestResOut
              routineInfo (DcmDspRoutineRequestResOutSignal): DcmDspRoutineSignalLength=8, DcmDspRoutineSignalType=UINT8, DcmDspRoutineSignalPos=0
              Result (DcmDspRoutineRequestResOutSignal): DcmDspRoutineSignalLength=8, DcmDspRoutineSignalType=UINT8, DcmDspRoutineSignalPos=8
          RoutineInfo_Cycle_Execution_Start
            DcmDspRoutineAuthorization:
              DcmDspRoutineSessionRef = Development
              DcmDspRoutineRoleRef = Supplier
              DcmDspRoutineRoleRef = Development_ENHANCED
              DcmDspRoutineRoleRef = Production
              DcmDspRoutineRoleRef = After_Sales_ENHANCED
              DcmDspRoutineRoleRef = After_Sales_STANDARD
            DcmDspStartRoutineIn
              Cycle (DcmDspStartRoutineInSignal): DcmDspRoutineSignalLength=8, DcmDspRoutineSignalType=UINT8, DcmDspRoutineSignalPos=0
            DcmDspStartRoutineOut
              routineInfo (DcmDspStartRoutineOutSignal): DcmDspRoutineSignalLength=8, DcmDspRoutineSignalType=UINT8, DcmDspRoutineSignalPos=0
            DcmDspRoutineStopOut
              routineInfo (DcmDspRoutineStopOutSignal): DcmDspRoutineSignalLength=8, DcmDspRoutineSignalType=UINT8, DcmDspRoutineSignalPos=0
            DcmDspRoutineRequestResOut
              routineInfo (DcmDspRoutineRequestResOutSignal): DcmDspRoutineSignalLength=8, DcmDspRoutineSignalType=UINT8, DcmDspRoutineSignalPos=0
              Executed_Cycle (DcmDspRoutineRequestResOutSignal): DcmDspRoutineSignalLength=8, DcmDspRoutineSignalType=UINT8, DcmDspRoutineSignalPos=8
          RoutineInfo_Erase_All_Start
            DcmDspRoutineAuthorization:
              DcmDspRoutineSessionRef = Development
              DcmDspRoutineRoleRef = Supplier
              DcmDspRoutineRoleRef = Development_ENHANCED
              DcmDspRoutineRoleRef = Production
              DcmDspRoutineRoleRef = After_Sales_ENHANCED
              DcmDspRoutineRoleRef = After_Sales_STANDARD
            DcmDspStartRoutineOut
              routineInfo (DcmDspStartRoutineOutSignal): DcmDspRoutineSignalLength=8, DcmDspRoutineSignalType=UINT8, DcmDspRoutineSignalPos=0
              Status (DcmDspStartRoutineOutSignal): DcmDspRoutineSignalLength=8, DcmDspRoutineSignalType=UINT8, DcmDspRoutineSignalPos=8
          RoutineInfo_Force_External_WDG_Start
            DcmDspRoutineAuthorization:
              DcmDspRoutineSessionRef = Development
              DcmDspRoutineRoleRef = Supplier
              DcmDspRoutineRoleRef = Development_ENHANCED
              DcmDspRoutineRoleRef = Production
              DcmDspRoutineRoleRef = After_Sales_ENHANCED
              DcmDspRoutineRoleRef = After_Sales_STANDARD
            DcmDspStartRoutineOut
              routineInfo (DcmDspStartRoutineOutSignal): DcmDspRoutineSignalLength=8, DcmDspRoutineSignalType=UINT8, DcmDspRoutineSignalPos=0
              Status (DcmDspStartRoutineOutSignal): DcmDspRoutineSignalLength=8, DcmDspRoutineSignalType=UINT8, DcmDspRoutineSignalPos=8
        DcmDspAuthentication: DcmDspAuthenticationRoleSize=2, DcmDspAuthenticationDeauthenticatedRoleRef=Anybody
          9 x DcmDspAuthenticationRow:
            Anybody: DcmDspAuthenticationRoleBitPosition=0
            Supplier: DcmDspAuthenticationRoleBitPosition=1
            Development_ENHANCED: DcmDspAuthenticationRoleBitPosition=2
            Production: DcmDspAuthenticationRoleBitPosition=3
            After_Sales_ENHANCED: DcmDspAuthenticationRoleBitPosition=4
            After_Sales_STANDARD: DcmDspAuthenticationRoleBitPosition=5
            After_Sales_BASIC: DcmDspAuthenticationRoleBitPosition=6
            Internal_Diagnostic_Test_Tool: DcmDspAuthenticationRoleBitPosition=7
            ePTI_Test_Tool: DcmDspAuthenticationRoleBitPosition=8
        DcmDspSession
          4 x DcmDspSessionRow, all with DcmDspSessionP2ServerMax=0.02, DcmDspSessionP2StarServerMax=2:
            Default: DcmDspSessionLevel=1, DcmDspSessionForBoot=DCM_NO_BOOT
            Programming: DcmDspSessionLevel=2
            Extended: DcmDspSessionLevel=3, DcmDspSessionForBoot=DCM_NO_BOOT
            Development: DcmDspSessionLevel=126
        ComControl (DcmDspComControl)
          DspComContolAllChannel (DcmDspComControlAllChannel)
