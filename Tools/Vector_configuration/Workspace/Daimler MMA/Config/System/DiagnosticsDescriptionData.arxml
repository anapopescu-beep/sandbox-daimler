[part 2 of 2: package /InitialEcuC]
AUTOSAR XML (schema 00049)
package /InitialEcuC  (continued)
  module config Dem: module-description=Dem_Impl
    DemConfigSet
      DtcAttributes_41914fb7 (DemDTCAttributes): DemMemoryDestinationRef=PrimaryMemory
      DtcClass_DTC_0x164456 (DemDTCClass): DemDTCSeverity=DEM_DTC_SEV_NO_SEVERITY, DemUdsDTC=1459286, DemDTCAttributesRef=DtcAttributes_41914fb7
      DTC_0x164456 (DemEventParameter):
        DemEventKind = DEM_EVENT_KIND_SWC
        DemDTCClassRef = DtcClass_DTC_0x164456
        DemExtendedDataClassRef = ExtendedDataClass_dda5abf3
        DemFreezeFrameClassRef = FreezeFrame_8035c374
        DemFreezeFrameRecNumClassRef = FreezeFrameRecNum_bc8f2da9
        DemEventClass:
          DemAgingAllowed = true
          DemAgingCycleCounterThreshold = 100
          DemEventPriority = 2
          DemEventSignificance = DEM_EVENT_SIGNIFICANCE_FAULT
          DemEventFailureCycleCounterThreshold = 0
          DemAgingCycleRef = IgnitionCycle
          DemEnableConditionGroupRef = EnableConditionGroup_DEM_SL_NETWORK_COMM_NO_CLAMP15
          DemOperationCycleRef = PowerCycle
          DemDebounceAlgorithmClass
            DemDebounceCounterBased:
              DemDebounceCounterDecrementStepSize = 1
              DemDebounceCounterIncrementStepSize = 1
              DemDebounceCounterJumpDown = true
              DemDebounceCounterJumpUp = false
              DemDebounceCounterFailedThreshold = 127
              DemDebounceCounterPassedThreshold = -128
      DtcClass_DTC_0x1ca000 (DemDTCClass): DemDTCSeverity=DEM_DTC_SEV_NO_SEVERITY, DemUdsDTC=1875968, DemDTCAttributesRef=DtcAttributes_41914fb7
      DTC_0x1ca000 (DemEventParameter):
        DemEventKind = DEM_EVENT_KIND_SWC
        DemDTCClassRef = DtcClass_DTC_0x1ca000
        DemExtendedDataClassRef = ExtendedDataClass_dda5abf3
        DemFreezeFrameClassRef = FreezeFrame_8035c374
        DemFreezeFrameRecNumClassRef = FreezeFrameRecNum_bc8f2da9
        DemEventClass:
          DemAgingAllowed = true
          DemAgingCycleCounterThreshold = 1
          DemEventPriority = 2
          DemEventSignificance = DEM_EVENT_SIGNIFICANCE_FAULT
          DemEventFailureCycleCounterThreshold = 0
          DemAgingCycleRef = IgnitionCycle
          DemEnableConditionGroupRef = EnableConditionGroup_DEM_SL_ECU_LEVEL
          DemOperationCycleRef = PowerCycle
          DemDebounceAlgorithmClass
            DemDebounceCounterBased:
              DemDebounceCounterDecrementStepSize = 1
              DemDebounceCounterIncrementStepSize = 1
              DemDebounceCounterJumpDown = true
              DemDebounceCounterJumpUp = false
              DemDebounceCounterFailedThreshold = 127
              DemDebounceCounterPassedThreshold = -128
      DtcClass_DTC_0x9a6857 (DemDTCClass): DemDTCSeverity=DEM_DTC_SEV_NO_SEVERITY, DemUdsDTC=10119255, DemDTCAttributesRef=DtcAttributes_41914fb7
      DTC_0x9a6857 (DemEventParameter):
        DemEventKind = DEM_EVENT_KIND_SWC
        DemDTCClassRef = DtcClass_DTC_0x9a6857
        DemExtendedDataClassRef = ExtendedDataClass_dda5abf3
        DemFreezeFrameClassRef = FreezeFrame_8035c374
        DemFreezeFrameRecNumClassRef = FreezeFrameRecNum_bc8f2da9
        DemEventClass:
          DemAgingAllowed = true
          DemAgingCycleCounterThreshold = 100
          DemEventPriority = 2
          DemEventSignificance = DEM_EVENT_SIGNIFICANCE_FAULT
          DemEventFailureCycleCounterThreshold = 0
          DemAgingCycleRef = IgnitionCycle
          DemEnableConditionGroupRef = EnableConditionGroup_DEM_SL_NONE
          DemOperationCycleRef = PowerCycle
          DemDebounceAlgorithmClass
            DemDebounceCounterBased:
              DemDebounceCounterDecrementStepSize = 1
              DemDebounceCounterIncrementStepSize = 1
              DemDebounceCounterJumpDown = true
              DemDebounceCounterJumpUp = false
              DemDebounceCounterFailedThreshold = 127
              DemDebounceCounterPassedThreshold = -128
      DtcClass_DTC_0xa10a00 (DemDTCClass): DemDTCSeverity=DEM_DTC_SEV_NO_SEVERITY, DemUdsDTC=10553856, DemDTCAttributesRef=DtcAttributes_41914fb7
      DTC_0xa10a00 (DemEventParameter):
        DemEventKind = DEM_EVENT_KIND_SWC
        DemDTCClassRef = DtcClass_DTC_0xa10a00
        DemExtendedDataClassRef = ExtendedDataClass_dda5abf3
        DemFreezeFrameClassRef = FreezeFrame_8035c374
        DemFreezeFrameRecNumClassRef = FreezeFrameRecNum_bc8f2da9
        DemEventClass:
          DemAgingAllowed = true
          DemAgingCycleCounterThreshold = 100
          DemEventPriority = 2
          DemEventSignificance = DEM_EVENT_SIGNIFICANCE_OCCURRENCE
          DemEventFailureCycleCounterThreshold = 0
          DemAgingCycleRef = IgnitionCycle
          DemEnableConditionGroupRef = EnableConditionGroup_DEM_SL_POWER_DISTRIBUTION
          DemOperationCycleRef = PowerCycle
          DemDebounceAlgorithmClass
            DemDebounceCounterBased:
              DemDebounceCounterDecrementStepSize = 1
              DemDebounceCounterIncrementStepSize = 1
              DemDebounceCounterJumpDown = true
              DemDebounceCounterJumpUp = false
              DemDebounceCounterFailedThreshold = 127
              DemDebounceCounterPassedThreshold = -128
      DtcClass_DTC_0xa10b00 (DemDTCClass): DemDTCSeverity=DEM_DTC_SEV_NO_SEVERITY, DemUdsDTC=10554112, DemDTCAttributesRef=DtcAttributes_41914fb7
      DTC_0xa10b00 (DemEventParameter):
        DemEventKind = DEM_EVENT_KIND_SWC
        DemDTCClassRef = DtcClass_DTC_0xa10b00
        DemExtendedDataClassRef = ExtendedDataClass_dda5abf3
        DemFreezeFrameClassRef = FreezeFrame_8035c374
        DemFreezeFrameRecNumClassRef = FreezeFrameRecNum_bc8f2da9
        DemEventClass:
          DemAgingAllowed = true
          DemAgingCycleCounterThreshold = 100
          DemEventPriority = 2
          DemEventSignificance = DEM_EVENT_SIGNIFICANCE_OCCURRENCE
          DemEventFailureCycleCounterThreshold = 0
          DemAgingCycleRef = IgnitionCycle
          DemEnableConditionGroupRef = EnableConditionGroup_DEM_SL_POWER_DISTRIBUTION
          DemOperationCycleRef = PowerCycle
          DemDebounceAlgorithmClass
            DemDebounceCounterBased:
              DemDebounceCounterDecrementStepSize = 1
              DemDebounceCounterIncrementStepSize = 1
              DemDebounceCounterJumpDown = true
              DemDebounceCounterJumpUp = false
              DemDebounceCounterFailedThreshold = 127
              DemDebounceCounterPassedThreshold = -128
      DtcClass_DTC_0xa10d00 (DemDTCClass): DemDTCSeverity=DEM_DTC_SEV_NO_SEVERITY, DemUdsDTC=10554624, DemDTCAttributesRef=DtcAttributes_41914fb7
      DTC_0xa10d00 (DemEventParameter):
        DemEventKind = DEM_EVENT_KIND_SWC
        DemDTCClassRef = DtcClass_DTC_0xa10d00
        DemExtendedDataClassRef = ExtendedDataClass_dda5abf3
        DemFreezeFrameClassRef = FreezeFrame_8035c374
        DemFreezeFrameRecNumClassRef = FreezeFrameRecNum_bc8f2da9
        DemEventClass:
          DemAgingAllowed = true
          DemAgingCycleCounterThreshold = 100
          DemEventPriority = 2
          DemEventSignificance = DEM_EVENT_SIGNIFICANCE_OCCURRENCE
          DemEventFailureCycleCounterThreshold = 0
          DemAgingCycleRef = IgnitionCycle
          DemEnableConditionGroupRef = EnableConditionGroup_DEM_SL_POWER_DISTRIBUTION
          DemOperationCycleRef = PowerCycle
          DemDebounceAlgorithmClass
            DemDebounceCounterBased:
              DemDebounceCounterDecrementStepSize = 1
              DemDebounceCounterIncrementStepSize = 1
              DemDebounceCounterJumpDown = true
              DemDebounceCounterJumpUp = false
              DemDebounceCounterFailedThreshold = 127
              DemDebounceCounterPassedThreshold = -128
      DtcClass_DTC_0xa10e00 (DemDTCClass): DemDTCSeverity=DEM_DTC_SEV_NO_SEVERITY, DemUdsDTC=10554880, DemDTCAttributesRef=DtcAttributes_41914fb7
      DTC_0xa10e00 (DemEventParameter):
        DemEventKind = DEM_EVENT_KIND_SWC
        DemDTCClassRef = DtcClass_DTC_0xa10e00
        DemExtendedDataClassRef = ExtendedDataClass_dda5abf3
        DemFreezeFrameClassRef = FreezeFrame_8035c374
        DemFreezeFrameRecNumClassRef = FreezeFrameRecNum_bc8f2da9
        DemEventClass:
          DemAgingAllowed = true
          DemAgingCycleCounterThreshold = 100
          DemEventPriority = 2
          DemEventSignificance = DEM_EVENT_SIGNIFICANCE_OCCURRENCE
          DemEventFailureCycleCounterThreshold = 0
          DemAgingCycleRef = IgnitionCycle
          DemEnableConditionGroupRef = EnableConditionGroup_DEM_SL_POWER_DISTRIBUTION
          DemOperationCycleRef = PowerCycle
          DemDebounceAlgorithmClass
            DemDebounceCounterBased:
              DemDebounceCounterDecrementStepSize = 1
              DemDebounceCounterIncrementStepSize = 1
              DemDebounceCounterJumpDown = true
              DemDebounceCounterJumpUp = false
              DemDebounceCounterFailedThreshold = 127
              DemDebounceCounterPassedThreshold = -128
      DtcClass_DTC_0xa20400 (DemDTCClass): DemDTCSeverity=DEM_DTC_SEV_NO_SEVERITY, DemUdsDTC=10617856, DemDTCAttributesRef=DtcAttributes_41914fb7
      DTC_0xa20400 (DemEventParameter):
        DemEventKind = DEM_EVENT_KIND_SWC
        DemDTCClassRef = DtcClass_DTC_0xa20400
        DemExtendedDataClassRef = ExtendedDataClass_dda5abf3
        DemFreezeFrameClassRef = FreezeFrame_8035c374
        DemFreezeFrameRecNumClassRef = FreezeFrameRecNum_bc8f2da9
        DemEventClass:
          DemAgingAllowed = false
          DemAgingCycleCounterThreshold = 255
          DemEventPriority = 1
          DemEventSignificance = DEM_EVENT_SIGNIFICANCE_FAULT
          DemEventFailureCycleCounterThreshold = 0
          DemAgingCycleRef = IgnitionCycle
          DemEnableConditionGroupRef = EnableConditionGroup_DEM_SL_ECU_LEVEL
          DemOperationCycleRef = PowerCycle
          DemDebounceAlgorithmClass
            DemDebounceCounterBased:
              DemDebounceCounterDecrementStepSize = 127
              DemDebounceCounterIncrementStepSize = 127
              DemDebounceCounterJumpDown = true
              DemDebounceCounterJumpUp = false
              DemDebounceCounterFailedThreshold = 0
              DemDebounceCounterPassedThreshold = 0
          WarningIndicator (DemIndicatorAttribute):
            DemIndicatorFailureCycleSource = DEM_FAILURE_CYCLE_EVENT
            DemIndicatorHealingCycleCounterThreshold = 0
            DemIndicatorHealingCycleRef = PowerCycle
            DemIndicatorRef = DemGeneral/WarningIndicator
      DtcClass_DTC_0xa28b16 (DemDTCClass): DemDTCSeverity=DEM_DTC_SEV_NO_SEVERITY, DemUdsDTC=10652438, DemDTCAttributesRef=DtcAttributes_41914fb7
      DTC_0xa28b16 (DemEventParameter):
        DemEventKind = DEM_EVENT_KIND_SWC
        DemDTCClassRef = DtcClass_DTC_0xa28b16
        DemExtendedDataClassRef = ExtendedDataClass_dda5abf3
        DemFreezeFrameClassRef = FreezeFrame_8035c374
        DemFreezeFrameRecNumClassRef = FreezeFrameRecNum_bc8f2da9
        DemEventClass:
          DemAgingAllowed = true
          DemAgingCycleCounterThreshold = 100
          DemEventPriority = 2
          DemEventSignificance = DEM_EVENT_SIGNIFICANCE_OCCURRENCE
          DemEventFailureCycleCounterThreshold = 0
          DemAgingCycleRef = IgnitionCycle
          DemEnableConditionGroupRef = EnableConditionGroup_DEM_SL_POWER_DISTRIBUTION
          DemOperationCycleRef = PowerCycle
          DemDebounceAlgorithmClass
            DemDebounceCounterBased:
              DemDebounceCounterDecrementStepSize = 127
              DemDebounceCounterIncrementStepSize = 43
              DemDebounceCounterJumpDown = true
              DemDebounceCounterJumpUp = false
              DemDebounceCounterFailedThreshold = 0
              DemDebounceCounterPassedThreshold = 0
      DtcClass_DTC_0xa28b17 (DemDTCClass): DemDTCSeverity=DEM_DTC_SEV_NO_SEVERITY, DemUdsDTC=10652439, DemDTCAttributesRef=DtcAttributes_41914fb7
      DTC_0xa28b17 (DemEventParameter):
        DemEventKind = DEM_EVENT_KIND_SWC
        DemDTCClassRef = DtcClass_DTC_0xa28b17
        DemExtendedDataClassRef = ExtendedDataClass_dda5abf3
        DemFreezeFrameClassRef = FreezeFrame_8035c374
        DemFreezeFrameRecNumClassRef = FreezeFrameRecNum_bc8f2da9
        DemEventClass:
          DemAgingAllowed = true
          DemAgingCycleCounterThreshold = 100
          DemEventPriority = 2
          DemEventSignificance = DEM_EVENT_SIGNIFICANCE_OCCURRENCE
          DemEventFailureCycleCounterThreshold = 0
          DemAgingCycleRef = IgnitionCycle
          DemEnableConditionGroupRef = EnableConditionGroup_DEM_SL_POWER_DISTRIBUTION
          DemOperationCycleRef = PowerCycle
          DemDebounceAlgorithmClass
            DemDebounceCounterBased:
              DemDebounceCounterDecrementStepSize = 127
              DemDebounceCounterIncrementStepSize = 43
              DemDebounceCounterJumpDown = true
              DemDebounceCounterJumpUp = false
              DemDebounceCounterFailedThreshold = 0
              DemDebounceCounterPassedThreshold = 0
      DtcClass_DTC_0xa28b45 (DemDTCClass): DemDTCSeverity=DEM_DTC_SEV_NO_SEVERITY, DemUdsDTC=10652485, DemDTCAttributesRef=DtcAttributes_41914fb7
      DTC_0xa28b45 (DemEventParameter):
        DemEventKind = DEM_EVENT_KIND_SWC
        DemDTCClassRef = DtcClass_DTC_0xa28b45
        DemExtendedDataClassRef = ExtendedDataClass_dda5abf3
        DemFreezeFrameClassRef = FreezeFrame_8035c374
        DemFreezeFrameRecNumClassRef = FreezeFrameRecNum_bc8f2da9
        DemEventClass:
          DemAgingAllowed = false
          DemAgingCycleCounterThreshold = 255
          DemEventPriority = 1
          DemEventSignificance = DEM_EVENT_SIGNIFICANCE_FAULT
          DemEventFailureCycleCounterThreshold = 0
          DemAgingCycleRef = IgnitionCycle
          DemEnableConditionGroupRef = EnableConditionGroup_DEM_SL_NONE
          DemOperationCycleRef = PowerCycle
          DemDebounceAlgorithmClass
            DemDebounceCounterBased:
              DemDebounceCounterDecrementStepSize = 127
              DemDebounceCounterIncrementStepSize = 127
              DemDebounceCounterJumpDown = true
              DemDebounceCounterJumpUp = false
              DemDebounceCounterFailedThreshold = 0
              DemDebounceCounterPassedThreshold = 0
          WarningIndicator (DemIndicatorAttribute):
            DemIndicatorFailureCycleSource = DEM_FAILURE_CYCLE_EVENT
            DemIndicatorHealingCycleCounterThreshold = 0
            DemIndicatorHealingCycleRef = PowerCycle
            DemIndicatorRef = DemGeneral/WarningIndicator
      DtcClass_DTC_0xa28b47 (DemDTCClass): DemDTCSeverity=DEM_DTC_SEV_NO_SEVERITY, DemUdsDTC=10652487, DemDTCAttributesRef=DtcAttributes_41914fb7
      DTC_0xa28b47 (DemEventParameter):
        DemEventKind = DEM_EVENT_KIND_SWC
        DemDTCClassRef = DtcClass_DTC_0xa28b47
        DemExtendedDataClassRef = ExtendedDataClass_dda5abf3
        DemFreezeFrameClassRef = FreezeFrame_8035c374
        DemFreezeFrameRecNumClassRef = FreezeFrameRecNum_bc8f2da9
        DemEventClass:
          DemAgingAllowed = false
          DemAgingCycleCounterThreshold = 255
          DemEventPriority = 1
          DemEventSignificance = DEM_EVENT_SIGNIFICANCE_OCCURRENCE
          DemEventFailureCycleCounterThreshold = 0
          DemAgingCycleRef = IgnitionCycle
          DemEnableConditionGroupRef = EnableConditionGroup_DEM_SL_NONE
          DemOperationCycleRef = PowerCycle
          DemDebounceAlgorithmClass
            DemDebounceCounterBased:
              DemDebounceCounterDecrementStepSize = 127
              DemDebounceCounterIncrementStepSize = 127
              DemDebounceCounterJumpDown = true
              DemDebounceCounterJumpUp = false
              DemDebounceCounterFailedThreshold = 0
              DemDebounceCounterPassedThreshold = 0
      DtcClass_DTC_0xa28b49 (DemDTCClass): DemDTCSeverity=DEM_DTC_SEV_NO_SEVERITY, DemUdsDTC=10652489, DemDTCAttributesRef=DtcAttributes_41914fb7
      DTC_0xa28b49 (DemEventParameter):
        DemEventKind = DEM_EVENT_KIND_SWC
        DemDTCClassRef = DtcClass_DTC_0xa28b49
        DemExtendedDataClassRef = ExtendedDataClass_dda5abf3
        DemFreezeFrameClassRef = FreezeFrame_8035c374
        DemFreezeFrameRecNumClassRef = FreezeFrameRecNum_bc8f2da9
        DemEventClass:
          DemAgingAllowed = false
          DemAgingCycleCounterThreshold = 255
          DemEventPriority = 1
          DemEventSignificance = DEM_EVENT_SIGNIFICANCE_FAULT
          DemEventFailureCycleCounterThreshold = 0
          DemAgingCycleRef = IgnitionCycle
          DemEnableConditionGroupRef = EnableConditionGroup_DEM_SL_ECU_LEVEL
          DemOperationCycleRef = PowerCycle
          DemDebounceAlgorithmClass
            DemDebounceCounterBased:
              DemDebounceCounterDecrementStepSize = 127
              DemDebounceCounterIncrementStepSize = 127
              DemDebounceCounterJumpDown = true
              DemDebounceCounterJumpUp = false
              DemDebounceCounterFailedThreshold = 0
              DemDebounceCounterPassedThreshold = 0
          WarningIndicator (DemIndicatorAttribute):
            DemIndicatorFailureCycleSource = DEM_FAILURE_CYCLE_EVENT
            DemIndicatorHealingCycleCounterThreshold = 0
            DemIndicatorHealingCycleRef = PowerCycle
            DemIndicatorRef = DemGeneral/WarningIndicator
      DtcClass_DTC_0xa28b4b (DemDTCClass): DemDTCSeverity=DEM_DTC_SEV_NO_SEVERITY, DemUdsDTC=10652491, DemDTCAttributesRef=DtcAttributes_41914fb7
      DTC_0xa28b4b (DemEventParameter):
        DemEventKind = DEM_EVENT_KIND_SWC
        DemDTCClassRef = DtcClass_DTC_0xa28b4b
        DemExtendedDataClassRef = ExtendedDataClass_dda5abf3
        DemFreezeFrameClassRef = FreezeFrame_8035c374
        DemFreezeFrameRecNumClassRef = FreezeFrameRecNum_bc8f2da9
        DemEventClass:
          DemAgingAllowed = true
          DemAgingCycleCounterThreshold = 100
          DemEventPriority = 2
          DemEventSignificance = DEM_EVENT_SIGNIFICANCE_OCCURRENCE
          DemEventFailureCycleCounterThreshold = 0
          DemAgingCycleRef = IgnitionCycle
          DemEnableConditionGroupRef = EnableConditionGroup_DEM_SL_ECU_LEVEL
          DemOperationCycleRef = PowerCycle
          DemDebounceAlgorithmClass
            DemDebounceCounterBased:
              DemDebounceCounterDecrementStepSize = 127
              DemDebounceCounterIncrementStepSize = 127
              DemDebounceCounterJumpDown = true
              DemDebounceCounterJumpUp = false
              DemDebounceCounterFailedThreshold = 0
              DemDebounceCounterPassedThreshold = 0
          WarningIndicator (DemIndicatorAttribute):
            DemIndicatorFailureCycleSource = DEM_FAILURE_CYCLE_EVENT
            DemIndicatorHealingCycleCounterThreshold = 0
            DemIndicatorHealingCycleRef = PowerCycle
            DemIndicatorRef = DemGeneral/WarningIndicator
      DtcClass_DTC_0xa28b71 (DemDTCClass): DemDTCSeverity=DEM_DTC_SEV_NO_SEVERITY, DemUdsDTC=10652529, DemDTCAttributesRef=DtcAttributes_41914fb7
      DTC_0xa28b71 (DemEventParameter):
        DemEventKind = DEM_EVENT_KIND_SWC
        DemDTCClassRef = DtcClass_DTC_0xa28b71
        DemExtendedDataClassRef = ExtendedDataClass_dda5abf3
        DemFreezeFrameClassRef = FreezeFrame_8035c374
        DemFreezeFrameRecNumClassRef = FreezeFrameRecNum_bc8f2da9
        DemEventClass:
          DemAgingAllowed = false
          DemAgingCycleCounterThreshold = 255
          DemEventPriority = 1
          DemEventSignificance = DEM_EVENT_SIGNIFICANCE_FAULT
          DemEventFailureCycleCounterThreshold = 0
          DemAgingCycleRef = IgnitionCycle
          DemEnableConditionGroupRef = EnableConditionGroup_DEM_SL_ECU_LEVEL
          DemOperationCycleRef = PowerCycle
          DemDebounceAlgorithmClass
            DemDebounceCounterBased:
              DemDebounceCounterDecrementStepSize = 127
              DemDebounceCounterIncrementStepSize = 127
              DemDebounceCounterJumpDown = true
              DemDebounceCounterJumpUp = false
              DemDebounceCounterFailedThreshold = 0
              DemDebounceCounterPassedThreshold = 0
          WarningIndicator (DemIndicatorAttribute):
            DemIndicatorFailureCycleSource = DEM_FAILURE_CYCLE_EVENT
            DemIndicatorHealingCycleCounterThreshold = 0
            DemIndicatorHealingCycleRef = PowerCycle
            DemIndicatorRef = DemGeneral/WarningIndicator
      DtcClass_DTC_0xa28b96 (DemDTCClass): DemDTCSeverity=DEM_DTC_SEV_NO_SEVERITY, DemUdsDTC=10652566, DemDTCAttributesRef=DtcAttributes_41914fb7
      DTC_0xa28b96 (DemEventParameter):
        DemEventKind = DEM_EVENT_KIND_SWC
        DemDTCClassRef = DtcClass_DTC_0xa28b96
        DemExtendedDataClassRef = ExtendedDataClass_dda5abf3
        DemFreezeFrameClassRef = FreezeFrame_8035c374
        DemFreezeFrameRecNumClassRef = FreezeFrameRecNum_bc8f2da9
        DemEventClass:
          DemAgingAllowed = false
          DemAgingCycleCounterThreshold = 255
          DemEventPriority = 1
          DemEventSignificance = DEM_EVENT_SIGNIFICANCE_FAULT
          DemEventFailureCycleCounterThreshold = 0
          DemAgingCycleRef = IgnitionCycle
          DemEnableConditionGroupRef = EnableConditionGroup_DEM_SL_ECU_LEVEL
          DemOperationCycleRef = PowerCycle
          DemDebounceAlgorithmClass
            DemDebounceCounterBased:
              DemDebounceCounterDecrementStepSize = 127
              DemDebounceCounterIncrementStepSize = 127
              DemDebounceCounterJumpDown = true
              DemDebounceCounterJumpUp = false
              DemDebounceCounterFailedThreshold = 0
              DemDebounceCounterPassedThreshold = 0
          WarningIndicator (DemIndicatorAttribute):
            DemIndicatorFailureCycleSource = DEM_FAILURE_CYCLE_EVENT
            DemIndicatorHealingCycleCounterThreshold = 0
            DemIndicatorHealingCycleRef = PowerCycle
            DemIndicatorRef = DemGeneral/WarningIndicator
      DtcClass_DTC_0xa28b97 (DemDTCClass): DemDTCSeverity=DEM_DTC_SEV_NO_SEVERITY, DemUdsDTC=10652567, DemDTCAttributesRef=DtcAttributes_41914fb7
      DTC_0xa28b97 (DemEventParameter):
        DemEventKind = DEM_EVENT_KIND_SWC
        DemDTCClassRef = DtcClass_DTC_0xa28b97
        DemExtendedDataClassRef = ExtendedDataClass_dda5abf3
        DemFreezeFrameClassRef = FreezeFrame_8035c374
        DemFreezeFrameRecNumClassRef = FreezeFrameRecNum_bc8f2da9
        DemEventClass:
          DemAgingAllowed = false
          DemAgingCycleCounterThreshold = 255
          DemEventPriority = 1
          DemEventSignificance = DEM_EVENT_SIGNIFICANCE_FAULT
          DemEventFailureCycleCounterThreshold = 0
          DemAgingCycleRef = IgnitionCycle
          DemEnableConditionGroupRef = EnableConditionGroup_DEM_SL_ECU_LEVEL
          DemOperationCycleRef = PowerCycle
          DemDebounceAlgorithmClass
            DemDebounceCounterBased:
              DemDebounceCounterDecrementStepSize = 127
              DemDebounceCounterIncrementStepSize = 127
              DemDebounceCounterJumpDown = true
              DemDebounceCounterJumpUp = false
              DemDebounceCounterFailedThreshold = 0
              DemDebounceCounterPassedThreshold = 0
      DtcClass_DTC_0xa28bfa (DemDTCClass): DemDTCSeverity=DEM_DTC_SEV_NO_SEVERITY, DemUdsDTC=10652666, DemDTCAttributesRef=DtcAttributes_41914fb7
      DTC_0xa28bfa (DemEventParameter):
        DemEventKind = DEM_EVENT_KIND_SWC
        DemDTCClassRef = DtcClass_DTC_0xa28bfa
        DemExtendedDataClassRef = ExtendedDataClass_dda5abf3
        DemFreezeFrameClassRef = FreezeFrame_8035c374
        DemFreezeFrameRecNumClassRef = FreezeFrameRecNum_bc8f2da9
        DemEventClass:
          DemAgingAllowed = false
          DemAgingCycleCounterThreshold = 255
          DemEventPriority = 1
          DemEventSignificance = DEM_EVENT_SIGNIFICANCE_OCCURRENCE
          DemEventFailureCycleCounterThreshold = 0
          DemAgingCycleRef = IgnitionCycle
          DemEnableConditionGroupRef = EnableConditionGroup_DEM_SL_ECU_LEVEL
          DemOperationCycleRef = PowerCycle
          DemDebounceAlgorithmClass
            DemDebounceCounterBased:
              DemDebounceCounterDecrementStepSize = 127
              DemDebounceCounterIncrementStepSize = 127
              DemDebounceCounterJumpDown = true
              DemDebounceCounterJumpUp = false
              DemDebounceCounterFailedThreshold = 0
              DemDebounceCounterPassedThreshold = 0
      DtcClass_DTC_0xc11587 (DemDTCClass): DemDTCSeverity=DEM_DTC_SEV_NO_SEVERITY, DemUdsDTC=12653959, DemDTCAttributesRef=DtcAttributes_41914fb7
      DTC_0xc11587 (DemEventParameter):
        DemEventKind = DEM_EVENT_KIND_SWC
        DemDTCClassRef = DtcClass_DTC_0xc11587
        DemExtendedDataClassRef = ExtendedDataClass_dda5abf3
        DemFreezeFrameClassRef = FreezeFrame_8035c374
        DemFreezeFrameRecNumClassRef = FreezeFrameRecNum_bc8f2da9
        DemEventClass:
          DemAgingAllowed = true
          DemAgingCycleCounterThreshold = 10
          DemEventPriority = 2
          DemEventSignificance = DEM_EVENT_SIGNIFICANCE_OCCURRENCE
          DemEventFailureCycleCounterThreshold = 0
          DemAgingCycleRef = IgnitionCycle
          DemEnableConditionGroupRef = EnableConditionGroup_DEM_SL_NETWORK_COMM_WITH_CLAMP15
          DemOperationCycleRef = PowerCycle
          DemDebounceAlgorithmClass
            DemDebounceCounterBased:
              DemDebounceCounterDecrementStepSize = 1
              DemDebounceCounterIncrementStepSize = 1
              DemDebounceCounterJumpDown = true
              DemDebounceCounterJumpUp = false
              DemDebounceCounterFailedThreshold = 127
              DemDebounceCounterPassedThreshold = -128
      DtcClass_DTC_0xc12287 (DemDTCClass): DemDTCSeverity=DEM_DTC_SEV_NO_SEVERITY, DemUdsDTC=12657287, DemDTCAttributesRef=DtcAttributes_41914fb7
      DTC_0xc12287 (DemEventParameter):
        DemEventKind = DEM_EVENT_KIND_SWC
        DemDTCClassRef = DtcClass_DTC_0xc12287
        DemExtendedDataClassRef = ExtendedDataClass_dda5abf3
        DemFreezeFrameClassRef = FreezeFrame_8035c374
        DemFreezeFrameRecNumClassRef = FreezeFrameRecNum_bc8f2da9
        DemEventClass:
          DemAgingAllowed = true
          DemAgingCycleCounterThreshold = 10
          DemEventPriority = 2
          DemEventSignificance = DEM_EVENT_SIGNIFICANCE_OCCURRENCE
          DemEventFailureCycleCounterThreshold = 0
          DemAgingCycleRef = IgnitionCycle
          DemEnableConditionGroupRef = EnableConditionGroup_DEM_SL_NETWORK_COMM_WITH_CLAMP15
          DemOperationCycleRef = PowerCycle
          DemDebounceAlgorithmClass
            DemDebounceCounterBased:
              DemDebounceCounterDecrementStepSize = 1
              DemDebounceCounterIncrementStepSize = 1
              DemDebounceCounterJumpDown = true
              DemDebounceCounterJumpUp = false
              DemDebounceCounterFailedThreshold = 127
              DemDebounceCounterPassedThreshold = -128
          WarningIndicator (DemIndicatorAttribute):
            DemIndicatorFailureCycleSource = DEM_FAILURE_CYCLE_EVENT
            DemIndicatorHealingCycleCounterThreshold = 100
            DemIndicatorHealingCycleRef = PowerCycle
            DemIndicatorRef = DemGeneral/WarningIndicator
      DtcClass_DTC_0xc15187 (DemDTCClass): DemDTCSeverity=DEM_DTC_SEV_NO_SEVERITY, DemUdsDTC=12669319, DemDTCAttributesRef=DtcAttributes_41914fb7
      DTC_0xc15187 (DemEventParameter):
        DemEventKind = DEM_EVENT_KIND_SWC
        DemDTCClassRef = DtcClass_DTC_0xc15187
        DemExtendedDataClassRef = ExtendedDataClass_dda5abf3
        DemFreezeFrameClassRef = FreezeFrame_8035c374
        DemFreezeFrameRecNumClassRef = FreezeFrameRecNum_bc8f2da9
        DemEventClass:
          DemAgingAllowed = true
          DemAgingCycleCounterThreshold = 10
          DemEventPriority = 2
          DemEventSignificance = DEM_EVENT_SIGNIFICANCE_OCCURRENCE
          DemEventFailureCycleCounterThreshold = 0
          DemAgingCycleRef = IgnitionCycle
          DemEnableConditionGroupRef = EnableConditionGroup_DEM_SL_NETWORK_COMM_WITH_CLAMP15
          DemOperationCycleRef = PowerCycle
          DemDebounceAlgorithmClass
            DemDebounceCounterBased:
              DemDebounceCounterDecrementStepSize = 1
              DemDebounceCounterIncrementStepSize = 1
              DemDebounceCounterJumpDown = true
              DemDebounceCounterJumpUp = false
              DemDebounceCounterFailedThreshold = 127
              DemDebounceCounterPassedThreshold = -128
          WarningIndicator (DemIndicatorAttribute):
            DemIndicatorFailureCycleSource = DEM_FAILURE_CYCLE_EVENT
            DemIndicatorHealingCycleCounterThreshold = 100
            DemIndicatorHealingCycleRef = PowerCycle
            DemIndicatorRef = DemGeneral/WarningIndicator
      DtcClass_DTC_0xc15587 (DemDTCClass): DemDTCSeverity=DEM_DTC_SEV_NO_SEVERITY, DemUdsDTC=12670343, DemDTCAttributesRef=DtcAttributes_41914fb7
      DTC_0xc15587 (DemEventParameter):
        DemEventKind = DEM_EVENT_KIND_SWC
        DemDTCClassRef = DtcClass_DTC_0xc15587
        DemExtendedDataClassRef = ExtendedDataClass_dda5abf3
        DemFreezeFrameClassRef = FreezeFrame_8035c374
        DemFreezeFrameRecNumClassRef = FreezeFrameRecNum_bc8f2da9
        DemEventClass:
          DemAgingAllowed = true
          DemAgingCycleCounterThreshold = 10
          DemEventPriority = 2
          DemEventSignificance = DEM_EVENT_SIGNIFICANCE_OCCURRENCE
          DemEventFailureCycleCounterThreshold = 0
          DemAgingCycleRef = IgnitionCycle
          DemEnableConditionGroupRef = EnableConditionGroup_DEM_SL_NETWORK_COMM_WITH_CLAMP15
          DemOperationCycleRef = PowerCycle
          DemDebounceAlgorithmClass
            DemDebounceCounterBased:
              DemDebounceCounterDecrementStepSize = 1
              DemDebounceCounterIncrementStepSize = 1
              DemDebounceCounterJumpDown = true
              DemDebounceCounterJumpUp = false
              DemDebounceCounterFailedThreshold = 127
              DemDebounceCounterPassedThreshold = -128
      DtcClass_DTC_0xc16887 (DemDTCClass): DemDTCSeverity=DEM_DTC_SEV_NO_SEVERITY, DemUdsDTC=12675207, DemDTCAttributesRef=DtcAttributes_41914fb7
      DTC_0xc16887 (DemEventParameter):
        DemEventKind = DEM_EVENT_KIND_SWC
        DemDTCClassRef = DtcClass_DTC_0xc16887
        DemExtendedDataClassRef = ExtendedDataClass_dda5abf3
        DemFreezeFrameClassRef = FreezeFrame_8035c374
        DemFreezeFrameRecNumClassRef = FreezeFrameRecNum_bc8f2da9
        DemEventClass:
          DemAgingAllowed = true
          DemAgingCycleCounterThreshold = 10
          DemEventPriority = 2
          DemEventSignificance = DEM_EVENT_SIGNIFICANCE_OCCURRENCE
          DemEventFailureCycleCounterThreshold = 0
          DemAgingCycleRef = IgnitionCycle
          DemEnableConditionGroupRef = EnableConditionGroup_DEM_SL_NETWORK_COMM_NO_CLAMP15
          DemOperationCycleRef = PowerCycle
          DemDebounceAlgorithmClass
            DemDebounceCounterBased:
              DemDebounceCounterDecrementStepSize = 1
              DemDebounceCounterIncrementStepSize = 1
              DemDebounceCounterJumpDown = true
              DemDebounceCounterJumpUp = false
              DemDebounceCounterFailedThreshold = 127
              DemDebounceCounterPassedThreshold = -128
      DtcClass_DTC_0xc20187 (DemDTCClass): DemDTCSeverity=DEM_DTC_SEV_NO_SEVERITY, DemUdsDTC=12714375, DemDTCAttributesRef=DtcAttributes_41914fb7
      DTC_0xc20187 (DemEventParameter):
        DemEventKind = DEM_EVENT_KIND_SWC
        DemDTCClassRef = DtcClass_DTC_0xc20187
        DemExtendedDataClassRef = ExtendedDataClass_dda5abf3
        DemFreezeFrameClassRef = FreezeFrame_8035c374
        DemFreezeFrameRecNumClassRef = FreezeFrameRecNum_bc8f2da9
        DemEventClass:
          DemAgingAllowed = true
          DemAgingCycleCounterThreshold = 10
          DemEventPriority = 2
          DemEventSignificance = DEM_EVENT_SIGNIFICANCE_OCCURRENCE
          DemEventFailureCycleCounterThreshold = 0
          DemAgingCycleRef = IgnitionCycle
          DemEnableConditionGroupRef = EnableConditionGroup_DEM_SL_NETWORK_COMM_WITH_CLAMP15
          DemOperationCycleRef = PowerCycle
          DemDebounceAlgorithmClass
            DemDebounceCounterBased:
              DemDebounceCounterDecrementStepSize = 1
              DemDebounceCounterIncrementStepSize = 1
              DemDebounceCounterJumpDown = true
              DemDebounceCounterJumpUp = false
              DemDebounceCounterFailedThreshold = 127
              DemDebounceCounterPassedThreshold = -128
      DtcClass_DTC_0xc20287 (DemDTCClass): DemDTCSeverity=DEM_DTC_SEV_NO_SEVERITY, DemUdsDTC=12714631, DemDTCAttributesRef=DtcAttributes_41914fb7
      DTC_0xc20287 (DemEventParameter):
        DemEventKind = DEM_EVENT_KIND_SWC
        DemDTCClassRef = DtcClass_DTC_0xc20287
        DemExtendedDataClassRef = ExtendedDataClass_dda5abf3
        DemFreezeFrameClassRef = FreezeFrame_8035c374
        DemFreezeFrameRecNumClassRef = FreezeFrameRecNum_bc8f2da9
        DemEventClass:
          DemAgingAllowed = true
          DemAgingCycleCounterThreshold = 10
          DemEventPriority = 2
          DemEventSignificance = DEM_EVENT_SIGNIFICANCE_OCCURRENCE
          DemEventFailureCycleCounterThreshold = 0
          DemAgingCycleRef = IgnitionCycle
          DemEnableConditionGroupRef = EnableConditionGroup_DEM_SL_NETWORK_COMM_WITH_CLAMP15
          DemOperationCycleRef = PowerCycle
          DemDebounceAlgorithmClass
            DemDebounceCounterBased:
              DemDebounceCounterDecrementStepSize = 1
              DemDebounceCounterIncrementStepSize = 1
              DemDebounceCounterJumpDown = true
              DemDebounceCounterJumpUp = false
              DemDebounceCounterFailedThreshold = 127
              DemDebounceCounterPassedThreshold = -128
      DtcClass_DTC_0xc41608 (DemDTCClass): DemDTCSeverity=DEM_DTC_SEV_NO_SEVERITY, DemUdsDTC=12850696, DemDTCAttributesRef=DtcAttributes_41914fb7
      DTC_0xc41608 (DemEventParameter):
        DemEventKind = DEM_EVENT_KIND_SWC
        DemDTCClassRef = DtcClass_DTC_0xc41608
        DemExtendedDataClassRef = ExtendedDataClass_dda5abf3
        DemFreezeFrameClassRef = FreezeFrame_8035c374
        DemFreezeFrameRecNumClassRef = FreezeFrameRecNum_bc8f2da9
        DemEventClass:
          DemAgingAllowed = true
          DemAgingCycleCounterThreshold = 10
          DemEventPriority = 2
          DemEventSignificance = DEM_EVENT_SIGNIFICANCE_OCCURRENCE
          DemEventFailureCycleCounterThreshold = 0
          DemAgingCycleRef = IgnitionCycle
          DemEnableConditionGroupRef = EnableConditionGroup_DEM_SL_NETWORK_COMM_WITH_CLAMP15
          DemOperationCycleRef = PowerCycle
          DemDebounceAlgorithmClass
            DemDebounceCounterBased:
              DemDebounceCounterDecrementStepSize = 1
              DemDebounceCounterIncrementStepSize = 1
              DemDebounceCounterJumpDown = true
              DemDebounceCounterJumpUp = false
              DemDebounceCounterFailedThreshold = 127
              DemDebounceCounterPassedThreshold = -128
          WarningIndicator (DemIndicatorAttribute):
            DemIndicatorFailureCycleSource = DEM_FAILURE_CYCLE_EVENT
            DemIndicatorHealingCycleCounterThreshold = 100
            DemIndicatorHealingCycleRef = PowerCycle
            DemIndicatorRef = DemGeneral/WarningIndicator
      DtcClass_DTC_0xc42708 (DemDTCClass): DemDTCSeverity=DEM_DTC_SEV_NO_SEVERITY, DemUdsDTC=12855048, DemDTCAttributesRef=DtcAttributes_41914fb7
      DTC_0xc42708 (DemEventParameter):
        DemEventKind = DEM_EVENT_KIND_SWC
        DemDTCClassRef = DtcClass_DTC_0xc42708
        DemExtendedDataClassRef = ExtendedDataClass_dda5abf3
        DemFreezeFrameClassRef = FreezeFrame_8035c374
        DemFreezeFrameRecNumClassRef = FreezeFrameRecNum_bc8f2da9
        DemEventClass:
          DemAgingAllowed = true
          DemAgingCycleCounterThreshold = 10
          DemEventPriority = 2
          DemEventSignificance = DEM_EVENT_SIGNIFICANCE_OCCURRENCE
          DemEventFailureCycleCounterThreshold = 0
          DemAgingCycleRef = IgnitionCycle
          DemEnableConditionGroupRef = EnableConditionGroup_DEM_SL_NETWORK_COMM_WITH_CLAMP15
          DemOperationCycleRef = PowerCycle
          DemDebounceAlgorithmClass
            DemDebounceCounterBased:
              DemDebounceCounterDecrementStepSize = 1
              DemDebounceCounterIncrementStepSize = 1
              DemDebounceCounterJumpDown = true
              DemDebounceCounterJumpUp = false
              DemDebounceCounterFailedThreshold = 127
              DemDebounceCounterPassedThreshold = -128
          WarningIndicator (DemIndicatorAttribute):
            DemIndicatorFailureCycleSource = DEM_FAILURE_CYCLE_EVENT
            DemIndicatorHealingCycleCounterThreshold = 100
            DemIndicatorHealingCycleRef = PowerCycle
            DemIndicatorRef = DemGeneral/WarningIndicator
      DtcClass_DTC_0xc44286 (DemDTCClass): DemDTCSeverity=DEM_DTC_SEV_NO_SEVERITY, DemUdsDTC=12862086, DemDTCAttributesRef=DtcAttributes_41914fb7
      DTC_0xc44286 (DemEventParameter):
        DemEventKind = DEM_EVENT_KIND_SWC
        DemDTCClassRef = DtcClass_DTC_0xc44286
        DemExtendedDataClassRef = ExtendedDataClass_dda5abf3
        DemFreezeFrameClassRef = FreezeFrame_8035c374
        DemFreezeFrameRecNumClassRef = FreezeFrameRecNum_bc8f2da9
        DemEventClass:
          DemAgingAllowed = true
          DemAgingCycleCounterThreshold = 10
          DemEventPriority = 2
          DemEventSignificance = DEM_EVENT_SIGNIFICANCE_OCCURRENCE
          DemEventFailureCycleCounterThreshold = 0
          DemAgingCycleRef = IgnitionCycle
          DemEnableConditionGroupRef = EnableConditionGroup_DEM_SL_NETWORK_COMM_WITH_CLAMP15
          DemOperationCycleRef = PowerCycle
          DemDebounceAlgorithmClass
            DemDebounceCounterBased:
              DemDebounceCounterDecrementStepSize = 1
              DemDebounceCounterIncrementStepSize = 1
              DemDebounceCounterJumpDown = true
              DemDebounceCounterJumpUp = false
              DemDebounceCounterFailedThreshold = 127
              DemDebounceCounterPassedThreshold = -128
      DtcClass_DTC_0xc45208 (DemDTCClass): DemDTCSeverity=DEM_DTC_SEV_NO_SEVERITY, DemUdsDTC=12866056, DemDTCAttributesRef=DtcAttributes_41914fb7
      DTC_0xc45208 (DemEventParameter):
        DemEventKind = DEM_EVENT_KIND_SWC
        DemDTCClassRef = DtcClass_DTC_0xc45208
        DemExtendedDataClassRef = ExtendedDataClass_dda5abf3
        DemFreezeFrameClassRef = FreezeFrame_8035c374
        DemFreezeFrameRecNumClassRef = FreezeFrameRecNum_bc8f2da9
        DemEventClass:
          DemAgingAllowed = true
          DemAgingCycleCounterThreshold = 10
          DemEventPriority = 2
          DemEventSignificance = DEM_EVENT_SIGNIFICANCE_OCCURRENCE
          DemEventFailureCycleCounterThreshold = 0
          DemAgingCycleRef = IgnitionCycle
          DemEnableConditionGroupRef = EnableConditionGroup_DEM_SL_NETWORK_COMM_WITH_CLAMP15
          DemOperationCycleRef = PowerCycle
          DemDebounceAlgorithmClass
            DemDebounceCounterBased:
              DemDebounceCounterDecrementStepSize = 1
              DemDebounceCounterIncrementStepSize = 1
              DemDebounceCounterJumpDown = true
              DemDebounceCounterJumpUp = false
              DemDebounceCounterFailedThreshold = 127
              DemDebounceCounterPassedThreshold = -128
          WarningIndicator (DemIndicatorAttribute):
            DemIndicatorFailureCycleSource = DEM_FAILURE_CYCLE_EVENT
            DemIndicatorHealingCycleCounterThreshold = 100
            DemIndicatorHealingCycleRef = PowerCycle
            DemIndicatorRef = DemGeneral/WarningIndicator
      DtcClass_DTC_0xd12081 (DemDTCClass): DemDTCSeverity=DEM_DTC_SEV_NO_SEVERITY, DemUdsDTC=13705345, DemDTCAttributesRef=DtcAttributes_41914fb7
      DTC_0xd12081 (DemEventParameter):
        DemEventKind = DEM_EVENT_KIND_SWC
        DemDTCClassRef = DtcClass_DTC_0xd12081
        DemExtendedDataClassRef = ExtendedDataClass_dda5abf3
        DemFreezeFrameClassRef = FreezeFrame_8035c374
        DemFreezeFrameRecNumClassRef = FreezeFrameRecNum_bc8f2da9
        DemEventClass:
          DemAgingAllowed = true
          DemAgingCycleCounterThreshold = 10
          DemEventPriority = 2
          DemEventSignificance = DEM_EVENT_SIGNIFICANCE_OCCURRENCE
          DemEventFailureCycleCounterThreshold = 0
          DemAgingCycleRef = IgnitionCycle
          DemEnableConditionGroupRef = EnableConditionGroup_DEM_SL_ECU_LEVEL
          DemOperationCycleRef = PowerCycle
          DemDebounceAlgorithmClass
            DemDebounceCounterBased:
              DemDebounceCounterDecrementStepSize = 1
              DemDebounceCounterIncrementStepSize = 1
              DemDebounceCounterJumpDown = true
              DemDebounceCounterJumpUp = false
              DemDebounceCounterFailedThreshold = 127
              DemDebounceCounterPassedThreshold = -128
      DtcClass_DTC_0xd12083 (DemDTCClass): DemDTCSeverity=DEM_DTC_SEV_NO_SEVERITY, DemUdsDTC=13705347, DemDTCAttributesRef=DtcAttributes_41914fb7
      DTC_0xd12083 (DemEventParameter):
        DemEventKind = DEM_EVENT_KIND_SWC
        DemDTCClassRef = DtcClass_DTC_0xd12083
        DemExtendedDataClassRef = ExtendedDataClass_dda5abf3
        DemFreezeFrameClassRef = FreezeFrame_b430d746
        DemFreezeFrameRecNumClassRef = FreezeFrameRecNum_bc8f2da9
        DemEventClass:
          DemAgingAllowed = true
          DemAgingCycleCounterThreshold = 10
          DemEventPriority = 2
          DemEventSignificance = DEM_EVENT_SIGNIFICANCE_OCCURRENCE
          DemEventFailureCycleCounterThreshold = 0
          DemAgingCycleRef = IgnitionCycle
          DemEnableConditionGroupRef = EnableConditionGroup_DEM_SL_ECU_LEVEL
          DemOperationCycleRef = PowerCycle
          DemDebounceAlgorithmClass
            DemDebounceCounterBased:
              DemDebounceCounterDecrementStepSize = 1
              DemDebounceCounterIncrementStepSize = 1
              DemDebounceCounterJumpDown = true
              DemDebounceCounterJumpUp = false
              DemDebounceCounterFailedThreshold = 127
              DemDebounceCounterPassedThreshold = -128
      DtcClass_DTC_0xd12087 (DemDTCClass): DemDTCSeverity=DEM_DTC_SEV_NO_SEVERITY, DemUdsDTC=13705351, DemDTCAttributesRef=DtcAttributes_41914fb7
      DTC_0xd12087 (DemEventParameter):
        DemEventKind = DEM_EVENT_KIND_SWC
        DemDTCClassRef = DtcClass_DTC_0xd12087
        DemExtendedDataClassRef = ExtendedDataClass_dda5abf3
        DemFreezeFrameClassRef = FreezeFrame_8035c374
        DemFreezeFrameRecNumClassRef = FreezeFrameRecNum_bc8f2da9
        DemEventClass:
          DemAgingAllowed = true
          DemAgingCycleCounterThreshold = 10
          DemEventPriority = 2
          DemEventSignificance = DEM_EVENT_SIGNIFICANCE_OCCURRENCE
          DemEventFailureCycleCounterThreshold = 0
          DemAgingCycleRef = IgnitionCycle
          DemEnableConditionGroupRef = EnableConditionGroup_DEM_SL_ECU_LEVEL
          DemOperationCycleRef = PowerCycle
          DemDebounceAlgorithmClass
            DemDebounceTimeBase: DemDebounceTimeFailedThreshold=3, DemDebounceTimePassedThreshold=0.01
      DtcClass_DTC_0xd22488 (DemDTCClass): DemDTCSeverity=DEM_DTC_SEV_NO_SEVERITY, DemUdsDTC=13771912, DemDTCAttributesRef=DtcAttributes_41914fb7
      DTC_0xd22488 (DemEventParameter):
        DemEventKind = DEM_EVENT_KIND_SWC
        DemDTCClassRef = DtcClass_DTC_0xd22488
        DemExtendedDataClassRef = ExtendedDataClass_dda5abf3
        DemFreezeFrameClassRef = FreezeFrame_8035c374
        DemFreezeFrameRecNumClassRef = FreezeFrameRecNum_bc8f2da9
        DemEventClass:
          DemAgingAllowed = true
          DemAgingCycleCounterThreshold = 100
          DemEventPriority = 2
          DemEventSignificance = DEM_EVENT_SIGNIFICANCE_FAULT
          DemEventFailureCycleCounterThreshold = 0
          DemAgingCycleRef = IgnitionCycle
          DemEnableConditionGroupRef = EnableConditionGroup_DEM_SL_POWER_DISTRIBUTION
          DemOperationCycleRef = PowerCycle
          DemDebounceAlgorithmClass
            DemDebounceCounterBased:
              DemDebounceCounterDecrementStepSize = 1
              DemDebounceCounterIncrementStepSize = 1
              DemDebounceCounterJumpDown = true
              DemDebounceCounterJumpUp = false
              DemDebounceCounterFailedThreshold = 127
              DemDebounceCounterPassedThreshold = -128
      DtcClass_DTC_0xd88987 (DemDTCClass): DemDTCSeverity=DEM_DTC_SEV_NO_SEVERITY, DemUdsDTC=14190983, DemDTCAttributesRef=DtcAttributes_41914fb7
      DTC_0xd88987 (DemEventParameter):
        DemEventKind = DEM_EVENT_KIND_SWC
        DemDTCClassRef = DtcClass_DTC_0xd88987
        DemExtendedDataClassRef = ExtendedDataClass_dda5abf3
        DemFreezeFrameClassRef = FreezeFrame_8035c374
        DemFreezeFrameRecNumClassRef = FreezeFrameRecNum_bc8f2da9
        DemEventClass:
          DemAgingAllowed = true
          DemAgingCycleCounterThreshold = 10
          DemEventPriority = 2
          DemEventSignificance = DEM_EVENT_SIGNIFICANCE_OCCURRENCE
          DemEventFailureCycleCounterThreshold = 0
          DemAgingCycleRef = IgnitionCycle
          DemEnableConditionGroupRef = EnableConditionGroup_DEM_SL_NETWORK_COMM_WITH_CLAMP15
          DemOperationCycleRef = PowerCycle
          DemDebounceAlgorithmClass
            DemDebounceCounterBased:
              DemDebounceCounterDecrementStepSize = 1
              DemDebounceCounterIncrementStepSize = 1
              DemDebounceCounterJumpDown = true
              DemDebounceCounterJumpUp = false
              DemDebounceCounterFailedThreshold = 127
              DemDebounceCounterPassedThreshold = -128
      DtcClass_DTC_0xd88a08 (DemDTCClass): DemDTCSeverity=DEM_DTC_SEV_NO_SEVERITY, DemUdsDTC=14191112, DemDTCAttributesRef=DtcAttributes_41914fb7
      DTC_0xd88a08 (DemEventParameter):
        DemEventKind = DEM_EVENT_KIND_SWC
        DemDTCClassRef = DtcClass_DTC_0xd88a08
        DemExtendedDataClassRef = ExtendedDataClass_dda5abf3
        DemFreezeFrameClassRef = FreezeFrame_8035c374
        DemFreezeFrameRecNumClassRef = FreezeFrameRecNum_bc8f2da9
        DemEventClass:
          DemAgingAllowed = true
          DemAgingCycleCounterThreshold = 10
          DemEventPriority = 2
          DemEventSignificance = DEM_EVENT_SIGNIFICANCE_OCCURRENCE
          DemEventFailureCycleCounterThreshold = 0
          DemAgingCycleRef = IgnitionCycle
          DemEnableConditionGroupRef = EnableConditionGroup_DEM_SL_NETWORK_COMM_WITH_CLAMP15
          DemOperationCycleRef = PowerCycle
          DemDebounceAlgorithmClass
            DemDebounceCounterBased:
              DemDebounceCounterDecrementStepSize = 1
              DemDebounceCounterIncrementStepSize = 1
              DemDebounceCounterJumpDown = true
              DemDebounceCounterJumpUp = false
              DemDebounceCounterFailedThreshold = 127
              DemDebounceCounterPassedThreshold = -128
    DemGeneral:
      DemAgingCycleCounterProcessing = DEM_PROCESS_AGINGCTR_INTERN
      DemDebounceCounterBasedSupport = true
      DemDebounceTimeBasedSupport = true
      DemEnableConditionSupport = true
      DemPTOSupport = false
      DemDtcStatusAvailabilityMask = 57
      DemEventMemorySet
        PrimaryMemory (DemPrimaryMemory): DemTypeOfFreezeFrameRecordNumeration=DEM_FF_RECNUM_CONFIGURED
      4 x DemDidClass:
        DID_Vehicle_Odometer_in_Low_Resolution_Read_0x10a: DemDidIdentifier=266, DemDidDataClassRef=Data_DID_0x10a_Vehicle_Odometer_in_Low_Resolution
        DID_Current_Operating_Time_Read_0x133: DemDidIdentifier=307, DemDidDataClassRef=Data_DID_0x133_Current_Operating_Time, DemDidDataClassRef=Data_DID_0x133_Operating_Time_Status
        DID_0x18b: DemDidIdentifier=395, DemDidDataClassRef=Data_DID_0x18b_SecOcDataID
        DID_0xfd05: DemDidIdentifier=64773, DemDidDataClassRef=Data_DID_0xfd05_Root_Causes
      5 x DemEnableCondition:
        DEM_SL_NETWORK_COMM_NO_CLAMP15
        DEM_SL_ECU_LEVEL
        DEM_SL_NONE
        DEM_SL_POWER_DISTRIBUTION
        DEM_SL_NETWORK_COMM_WITH_CLAMP15
      ExtendedDataClass_dda5abf3 (DemExtendedDataClass): DemExtendedDataRecordClassRef=ExtendedDataRecord_StandardEnvironmentData
      5 x DemEnableConditionGroup:
        EnableConditionGroup_DEM_SL_POWER_DISTRIBUTION: DemEnableConditionRef=DEM_SL_POWER_DISTRIBUTION
        EnableConditionGroup_DEM_SL_NETWORK_COMM_NO_CLAMP15: DemEnableConditionRef=DEM_SL_NETWORK_COMM_NO_CLAMP15
        EnableConditionGroup_DEM_SL_NONE: DemEnableConditionRef=DEM_SL_NONE
        EnableConditionGroup_DEM_SL_NETWORK_COMM_WITH_CLAMP15: DemEnableConditionRef=DEM_SL_NETWORK_COMM_WITH_CLAMP15
        EnableConditionGroup_DEM_SL_ECU_LEVEL: DemEnableConditionRef=DEM_SL_ECU_LEVEL
      ExtendedDataRecord_StandardEnvironmentData (DemExtendedDataRecordClass):
        DemExtendedDataRecordNumber = 1
        DemExtendedDataRecordTrigger = DEM_RECORD_TRIGGER_CONFIRMED
        DemExtendedDataRecordUpdate = DEM_UPDATE_RECORD_YES
        DemDataClassRef = Data_StandardEnvironmentData_Occurrence_Flag
        DemDataClassRef = Data_StandardEnvironmentData_External_Tester_Present_Flag
        DemDataClassRef = Data_StandardEnvironmentData_Frequency_Counter
        DemDataClassRef = Data_StandardEnvironmentData_Operation_Cycle_Counter
      FreezeFrame_8035c374 (DemFreezeFrameClass):
        DemDidClassRef = DID_Vehicle_Odometer_in_Low_Resolution_Read_0x10a
        DemDidClassRef = DID_Current_Operating_Time_Read_0x133
        DemDidClassRef = DID_0xfd05
      FreezeFrame_b430d746 (DemFreezeFrameClass):
        DemDidClassRef = DID_Vehicle_Odometer_in_Low_Resolution_Read_0x10a
        DemDidClassRef = DID_Current_Operating_Time_Read_0x133
        DemDidClassRef = DID_0x18b
        DemDidClassRef = DID_0xfd05
      FreezeFrameRecNum_bc8f2da9 (DemFreezeFrameRecNumClass):
        DemFreezeFrameRecordNumber = 16
        DemFreezeFrameRecordTrigger = DEM_RECORD_TRIGGER_CONFIRMED
        DemFreezeFrameRecordNumber = 32
        DemFreezeFrameRecordTrigger = DEM_RECORD_TRIGGER_TESTFAILED
      WarningIndicator (DemIndicator)
      IgnitionCycle (DemOperationCycle): DemOperationCycleType=DEM_OPCYC_IGNITION
      PowerCycle (DemOperationCycle): DemOperationCycleType=DEM_OPCYC_POWER
      9 x DemDataClass:
        Data_StandardEnvironmentData_External_Tester_Present_Flag: DemDataElementDataSize=1, DemDataElementDataType=UINT8, DemDataElementUsePort=USE_DATA_CLIENT_SERVER_PORT, DemDataElementStoreNonVolatile=true
        Data_DID_0x133_Operating_Time_Status: DemDataElementDataSize=1, DemDataElementDataType=UINT8, DemDataElementUsePort=USE_DATA_CLIENT_SERVER_PORT, DemDataElementStoreNonVolatile=true
        Data_DID_0xfd05_Root_Causes: DemDataElementDataSize=1, DemDataElementDataType=UINT8, DemDataElementUsePort=USE_DATA_CLIENT_SERVER_PORT, DemDataElementStoreNonVolatile=true
        Data_DID_0x10a_Vehicle_Odometer_in_Low_Resolution: DemDataElementDataSize=2, DemDataElementDataType=UINT16, DemDataElementEndianness=BIG_ENDIAN, DemDataElementUsePort=USE_DATA_CLIENT_SERVER_PORT, DemDataElementStoreNonVolatile=true
        Data_DID_0x133_Current_Operating_Time: DemDataElementDataSize=4, DemDataElementDataType=UINT32, DemDataElementEndianness=BIG_ENDIAN, DemDataElementUsePort=USE_DATA_CLIENT_SERVER_PORT, DemDataElementStoreNonVolatile=true
        Data_DID_0x18b_SecOcDataID: DemDataElementDataSize=2, DemDataElementDataType=UINT8_N, DemDataElementEndianness=opaque, DemDataElementUsePort=USE_DATA_CLIENT_SERVER_PORT, DemDataElementStoreNonVolatile=true
        Data_StandardEnvironmentData_Frequency_Counter: DemDataElementDataSize=1, DemDataElementInternalData=DEM_OCCCTR, DemDataElementUsePort=USE_DATA_INTERNAL
        Data_StandardEnvironmentData_Occurrence_Flag: DemDataElementDataSize=1, DemDataElementInternalData=DEM_SIGNIFICANCE, DemDataElementUsePort=USE_DATA_INTERNAL
        Data_StandardEnvironmentData_Operation_Cycle_Counter: DemDataElementDataSize=1, DemDataElementInternalData=DEM_AGINGCTR_UPCNT, DemDataElementUsePort=USE_DATA_INTERNAL
      RoELight (DemCallbackDTCStatusChanged)
