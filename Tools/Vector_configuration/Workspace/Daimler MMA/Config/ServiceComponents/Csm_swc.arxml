[part 1 of 2: packages /MICROSAR/Csm_swc/DataTypes to /MICROSAR/Csm_swc/Interfaces]
AUTOSAR XML (schema 00049)
package /MICROSAR/Csm_swc/DataTypes
  89 x impl type:
    Csm_ConfigIdType: range raw 0..65535, implementation-data-type=uint16  # The data type Csm_ConfigIdType identifies a configuration data set, which is unique within a service.
    Csm_DataPtr: category=DATA_REFERENCE, sw-pointer-target-props={target-category=TYPE_REFERENCE, implementation-data-type=uint8}
    Csm_const_DataPtr: category=DATA_REFERENCE, sw-pointer-target-props={target-category=TYPE_REFERENCE, implementation-data-type=uint8, sw-impl-policy=CONST}
    Csm_LengthPtr: category=DATA_REFERENCE, sw-pointer-target-props={target-category=TYPE_REFERENCE, implementation-data-type=uint32}
    Csm_VerifyResultPtr: category=DATA_REFERENCE, sw-pointer-target-props={target-category=TYPE_REFERENCE, implementation-data-type=Csm_VerifyResultType}
    Crypto_ResultType: compu {1=E_NOT_OK, 2=CRYPTO_E_BUSY, 4=CRYPTO_E_ENTROPY_EXHAUSTED, 6=CRYPTO_E_KEY_READ_FAIL, 7=CRYPTO_E_KEY_WRITE_FAIL, 8=CRYPTO_E_KEY_NOT_AVAILABLE, 9=CRYPTO_E_KEY_NOT_VALID, 10=CRYPTO_E_KEY_SIZE_MISMATCH, 12=CRYPTO_E_JOB_CANCELED, 13=CRYPTO_E_KEY_EMPTY}, range raw 0..13, implementation-data-type=uint8  # Return for Std_ReturnType for Cryptostack.
    dtRef_: implementation-data-type=uint8
    Csm_KeyDataType_Ssa_TickCount: category=ARRAY, sw-calibration-access=READ-ONLY  # Used as Buffer for service.
      element Csm_KeyDataType_Ssa_TickCountElement: array-size=16, array-size-semantics=FIXED-SIZE, implementation-data-type=uint8
    Csm_PublicValueDataType_Ssa_TickCount: category=ARRAY, sw-calibration-access=READ-ONLY  # Used as Buffer for service.
      element Csm_PublicValueDataType_Ssa_TickCountElement: array-size=16, array-size-semantics=FIXED-SIZE, implementation-data-type=uint8
    Csm_SeedDataTypeSsa_TickCount: category=ARRAY, sw-calibration-access=READ-ONLY  # Used as Buffer for service.
      element Csm_SeedDataTypeSsa_TickCountElement: array-size=16, array-size-semantics=FIXED-SIZE, implementation-data-type=uint8
    Csm_KeyDataType_Ssa_Authentication: category=ARRAY, sw-calibration-access=READ-ONLY  # Used as Buffer for service.
      element Csm_KeyDataType_Ssa_AuthenticationElement: array-size=16, array-size-semantics=FIXED-SIZE, implementation-data-type=uint8
    Csm_PublicValueDataType_Ssa_Authentication: category=ARRAY, sw-calibration-access=READ-ONLY  # Used as Buffer for service.
      element Csm_PublicValueDataType_Ssa_AuthenticationElement: array-size=16, array-size-semantics=FIXED-SIZE, implementation-data-type=uint8
    Csm_SeedDataTypeSsa_Authentication: category=ARRAY, sw-calibration-access=READ-ONLY  # Used as Buffer for service.
      element Csm_SeedDataTypeSsa_AuthenticationElement: array-size=16, array-size-semantics=FIXED-SIZE, implementation-data-type=uint8
    Csm_KeyDataType_Ssa_VIN: category=ARRAY, sw-calibration-access=READ-ONLY  # Used as Buffer for service.
      element Csm_KeyDataType_Ssa_VINElement: array-size=16, array-size-semantics=FIXED-SIZE, implementation-data-type=uint8
    Csm_PublicValueDataType_Ssa_VIN: category=ARRAY, sw-calibration-access=READ-ONLY  # Used as Buffer for service.
      element Csm_PublicValueDataType_Ssa_VINElement: array-size=16, array-size-semantics=FIXED-SIZE, implementation-data-type=uint8
    Csm_SeedDataTypeSsa_VIN: category=ARRAY, sw-calibration-access=READ-ONLY  # Used as Buffer for service.
      element Csm_SeedDataTypeSsa_VINElement: array-size=16, array-size-semantics=FIXED-SIZE, implementation-data-type=uint8
    Csm_KeyDataType_Ssa_RealTime: category=ARRAY, sw-calibration-access=READ-ONLY  # Used as Buffer for service.
      element Csm_KeyDataType_Ssa_RealTimeElement: array-size=16, array-size-semantics=FIXED-SIZE, implementation-data-type=uint8
    Csm_PublicValueDataType_Ssa_RealTime: category=ARRAY, sw-calibration-access=READ-ONLY  # Used as Buffer for service.
      element Csm_PublicValueDataType_Ssa_RealTimeElement: array-size=16, array-size-semantics=FIXED-SIZE, implementation-data-type=uint8
    Csm_SeedDataTypeSsa_RealTime: category=ARRAY, sw-calibration-access=READ-ONLY  # Used as Buffer for service.
      element Csm_SeedDataTypeSsa_RealTimeElement: array-size=16, array-size-semantics=FIXED-SIZE, implementation-data-type=uint8
    Csm_KeyDataType_Ssa_SharedSecretKeyExchange: category=ARRAY, sw-calibration-access=READ-ONLY  # Used as Buffer for service.
      element Csm_KeyDataType_Ssa_SharedSecretKeyExchangeElement: array-size=32, array-size-semantics=FIXED-SIZE, implementation-data-type=uint8
    Csm_PublicValueDataType_Ssa_SharedSecretKeyExchange: category=ARRAY, sw-calibration-access=READ-ONLY  # Used as Buffer for service.
      element Csm_PublicValueDataType_Ssa_SharedSecretKeyExchangeElement: array-size=32, array-size-semantics=FIXED-SIZE, implementation-data-type=uint8
    Csm_SeedDataTypeSsa_SharedSecretKeyExchange: category=ARRAY, sw-calibration-access=READ-ONLY  # Used as Buffer for service.
      element Csm_SeedDataTypeSsa_SharedSecretKeyExchangeElement: array-size=32, array-size-semantics=FIXED-SIZE, implementation-data-type=uint8
    Csm_KeyDataType_Ssa_AesRamKey: category=ARRAY, sw-calibration-access=READ-ONLY  # Used as Buffer for service.
      element Csm_KeyDataType_Ssa_AesRamKeyElement: array-size=16, array-size-semantics=FIXED-SIZE, implementation-data-type=uint8
    Csm_PublicValueDataType_Ssa_AesRamKey: category=ARRAY, sw-calibration-access=READ-ONLY  # Used as Buffer for service.
      element Csm_PublicValueDataType_Ssa_AesRamKeyElement: array-size=16, array-size-semantics=FIXED-SIZE, implementation-data-type=uint8
    Csm_SeedDataTypeSsa_AesRamKey: category=ARRAY, sw-calibration-access=READ-ONLY  # Used as Buffer for service.
      element Csm_SeedDataTypeSsa_AesRamKeyElement: array-size=16, array-size-semantics=FIXED-SIZE, implementation-data-type=uint8
    Csm_KeyDataType_Ssa_SharedSecretHash: category=ARRAY, sw-calibration-access=READ-ONLY  # Used as Buffer for service.
      element Csm_KeyDataType_Ssa_SharedSecretHashElement: array-size=4, array-size-semantics=FIXED-SIZE, implementation-data-type=uint8
    Csm_PublicValueDataType_Ssa_SharedSecretHash: category=ARRAY, sw-calibration-access=READ-ONLY  # Used as Buffer for service.
      element Csm_PublicValueDataType_Ssa_SharedSecretHashElement: array-size=4, array-size-semantics=FIXED-SIZE, implementation-data-type=uint8
    Csm_SeedDataTypeSsa_SharedSecretHash: category=ARRAY, sw-calibration-access=READ-ONLY  # Used as Buffer for service.
      element Csm_SeedDataTypeSsa_SharedSecretHashElement: array-size=4, array-size-semantics=FIXED-SIZE, implementation-data-type=uint8
    Csm_KeyDataType_Ssa_SignatureRamKey: category=ARRAY, sw-calibration-access=READ-ONLY  # Used as Buffer for service.
      element Csm_KeyDataType_Ssa_SignatureRamKeyElement: array-size=32, array-size-semantics=FIXED-SIZE, implementation-data-type=uint8
    Csm_PublicValueDataType_Ssa_SignatureRamKey: category=ARRAY, sw-calibration-access=READ-ONLY  # Used as Buffer for service.
      element Csm_PublicValueDataType_Ssa_SignatureRamKeyElement: array-size=32, array-size-semantics=FIXED-SIZE, implementation-data-type=uint8
    Csm_SeedDataTypeSsa_SignatureRamKey: category=ARRAY, sw-calibration-access=READ-ONLY  # Used as Buffer for service.
      element Csm_SeedDataTypeSsa_SignatureRamKeyElement: array-size=32, array-size-semantics=FIXED-SIZE, implementation-data-type=uint8
    Csm_KeyDataType_KeyM_SigVerifyKey_TrustModelEcuPeer: category=ARRAY, sw-calibration-access=READ-ONLY  # Used as Buffer for service.
      element Csm_KeyDataType_KeyM_SigVerifyKey_TrustModelEcuPeerElement: array-size=32, array-size-semantics=FIXED-SIZE, implementation-data-type=uint8
    Csm_PublicValueDataType_KeyM_SigVerifyKey_TrustModelEcuPeer: category=ARRAY, sw-calibration-access=READ-ONLY  # Used as Buffer for service.
      element Csm_PublicValueDataType_KeyM_SigVerifyKey_TrustModelEcuPeerElement: array-size=32, array-size-semantics=FIXED-SIZE, implementation-data-type=uint8
    Csm_SeedDataTypeKeyM_SigVerifyKey_TrustModelEcuPeer: category=ARRAY, sw-calibration-access=READ-ONLY  # Used as Buffer for service.
      element Csm_SeedDataTypeKeyM_SigVerifyKey_TrustModelEcuPeerElement: array-size=32, array-size-semantics=FIXED-SIZE, implementation-data-type=uint8
    Csm_KeyDataType_Ssa_SecurityAccessPublicKey: category=ARRAY, sw-calibration-access=READ-ONLY  # Used as Buffer for service.
      element Csm_KeyDataType_Ssa_SecurityAccessPublicKeyElement: array-size=32, array-size-semantics=FIXED-SIZE, implementation-data-type=uint8
    Csm_PublicValueDataType_Ssa_SecurityAccessPublicKey: category=ARRAY, sw-calibration-access=READ-ONLY  # Used as Buffer for service.
      element Csm_PublicValueDataType_Ssa_SecurityAccessPublicKeyElement: array-size=32, array-size-semantics=FIXED-SIZE, implementation-data-type=uint8
    Csm_SeedDataTypeSsa_SecurityAccessPublicKey: category=ARRAY, sw-calibration-access=READ-ONLY  # Used as Buffer for service.
      element Csm_SeedDataTypeSsa_SecurityAccessPublicKeyElement: array-size=32, array-size-semantics=FIXED-SIZE, implementation-data-type=uint8
    Csm_SignatureVerifyDataType_SigVerifyEd25519ph_SyncAsync: category=ARRAY, sw-calibration-access=READ-ONLY  # Used as Buffer for service.
      element Csm_SignatureVerifyDataType_SigVerifyEd25519ph_SyncAsyncElement: array-size=8192, array-size-semantics=FIXED-SIZE, implementation-data-type=uint8
    Csm_SignatureVerifyCompareType_SigVerifyEd25519ph_SyncAsync: category=ARRAY, sw-calibration-access=READ-ONLY  # Used as Buffer for service.
      element Csm_SignatureVerifyCompareType_SigVerifyEd25519ph_SyncAsyncElement: array-size=64, array-size-semantics=FIXED-SIZE, implementation-data-type=uint8
    Csm_HashDataType_Sha2_512: category=ARRAY, sw-calibration-access=READ-ONLY  # Used as Buffer for service.
      element Csm_HashDataType_Sha2_512Element: array-size=8192, array-size-semantics=FIXED-SIZE, implementation-data-type=uint8
    Csm_HashResultType_Sha2_512: category=ARRAY, sw-calibration-access=READ-ONLY  # Used as Buffer for service.
      element Csm_HashResultType_Sha2_512Element: array-size=64, array-size-semantics=FIXED-SIZE, implementation-data-type=uint8
    Csm_MacVerifyDataType_MacVerifyAesCmac: category=ARRAY, sw-calibration-access=READ-ONLY  # Used as Buffer for service.
      element Csm_MacVerifyDataType_MacVerifyAesCmacElement: array-size=27, array-size-semantics=FIXED-SIZE, implementation-data-type=uint8
    Csm_MacVerifyCompareType_MacVerifyAesCmac: category=ARRAY, sw-calibration-access=READ-ONLY  # Used as Buffer for service.
      element Csm_MacVerifyCompareType_MacVerifyAesCmacElement: array-size=8, array-size-semantics=FIXED-SIZE, implementation-data-type=uint8
    Csm_DecryptDataType_AES128Decrypt: category=ARRAY, sw-calibration-access=READ-ONLY  # Used as Buffer for service.
      element Csm_DecryptDataType_AES128DecryptElement: array-size=80, array-size-semantics=FIXED-SIZE, implementation-data-type=uint8
    Csm_DecryptResultType_AES128Decrypt: category=ARRAY, sw-calibration-access=READ-ONLY  # Used as Buffer for service.
      element Csm_DecryptResultType_AES128DecryptElement: array-size=80, array-size-semantics=FIXED-SIZE, implementation-data-type=uint8
    Csm_MacGenerateDataType_MacGenAesCmac: category=ARRAY, sw-calibration-access=READ-ONLY  # Used as Buffer for service.
      element Csm_MacGenerateDataType_MacGenAesCmacElement: array-size=27, array-size-semantics=FIXED-SIZE, implementation-data-type=uint8
    Csm_MacGenerateResultType_MacGenAesCmac: category=ARRAY, sw-calibration-access=READ-ONLY  # Used as Buffer for service.
      element Csm_MacGenerateResultType_MacGenAesCmacElement: array-size=16, array-size-semantics=FIXED-SIZE, implementation-data-type=uint8
    Csm_SignatureGenerateDataType_SigGenEd25519: category=ARRAY, sw-calibration-access=READ-ONLY  # Used as Buffer for service.
      element Csm_SignatureGenerateDataType_SigGenEd25519Element: array-size=129, array-size-semantics=FIXED-SIZE, implementation-data-type=uint8
    Csm_SignatureGenerateResultType_SigGenEd25519: category=ARRAY, sw-calibration-access=READ-ONLY  # Used as Buffer for service.
      element Csm_SignatureGenerateResultType_SigGenEd25519Element: array-size=64, array-size-semantics=FIXED-SIZE, implementation-data-type=uint8
    Csm_SignatureVerifyCompareType_SigVerifyEd25519_SSA: category=ARRAY, sw-calibration-access=READ-ONLY  # Used as Buffer for service.
      element Csm_SignatureVerifyCompareType_SigVerifyEd25519_SSAElement: array-size=64, array-size-semantics=FIXED-SIZE, implementation-data-type=uint8
    Csm_ResultType: compu {1=E_NOT_OK, 2=E_SMALL_BUFFER, 3=E_ENTROPY_EXHAUSTION, 4=E_KEY_READ_FAIL, 5=E_KEY_NOT_AVAILABLE, 6=E_KEY_NOT_VALID, 7=E_JOB_CANCELED, 8=E_KEY_EMPTY}, range raw 0..8, implementation-data-type=uint8  # Csm module specific return values for use in Std_ReturnType that could occur during asynchronous job processing.
    Csm_SignatureVerifyDataType_SigVerifyEd25519_SSA: category=ARRAY, sw-calibration-access=READ-ONLY  # Used as Buffer for service.
      element Csm_SignatureVerifyDataType_SigVerifyEd25519_SSAElement: array-size=8192, array-size-semantics=FIXED-SIZE, implementation-data-type=uint8
    Csm_KeyDataType_CsmKey_Ssa_TrustModelEcuPublic_LiveKey: category=ARRAY, sw-calibration-access=READ-ONLY  # Used as Buffer for service.
      element Csm_KeyDataType_CsmKey_Ssa_TrustModelEcuPublic_LiveKeyElement: array-size=32, array-size-semantics=FIXED-SIZE, implementation-data-type=uint8
    Csm_PublicValueDataType_CsmKey_Ssa_TrustModelEcuPublic_LiveKey: category=ARRAY, sw-calibration-access=READ-ONLY  # Used as Buffer for service.
      element Csm_PublicValueDataType_CsmKey_Ssa_TrustModelEcuPublic_LiveKeyElement: array-size=32, array-size-semantics=FIXED-SIZE, implementation-data-type=uint8
    Csm_SeedDataTypeCsmKey_Ssa_TrustModelEcuPublic_LiveKey: category=ARRAY, sw-calibration-access=READ-ONLY  # Used as Buffer for service.
      element Csm_SeedDataTypeCsmKey_Ssa_TrustModelEcuPublic_LiveKeyElement: array-size=32, array-size-semantics=FIXED-SIZE, implementation-data-type=uint8
    Csm_KeyDataType_CsmKey_Ssa_TrustModelEcuPublicCsr_StagingKey: category=ARRAY, sw-calibration-access=READ-ONLY  # Used as Buffer for service.
      element Csm_KeyDataType_CsmKey_Ssa_TrustModelEcuPublicCsr_StagingKeyElement: array-size=32, array-size-semantics=FIXED-SIZE, implementation-data-type=uint8
    Csm_PublicValueDataType_CsmKey_Ssa_TrustModelEcuPublicCsr_StagingKey: category=ARRAY, sw-calibration-access=READ-ONLY  # Used as Buffer for service.
      element Csm_PublicValueDataType_CsmKey_Ssa_TrustModelEcuPublicCsr_StagingKeyElement: array-size=32, array-size-semantics=FIXED-SIZE, implementation-data-type=uint8
    Csm_SeedDataTypeCsmKey_Ssa_TrustModelEcuPublicCsr_StagingKey: category=ARRAY, sw-calibration-access=READ-ONLY  # Used as Buffer for service.
      element Csm_SeedDataTypeCsmKey_Ssa_TrustModelEcuPublicCsr_StagingKeyElement: array-size=32, array-size-semantics=FIXED-SIZE, implementation-data-type=uint8
    Csm_KeyDataType_CsmKey_Ssa_TrustModelPrivateEcu_LiveKey: category=ARRAY, sw-calibration-access=READ-ONLY  # Used as Buffer for service.
      element Csm_KeyDataType_CsmKey_Ssa_TrustModelPrivateEcu_LiveKeyElement: array-size=32, array-size-semantics=FIXED-SIZE, implementation-data-type=uint8
    Csm_PublicValueDataType_CsmKey_Ssa_TrustModelPrivateEcu_LiveKey: category=ARRAY, sw-calibration-access=READ-ONLY  # Used as Buffer for service.
      element Csm_PublicValueDataType_CsmKey_Ssa_TrustModelPrivateEcu_LiveKeyElement: array-size=32, array-size-semantics=FIXED-SIZE, implementation-data-type=uint8
    Csm_SeedDataTypeCsmKey_Ssa_TrustModelPrivateEcu_LiveKey: category=ARRAY, sw-calibration-access=READ-ONLY  # Used as Buffer for service.
      element Csm_SeedDataTypeCsmKey_Ssa_TrustModelPrivateEcu_LiveKeyElement: array-size=32, array-size-semantics=FIXED-SIZE, implementation-data-type=uint8
    Csm_KeyDataType_CsmKey_Ssa_TrustModel_Ecu_CsrPrivateKey: category=ARRAY, sw-calibration-access=READ-ONLY  # Used as Buffer for service.
      element Csm_KeyDataType_CsmKey_Ssa_TrustModel_Ecu_CsrPrivateKeyElement: array-size=32, array-size-semantics=FIXED-SIZE, implementation-data-type=uint8
    Csm_PublicValueDataType_CsmKey_Ssa_TrustModel_Ecu_CsrPrivateKey: category=ARRAY, sw-calibration-access=READ-ONLY  # Used as Buffer for service.
      element Csm_PublicValueDataType_CsmKey_Ssa_TrustModel_Ecu_CsrPrivateKeyElement: array-size=32, array-size-semantics=FIXED-SIZE, implementation-data-type=uint8
    Csm_SeedDataTypeCsmKey_Ssa_TrustModel_Ecu_CsrPrivateKey: category=ARRAY, sw-calibration-access=READ-ONLY  # Used as Buffer for service.
      element Csm_SeedDataTypeCsmKey_Ssa_TrustModel_Ecu_CsrPrivateKeyElement: array-size=32, array-size-semantics=FIXED-SIZE, implementation-data-type=uint8
    Csm_KeyDataType_CsmKey_Ssa_TrustModel_Ecu_CsrPublicKey: category=ARRAY, sw-calibration-access=READ-ONLY  # Used as Buffer for service.
      element Csm_KeyDataType_CsmKey_Ssa_TrustModel_Ecu_CsrPublicKeyElement: array-size=32, array-size-semantics=FIXED-SIZE, implementation-data-type=uint8
    Csm_PublicValueDataType_CsmKey_Ssa_TrustModel_Ecu_CsrPublicKey: category=ARRAY, sw-calibration-access=READ-ONLY  # Used as Buffer for service.
      element Csm_PublicValueDataType_CsmKey_Ssa_TrustModel_Ecu_CsrPublicKeyElement: array-size=32, array-size-semantics=FIXED-SIZE, implementation-data-type=uint8
    Csm_SeedDataTypeCsmKey_Ssa_TrustModel_Ecu_CsrPublicKey: category=ARRAY, sw-calibration-access=READ-ONLY  # Used as Buffer for service.
      element Csm_SeedDataTypeCsmKey_Ssa_TrustModel_Ecu_CsrPublicKeyElement: array-size=32, array-size-semantics=FIXED-SIZE, implementation-data-type=uint8
    Csm_KeyDataType_CsmKey_Ssa_SignatureRamKey_replacementAuthority: category=ARRAY, sw-calibration-access=READ-ONLY  # Used as Buffer for service.
      element Csm_KeyDataType_CsmKey_Ssa_SignatureRamKey_replacementAuthorityElement: array-size=32, array-size-semantics=FIXED-SIZE, implementation-data-type=uint8
    Csm_PublicValueDataType_CsmKey_Ssa_SignatureRamKey_replacementAuthority: category=ARRAY, sw-calibration-access=READ-ONLY  # Used as Buffer for service.
      element Csm_PublicValueDataType_CsmKey_Ssa_SignatureRamKey_replacementAuthorityElement: array-size=32, array-size-semantics=FIXED-SIZE, implementation-data-type=uint8
    Csm_SeedDataTypeCsmKey_Ssa_SignatureRamKey_replacementAuthority: category=ARRAY, sw-calibration-access=READ-ONLY  # Used as Buffer for service.
      element Csm_SeedDataTypeCsmKey_Ssa_SignatureRamKey_replacementAuthorityElement: array-size=32, array-size-semantics=FIXED-SIZE, implementation-data-type=uint8
    Csm_KeyDataType_CsmKey_Ssa_TrustModelPrivateEcuUnique_StagingKey: category=ARRAY, sw-calibration-access=READ-ONLY  # Used as Buffer for service.
      element Csm_KeyDataType_CsmKey_Ssa_TrustModelPrivateEcuUnique_StagingKeyElement: array-size=32, array-size-semantics=FIXED-SIZE, implementation-data-type=uint8
    Csm_PublicValueDataType_CsmKey_Ssa_TrustModelPrivateEcuUnique_StagingKey: category=ARRAY, sw-calibration-access=READ-ONLY  # Used as Buffer for service.
      element Csm_PublicValueDataType_CsmKey_Ssa_TrustModelPrivateEcuUnique_StagingKeyElement: array-size=32, array-size-semantics=FIXED-SIZE, implementation-data-type=uint8
    Csm_SeedDataTypeCsmKey_Ssa_TrustModelPrivateEcuUnique_StagingKey: category=ARRAY, sw-calibration-access=READ-ONLY  # Used as Buffer for service.
      element Csm_SeedDataTypeCsmKey_Ssa_TrustModelPrivateEcuUnique_StagingKeyElement: array-size=32, array-size-semantics=FIXED-SIZE, implementation-data-type=uint8
    Csm_RandomGenerateResultType_Random_TRNG: category=ARRAY, sw-calibration-access=READ-ONLY  # Used as Buffer for service.
      element Csm_RandomGenerateResultType_Random_TRNGElement: array-size=32, array-size-semantics=FIXED-SIZE, implementation-data-type=uint8
    Csm_KeyDataType_Ssa_RandomSeed: category=ARRAY, sw-calibration-access=READ-ONLY  # Used as Buffer for service.
      element Csm_KeyDataType_Ssa_RandomSeedElement: array-size=209, array-size-semantics=FIXED-SIZE, implementation-data-type=uint8
    Csm_PublicValueDataType_Ssa_RandomSeed: category=ARRAY, sw-calibration-access=READ-ONLY  # Used as Buffer for service.
      element Csm_PublicValueDataType_Ssa_RandomSeedElement: array-size=209, array-size-semantics=FIXED-SIZE, implementation-data-type=uint8
    Csm_SeedDataTypeSsa_RandomSeed: category=ARRAY, sw-calibration-access=READ-ONLY  # Used as Buffer for service.
      element Csm_SeedDataTypeSsa_RandomSeedElement: array-size=209, array-size-semantics=FIXED-SIZE, implementation-data-type=uint8
    Csm_KeyDataType_Ssa_BackendCert: category=ARRAY, sw-calibration-access=READ-ONLY  # Used as Buffer for service.
      element Csm_KeyDataType_Ssa_BackendCertElement: array-size=600, array-size-semantics=FIXED-SIZE, implementation-data-type=uint8
    Csm_PublicValueDataType_Ssa_BackendCert: category=ARRAY, sw-calibration-access=READ-ONLY  # Used as Buffer for service.
      element Csm_PublicValueDataType_Ssa_BackendCertElement: array-size=600, array-size-semantics=FIXED-SIZE, implementation-data-type=uint8
    Csm_SeedDataTypeSsa_BackendCert: category=ARRAY, sw-calibration-access=READ-ONLY  # Used as Buffer for service.
      element Csm_SeedDataTypeSsa_BackendCertElement: array-size=600, array-size-semantics=FIXED-SIZE, implementation-data-type=uint8
    Csm_KeyDataType_Ssa_RootCert: category=ARRAY, sw-calibration-access=READ-ONLY  # Used as Buffer for service.
      element Csm_KeyDataType_Ssa_RootCertElement: array-size=600, array-size-semantics=FIXED-SIZE, implementation-data-type=uint8
    Csm_PublicValueDataType_Ssa_RootCert: category=ARRAY, sw-calibration-access=READ-ONLY  # Used as Buffer for service.
      element Csm_PublicValueDataType_Ssa_RootCertElement: array-size=600, array-size-semantics=FIXED-SIZE, implementation-data-type=uint8
    Csm_SeedDataTypeSsa_RootCert: category=ARRAY, sw-calibration-access=READ-ONLY  # Used as Buffer for service.
      element Csm_SeedDataTypeSsa_RootCertElement: array-size=600, array-size-semantics=FIXED-SIZE, implementation-data-type=uint8
    Csm_VerifyResultType: compu {0=CRYPTO_E_VER_OK, 1=CRYPTO_E_VER_NOT_OK}, range raw 0..1, implementation-data-type=uint8  # The data type Csm_VerifyResultType indicates the result of a verification operation.
    Crypto_OperationModeType: compu {1=CRYPTO_OPERATIONMODE_START, 2=CRYPTO_OPERATIONMODE_UPDATE, 3=CRYPTO_OPERATIONMODE_STREAMSTART, 4=CRYPTO_OPERATIONMODE_FINISH, 7=CRYPTO_OPERATIONMODE_SINGLECALL}, range raw 0..7, implementation-data-type=uint8  # Enum which operation shall be performed. This enum is constructed from a bit mask, where the first bit indicates “Start”, the second “Update” and the third “Finish”.
    Crypto_VerifyResultType: compu {0=CRYPTO_E_VER_OK, 1=CRYPTO_E_VER_NOT_OK}, range raw 0..1, implementation-data-type=uint8  # Enumeration of the result type of verification operations.
    Csm_KeyElementEnumType:  # Enum which lists the most common Crypto Key Elements IDs
      compu {1=CRYPTO_KE_MAC_KEY, 2=CRYPTO_KE_MAC_PROOF, 1=CRYPTO_KE_SIGNATURE_KEY, 29=CRYPTO_KE_SIGNATURE_CURVETYPE, 3=CRYPTO_KE_RANDOM_SEED_STATE, 4=CRYPTO_KE_RANDOM_ALGORITHM, 1=CRYPTO_KE_CIPHER_KEY, 5=CRYPTO_KE_CIPHER_IV, 6=CRYPTO_KE_CIPHER_PROOF, 7=CRYPTO_KE_CIPHER_2NDKEY, 8=CRYPTO_KE_KEYEXCHANGE_BASE, 9=CRYPTO_KE_KEYEXCHANGE_PRIVKEY, 10=CRYPTO_KE_KEYEXCHANGE_OWNPUBKEY, 1=CRYPTO_KE_KEYEXCHANGE_SHAREDVALUE, 1=CYRPTO_KE_KEYEXCHANGE_SHAREDVALUE, 12=CRYPTO_KE_KEYEXCHANGE_ALGORITHM, 29=CRYPTO_KE_KEYEXCHANGE_CURVETYPE, 1=CRYPTO_KE_KEYDERIVATION_PASSWORD, 13=CRYPTO_KE_KEYDERIVATION_SALT, 14=CRYPTO_KE_KEYDERIVATION_ITERATIONS, 15=CRYPTO_KE_KEYDERIVATION_ALGORITHM, 29=CRYPTO_KE_KEYDERIVATION_CURVETYPE, 1=CRYPTO_KE_KEYGENERATE_KEY, 16=CRYPTO_KE_KEYGENERATE_SEED, 17=CRYPTO_KE_KEYGENERATE_ALGORITHM, 29=CRYPTO_KE_KEYGENERATE_CURVETYPE, 0=CRYPTO_KE_CERTIFICATE_DATA, 18=CRYPTO_KE_CERTIFICATE_PARSING_FORMAT, 19=CRYPTO_KE_CERTIFICATE_CURRENT_TIME, 20=CRYPTO_KE_CERTIFICATE_VERSION, 21=CRYPTO_KE_CERTIFICATE_SERIALNUMBER, 22=CRYPTO_KE_CERTIFICATE_SIGNATURE_ALGORITHM, 23=CRYPTO_KE_CERTIFICATE_ISSUER, 24=CRYPTO_KE_CERTIFICATE_VALIDITY_NOT_BEFORE, 25=CRYPTO_KE_CERTIFICATE_VALIDITY_NOT_AFTER, 26=CRYPTO_KE_CERTIFICATE_SUBJECT, 1=CRYPTO_KE_CERTIFICATE_SUBJECT_PUBLIC_KEY, 27=CRYPTO_KE_CERTIFICATE_EXTENSIONS, 28=CRYPTO_KE_CERTIFICATE_SIGNATURE}
      range raw 0..4294967295
      implementation-data-type=uint32
    Csm_SignatureVerifyDataType_SigVerifyEd25519ph_SyncAsync_HWA: category=ARRAY, sw-calibration-access=READ-ONLY  # Used as Buffer for service.
      element Csm_SignatureVerifyDataType_SigVerifyEd25519ph_SyncAsync_HWAElement: array-size=8192, array-size-semantics=FIXED-SIZE, implementation-data-type=uint8
    Csm_SignatureVerifyCompareType_SigVerifyEd25519ph_SyncAsync_HWA: category=ARRAY, sw-calibration-access=READ-ONLY  # Used as Buffer for service.
      element Csm_SignatureVerifyCompareType_SigVerifyEd25519ph_SyncAsync_HWAElement: array-size=64, array-size-semantics=FIXED-SIZE, implementation-data-type=uint8
package /MICROSAR/Csm_swc/Interfaces
  29 x client server interface, all with is-service=true, service-kind=CRYPTO-SERVICE-MANAGER:
    CsmKeyManagement_Ssa_TickCount  # Interface to execute the key management functions.
      13 x operation:
        CertificateParse: possible-error=[CsmKeyManagement_Ssa_TickCount/E_NOT_OK, CsmKeyManagement_Ssa_TickCount/CSM_E_BUSY, CsmKeyManagement_Ssa_TickCount/CSM_E_KEY_EMPTY]  # This function shall dispatch the certificate parse function to the CRYIF.
        CertificateVerify: possible-error=[CsmKeyManagement_Ssa_TickCount/E_NOT_OK, CsmKeyManagement_Ssa_TickCount/CSM_E_BUSY, CsmKeyManagement_Ssa_TickCount/CSM_E_KEY_EMPTY]  # Verifies the certificate stored in the key referenced by verifyKeyId with the certificate stored in the key referenced by keyId. Note: Only certificates stored in the same Crypto Driver can be verified against each other. If the key element CRYPTO_KE_CERTIFICATE_CURRENT_TIME is used for the verification of the validity period of the certificate indentified by verifyKeyId, it shall have the same format as the timestamp in the certificate.
          arg verifyKeyId: type=uint32, direction=IN  # Holds the identifier of the key containing the certificate to be verified.
          arg verifyPtr: type=Crypto_VerifyResultType, direction=OUT  # Contains the result of the certificate verification.
        KeyCopy: possible-error=[CsmKeyManagement_Ssa_TickCount/E_NOT_OK, CsmKeyManagement_Ssa_TickCount/CSM_E_BUSY, CsmKeyManagement_Ssa_TickCount/CSM_E_SMALL_BUFFER, CsmKeyManagement_Ssa_TickCount/CSM_E_KEY_READ_FAIL, CsmKeyManagement_Ssa_TickCount/CSM_E_KEY_WRITE_FAIL, CsmKeyManagement_Ssa_TickCount/CSM_E_KEY_SIZE_MISMATCH, CsmKeyManagement_Ssa_TickCount/CSM_E_KEY_EMPTY]  # This function shall copy all key elements from the source key to a target key.
          arg targetKeyId: type=uint32, direction=IN  # Holds the identifier of the key whose key element shall be the destination element.
        KeyDerive: possible-error=[CsmKeyManagement_Ssa_TickCount/E_NOT_OK, CsmKeyManagement_Ssa_TickCount/CSM_E_BUSY, CsmKeyManagement_Ssa_TickCount/CSM_E_KEY_READ_FAIL, CsmKeyManagement_Ssa_TickCount/CSM_E_KEY_WRITE_FAIL, CsmKeyManagement_Ssa_TickCount/CSM_E_KEY_SIZE_MISMATCH, CsmKeyManagement_Ssa_TickCount/CSM_E_KEY_EMPTY]  # Derives a new key by using the key elements in the given key. The given key contains the key elements for the password and salt. The derived key is stored in the key element with the id 1 of the key identified by targetCryptoKeyId.
          arg targetKeyId: type=uint32, direction=IN  # Holds the identifier of the key which is used to store the derived key.
        KeyElementCopy: possible-error=[CsmKeyManagement_Ssa_TickCount/E_NOT_OK, CsmKeyManagement_Ssa_TickCount/CSM_E_BUSY, CsmKeyManagement_Ssa_TickCount/CSM_E_SMALL_BUFFER, CsmKeyManagement_Ssa_TickCount/CSM_E_KEY_READ_FAIL, CsmKeyManagement_Ssa_TickCount/CSM_E_KEY_WRITE_FAIL, CsmKeyManagement_Ssa_TickCount/CSM_E_KEY_SIZE_MISMATCH, CsmKeyManagement_Ssa_TickCount/CSM_E_KEY_EMPTY]  # This function shall copy a key elements from one key to a target key.
          arg keyElementId: type=uint32, direction=IN  # Holds the identifier of the key element which shall be the source for the copy operation.
          arg targetKeyId: type=uint32, direction=IN  # Holds the identifier of the key whose key element shall be the destination element.
          arg targetKeyElementId: type=uint32, direction=IN  # Holds the identifier of the key element which shall be the destination for the copy operation.
        KeyElementCopyPartial: possible-error=[CsmKeyManagement_Ssa_TickCount/E_NOT_OK, CsmKeyManagement_Ssa_TickCount/CSM_E_BUSY, CsmKeyManagement_Ssa_TickCount/CSM_E_KEY_NOT_AVAILABLE, CsmKeyManagement_Ssa_TickCount/CSM_E_KEY_READ_FAIL, CsmKeyManagement_Ssa_TickCount/CSM_E_KEY_WRITE_FAIL, CsmKeyManagement_Ssa_TickCount/CSM_E_KEY_SIZE_MISMATCH, CsmKeyManagement_Ssa_TickCount/CSM_E_KEY_EMPTY]  # This function shall copy parts of a key element from one key to parts of a target key element of a target key.
          6 x arg, all with type=uint32, direction=IN:
            keyElementId  # Holds the identifier of the key element which shall be the source for the copy operation.
            keyElementSourceOffset  # This is the offset of the source key element indicating the start index of the copy operation.
            keyElementTargetOffset  # This is the offset of the destination key element indicating the start index of the copy operation.
            keyElementCopyLength  # Specifies the number of bytes that shall be copied.
            targetKeyId  # Holds the identifier of the key whose key element shall be the destination element.
            targetKeyElementId  # Holds the identifier of the key element which shall be the destination for the copy operation.
        KeyElementGet: possible-error=[CsmKeyManagement_Ssa_TickCount/E_NOT_OK, CsmKeyManagement_Ssa_TickCount/CSM_E_BUSY, CsmKeyManagement_Ssa_TickCount/CSM_E_SMALL_BUFFER, CsmKeyManagement_Ssa_TickCount/CSM_E_KEY_READ_FAIL, CsmKeyManagement_Ssa_TickCount/CSM_E_KEY_NOT_AVAILABLE, CsmKeyManagement_Ssa_TickCount/CSM_E_KEY_EMPTY]  # Retrieves the key element bytes from a specific key element of the key and stores the key element in the provided buffer.
          arg keyElementId: type=uint32, direction=IN  # Holds the identifier of the key element to be read.
          arg keyPtr: type=Csm_KeyDataType_Ssa_TickCount, direction=OUT, server-argument-impl-policy=USE-ARRAY-BASE-TYPE  # Holds the data to the key element bytes to be written.
          arg keyLength: type=uint32, direction=INOUT  # Contains the number of key element bytes.
        KeyElementSet: possible-error=[CsmKeyManagement_Ssa_TickCount/E_NOT_OK, CsmKeyManagement_Ssa_TickCount/CSM_E_BUSY, CsmKeyManagement_Ssa_TickCount/CSM_E_KEY_WRITE_FAIL, CsmKeyManagement_Ssa_TickCount/CSM_E_KEY_NOT_AVAILABLE, CsmKeyManagement_Ssa_TickCount/CSM_E_KEY_SIZE_MISMATCH]  # Sets the given key element bytes to the key.
          arg keyElementId: type=uint32, direction=IN  # Holds the identifier of the key element to be written.
          arg keyPtr: type=Csm_KeyDataType_Ssa_TickCount, direction=IN, server-argument-impl-policy=USE-ARRAY-BASE-TYPE  # Holds the data to the key element bytes to be processed.
          arg keyLength: type=uint32, direction=IN  # Contains the number of key element bytes.
        KeyExchangeCalcPubVal: possible-error=[CsmKeyManagement_Ssa_TickCount/E_NOT_OK, CsmKeyManagement_Ssa_TickCount/CSM_E_BUSY, CsmKeyManagement_Ssa_TickCount/CSM_E_SMALL_BUFFER, CsmKeyManagement_Ssa_TickCount/CSM_E_KEY_EMPTY]  # Calculates the public value of the current user for the key exchange and stores the public key in the provided buffer.
          arg publicValuePtr: type=Csm_PublicValueDataType_Ssa_TickCount, direction=OUT, server-argument-impl-policy=USE-ARRAY-BASE-TYPE  # Holds a pointer to the memory location in which the public value length in bytes is stored. On calling this function, this parameter shall contain the size of the buffer in bytes provided by publicValuePtr. When the request has finished, the actual length of the returned value shall be stored.
          arg publicValueLengthPtr: type=uint32, direction=INOUT  # Contains the pointer to the data where the public value shall be stored.
        KeyExchangeCalcSecret: possible-error=[CsmKeyManagement_Ssa_TickCount/E_NOT_OK, CsmKeyManagement_Ssa_TickCount/CSM_E_BUSY, CsmKeyManagement_Ssa_TickCount/CSM_E_SMALL_BUFFER, CsmKeyManagement_Ssa_TickCount/CSM_E_KEY_EMPTY]  # Calculates the shared secret key for the key exchange with the key material of the key identified by the keyId and the partner public key. The shared secret key is stored as a key element in the same key.
          arg partnerPublicValuePtr: type=Csm_PublicValueDataType_Ssa_TickCount, direction=IN, server-argument-impl-policy=USE-ARRAY-BASE-TYPE  # Holds the pointer to the memory location containing the partner's public value.
          arg partnerPublicValueLength: type=uint32, direction=IN  # Contains the number of bytes of the partner public value.
        KeyGenerate: possible-error=[CsmKeyManagement_Ssa_TickCount/E_NOT_OK, CsmKeyManagement_Ssa_TickCount/CSM_E_BUSY, CsmKeyManagement_Ssa_TickCount/CSM_E_KEY_EMPTY]  # Generates new key material and store it in the key identified by keyId.
        KeySetValid: possible-error=[CsmKeyManagement_Ssa_TickCount/E_NOT_OK, CsmKeyManagement_Ssa_TickCount/CSM_E_BUSY]  # Sets the given key element bytes to the key.
        RandomSeed: possible-error=[CsmKeyManagement_Ssa_TickCount/E_NOT_OK, CsmKeyManagement_Ssa_TickCount/CSM_E_BUSY]  # Feeds a key element with a random seed.
          arg seedPtr: type=Csm_SeedDataTypeSsa_TickCount, direction=IN, server-argument-impl-policy=USE-ARRAY-BASE-TYPE  # Holds the data which shall be used for the random seed initialization.
          arg seedLength: type=uint32, direction=IN  # Contains the length of the seed in bytes.
      8 x error:
        E_NOT_OK: error-code=1  # The service request failed.
        CSM_E_BUSY: error-code=2  # The service request failed because the service is still busy.
        CSM_E_SMALL_BUFFER: error-code=3  # The service request failed because the provided buffer is too small to store the result.
        CSM_E_KEY_READ_FAIL: error-code=6  # The service request failed because read access was denied.
        CSM_E_KEY_WRITE_FAIL: error-code=7  # The service request failed because write access was denied.
        CSM_E_KEY_NOT_AVAILABLE: error-code=8  # The service request failed because the key is not available.
        CSM_E_KEY_SIZE_MISMATCH: error-code=10  # The service request failed because the key element is not partially accessible and the provided key element length is too short or too long for that key element.
        CSM_E_KEY_EMPTY: error-code=13  # The service request failed because of uninitialized source key element.
    CsmKeyManagement_Ssa_Authentication  # Interface to execute the key management functions.
      13 x operation:
        CertificateParse: possible-error=[CsmKeyManagement_Ssa_Authentication/E_NOT_OK, CsmKeyManagement_Ssa_Authentication/CSM_E_BUSY, CsmKeyManagement_Ssa_Authentication/CSM_E_KEY_EMPTY]  # This function shall dispatch the certificate parse function to the CRYIF.
        CertificateVerify: possible-error=[CsmKeyManagement_Ssa_Authentication/E_NOT_OK, CsmKeyManagement_Ssa_Authentication/CSM_E_BUSY, CsmKeyManagement_Ssa_Authentication/CSM_E_KEY_EMPTY]  # Verifies the certificate stored in the key referenced by verifyKeyId with the certificate stored in the key referenced by keyId. Note: Only certificates stored in the same Crypto Driver can be verified against each other. If the key element CRYPTO_KE_CERTIFICATE_CURRENT_TIME is used for the verification of the validity period of the certificate indentified by verifyKeyId, it shall have the same format as the timestamp in the certificate.
          arg verifyKeyId: type=uint32, direction=IN  # Holds the identifier of the key containing the certificate to be verified.
          arg verifyPtr: type=Crypto_VerifyResultType, direction=OUT  # Contains the result of the certificate verification.
        KeyCopy: possible-error=[CsmKeyManagement_Ssa_Authentication/E_NOT_OK, CsmKeyManagement_Ssa_Authentication/CSM_E_BUSY, CsmKeyManagement_Ssa_Authentication/CSM_E_SMALL_BUFFER, CsmKeyManagement_Ssa_Authentication/CSM_E_KEY_READ_FAIL, CsmKeyManagement_Ssa_Authentication/CSM_E_KEY_WRITE_FAIL, CsmKeyManagement_Ssa_Authentication/CSM_E_KEY_SIZE_MISMATCH, CsmKeyManagement_Ssa_Authentication/CSM_E_KEY_EMPTY]  # This function shall copy all key elements from the source key to a target key.
          arg targetKeyId: type=uint32, direction=IN  # Holds the identifier of the key whose key element shall be the destination element.
        KeyDerive: possible-error=[CsmKeyManagement_Ssa_Authentication/E_NOT_OK, CsmKeyManagement_Ssa_Authentication/CSM_E_BUSY, CsmKeyManagement_Ssa_Authentication/CSM_E_KEY_READ_FAIL, CsmKeyManagement_Ssa_Authentication/CSM_E_KEY_WRITE_FAIL, CsmKeyManagement_Ssa_Authentication/CSM_E_KEY_SIZE_MISMATCH, CsmKeyManagement_Ssa_Authentication/CSM_E_KEY_EMPTY]  # Derives a new key by using the key elements in the given key. The given key contains the key elements for the password and salt. The derived key is stored in the key element with the id 1 of the key identified by targetCryptoKeyId.
          arg targetKeyId: type=uint32, direction=IN  # Holds the identifier of the key which is used to store the derived key.
        KeyElementCopy: possible-error=[CsmKeyManagement_Ssa_Authentication/E_NOT_OK, CsmKeyManagement_Ssa_Authentication/CSM_E_BUSY, CsmKeyManagement_Ssa_Authentication/CSM_E_SMALL_BUFFER, CsmKeyManagement_Ssa_Authentication/CSM_E_KEY_READ_FAIL, CsmKeyManagement_Ssa_Authentication/CSM_E_KEY_WRITE_FAIL, CsmKeyManagement_Ssa_Authentication/CSM_E_KEY_SIZE_MISMATCH, CsmKeyManagement_Ssa_Authentication/CSM_E_KEY_EMPTY]  # This function shall copy a key elements from one key to a target key.
          arg keyElementId: type=uint32, direction=IN  # Holds the identifier of the key element which shall be the source for the copy operation.
          arg targetKeyId: type=uint32, direction=IN  # Holds the identifier of the key whose key element shall be the destination element.
          arg targetKeyElementId: type=uint32, direction=IN  # Holds the identifier of the key element which shall be the destination for the copy operation.
        KeyElementCopyPartial: possible-error=[CsmKeyManagement_Ssa_Authentication/E_NOT_OK, CsmKeyManagement_Ssa_Authentication/CSM_E_BUSY, CsmKeyManagement_Ssa_Authentication/CSM_E_KEY_NOT_AVAILABLE, CsmKeyManagement_Ssa_Authentication/CSM_E_KEY_READ_FAIL, CsmKeyManagement_Ssa_Authentication/CSM_E_KEY_WRITE_FAIL, CsmKeyManagement_Ssa_Authentication/CSM_E_KEY_SIZE_MISMATCH, CsmKeyManagement_Ssa_Authentication/CSM_E_KEY_EMPTY]  # This function shall copy parts of a key element from one key to parts of a target key element of a target key.
          6 x arg, all with type=uint32, direction=IN:
            keyElementId  # Holds the identifier of the key element which shall be the source for the copy operation.
            keyElementSourceOffset  # This is the offset of the source key element indicating the start index of the copy operation.
            keyElementTargetOffset  # This is the offset of the destination key element indicating the start index of the copy operation.
            keyElementCopyLength  # Specifies the number of bytes that shall be copied.
            targetKeyId  # Holds the identifier of the key whose key element shall be the destination element.
            targetKeyElementId  # Holds the identifier of the key element which shall be the destination for the copy operation.
        KeyElementGet: possible-error=[CsmKeyManagement_Ssa_Authentication/E_NOT_OK, CsmKeyManagement_Ssa_Authentication/CSM_E_BUSY, CsmKeyManagement_Ssa_Authentication/CSM_E_SMALL_BUFFER, CsmKeyManagement_Ssa_Authentication/CSM_E_KEY_READ_FAIL, CsmKeyManagement_Ssa_Authentication/CSM_E_KEY_NOT_AVAILABLE, CsmKeyManagement_Ssa_Authentication/CSM_E_KEY_EMPTY]  # Retrieves the key element bytes from a specific key element of the key and stores the key element in the provided buffer.
          arg keyElementId: type=uint32, direction=IN  # Holds the identifier of the key element to be read.
          arg keyPtr: type=Csm_KeyDataType_Ssa_Authentication, direction=OUT, server-argument-impl-policy=USE-ARRAY-BASE-TYPE  # Holds the data to the key element bytes to be written.
          arg keyLength: type=uint32, direction=INOUT  # Contains the number of key element bytes.
        KeyElementSet: possible-error=[CsmKeyManagement_Ssa_Authentication/E_NOT_OK, CsmKeyManagement_Ssa_Authentication/CSM_E_BUSY, CsmKeyManagement_Ssa_Authentication/CSM_E_KEY_WRITE_FAIL, CsmKeyManagement_Ssa_Authentication/CSM_E_KEY_NOT_AVAILABLE, CsmKeyManagement_Ssa_Authentication/CSM_E_KEY_SIZE_MISMATCH]  # Sets the given key element bytes to the key.
          arg keyElementId: type=uint32, direction=IN  # Holds the identifier of the key element to be written.
          arg keyPtr: type=Csm_KeyDataType_Ssa_Authentication, direction=IN, server-argument-impl-policy=USE-ARRAY-BASE-TYPE  # Holds the data to the key element bytes to be processed.
          arg keyLength: type=uint32, direction=IN  # Contains the number of key element bytes.
        KeyExchangeCalcPubVal: possible-error=[CsmKeyManagement_Ssa_Authentication/E_NOT_OK, CsmKeyManagement_Ssa_Authentication/CSM_E_BUSY, CsmKeyManagement_Ssa_Authentication/CSM_E_SMALL_BUFFER, CsmKeyManagement_Ssa_Authentication/CSM_E_KEY_EMPTY]  # Calculates the public value of the current user for the key exchange and stores the public key in the provided buffer.
          arg publicValuePtr: type=Csm_PublicValueDataType_Ssa_Authentication, direction=OUT, server-argument-impl-policy=USE-ARRAY-BASE-TYPE  # Holds a pointer to the memory location in which the public value length in bytes is stored. On calling this function, this parameter shall contain the size of the buffer in bytes provided by publicValuePtr. When the request has finished, the actual length of the returned value shall be stored.
          arg publicValueLengthPtr: type=uint32, direction=INOUT  # Contains the pointer to the data where the public value shall be stored.
        KeyExchangeCalcSecret: possible-error=[CsmKeyManagement_Ssa_Authentication/E_NOT_OK, CsmKeyManagement_Ssa_Authentication/CSM_E_BUSY, CsmKeyManagement_Ssa_Authentication/CSM_E_SMALL_BUFFER, CsmKeyManagement_Ssa_Authentication/CSM_E_KEY_EMPTY]  # Calculates the shared secret key for the key exchange with the key material of the key identified by the keyId and the partner public key. The shared secret key is stored as a key element in the same key.
          arg partnerPublicValuePtr: type=Csm_PublicValueDataType_Ssa_Authentication, direction=IN, server-argument-impl-policy=USE-ARRAY-BASE-TYPE  # Holds the pointer to the memory location containing the partner's public value.
          arg partnerPublicValueLength: type=uint32, direction=IN  # Contains the number of bytes of the partner public value.
        KeyGenerate: possible-error=[CsmKeyManagement_Ssa_Authentication/E_NOT_OK, CsmKeyManagement_Ssa_Authentication/CSM_E_BUSY, CsmKeyManagement_Ssa_Authentication/CSM_E_KEY_EMPTY]  # Generates new key material and store it in the key identified by keyId.
        KeySetValid: possible-error=[CsmKeyManagement_Ssa_Authentication/E_NOT_OK, CsmKeyManagement_Ssa_Authentication/CSM_E_BUSY]  # Sets the given key element bytes to the key.
        RandomSeed: possible-error=[CsmKeyManagement_Ssa_Authentication/E_NOT_OK, CsmKeyManagement_Ssa_Authentication/CSM_E_BUSY]  # Feeds a key element with a random seed.
          arg seedPtr: type=Csm_SeedDataTypeSsa_Authentication, direction=IN, server-argument-impl-policy=USE-ARRAY-BASE-TYPE  # Holds the data which shall be used for the random seed initialization.
          arg seedLength: type=uint32, direction=IN  # Contains the length of the seed in bytes.
      8 x error:
        E_NOT_OK: error-code=1  # The service request failed.
        CSM_E_BUSY: error-code=2  # The service request failed because the service is still busy.
        CSM_E_SMALL_BUFFER: error-code=3  # The service request failed because the provided buffer is too small to store the result.
        CSM_E_KEY_READ_FAIL: error-code=6  # The service request failed because read access was denied.
        CSM_E_KEY_WRITE_FAIL: error-code=7  # The service request failed because write access was denied.
        CSM_E_KEY_NOT_AVAILABLE: error-code=8  # The service request failed because the key is not available.
        CSM_E_KEY_SIZE_MISMATCH: error-code=10  # The service request failed because the key element is not partially accessible and the provided key element length is too short or too long for that key element.
        CSM_E_KEY_EMPTY: error-code=13  # The service request failed because of uninitialized source key element.
    CsmKeyManagement_Ssa_VIN  # Interface to execute the key management functions.
      13 x operation:
        CertificateParse: possible-error=[CsmKeyManagement_Ssa_VIN/E_NOT_OK, CsmKeyManagement_Ssa_VIN/CSM_E_BUSY, CsmKeyManagement_Ssa_VIN/CSM_E_KEY_EMPTY]  # This function shall dispatch the certificate parse function to the CRYIF.
        CertificateVerify: possible-error=[CsmKeyManagement_Ssa_VIN/E_NOT_OK, CsmKeyManagement_Ssa_VIN/CSM_E_BUSY, CsmKeyManagement_Ssa_VIN/CSM_E_KEY_EMPTY]  # Verifies the certificate stored in the key referenced by verifyKeyId with the certificate stored in the key referenced by keyId. Note: Only certificates stored in the same Crypto Driver can be verified against each other. If the key element CRYPTO_KE_CERTIFICATE_CURRENT_TIME is used for the verification of the validity period of the certificate indentified by verifyKeyId, it shall have the same format as the timestamp in the certificate.
          arg verifyKeyId: type=uint32, direction=IN  # Holds the identifier of the key containing the certificate to be verified.
          arg verifyPtr: type=Crypto_VerifyResultType, direction=OUT  # Contains the result of the certificate verification.
        KeyCopy: possible-error=[CsmKeyManagement_Ssa_VIN/E_NOT_OK, CsmKeyManagement_Ssa_VIN/CSM_E_BUSY, CsmKeyManagement_Ssa_VIN/CSM_E_SMALL_BUFFER, CsmKeyManagement_Ssa_VIN/CSM_E_KEY_READ_FAIL, CsmKeyManagement_Ssa_VIN/CSM_E_KEY_WRITE_FAIL, CsmKeyManagement_Ssa_VIN/CSM_E_KEY_SIZE_MISMATCH, CsmKeyManagement_Ssa_VIN/CSM_E_KEY_EMPTY]  # This function shall copy all key elements from the source key to a target key.
          arg targetKeyId: type=uint32, direction=IN  # Holds the identifier of the key whose key element shall be the destination element.
        KeyDerive: possible-error=[CsmKeyManagement_Ssa_VIN/E_NOT_OK, CsmKeyManagement_Ssa_VIN/CSM_E_BUSY, CsmKeyManagement_Ssa_VIN/CSM_E_KEY_READ_FAIL, CsmKeyManagement_Ssa_VIN/CSM_E_KEY_WRITE_FAIL, CsmKeyManagement_Ssa_VIN/CSM_E_KEY_SIZE_MISMATCH, CsmKeyManagement_Ssa_VIN/CSM_E_KEY_EMPTY]  # Derives a new key by using the key elements in the given key. The given key contains the key elements for the password and salt. The derived key is stored in the key element with the id 1 of the key identified by targetCryptoKeyId.
          arg targetKeyId: type=uint32, direction=IN  # Holds the identifier of the key which is used to store the derived key.
        KeyElementCopy: possible-error=[CsmKeyManagement_Ssa_VIN/E_NOT_OK, CsmKeyManagement_Ssa_VIN/CSM_E_BUSY, CsmKeyManagement_Ssa_VIN/CSM_E_SMALL_BUFFER, CsmKeyManagement_Ssa_VIN/CSM_E_KEY_READ_FAIL, CsmKeyManagement_Ssa_VIN/CSM_E_KEY_WRITE_FAIL, CsmKeyManagement_Ssa_VIN/CSM_E_KEY_SIZE_MISMATCH, CsmKeyManagement_Ssa_VIN/CSM_E_KEY_EMPTY]  # This function shall copy a key elements from one key to a target key.
          arg keyElementId: type=uint32, direction=IN  # Holds the identifier of the key element which shall be the source for the copy operation.
          arg targetKeyId: type=uint32, direction=IN  # Holds the identifier of the key whose key element shall be the destination element.
          arg targetKeyElementId: type=uint32, direction=IN  # Holds the identifier of the key element which shall be the destination for the copy operation.
        KeyElementCopyPartial: possible-error=[CsmKeyManagement_Ssa_VIN/E_NOT_OK, CsmKeyManagement_Ssa_VIN/CSM_E_BUSY, CsmKeyManagement_Ssa_VIN/CSM_E_KEY_NOT_AVAILABLE, CsmKeyManagement_Ssa_VIN/CSM_E_KEY_READ_FAIL, CsmKeyManagement_Ssa_VIN/CSM_E_KEY_WRITE_FAIL, CsmKeyManagement_Ssa_VIN/CSM_E_KEY_SIZE_MISMATCH, CsmKeyManagement_Ssa_VIN/CSM_E_KEY_EMPTY]  # This function shall copy parts of a key element from one key to parts of a target key element of a target key.
          6 x arg, all with type=uint32, direction=IN:
            keyElementId  # Holds the identifier of the key element which shall be the source for the copy operation.
            keyElementSourceOffset  # This is the offset of the source key element indicating the start index of the copy operation.
            keyElementTargetOffset  # This is the offset of the destination key element indicating the start index of the copy operation.
            keyElementCopyLength  # Specifies the number of bytes that shall be copied.
            targetKeyId  # Holds the identifier of the key whose key element shall be the destination element.
            targetKeyElementId  # Holds the identifier of the key element which shall be the destination for the copy operation.
        KeyElementGet: possible-error=[CsmKeyManagement_Ssa_VIN/E_NOT_OK, CsmKeyManagement_Ssa_VIN/CSM_E_BUSY, CsmKeyManagement_Ssa_VIN/CSM_E_SMALL_BUFFER, CsmKeyManagement_Ssa_VIN/CSM_E_KEY_READ_FAIL, CsmKeyManagement_Ssa_VIN/CSM_E_KEY_NOT_AVAILABLE, CsmKeyManagement_Ssa_VIN/CSM_E_KEY_EMPTY]  # Retrieves the key element bytes from a specific key element of the key and stores the key element in the provided buffer.
          arg keyElementId: type=uint32, direction=IN  # Holds the identifier of the key element to be read.
          arg keyPtr: type=Csm_KeyDataType_Ssa_VIN, direction=OUT, server-argument-impl-policy=USE-ARRAY-BASE-TYPE  # Holds the data to the key element bytes to be written.
          arg keyLength: type=uint32, direction=INOUT  # Contains the number of key element bytes.
        KeyElementSet: possible-error=[CsmKeyManagement_Ssa_VIN/E_NOT_OK, CsmKeyManagement_Ssa_VIN/CSM_E_BUSY, CsmKeyManagement_Ssa_VIN/CSM_E_KEY_WRITE_FAIL, CsmKeyManagement_Ssa_VIN/CSM_E_KEY_NOT_AVAILABLE, CsmKeyManagement_Ssa_VIN/CSM_E_KEY_SIZE_MISMATCH]  # Sets the given key element bytes to the key.
          arg keyElementId: type=uint32, direction=IN  # Holds the identifier of the key element to be written.
          arg keyPtr: type=Csm_KeyDataType_Ssa_VIN, direction=IN, server-argument-impl-policy=USE-ARRAY-BASE-TYPE  # Holds the data to the key element bytes to be processed.
          arg keyLength: type=uint32, direction=IN  # Contains the number of key element bytes.
        KeyExchangeCalcPubVal: possible-error=[CsmKeyManagement_Ssa_VIN/E_NOT_OK, CsmKeyManagement_Ssa_VIN/CSM_E_BUSY, CsmKeyManagement_Ssa_VIN/CSM_E_SMALL_BUFFER, CsmKeyManagement_Ssa_VIN/CSM_E_KEY_EMPTY]  # Calculates the public value of the current user for the key exchange and stores the public key in the provided buffer.
          arg publicValuePtr: type=Csm_PublicValueDataType_Ssa_VIN, direction=OUT, server-argument-impl-policy=USE-ARRAY-BASE-TYPE  # Holds a pointer to the memory location in which the public value length in bytes is stored. On calling this function, this parameter shall contain the size of the buffer in bytes provided by publicValuePtr. When the request has finished, the actual length of the returned value shall be stored.
          arg publicValueLengthPtr: type=uint32, direction=INOUT  # Contains the pointer to the data where the public value shall be stored.
        KeyExchangeCalcSecret: possible-error=[CsmKeyManagement_Ssa_VIN/E_NOT_OK, CsmKeyManagement_Ssa_VIN/CSM_E_BUSY, CsmKeyManagement_Ssa_VIN/CSM_E_SMALL_BUFFER, CsmKeyManagement_Ssa_VIN/CSM_E_KEY_EMPTY]  # Calculates the shared secret key for the key exchange with the key material of the key identified by the keyId and the partner public key. The shared secret key is stored as a key element in the same key.
          arg partnerPublicValuePtr: type=Csm_PublicValueDataType_Ssa_VIN, direction=IN, server-argument-impl-policy=USE-ARRAY-BASE-TYPE  # Holds the pointer to the memory location containing the partner's public value.
          arg partnerPublicValueLength: type=uint32, direction=IN  # Contains the number of bytes of the partner public value.
        KeyGenerate: possible-error=[CsmKeyManagement_Ssa_VIN/E_NOT_OK, CsmKeyManagement_Ssa_VIN/CSM_E_BUSY, CsmKeyManagement_Ssa_VIN/CSM_E_KEY_EMPTY]  # Generates new key material and store it in the key identified by keyId.
        KeySetValid: possible-error=[CsmKeyManagement_Ssa_VIN/E_NOT_OK, CsmKeyManagement_Ssa_VIN/CSM_E_BUSY]  # Sets the given key element bytes to the key.
        RandomSeed: possible-error=[CsmKeyManagement_Ssa_VIN/E_NOT_OK, CsmKeyManagement_Ssa_VIN/CSM_E_BUSY]  # Feeds a key element with a random seed.
          arg seedPtr: type=Csm_SeedDataTypeSsa_VIN, direction=IN, server-argument-impl-policy=USE-ARRAY-BASE-TYPE  # Holds the data which shall be used for the random seed initialization.
          arg seedLength: type=uint32, direction=IN  # Contains the length of the seed in bytes.
      8 x error:
        E_NOT_OK: error-code=1  # The service request failed.
        CSM_E_BUSY: error-code=2  # The service request failed because the service is still busy.
        CSM_E_SMALL_BUFFER: error-code=3  # The service request failed because the provided buffer is too small to store the result.
        CSM_E_KEY_READ_FAIL: error-code=6  # The service request failed because read access was denied.
        CSM_E_KEY_WRITE_FAIL: error-code=7  # The service request failed because write access was denied.
        CSM_E_KEY_NOT_AVAILABLE: error-code=8  # The service request failed because the key is not available.
        CSM_E_KEY_SIZE_MISMATCH: error-code=10  # The service request failed because the key element is not partially accessible and the provided key element length is too short or too long for that key element.
        CSM_E_KEY_EMPTY: error-code=13  # The service request failed because of uninitialized source key element.
    CsmKeyManagement_Ssa_RealTime  # Interface to execute the key management functions.
      13 x operation:
        CertificateParse: possible-error=[CsmKeyManagement_Ssa_RealTime/E_NOT_OK, CsmKeyManagement_Ssa_RealTime/CSM_E_BUSY, CsmKeyManagement_Ssa_RealTime/CSM_E_KEY_EMPTY]  # This function shall dispatch the certificate parse function to the CRYIF.
        CertificateVerify: possible-error=[CsmKeyManagement_Ssa_RealTime/E_NOT_OK, CsmKeyManagement_Ssa_RealTime/CSM_E_BUSY, CsmKeyManagement_Ssa_RealTime/CSM_E_KEY_EMPTY]  # Verifies the certificate stored in the key referenced by verifyKeyId with the certificate stored in the key referenced by keyId. Note: Only certificates stored in the same Crypto Driver can be verified against each other. If the key element CRYPTO_KE_CERTIFICATE_CURRENT_TIME is used for the verification of the validity period of the certificate indentified by verifyKeyId, it shall have the same format as the timestamp in the certificate.
          arg verifyKeyId: type=uint32, direction=IN  # Holds the identifier of the key containing the certificate to be verified.
          arg verifyPtr: type=Crypto_VerifyResultType, direction=OUT  # Contains the result of the certificate verification.
        KeyCopy: possible-error=[CsmKeyManagement_Ssa_RealTime/E_NOT_OK, CsmKeyManagement_Ssa_RealTime/CSM_E_BUSY, CsmKeyManagement_Ssa_RealTime/CSM_E_SMALL_BUFFER, CsmKeyManagement_Ssa_RealTime/CSM_E_KEY_READ_FAIL, CsmKeyManagement_Ssa_RealTime/CSM_E_KEY_WRITE_FAIL, CsmKeyManagement_Ssa_RealTime/CSM_E_KEY_SIZE_MISMATCH, CsmKeyManagement_Ssa_RealTime/CSM_E_KEY_EMPTY]  # This function shall copy all key elements from the source key to a target key.
          arg targetKeyId: type=uint32, direction=IN  # Holds the identifier of the key whose key element shall be the destination element.
        KeyDerive: possible-error=[CsmKeyManagement_Ssa_RealTime/E_NOT_OK, CsmKeyManagement_Ssa_RealTime/CSM_E_BUSY, CsmKeyManagement_Ssa_RealTime/CSM_E_KEY_READ_FAIL, CsmKeyManagement_Ssa_RealTime/CSM_E_KEY_WRITE_FAIL, CsmKeyManagement_Ssa_RealTime/CSM_E_KEY_SIZE_MISMATCH, CsmKeyManagement_Ssa_RealTime/CSM_E_KEY_EMPTY]  # Derives a new key by using the key elements in the given key. The given key contains the key elements for the password and salt. The derived key is stored in the key element with the id 1 of the key identified by targetCryptoKeyId.
          arg targetKeyId: type=uint32, direction=IN  # Holds the identifier of the key which is used to store the derived key.
        KeyElementCopy: possible-error=[CsmKeyManagement_Ssa_RealTime/E_NOT_OK, CsmKeyManagement_Ssa_RealTime/CSM_E_BUSY, CsmKeyManagement_Ssa_RealTime/CSM_E_SMALL_BUFFER, CsmKeyManagement_Ssa_RealTime/CSM_E_KEY_READ_FAIL, CsmKeyManagement_Ssa_RealTime/CSM_E_KEY_WRITE_FAIL, CsmKeyManagement_Ssa_RealTime/CSM_E_KEY_SIZE_MISMATCH, CsmKeyManagement_Ssa_RealTime/CSM_E_KEY_EMPTY]  # This function shall copy a key elements from one key to a target key.
          arg keyElementId: type=uint32, direction=IN  # Holds the identifier of the key element which shall be the source for the copy operation.
          arg targetKeyId: type=uint32, direction=IN  # Holds the identifier of the key whose key element shall be the destination element.
          arg targetKeyElementId: type=uint32, direction=IN  # Holds the identifier of the key element which shall be the destination for the copy operation.
        KeyElementCopyPartial: possible-error=[CsmKeyManagement_Ssa_RealTime/E_NOT_OK, CsmKeyManagement_Ssa_RealTime/CSM_E_BUSY, CsmKeyManagement_Ssa_RealTime/CSM_E_KEY_NOT_AVAILABLE, CsmKeyManagement_Ssa_RealTime/CSM_E_KEY_READ_FAIL, CsmKeyManagement_Ssa_RealTime/CSM_E_KEY_WRITE_FAIL, CsmKeyManagement_Ssa_RealTime/CSM_E_KEY_SIZE_MISMATCH, CsmKeyManagement_Ssa_RealTime/CSM_E_KEY_EMPTY]  # This function shall copy parts of a key element from one key to parts of a target key element of a target key.
          6 x arg, all with type=uint32, direction=IN:
            keyElementId  # Holds the identifier of the key element which shall be the source for the copy operation.
            keyElementSourceOffset  # This is the offset of the source key element indicating the start index of the copy operation.
            keyElementTargetOffset  # This is the offset of the destination key element indicating the start index of the copy operation.
            keyElementCopyLength  # Specifies the number of bytes that shall be copied.
            targetKeyId  # Holds the identifier of the key whose key element shall be the destination element.
            targetKeyElementId  # Holds the identifier of the key element which shall be the destination for the copy operation.
        KeyElementGet: possible-error=[CsmKeyManagement_Ssa_RealTime/E_NOT_OK, CsmKeyManagement_Ssa_RealTime/CSM_E_BUSY, CsmKeyManagement_Ssa_RealTime/CSM_E_SMALL_BUFFER, CsmKeyManagement_Ssa_RealTime/CSM_E_KEY_READ_FAIL, CsmKeyManagement_Ssa_RealTime/CSM_E_KEY_NOT_AVAILABLE, CsmKeyManagement_Ssa_RealTime/CSM_E_KEY_EMPTY]  # Retrieves the key element bytes from a specific key element of the key and stores the key element in the provided buffer.
          arg keyElementId: type=uint32, direction=IN  # Holds the identifier of the key element to be read.
          arg keyPtr: type=Csm_KeyDataType_Ssa_RealTime, direction=OUT, server-argument-impl-policy=USE-ARRAY-BASE-TYPE  # Holds the data to the key element bytes to be written.
          arg keyLength: type=uint32, direction=INOUT  # Contains the number of key element bytes.
        KeyElementSet: possible-error=[CsmKeyManagement_Ssa_RealTime/E_NOT_OK, CsmKeyManagement_Ssa_RealTime/CSM_E_BUSY, CsmKeyManagement_Ssa_RealTime/CSM_E_KEY_WRITE_FAIL, CsmKeyManagement_Ssa_RealTime/CSM_E_KEY_NOT_AVAILABLE, CsmKeyManagement_Ssa_RealTime/CSM_E_KEY_SIZE_MISMATCH]  # Sets the given key element bytes to the key.
          arg keyElementId: type=uint32, direction=IN  # Holds the identifier of the key element to be written.
          arg keyPtr: type=Csm_KeyDataType_Ssa_RealTime, direction=IN, server-argument-impl-policy=USE-ARRAY-BASE-TYPE  # Holds the data to the key element bytes to be processed.
          arg keyLength: type=uint32, direction=IN  # Contains the number of key element bytes.
        KeyExchangeCalcPubVal: possible-error=[CsmKeyManagement_Ssa_RealTime/E_NOT_OK, CsmKeyManagement_Ssa_RealTime/CSM_E_BUSY, CsmKeyManagement_Ssa_RealTime/CSM_E_SMALL_BUFFER, CsmKeyManagement_Ssa_RealTime/CSM_E_KEY_EMPTY]  # Calculates the public value of the current user for the key exchange and stores the public key in the provided buffer.
          arg publicValuePtr: type=Csm_PublicValueDataType_Ssa_RealTime, direction=OUT, server-argument-impl-policy=USE-ARRAY-BASE-TYPE  # Holds a pointer to the memory location in which the public value length in bytes is stored. On calling this function, this parameter shall contain the size of the buffer in bytes provided by publicValuePtr. When the request has finished, the actual length of the returned value shall be stored.
          arg publicValueLengthPtr: type=uint32, direction=INOUT  # Contains the pointer to the data where the public value shall be stored.
        KeyExchangeCalcSecret: possible-error=[CsmKeyManagement_Ssa_RealTime/E_NOT_OK, CsmKeyManagement_Ssa_RealTime/CSM_E_BUSY, CsmKeyManagement_Ssa_RealTime/CSM_E_SMALL_BUFFER, CsmKeyManagement_Ssa_RealTime/CSM_E_KEY_EMPTY]  # Calculates the shared secret key for the key exchange with the key material of the key identified by the keyId and the partner public key. The shared secret key is stored as a key element in the same key.
          arg partnerPublicValuePtr: type=Csm_PublicValueDataType_Ssa_RealTime, direction=IN, server-argument-impl-policy=USE-ARRAY-BASE-TYPE  # Holds the pointer to the memory location containing the partner's public value.
          arg partnerPublicValueLength: type=uint32, direction=IN  # Contains the number of bytes of the partner public value.
        KeyGenerate: possible-error=[CsmKeyManagement_Ssa_RealTime/E_NOT_OK, CsmKeyManagement_Ssa_RealTime/CSM_E_BUSY, CsmKeyManagement_Ssa_RealTime/CSM_E_KEY_EMPTY]  # Generates new key material and store it in the key identified by keyId.
        KeySetValid: possible-error=[CsmKeyManagement_Ssa_RealTime/E_NOT_OK, CsmKeyManagement_Ssa_RealTime/CSM_E_BUSY]  # Sets the given key element bytes to the key.
        RandomSeed: possible-error=[CsmKeyManagement_Ssa_RealTime/E_NOT_OK, CsmKeyManagement_Ssa_RealTime/CSM_E_BUSY]  # Feeds a key element with a random seed.
          arg seedPtr: type=Csm_SeedDataTypeSsa_RealTime, direction=IN, server-argument-impl-policy=USE-ARRAY-BASE-TYPE  # Holds the data which shall be used for the random seed initialization.
          arg seedLength: type=uint32, direction=IN  # Contains the length of the seed in bytes.
      8 x error:
        E_NOT_OK: error-code=1  # The service request failed.
        CSM_E_BUSY: error-code=2  # The service request failed because the service is still busy.
        CSM_E_SMALL_BUFFER: error-code=3  # The service request failed because the provided buffer is too small to store the result.
        CSM_E_KEY_READ_FAIL: error-code=6  # The service request failed because read access was denied.
        CSM_E_KEY_WRITE_FAIL: error-code=7  # The service request failed because write access was denied.
        CSM_E_KEY_NOT_AVAILABLE: error-code=8  # The service request failed because the key is not available.
        CSM_E_KEY_SIZE_MISMATCH: error-code=10  # The service request failed because the key element is not partially accessible and the provided key element length is too short or too long for that key element.
        CSM_E_KEY_EMPTY: error-code=13  # The service request failed because of uninitialized source key element.
    CsmKeyManagement_Ssa_SharedSecretKeyExchange  # Interface to execute the key management functions.
      13 x operation:
        CertificateParse: possible-error=[CsmKeyManagement_Ssa_SharedSecretKeyExchange/E_NOT_OK, CsmKeyManagement_Ssa_SharedSecretKeyExchange/CSM_E_BUSY, CsmKeyManagement_Ssa_SharedSecretKeyExchange/CSM_E_KEY_EMPTY]  # This function shall dispatch the certificate parse function to the CRYIF.
        CertificateVerify: possible-error=[CsmKeyManagement_Ssa_SharedSecretKeyExchange/E_NOT_OK, CsmKeyManagement_Ssa_SharedSecretKeyExchange/CSM_E_BUSY, CsmKeyManagement_Ssa_SharedSecretKeyExchange/CSM_E_KEY_EMPTY]  # Verifies the certificate stored in the key referenced by verifyKeyId with the certificate stored in the key referenced by keyId. Note: Only certificates stored in the same Crypto Driver can be verified against each other. If the key element CRYPTO_KE_CERTIFICATE_CURRENT_TIME is used for the verification of the validity period of the certificate indentified by verifyKeyId, it shall have the same format as the timestamp in the certificate.
          arg verifyKeyId: type=uint32, direction=IN  # Holds the identifier of the key containing the certificate to be verified.
          arg verifyPtr: type=Crypto_VerifyResultType, direction=OUT  # Contains the result of the certificate verification.
        KeyCopy: possible-error=[CsmKeyManagement_Ssa_SharedSecretKeyExchange/E_NOT_OK, CsmKeyManagement_Ssa_SharedSecretKeyExchange/CSM_E_BUSY, CsmKeyManagement_Ssa_SharedSecretKeyExchange/CSM_E_SMALL_BUFFER, CsmKeyManagement_Ssa_SharedSecretKeyExchange/CSM_E_KEY_READ_FAIL, CsmKeyManagement_Ssa_SharedSecretKeyExchange/CSM_E_KEY_WRITE_FAIL, CsmKeyManagement_Ssa_SharedSecretKeyExchange/CSM_E_KEY_SIZE_MISMATCH, CsmKeyManagement_Ssa_SharedSecretKeyExchange/CSM_E_KEY_EMPTY]  # This function shall copy all key elements from the source key to a target key.
          arg targetKeyId: type=uint32, direction=IN  # Holds the identifier of the key whose key element shall be the destination element.
        KeyDerive: possible-error=[CsmKeyManagement_Ssa_SharedSecretKeyExchange/E_NOT_OK, CsmKeyManagement_Ssa_SharedSecretKeyExchange/CSM_E_BUSY, CsmKeyManagement_Ssa_SharedSecretKeyExchange/CSM_E_KEY_READ_FAIL, CsmKeyManagement_Ssa_SharedSecretKeyExchange/CSM_E_KEY_WRITE_FAIL, CsmKeyManagement_Ssa_SharedSecretKeyExchange/CSM_E_KEY_SIZE_MISMATCH, CsmKeyManagement_Ssa_SharedSecretKeyExchange/CSM_E_KEY_EMPTY]  # Derives a new key by using the key elements in the given key. The given key contains the key elements for the password and salt. The derived key is stored in the key element with the id 1 of the key identified by targetCryptoKeyId.
          arg targetKeyId: type=uint32, direction=IN  # Holds the identifier of the key which is used to store the derived key.
        KeyElementCopy: possible-error=[CsmKeyManagement_Ssa_SharedSecretKeyExchange/E_NOT_OK, CsmKeyManagement_Ssa_SharedSecretKeyExchange/CSM_E_BUSY, CsmKeyManagement_Ssa_SharedSecretKeyExchange/CSM_E_SMALL_BUFFER, CsmKeyManagement_Ssa_SharedSecretKeyExchange/CSM_E_KEY_READ_FAIL, CsmKeyManagement_Ssa_SharedSecretKeyExchange/CSM_E_KEY_WRITE_FAIL, CsmKeyManagement_Ssa_SharedSecretKeyExchange/CSM_E_KEY_SIZE_MISMATCH, CsmKeyManagement_Ssa_SharedSecretKeyExchange/CSM_E_KEY_EMPTY]  # This function shall copy a key elements from one key to a target key.
          arg keyElementId: type=uint32, direction=IN  # Holds the identifier of the key element which shall be the source for the copy operation.
          arg targetKeyId: type=uint32, direction=IN  # Holds the identifier of the key whose key element shall be the destination element.
          arg targetKeyElementId: type=uint32, direction=IN  # Holds the identifier of the key element which shall be the destination for the copy operation.
        KeyElementCopyPartial: possible-error=[CsmKeyManagement_Ssa_SharedSecretKeyExchange/E_NOT_OK, CsmKeyManagement_Ssa_SharedSecretKeyExchange/CSM_E_BUSY, CsmKeyManagement_Ssa_SharedSecretKeyExchange/CSM_E_KEY_NOT_AVAILABLE, CsmKeyManagement_Ssa_SharedSecretKeyExchange/CSM_E_KEY_READ_FAIL, CsmKeyManagement_Ssa_SharedSecretKeyExchange/CSM_E_KEY_WRITE_FAIL, CsmKeyManagement_Ssa_SharedSecretKeyExchange/CSM_E_KEY_SIZE_MISMATCH, CsmKeyManagement_Ssa_SharedSecretKeyExchange/CSM_E_KEY_EMPTY]  # This function shall copy parts of a key element from one key to parts of a target key element of a target key.
          6 x arg, all with type=uint32, direction=IN:
            keyElementId  # Holds the identifier of the key element which shall be the source for the copy operation.
            keyElementSourceOffset  # This is the offset of the source key element indicating the start index of the copy operation.
            keyElementTargetOffset  # This is the offset of the destination key element indicating the start index of the copy operation.
            keyElementCopyLength  # Specifies the number of bytes that shall be copied.
            targetKeyId  # Holds the identifier of the key whose key element shall be the destination element.
            targetKeyElementId  # Holds the identifier of the key element which shall be the destination for the copy operation.
        KeyElementGet: possible-error=[CsmKeyManagement_Ssa_SharedSecretKeyExchange/E_NOT_OK, CsmKeyManagement_Ssa_SharedSecretKeyExchange/CSM_E_BUSY, CsmKeyManagement_Ssa_SharedSecretKeyExchange/CSM_E_SMALL_BUFFER, CsmKeyManagement_Ssa_SharedSecretKeyExchange/CSM_E_KEY_READ_FAIL, CsmKeyManagement_Ssa_SharedSecretKeyExchange/CSM_E_KEY_NOT_AVAILABLE, CsmKeyManagement_Ssa_SharedSecretKeyExchange/CSM_E_KEY_EMPTY]  # Retrieves the key element bytes from a specific key element of the key and stores the key element in the provided buffer.
          arg keyElementId: type=uint32, direction=IN  # Holds the identifier of the key element to be read.
          arg keyPtr: type=Csm_KeyDataType_Ssa_SharedSecretKeyExchange, direction=OUT, server-argument-impl-policy=USE-ARRAY-BASE-TYPE  # Holds the data to the key element bytes to be written.
          arg keyLength: type=uint32, direction=INOUT  # Contains the number of key element bytes.
        KeyElementSet: possible-error=[CsmKeyManagement_Ssa_SharedSecretKeyExchange/E_NOT_OK, CsmKeyManagement_Ssa_SharedSecretKeyExchange/CSM_E_BUSY, CsmKeyManagement_Ssa_SharedSecretKeyExchange/CSM_E_KEY_WRITE_FAIL, CsmKeyManagement_Ssa_SharedSecretKeyExchange/CSM_E_KEY_NOT_AVAILABLE, CsmKeyManagement_Ssa_SharedSecretKeyExchange/CSM_E_KEY_SIZE_MISMATCH]  # Sets the given key element bytes to the key.
          arg keyElementId: type=uint32, direction=IN  # Holds the identifier of the key element to be written.
          arg keyPtr: type=Csm_KeyDataType_Ssa_SharedSecretKeyExchange, direction=IN, server-argument-impl-policy=USE-ARRAY-BASE-TYPE  # Holds the data to the key element bytes to be processed.
          arg keyLength: type=uint32, direction=IN  # Contains the number of key element bytes.
        KeyExchangeCalcPubVal: possible-error=[CsmKeyManagement_Ssa_SharedSecretKeyExchange/E_NOT_OK, CsmKeyManagement_Ssa_SharedSecretKeyExchange/CSM_E_BUSY, CsmKeyManagement_Ssa_SharedSecretKeyExchange/CSM_E_SMALL_BUFFER, CsmKeyManagement_Ssa_SharedSecretKeyExchange/CSM_E_KEY_EMPTY]  # Calculates the public value of the current user for the key exchange and stores the public key in the provided buffer.
          arg publicValuePtr: type=Csm_PublicValueDataType_Ssa_SharedSecretKeyExchange, direction=OUT, server-argument-impl-policy=USE-ARRAY-BASE-TYPE  # Holds a pointer to the memory location in which the public value length in bytes is stored. On calling this function, this parameter shall contain the size of the buffer in bytes provided by publicValuePtr. When the request has finished, the actual length of the returned value shall be stored.
          arg publicValueLengthPtr: type=uint32, direction=INOUT  # Contains the pointer to the data where the public value shall be stored.
        KeyExchangeCalcSecret: possible-error=[CsmKeyManagement_Ssa_SharedSecretKeyExchange/E_NOT_OK, CsmKeyManagement_Ssa_SharedSecretKeyExchange/CSM_E_BUSY, CsmKeyManagement_Ssa_SharedSecretKeyExchange/CSM_E_SMALL_BUFFER, CsmKeyManagement_Ssa_SharedSecretKeyExchange/CSM_E_KEY_EMPTY]  # Calculates the shared secret key for the key exchange with the key material of the key identified by the keyId and the partner public key. The shared secret key is stored as a key element in the same key.
          arg partnerPublicValuePtr: type=Csm_PublicValueDataType_Ssa_SharedSecretKeyExchange, direction=IN, server-argument-impl-policy=USE-ARRAY-BASE-TYPE  # Holds the pointer to the memory location containing the partner's public value.
          arg partnerPublicValueLength: type=uint32, direction=IN  # Contains the number of bytes of the partner public value.
        KeyGenerate: possible-error=[CsmKeyManagement_Ssa_SharedSecretKeyExchange/E_NOT_OK, CsmKeyManagement_Ssa_SharedSecretKeyExchange/CSM_E_BUSY, CsmKeyManagement_Ssa_SharedSecretKeyExchange/CSM_E_KEY_EMPTY]  # Generates new key material and store it in the key identified by keyId.
        KeySetValid: possible-error=[CsmKeyManagement_Ssa_SharedSecretKeyExchange/E_NOT_OK, CsmKeyManagement_Ssa_SharedSecretKeyExchange/CSM_E_BUSY]  # Sets the given key element bytes to the key.
        RandomSeed: possible-error=[CsmKeyManagement_Ssa_SharedSecretKeyExchange/E_NOT_OK, CsmKeyManagement_Ssa_SharedSecretKeyExchange/CSM_E_BUSY]  # Feeds a key element with a random seed.
          arg seedPtr: type=Csm_SeedDataTypeSsa_SharedSecretKeyExchange, direction=IN, server-argument-impl-policy=USE-ARRAY-BASE-TYPE  # Holds the data which shall be used for the random seed initialization.
          arg seedLength: type=uint32, direction=IN  # Contains the length of the seed in bytes.
      8 x error:
        E_NOT_OK: error-code=1  # The service request failed.
        CSM_E_BUSY: error-code=2  # The service request failed because the service is still busy.
        CSM_E_SMALL_BUFFER: error-code=3  # The service request failed because the provided buffer is too small to store the result.
        CSM_E_KEY_READ_FAIL: error-code=6  # The service request failed because read access was denied.
        CSM_E_KEY_WRITE_FAIL: error-code=7  # The service request failed because write access was denied.
        CSM_E_KEY_NOT_AVAILABLE: error-code=8  # The service request failed because the key is not available.
        CSM_E_KEY_SIZE_MISMATCH: error-code=10  # The service request failed because the key element is not partially accessible and the provided key element length is too short or too long for that key element.
        CSM_E_KEY_EMPTY: error-code=13  # The service request failed because of uninitialized source key element.
    CsmKeyManagement_Ssa_BackendCert  # Interface to execute the key management functions.
      13 x operation:
        CertificateParse: possible-error=[CsmKeyManagement_Ssa_BackendCert/E_NOT_OK, CsmKeyManagement_Ssa_BackendCert/CSM_E_BUSY, CsmKeyManagement_Ssa_BackendCert/CSM_E_KEY_EMPTY]  # This function shall dispatch the certificate parse function to the CRYIF.
        CertificateVerify: possible-error=[CsmKeyManagement_Ssa_BackendCert/E_NOT_OK, CsmKeyManagement_Ssa_BackendCert/CSM_E_BUSY, CsmKeyManagement_Ssa_BackendCert/CSM_E_KEY_EMPTY]  # Verifies the certificate stored in the key referenced by verifyKeyId with the certificate stored in the key referenced by keyId. Note: Only certificates stored in the same Crypto Driver can be verified against each other. If the key element CRYPTO_KE_CERTIFICATE_CURRENT_TIME is used for the verification of the validity period of the certificate indentified by verifyKeyId, it shall have the same format as the timestamp in the certificate.
          arg verifyKeyId: type=uint32, direction=IN  # Holds the identifier of the key containing the certificate to be verified.
          arg verifyPtr: type=Crypto_VerifyResultType, direction=OUT  # Contains the result of the certificate verification.
        KeyCopy: possible-error=[CsmKeyManagement_Ssa_BackendCert/E_NOT_OK, CsmKeyManagement_Ssa_BackendCert/CSM_E_BUSY, CsmKeyManagement_Ssa_BackendCert/CSM_E_SMALL_BUFFER, CsmKeyManagement_Ssa_BackendCert/CSM_E_KEY_READ_FAIL, CsmKeyManagement_Ssa_BackendCert/CSM_E_KEY_WRITE_FAIL, CsmKeyManagement_Ssa_BackendCert/CSM_E_KEY_SIZE_MISMATCH, CsmKeyManagement_Ssa_BackendCert/CSM_E_KEY_EMPTY]  # This function shall copy all key elements from the source key to a target key.
          arg targetKeyId: type=uint32, direction=IN  # Holds the identifier of the key whose key element shall be the destination element.
        KeyDerive: possible-error=[CsmKeyManagement_Ssa_BackendCert/E_NOT_OK, CsmKeyManagement_Ssa_BackendCert/CSM_E_BUSY, CsmKeyManagement_Ssa_BackendCert/CSM_E_KEY_READ_FAIL, CsmKeyManagement_Ssa_BackendCert/CSM_E_KEY_WRITE_FAIL, CsmKeyManagement_Ssa_BackendCert/CSM_E_KEY_SIZE_MISMATCH, CsmKeyManagement_Ssa_BackendCert/CSM_E_KEY_EMPTY]  # Derives a new key by using the key elements in the given key. The given key contains the key elements for the password and salt. The derived key is stored in the key element with the id 1 of the key identified by targetCryptoKeyId.
          arg targetKeyId: type=uint32, direction=IN  # Holds the identifier of the key which is used to store the derived key.
        KeyElementCopy: possible-error=[CsmKeyManagement_Ssa_BackendCert/E_NOT_OK, CsmKeyManagement_Ssa_BackendCert/CSM_E_BUSY, CsmKeyManagement_Ssa_BackendCert/CSM_E_SMALL_BUFFER, CsmKeyManagement_Ssa_BackendCert/CSM_E_KEY_READ_FAIL, CsmKeyManagement_Ssa_BackendCert/CSM_E_KEY_WRITE_FAIL, CsmKeyManagement_Ssa_BackendCert/CSM_E_KEY_SIZE_MISMATCH, CsmKeyManagement_Ssa_BackendCert/CSM_E_KEY_EMPTY]  # This function shall copy a key elements from one key to a target key.
          arg keyElementId: type=uint32, direction=IN  # Holds the identifier of the key element which shall be the source for the copy operation.
          arg targetKeyId: type=uint32, direction=IN  # Holds the identifier of the key whose key element shall be the destination element.
          arg targetKeyElementId: type=uint32, direction=IN  # Holds the identifier of the key element which shall be the destination for the copy operation.
        KeyElementCopyPartial: possible-error=[CsmKeyManagement_Ssa_BackendCert/E_NOT_OK, CsmKeyManagement_Ssa_BackendCert/CSM_E_BUSY, CsmKeyManagement_Ssa_BackendCert/CSM_E_KEY_NOT_AVAILABLE, CsmKeyManagement_Ssa_BackendCert/CSM_E_KEY_READ_FAIL, CsmKeyManagement_Ssa_BackendCert/CSM_E_KEY_WRITE_FAIL, CsmKeyManagement_Ssa_BackendCert/CSM_E_KEY_SIZE_MISMATCH, CsmKeyManagement_Ssa_BackendCert/CSM_E_KEY_EMPTY]  # This function shall copy parts of a key element from one key to parts of a target key element of a target key.
          6 x arg, all with type=uint32, direction=IN:
            keyElementId  # Holds the identifier of the key element which shall be the source for the copy operation.
            keyElementSourceOffset  # This is the offset of the source key element indicating the start index of the copy operation.
            keyElementTargetOffset  # This is the offset of the destination key element indicating the start index of the copy operation.
            keyElementCopyLength  # Specifies the number of bytes that shall be copied.
            targetKeyId  # Holds the identifier of the key whose key element shall be the destination element.
            targetKeyElementId  # Holds the identifier of the key element which shall be the destination for the copy operation.
        KeyElementGet: possible-error=[CsmKeyManagement_Ssa_BackendCert/E_NOT_OK, CsmKeyManagement_Ssa_BackendCert/CSM_E_BUSY, CsmKeyManagement_Ssa_BackendCert/CSM_E_SMALL_BUFFER, CsmKeyManagement_Ssa_BackendCert/CSM_E_KEY_READ_FAIL, CsmKeyManagement_Ssa_BackendCert/CSM_E_KEY_NOT_AVAILABLE, CsmKeyManagement_Ssa_BackendCert/CSM_E_KEY_EMPTY]  # Retrieves the key element bytes from a specific key element of the key and stores the key element in the provided buffer.
          arg keyElementId: type=uint32, direction=IN  # Holds the identifier of the key element to be read.
          arg keyPtr: type=Csm_KeyDataType_Ssa_BackendCert, direction=OUT, server-argument-impl-policy=USE-ARRAY-BASE-TYPE  # Holds the data to the key element bytes to be written.
          arg keyLength: type=uint32, direction=INOUT  # Contains the number of key element bytes.
        KeyElementSet: possible-error=[CsmKeyManagement_Ssa_BackendCert/E_NOT_OK, CsmKeyManagement_Ssa_BackendCert/CSM_E_BUSY, CsmKeyManagement_Ssa_BackendCert/CSM_E_KEY_WRITE_FAIL, CsmKeyManagement_Ssa_BackendCert/CSM_E_KEY_NOT_AVAILABLE, CsmKeyManagement_Ssa_BackendCert/CSM_E_KEY_SIZE_MISMATCH]  # Sets the given key element bytes to the key.
          arg keyElementId: type=uint32, direction=IN  # Holds the identifier of the key element to be written.
          arg keyPtr: type=Csm_KeyDataType_Ssa_BackendCert, direction=IN, server-argument-impl-policy=USE-ARRAY-BASE-TYPE  # Holds the data to the key element bytes to be processed.
          arg keyLength: type=uint32, direction=IN  # Contains the number of key element bytes.
        KeyExchangeCalcPubVal: possible-error=[CsmKeyManagement_Ssa_BackendCert/E_NOT_OK, CsmKeyManagement_Ssa_BackendCert/CSM_E_BUSY, CsmKeyManagement_Ssa_BackendCert/CSM_E_SMALL_BUFFER, CsmKeyManagement_Ssa_BackendCert/CSM_E_KEY_EMPTY]  # Calculates the public value of the current user for the key exchange and stores the public key in the provided buffer.
          arg publicValuePtr: type=Csm_PublicValueDataType_Ssa_BackendCert, direction=OUT, server-argument-impl-policy=USE-ARRAY-BASE-TYPE  # Holds a pointer to the memory location in which the public value length in bytes is stored. On calling this function, this parameter shall contain the size of the buffer in bytes provided by publicValuePtr. When the request has finished, the actual length of the returned value shall be stored.
          arg publicValueLengthPtr: type=uint32, direction=INOUT  # Contains the pointer to the data where the public value shall be stored.
        KeyExchangeCalcSecret: possible-error=[CsmKeyManagement_Ssa_BackendCert/E_NOT_OK, CsmKeyManagement_Ssa_BackendCert/CSM_E_BUSY, CsmKeyManagement_Ssa_BackendCert/CSM_E_SMALL_BUFFER, CsmKeyManagement_Ssa_BackendCert/CSM_E_KEY_EMPTY]  # Calculates the shared secret key for the key exchange with the key material of the key identified by the keyId and the partner public key. The shared secret key is stored as a key element in the same key.
          arg partnerPublicValuePtr: type=Csm_PublicValueDataType_Ssa_BackendCert, direction=IN, server-argument-impl-policy=USE-ARRAY-BASE-TYPE  # Holds the pointer to the memory location containing the partner's public value.
          arg partnerPublicValueLength: type=uint32, direction=IN  # Contains the number of bytes of the partner public value.
        KeyGenerate: possible-error=[CsmKeyManagement_Ssa_BackendCert/E_NOT_OK, CsmKeyManagement_Ssa_BackendCert/CSM_E_BUSY, CsmKeyManagement_Ssa_BackendCert/CSM_E_KEY_EMPTY]  # Generates new key material and store it in the key identified by keyId.
        KeySetValid: possible-error=[CsmKeyManagement_Ssa_BackendCert/E_NOT_OK, CsmKeyManagement_Ssa_BackendCert/CSM_E_BUSY]  # Sets the given key element bytes to the key.
        RandomSeed: possible-error=[CsmKeyManagement_Ssa_BackendCert/E_NOT_OK, CsmKeyManagement_Ssa_BackendCert/CSM_E_BUSY]  # Feeds a key element with a random seed.
          arg seedPtr: type=Csm_SeedDataTypeSsa_BackendCert, direction=IN, server-argument-impl-policy=USE-ARRAY-BASE-TYPE  # Holds the data which shall be used for the random seed initialization.
          arg seedLength: type=uint32, direction=IN  # Contains the length of the seed in bytes.
      8 x error:
        E_NOT_OK: error-code=1  # The service request failed.
        CSM_E_BUSY: error-code=2  # The service request failed because the service is still busy.
        CSM_E_SMALL_BUFFER: error-code=3  # The service request failed because the provided buffer is too small to store the result.
        CSM_E_KEY_READ_FAIL: error-code=6  # The service request failed because read access was denied.
        CSM_E_KEY_WRITE_FAIL: error-code=7  # The service request failed because write access was denied.
        CSM_E_KEY_NOT_AVAILABLE: error-code=8  # The service request failed because the key is not available.
        CSM_E_KEY_SIZE_MISMATCH: error-code=10  # The service request failed because the key element is not partially accessible and the provided key element length is too short or too long for that key element.
        CSM_E_KEY_EMPTY: error-code=13  # The service request failed because of uninitialized source key element.
    CsmKeyManagement_Ssa_RootCert  # Interface to execute the key management functions.
      13 x operation:
        CertificateParse: possible-error=[CsmKeyManagement_Ssa_RootCert/E_NOT_OK, CsmKeyManagement_Ssa_RootCert/CSM_E_BUSY, CsmKeyManagement_Ssa_RootCert/CSM_E_KEY_EMPTY]  # This function shall dispatch the certificate parse function to the CRYIF.
        CertificateVerify: possible-error=[CsmKeyManagement_Ssa_RootCert/E_NOT_OK, CsmKeyManagement_Ssa_RootCert/CSM_E_BUSY, CsmKeyManagement_Ssa_RootCert/CSM_E_KEY_EMPTY]  # Verifies the certificate stored in the key referenced by verifyKeyId with the certificate stored in the key referenced by keyId. Note: Only certificates stored in the same Crypto Driver can be verified against each other. If the key element CRYPTO_KE_CERTIFICATE_CURRENT_TIME is used for the verification of the validity period of the certificate indentified by verifyKeyId, it shall have the same format as the timestamp in the certificate.
          arg verifyKeyId: type=uint32, direction=IN  # Holds the identifier of the key containing the certificate to be verified.
          arg verifyPtr: type=Crypto_VerifyResultType, direction=OUT  # Contains the result of the certificate verification.
        KeyCopy: possible-error=[CsmKeyManagement_Ssa_RootCert/E_NOT_OK, CsmKeyManagement_Ssa_RootCert/CSM_E_BUSY, CsmKeyManagement_Ssa_RootCert/CSM_E_SMALL_BUFFER, CsmKeyManagement_Ssa_RootCert/CSM_E_KEY_READ_FAIL, CsmKeyManagement_Ssa_RootCert/CSM_E_KEY_WRITE_FAIL, CsmKeyManagement_Ssa_RootCert/CSM_E_KEY_SIZE_MISMATCH, CsmKeyManagement_Ssa_RootCert/CSM_E_KEY_EMPTY]  # This function shall copy all key elements from the source key to a target key.
          arg targetKeyId: type=uint32, direction=IN  # Holds the identifier of the key whose key element shall be the destination element.
        KeyDerive: possible-error=[CsmKeyManagement_Ssa_RootCert/E_NOT_OK, CsmKeyManagement_Ssa_RootCert/CSM_E_BUSY, CsmKeyManagement_Ssa_RootCert/CSM_E_KEY_READ_FAIL, CsmKeyManagement_Ssa_RootCert/CSM_E_KEY_WRITE_FAIL, CsmKeyManagement_Ssa_RootCert/CSM_E_KEY_SIZE_MISMATCH, CsmKeyManagement_Ssa_RootCert/CSM_E_KEY_EMPTY]  # Derives a new key by using the key elements in the given key. The given key contains the key elements for the password and salt. The derived key is stored in the key element with the id 1 of the key identified by targetCryptoKeyId.
          arg targetKeyId: type=uint32, direction=IN  # Holds the identifier of the key which is used to store the derived key.
        KeyElementCopy: possible-error=[CsmKeyManagement_Ssa_RootCert/E_NOT_OK, CsmKeyManagement_Ssa_RootCert/CSM_E_BUSY, CsmKeyManagement_Ssa_RootCert/CSM_E_SMALL_BUFFER, CsmKeyManagement_Ssa_RootCert/CSM_E_KEY_READ_FAIL, CsmKeyManagement_Ssa_RootCert/CSM_E_KEY_WRITE_FAIL, CsmKeyManagement_Ssa_RootCert/CSM_E_KEY_SIZE_MISMATCH, CsmKeyManagement_Ssa_RootCert/CSM_E_KEY_EMPTY]  # This function shall copy a key elements from one key to a target key.
          arg keyElementId: type=uint32, direction=IN  # Holds the identifier of the key element which shall be the source for the copy operation.
          arg targetKeyId: type=uint32, direction=IN  # Holds the identifier of the key whose key element shall be the destination element.
          arg targetKeyElementId: type=uint32, direction=IN  # Holds the identifier of the key element which shall be the destination for the copy operation.
        KeyElementCopyPartial: possible-error=[CsmKeyManagement_Ssa_RootCert/E_NOT_OK, CsmKeyManagement_Ssa_RootCert/CSM_E_BUSY, CsmKeyManagement_Ssa_RootCert/CSM_E_KEY_NOT_AVAILABLE, CsmKeyManagement_Ssa_RootCert/CSM_E_KEY_READ_FAIL, CsmKeyManagement_Ssa_RootCert/CSM_E_KEY_WRITE_FAIL, CsmKeyManagement_Ssa_RootCert/CSM_E_KEY_SIZE_MISMATCH, CsmKeyManagement_Ssa_RootCert/CSM_E_KEY_EMPTY]  # This function shall copy parts of a key element from one key to parts of a target key element of a target key.
          6 x arg, all with type=uint32, direction=IN:
            keyElementId  # Holds the identifier of the key element which shall be the source for the copy operation.
            keyElementSourceOffset  # This is the offset of the source key element indicating the start index of the copy operation.
            keyElementTargetOffset  # This is the offset of the destination key element indicating the start index of the copy operation.
            keyElementCopyLength  # Specifies the number of bytes that shall be copied.
            targetKeyId  # Holds the identifier of the key whose key element shall be the destination element.
            targetKeyElementId  # Holds the identifier of the key element which shall be the destination for the copy operation.
        KeyElementGet: possible-error=[CsmKeyManagement_Ssa_RootCert/E_NOT_OK, CsmKeyManagement_Ssa_RootCert/CSM_E_BUSY, CsmKeyManagement_Ssa_RootCert/CSM_E_SMALL_BUFFER, CsmKeyManagement_Ssa_RootCert/CSM_E_KEY_READ_FAIL, CsmKeyManagement_Ssa_RootCert/CSM_E_KEY_NOT_AVAILABLE, CsmKeyManagement_Ssa_RootCert/CSM_E_KEY_EMPTY]  # Retrieves the key element bytes from a specific key element of the key and stores the key element in the provided buffer.
          arg keyElementId: type=uint32, direction=IN  # Holds the identifier of the key element to be read.
          arg keyPtr: type=Csm_KeyDataType_Ssa_RootCert, direction=OUT, server-argument-impl-policy=USE-ARRAY-BASE-TYPE  # Holds the data to the key element bytes to be written.
          arg keyLength: type=uint32, direction=INOUT  # Contains the number of key element bytes.
        KeyElementSet: possible-error=[CsmKeyManagement_Ssa_RootCert/E_NOT_OK, CsmKeyManagement_Ssa_RootCert/CSM_E_BUSY, CsmKeyManagement_Ssa_RootCert/CSM_E_KEY_WRITE_FAIL, CsmKeyManagement_Ssa_RootCert/CSM_E_KEY_NOT_AVAILABLE, CsmKeyManagement_Ssa_RootCert/CSM_E_KEY_SIZE_MISMATCH]  # Sets the given key element bytes to the key.
          arg keyElementId: type=uint32, direction=IN  # Holds the identifier of the key element to be written.
          arg keyPtr: type=Csm_KeyDataType_Ssa_RootCert, direction=IN, server-argument-impl-policy=USE-ARRAY-BASE-TYPE  # Holds the data to the key element bytes to be processed.
          arg keyLength: type=uint32, direction=IN  # Contains the number of key element bytes.
        KeyExchangeCalcPubVal: possible-error=[CsmKeyManagement_Ssa_RootCert/E_NOT_OK, CsmKeyManagement_Ssa_RootCert/CSM_E_BUSY, CsmKeyManagement_Ssa_RootCert/CSM_E_SMALL_BUFFER, CsmKeyManagement_Ssa_RootCert/CSM_E_KEY_EMPTY]  # Calculates the public value of the current user for the key exchange and stores the public key in the provided buffer.
          arg publicValuePtr: type=Csm_PublicValueDataType_Ssa_RootCert, direction=OUT, server-argument-impl-policy=USE-ARRAY-BASE-TYPE  # Holds a pointer to the memory location in which the public value length in bytes is stored. On calling this function, this parameter shall contain the size of the buffer in bytes provided by publicValuePtr. When the request has finished, the actual length of the returned value shall be stored.
          arg publicValueLengthPtr: type=uint32, direction=INOUT  # Contains the pointer to the data where the public value shall be stored.
        KeyExchangeCalcSecret: possible-error=[CsmKeyManagement_Ssa_RootCert/E_NOT_OK, CsmKeyManagement_Ssa_RootCert/CSM_E_BUSY, CsmKeyManagement_Ssa_RootCert/CSM_E_SMALL_BUFFER, CsmKeyManagement_Ssa_RootCert/CSM_E_KEY_EMPTY]  # Calculates the shared secret key for the key exchange with the key material of the key identified by the keyId and the partner public key. The shared secret key is stored as a key element in the same key.
          arg partnerPublicValuePtr: type=Csm_PublicValueDataType_Ssa_RootCert, direction=IN, server-argument-impl-policy=USE-ARRAY-BASE-TYPE  # Holds the pointer to the memory location containing the partner's public value.
          arg partnerPublicValueLength: type=uint32, direction=IN  # Contains the number of bytes of the partner public value.
        KeyGenerate: possible-error=[CsmKeyManagement_Ssa_RootCert/E_NOT_OK, CsmKeyManagement_Ssa_RootCert/CSM_E_BUSY, CsmKeyManagement_Ssa_RootCert/CSM_E_KEY_EMPTY]  # Generates new key material and store it in the key identified by keyId.
        KeySetValid: possible-error=[CsmKeyManagement_Ssa_RootCert/E_NOT_OK, CsmKeyManagement_Ssa_RootCert/CSM_E_BUSY]  # Sets the given key element bytes to the key.
        RandomSeed: possible-error=[CsmKeyManagement_Ssa_RootCert/E_NOT_OK, CsmKeyManagement_Ssa_RootCert/CSM_E_BUSY]  # Feeds a key element with a random seed.
          arg seedPtr: type=Csm_SeedDataTypeSsa_RootCert, direction=IN, server-argument-impl-policy=USE-ARRAY-BASE-TYPE  # Holds the data which shall be used for the random seed initialization.
          arg seedLength: type=uint32, direction=IN  # Contains the length of the seed in bytes.
      8 x error:
        E_NOT_OK: error-code=1  # The service request failed.
        CSM_E_BUSY: error-code=2  # The service request failed because the service is still busy.
        CSM_E_SMALL_BUFFER: error-code=3  # The service request failed because the provided buffer is too small to store the result.
        CSM_E_KEY_READ_FAIL: error-code=6  # The service request failed because read access was denied.
        CSM_E_KEY_WRITE_FAIL: error-code=7  # The service request failed because write access was denied.
        CSM_E_KEY_NOT_AVAILABLE: error-code=8  # The service request failed because the key is not available.
        CSM_E_KEY_SIZE_MISMATCH: error-code=10  # The service request failed because the key element is not partially accessible and the provided key element length is too short or too long for that key element.
        CSM_E_KEY_EMPTY: error-code=13  # The service request failed because of uninitialized source key element.
    CsmKeyManagement_Ssa_RandomSeed  # Interface to execute the key management functions.
      13 x operation:
        CertificateParse: possible-error=[CsmKeyManagement_Ssa_RandomSeed/E_NOT_OK, CsmKeyManagement_Ssa_RandomSeed/CSM_E_BUSY, CsmKeyManagement_Ssa_RandomSeed/CSM_E_KEY_EMPTY]  # This function shall dispatch the certificate parse function to the CRYIF.
        CertificateVerify: possible-error=[CsmKeyManagement_Ssa_RandomSeed/E_NOT_OK, CsmKeyManagement_Ssa_RandomSeed/CSM_E_BUSY, CsmKeyManagement_Ssa_RandomSeed/CSM_E_KEY_EMPTY]  # Verifies the certificate stored in the key referenced by verifyKeyId with the certificate stored in the key referenced by keyId. Note: Only certificates stored in the same Crypto Driver can be verified against each other. If the key element CRYPTO_KE_CERTIFICATE_CURRENT_TIME is used for the verification of the validity period of the certificate indentified by verifyKeyId, it shall have the same format as the timestamp in the certificate.
          arg verifyKeyId: type=uint32, direction=IN  # Holds the identifier of the key containing the certificate to be verified.
          arg verifyPtr: type=Crypto_VerifyResultType, direction=OUT  # Contains the result of the certificate verification.
        KeyCopy: possible-error=[CsmKeyManagement_Ssa_RandomSeed/E_NOT_OK, CsmKeyManagement_Ssa_RandomSeed/CSM_E_BUSY, CsmKeyManagement_Ssa_RandomSeed/CSM_E_SMALL_BUFFER, CsmKeyManagement_Ssa_RandomSeed/CSM_E_KEY_READ_FAIL, CsmKeyManagement_Ssa_RandomSeed/CSM_E_KEY_WRITE_FAIL, CsmKeyManagement_Ssa_RandomSeed/CSM_E_KEY_SIZE_MISMATCH, CsmKeyManagement_Ssa_RandomSeed/CSM_E_KEY_EMPTY]  # This function shall copy all key elements from the source key to a target key.
          arg targetKeyId: type=uint32, direction=IN  # Holds the identifier of the key whose key element shall be the destination element.
        KeyDerive: possible-error=[CsmKeyManagement_Ssa_RandomSeed/E_NOT_OK, CsmKeyManagement_Ssa_RandomSeed/CSM_E_BUSY, CsmKeyManagement_Ssa_RandomSeed/CSM_E_KEY_READ_FAIL, CsmKeyManagement_Ssa_RandomSeed/CSM_E_KEY_WRITE_FAIL, CsmKeyManagement_Ssa_RandomSeed/CSM_E_KEY_SIZE_MISMATCH, CsmKeyManagement_Ssa_RandomSeed/CSM_E_KEY_EMPTY]  # Derives a new key by using the key elements in the given key. The given key contains the key elements for the password and salt. The derived key is stored in the key element with the id 1 of the key identified by targetCryptoKeyId.
          arg targetKeyId: type=uint32, direction=IN  # Holds the identifier of the key which is used to store the derived key.
        KeyElementCopy: possible-error=[CsmKeyManagement_Ssa_RandomSeed/E_NOT_OK, CsmKeyManagement_Ssa_RandomSeed/CSM_E_BUSY, CsmKeyManagement_Ssa_RandomSeed/CSM_E_SMALL_BUFFER, CsmKeyManagement_Ssa_RandomSeed/CSM_E_KEY_READ_FAIL, CsmKeyManagement_Ssa_RandomSeed/CSM_E_KEY_WRITE_FAIL, CsmKeyManagement_Ssa_RandomSeed/CSM_E_KEY_SIZE_MISMATCH, CsmKeyManagement_Ssa_RandomSeed/CSM_E_KEY_EMPTY]  # This function shall copy a key elements from one key to a target key.
          arg keyElementId: type=uint32, direction=IN  # Holds the identifier of the key element which shall be the source for the copy operation.
          arg targetKeyId: type=uint32, direction=IN  # Holds the identifier of the key whose key element shall be the destination element.
          arg targetKeyElementId: type=uint32, direction=IN  # Holds the identifier of the key element which shall be the destination for the copy operation.
        KeyElementCopyPartial: possible-error=[CsmKeyManagement_Ssa_RandomSeed/E_NOT_OK, CsmKeyManagement_Ssa_RandomSeed/CSM_E_BUSY, CsmKeyManagement_Ssa_RandomSeed/CSM_E_KEY_NOT_AVAILABLE, CsmKeyManagement_Ssa_RandomSeed/CSM_E_KEY_READ_FAIL, CsmKeyManagement_Ssa_RandomSeed/CSM_E_KEY_WRITE_FAIL, CsmKeyManagement_Ssa_RandomSeed/CSM_E_KEY_SIZE_MISMATCH, CsmKeyManagement_Ssa_RandomSeed/CSM_E_KEY_EMPTY]  # This function shall copy parts of a key element from one key to parts of a target key element of a target key.
          6 x arg, all with type=uint32, direction=IN:
            keyElementId  # Holds the identifier of the key element which shall be the source for the copy operation.
            keyElementSourceOffset  # This is the offset of the source key element indicating the start index of the copy operation.
            keyElementTargetOffset  # This is the offset of the destination key element indicating the start index of the copy operation.
            keyElementCopyLength  # Specifies the number of bytes that shall be copied.
            targetKeyId  # Holds the identifier of the key whose key element shall be the destination element.
            targetKeyElementId  # Holds the identifier of the key element which shall be the destination for the copy operation.
        KeyElementGet: possible-error=[CsmKeyManagement_Ssa_RandomSeed/E_NOT_OK, CsmKeyManagement_Ssa_RandomSeed/CSM_E_BUSY, CsmKeyManagement_Ssa_RandomSeed/CSM_E_SMALL_BUFFER, CsmKeyManagement_Ssa_RandomSeed/CSM_E_KEY_READ_FAIL, CsmKeyManagement_Ssa_RandomSeed/CSM_E_KEY_NOT_AVAILABLE, CsmKeyManagement_Ssa_RandomSeed/CSM_E_KEY_EMPTY]  # Retrieves the key element bytes from a specific key element of the key and stores the key element in the provided buffer.
          arg keyElementId: type=uint32, direction=IN  # Holds the identifier of the key element to be read.
          arg keyPtr: type=Csm_KeyDataType_Ssa_RandomSeed, direction=OUT, server-argument-impl-policy=USE-ARRAY-BASE-TYPE  # Holds the data to the key element bytes to be written.
          arg keyLength: type=uint32, direction=INOUT  # Contains the number of key element bytes.
        KeyElementSet: possible-error=[CsmKeyManagement_Ssa_RandomSeed/E_NOT_OK, CsmKeyManagement_Ssa_RandomSeed/CSM_E_BUSY, CsmKeyManagement_Ssa_RandomSeed/CSM_E_KEY_WRITE_FAIL, CsmKeyManagement_Ssa_RandomSeed/CSM_E_KEY_NOT_AVAILABLE, CsmKeyManagement_Ssa_RandomSeed/CSM_E_KEY_SIZE_MISMATCH]  # Sets the given key element bytes to the key.
          arg keyElementId: type=uint32, direction=IN  # Holds the identifier of the key element to be written.
          arg keyPtr: type=Csm_KeyDataType_Ssa_RandomSeed, direction=IN, server-argument-impl-policy=USE-ARRAY-BASE-TYPE  # Holds the data to the key element bytes to be processed.
          arg keyLength: type=uint32, direction=IN  # Contains the number of key element bytes.
        KeyExchangeCalcPubVal: possible-error=[CsmKeyManagement_Ssa_RandomSeed/E_NOT_OK, CsmKeyManagement_Ssa_RandomSeed/CSM_E_BUSY, CsmKeyManagement_Ssa_RandomSeed/CSM_E_SMALL_BUFFER, CsmKeyManagement_Ssa_RandomSeed/CSM_E_KEY_EMPTY]  # Calculates the public value of the current user for the key exchange and stores the public key in the provided buffer.
          arg publicValuePtr: type=Csm_PublicValueDataType_Ssa_RandomSeed, direction=OUT, server-argument-impl-policy=USE-ARRAY-BASE-TYPE  # Holds a pointer to the memory location in which the public value length in bytes is stored. On calling this function, this parameter shall contain the size of the buffer in bytes provided by publicValuePtr. When the request has finished, the actual length of the returned value shall be stored.
          arg publicValueLengthPtr: type=uint32, direction=INOUT  # Contains the pointer to the data where the public value shall be stored.
        KeyExchangeCalcSecret: possible-error=[CsmKeyManagement_Ssa_RandomSeed/E_NOT_OK, CsmKeyManagement_Ssa_RandomSeed/CSM_E_BUSY, CsmKeyManagement_Ssa_RandomSeed/CSM_E_SMALL_BUFFER, CsmKeyManagement_Ssa_RandomSeed/CSM_E_KEY_EMPTY]  # Calculates the shared secret key for the key exchange with the key material of the key identified by the keyId and the partner public key. The shared secret key is stored as a key element in the same key.
          arg partnerPublicValuePtr: type=Csm_PublicValueDataType_Ssa_RandomSeed, direction=IN, server-argument-impl-policy=USE-ARRAY-BASE-TYPE  # Holds the pointer to the memory location containing the partner's public value.
          arg partnerPublicValueLength: type=uint32, direction=IN  # Contains the number of bytes of the partner public value.
        KeyGenerate: possible-error=[CsmKeyManagement_Ssa_RandomSeed/E_NOT_OK, CsmKeyManagement_Ssa_RandomSeed/CSM_E_BUSY, CsmKeyManagement_Ssa_RandomSeed/CSM_E_KEY_EMPTY]  # Generates new key material and store it in the key identified by keyId.
        KeySetValid: possible-error=[CsmKeyManagement_Ssa_RandomSeed/E_NOT_OK, CsmKeyManagement_Ssa_RandomSeed/CSM_E_BUSY]  # Sets the given key element bytes to the key.
        RandomSeed: possible-error=[CsmKeyManagement_Ssa_RandomSeed/E_NOT_OK, CsmKeyManagement_Ssa_RandomSeed/CSM_E_BUSY]  # Feeds a key element with a random seed.
          arg seedPtr: type=Csm_SeedDataTypeSsa_RandomSeed, direction=IN, server-argument-impl-policy=USE-ARRAY-BASE-TYPE  # Holds the data which shall be used for the random seed initialization.
          arg seedLength: type=uint32, direction=IN  # Contains the length of the seed in bytes.
      8 x error:
        E_NOT_OK: error-code=1  # The service request failed.
        CSM_E_BUSY: error-code=2  # The service request failed because the service is still busy.
        CSM_E_SMALL_BUFFER: error-code=3  # The service request failed because the provided buffer is too small to store the result.
        CSM_E_KEY_READ_FAIL: error-code=6  # The service request failed because read access was denied.
        CSM_E_KEY_WRITE_FAIL: error-code=7  # The service request failed because write access was denied.
        CSM_E_KEY_NOT_AVAILABLE: error-code=8  # The service request failed because the key is not available.
        CSM_E_KEY_SIZE_MISMATCH: error-code=10  # The service request failed because the key element is not partially accessible and the provided key element length is too short or too long for that key element.
        CSM_E_KEY_EMPTY: error-code=13  # The service request failed because of uninitialized source key element.
    CsmKeyManagement_Ssa_AesRamKey  # Interface to execute the key management functions.
      13 x operation:
        CertificateParse: possible-error=[CsmKeyManagement_Ssa_AesRamKey/E_NOT_OK, CsmKeyManagement_Ssa_AesRamKey/CSM_E_BUSY, CsmKeyManagement_Ssa_AesRamKey/CSM_E_KEY_EMPTY]  # This function shall dispatch the certificate parse function to the CRYIF.
        CertificateVerify: possible-error=[CsmKeyManagement_Ssa_AesRamKey/E_NOT_OK, CsmKeyManagement_Ssa_AesRamKey/CSM_E_BUSY, CsmKeyManagement_Ssa_AesRamKey/CSM_E_KEY_EMPTY]  # Verifies the certificate stored in the key referenced by verifyKeyId with the certificate stored in the key referenced by keyId. Note: Only certificates stored in the same Crypto Driver can be verified against each other. If the key element CRYPTO_KE_CERTIFICATE_CURRENT_TIME is used for the verification of the validity period of the certificate indentified by verifyKeyId, it shall have the same format as the timestamp in the certificate.
          arg verifyKeyId: type=uint32, direction=IN  # Holds the identifier of the key containing the certificate to be verified.
          arg verifyPtr: type=Crypto_VerifyResultType, direction=OUT  # Contains the result of the certificate verification.
        KeyCopy: possible-error=[CsmKeyManagement_Ssa_AesRamKey/E_NOT_OK, CsmKeyManagement_Ssa_AesRamKey/CSM_E_BUSY, CsmKeyManagement_Ssa_AesRamKey/CSM_E_SMALL_BUFFER, CsmKeyManagement_Ssa_AesRamKey/CSM_E_KEY_READ_FAIL, CsmKeyManagement_Ssa_AesRamKey/CSM_E_KEY_WRITE_FAIL, CsmKeyManagement_Ssa_AesRamKey/CSM_E_KEY_SIZE_MISMATCH, CsmKeyManagement_Ssa_AesRamKey/CSM_E_KEY_EMPTY]  # This function shall copy all key elements from the source key to a target key.
          arg targetKeyId: type=uint32, direction=IN  # Holds the identifier of the key whose key element shall be the destination element.
        KeyDerive: possible-error=[CsmKeyManagement_Ssa_AesRamKey/E_NOT_OK, CsmKeyManagement_Ssa_AesRamKey/CSM_E_BUSY, CsmKeyManagement_Ssa_AesRamKey/CSM_E_KEY_READ_FAIL, CsmKeyManagement_Ssa_AesRamKey/CSM_E_KEY_WRITE_FAIL, CsmKeyManagement_Ssa_AesRamKey/CSM_E_KEY_SIZE_MISMATCH, CsmKeyManagement_Ssa_AesRamKey/CSM_E_KEY_EMPTY]  # Derives a new key by using the key elements in the given key. The given key contains the key elements for the password and salt. The derived key is stored in the key element with the id 1 of the key identified by targetCryptoKeyId.
          arg targetKeyId: type=uint32, direction=IN  # Holds the identifier of the key which is used to store the derived key.
        KeyElementCopy: possible-error=[CsmKeyManagement_Ssa_AesRamKey/E_NOT_OK, CsmKeyManagement_Ssa_AesRamKey/CSM_E_BUSY, CsmKeyManagement_Ssa_AesRamKey/CSM_E_SMALL_BUFFER, CsmKeyManagement_Ssa_AesRamKey/CSM_E_KEY_READ_FAIL, CsmKeyManagement_Ssa_AesRamKey/CSM_E_KEY_WRITE_FAIL, CsmKeyManagement_Ssa_AesRamKey/CSM_E_KEY_SIZE_MISMATCH, CsmKeyManagement_Ssa_AesRamKey/CSM_E_KEY_EMPTY]  # This function shall copy a key elements from one key to a target key.
          arg keyElementId: type=uint32, direction=IN  # Holds the identifier of the key element which shall be the source for the copy operation.
          arg targetKeyId: type=uint32, direction=IN  # Holds the identifier of the key whose key element shall be the destination element.
          arg targetKeyElementId: type=uint32, direction=IN  # Holds the identifier of the key element which shall be the destination for the copy operation.
        KeyElementCopyPartial: possible-error=[CsmKeyManagement_Ssa_AesRamKey/E_NOT_OK, CsmKeyManagement_Ssa_AesRamKey/CSM_E_BUSY, CsmKeyManagement_Ssa_AesRamKey/CSM_E_KEY_NOT_AVAILABLE, CsmKeyManagement_Ssa_AesRamKey/CSM_E_KEY_READ_FAIL, CsmKeyManagement_Ssa_AesRamKey/CSM_E_KEY_WRITE_FAIL, CsmKeyManagement_Ssa_AesRamKey/CSM_E_KEY_SIZE_MISMATCH, CsmKeyManagement_Ssa_AesRamKey/CSM_E_KEY_EMPTY]  # This function shall copy parts of a key element from one key to parts of a target key element of a target key.
          6 x arg, all with type=uint32, direction=IN:
            keyElementId  # Holds the identifier of the key element which shall be the source for the copy operation.
            keyElementSourceOffset  # This is the offset of the source key element indicating the start index of the copy operation.
            keyElementTargetOffset  # This is the offset of the destination key element indicating the start index of the copy operation.
            keyElementCopyLength  # Specifies the number of bytes that shall be copied.
            targetKeyId  # Holds the identifier of the key whose key element shall be the destination element.
            targetKeyElementId  # Holds the identifier of the key element which shall be the destination for the copy operation.
        KeyElementGet: possible-error=[CsmKeyManagement_Ssa_AesRamKey/E_NOT_OK, CsmKeyManagement_Ssa_AesRamKey/CSM_E_BUSY, CsmKeyManagement_Ssa_AesRamKey/CSM_E_SMALL_BUFFER, CsmKeyManagement_Ssa_AesRamKey/CSM_E_KEY_READ_FAIL, CsmKeyManagement_Ssa_AesRamKey/CSM_E_KEY_NOT_AVAILABLE, CsmKeyManagement_Ssa_AesRamKey/CSM_E_KEY_EMPTY]  # Retrieves the key element bytes from a specific key element of the key and stores the key element in the provided buffer.
          arg keyElementId: type=uint32, direction=IN  # Holds the identifier of the key element to be read.
          arg keyPtr: type=Csm_KeyDataType_Ssa_AesRamKey, direction=OUT, server-argument-impl-policy=USE-ARRAY-BASE-TYPE  # Holds the data to the key element bytes to be written.
          arg keyLength: type=uint32, direction=INOUT  # Contains the number of key element bytes.
        KeyElementSet: possible-error=[CsmKeyManagement_Ssa_AesRamKey/E_NOT_OK, CsmKeyManagement_Ssa_AesRamKey/CSM_E_BUSY, CsmKeyManagement_Ssa_AesRamKey/CSM_E_KEY_WRITE_FAIL, CsmKeyManagement_Ssa_AesRamKey/CSM_E_KEY_NOT_AVAILABLE, CsmKeyManagement_Ssa_AesRamKey/CSM_E_KEY_SIZE_MISMATCH]  # Sets the given key element bytes to the key.
          arg keyElementId: type=uint32, direction=IN  # Holds the identifier of the key element to be written.
          arg keyPtr: type=Csm_KeyDataType_Ssa_AesRamKey, direction=IN, server-argument-impl-policy=USE-ARRAY-BASE-TYPE  # Holds the data to the key element bytes to be processed.
          arg keyLength: type=uint32, direction=IN  # Contains the number of key element bytes.
        KeyExchangeCalcPubVal: possible-error=[CsmKeyManagement_Ssa_AesRamKey/E_NOT_OK, CsmKeyManagement_Ssa_AesRamKey/CSM_E_BUSY, CsmKeyManagement_Ssa_AesRamKey/CSM_E_SMALL_BUFFER, CsmKeyManagement_Ssa_AesRamKey/CSM_E_KEY_EMPTY]  # Calculates the public value of the current user for the key exchange and stores the public key in the provided buffer.
          arg publicValuePtr: type=Csm_PublicValueDataType_Ssa_AesRamKey, direction=OUT, server-argument-impl-policy=USE-ARRAY-BASE-TYPE  # Holds a pointer to the memory location in which the public value length in bytes is stored. On calling this function, this parameter shall contain the size of the buffer in bytes provided by publicValuePtr. When the request has finished, the actual length of the returned value shall be stored.
          arg publicValueLengthPtr: type=uint32, direction=INOUT  # Contains the pointer to the data where the public value shall be stored.
        KeyExchangeCalcSecret: possible-error=[CsmKeyManagement_Ssa_AesRamKey/E_NOT_OK, CsmKeyManagement_Ssa_AesRamKey/CSM_E_BUSY, CsmKeyManagement_Ssa_AesRamKey/CSM_E_SMALL_BUFFER, CsmKeyManagement_Ssa_AesRamKey/CSM_E_KEY_EMPTY]  # Calculates the shared secret key for the key exchange with the key material of the key identified by the keyId and the partner public key. The shared secret key is stored as a key element in the same key.
          arg partnerPublicValuePtr: type=Csm_PublicValueDataType_Ssa_AesRamKey, direction=IN, server-argument-impl-policy=USE-ARRAY-BASE-TYPE  # Holds the pointer to the memory location containing the partner's public value.
          arg partnerPublicValueLength: type=uint32, direction=IN  # Contains the number of bytes of the partner public value.
        KeyGenerate: possible-error=[CsmKeyManagement_Ssa_AesRamKey/E_NOT_OK, CsmKeyManagement_Ssa_AesRamKey/CSM_E_BUSY, CsmKeyManagement_Ssa_AesRamKey/CSM_E_KEY_EMPTY]  # Generates new key material and store it in the key identified by keyId.
        KeySetValid: possible-error=[CsmKeyManagement_Ssa_AesRamKey/E_NOT_OK, CsmKeyManagement_Ssa_AesRamKey/CSM_E_BUSY]  # Sets the given key element bytes to the key.
        RandomSeed: possible-error=[CsmKeyManagement_Ssa_AesRamKey/E_NOT_OK, CsmKeyManagement_Ssa_AesRamKey/CSM_E_BUSY]  # Feeds a key element with a random seed.
          arg seedPtr: type=Csm_SeedDataTypeSsa_AesRamKey, direction=IN, server-argument-impl-policy=USE-ARRAY-BASE-TYPE  # Holds the data which shall be used for the random seed initialization.
          arg seedLength: type=uint32, direction=IN  # Contains the length of the seed in bytes.
      8 x error:
        E_NOT_OK: error-code=1  # The service request failed.
        CSM_E_BUSY: error-code=2  # The service request failed because the service is still busy.
        CSM_E_SMALL_BUFFER: error-code=3  # The service request failed because the provided buffer is too small to store the result.
        CSM_E_KEY_READ_FAIL: error-code=6  # The service request failed because read access was denied.
        CSM_E_KEY_WRITE_FAIL: error-code=7  # The service request failed because write access was denied.
        CSM_E_KEY_NOT_AVAILABLE: error-code=8  # The service request failed because the key is not available.
        CSM_E_KEY_SIZE_MISMATCH: error-code=10  # The service request failed because the key element is not partially accessible and the provided key element length is too short or too long for that key element.
        CSM_E_KEY_EMPTY: error-code=13  # The service request failed because of uninitialized source key element.
    CsmKeyManagement_Ssa_SharedSecretHash  # Interface to execute the key management functions.
      13 x operation:
        CertificateParse: possible-error=[CsmKeyManagement_Ssa_SharedSecretHash/E_NOT_OK, CsmKeyManagement_Ssa_SharedSecretHash/CSM_E_BUSY, CsmKeyManagement_Ssa_SharedSecretHash/CSM_E_KEY_EMPTY]  # This function shall dispatch the certificate parse function to the CRYIF.
        CertificateVerify: possible-error=[CsmKeyManagement_Ssa_SharedSecretHash/E_NOT_OK, CsmKeyManagement_Ssa_SharedSecretHash/CSM_E_BUSY, CsmKeyManagement_Ssa_SharedSecretHash/CSM_E_KEY_EMPTY]  # Verifies the certificate stored in the key referenced by verifyKeyId with the certificate stored in the key referenced by keyId. Note: Only certificates stored in the same Crypto Driver can be verified against each other. If the key element CRYPTO_KE_CERTIFICATE_CURRENT_TIME is used for the verification of the validity period of the certificate indentified by verifyKeyId, it shall have the same format as the timestamp in the certificate.
          arg verifyKeyId: type=uint32, direction=IN  # Holds the identifier of the key containing the certificate to be verified.
          arg verifyPtr: type=Crypto_VerifyResultType, direction=OUT  # Contains the result of the certificate verification.
        KeyCopy: possible-error=[CsmKeyManagement_Ssa_SharedSecretHash/E_NOT_OK, CsmKeyManagement_Ssa_SharedSecretHash/CSM_E_BUSY, CsmKeyManagement_Ssa_SharedSecretHash/CSM_E_SMALL_BUFFER, CsmKeyManagement_Ssa_SharedSecretHash/CSM_E_KEY_READ_FAIL, CsmKeyManagement_Ssa_SharedSecretHash/CSM_E_KEY_WRITE_FAIL, CsmKeyManagement_Ssa_SharedSecretHash/CSM_E_KEY_SIZE_MISMATCH, CsmKeyManagement_Ssa_SharedSecretHash/CSM_E_KEY_EMPTY]  # This function shall copy all key elements from the source key to a target key.
          arg targetKeyId: type=uint32, direction=IN  # Holds the identifier of the key whose key element shall be the destination element.
        KeyDerive: possible-error=[CsmKeyManagement_Ssa_SharedSecretHash/E_NOT_OK, CsmKeyManagement_Ssa_SharedSecretHash/CSM_E_BUSY, CsmKeyManagement_Ssa_SharedSecretHash/CSM_E_KEY_READ_FAIL, CsmKeyManagement_Ssa_SharedSecretHash/CSM_E_KEY_WRITE_FAIL, CsmKeyManagement_Ssa_SharedSecretHash/CSM_E_KEY_SIZE_MISMATCH, CsmKeyManagement_Ssa_SharedSecretHash/CSM_E_KEY_EMPTY]  # Derives a new key by using the key elements in the given key. The given key contains the key elements for the password and salt. The derived key is stored in the key element with the id 1 of the key identified by targetCryptoKeyId.
          arg targetKeyId: type=uint32, direction=IN  # Holds the identifier of the key which is used to store the derived key.
        KeyElementCopy: possible-error=[CsmKeyManagement_Ssa_SharedSecretHash/E_NOT_OK, CsmKeyManagement_Ssa_SharedSecretHash/CSM_E_BUSY, CsmKeyManagement_Ssa_SharedSecretHash/CSM_E_SMALL_BUFFER, CsmKeyManagement_Ssa_SharedSecretHash/CSM_E_KEY_READ_FAIL, CsmKeyManagement_Ssa_SharedSecretHash/CSM_E_KEY_WRITE_FAIL, CsmKeyManagement_Ssa_SharedSecretHash/CSM_E_KEY_SIZE_MISMATCH, CsmKeyManagement_Ssa_SharedSecretHash/CSM_E_KEY_EMPTY]  # This function shall copy a key elements from one key to a target key.
          arg keyElementId: type=uint32, direction=IN  # Holds the identifier of the key element which shall be the source for the copy operation.
          arg targetKeyId: type=uint32, direction=IN  # Holds the identifier of the key whose key element shall be the destination element.
          arg targetKeyElementId: type=uint32, direction=IN  # Holds the identifier of the key element which shall be the destination for the copy operation.
        KeyElementCopyPartial: possible-error=[CsmKeyManagement_Ssa_SharedSecretHash/E_NOT_OK, CsmKeyManagement_Ssa_SharedSecretHash/CSM_E_BUSY, CsmKeyManagement_Ssa_SharedSecretHash/CSM_E_KEY_NOT_AVAILABLE, CsmKeyManagement_Ssa_SharedSecretHash/CSM_E_KEY_READ_FAIL, CsmKeyManagement_Ssa_SharedSecretHash/CSM_E_KEY_WRITE_FAIL, CsmKeyManagement_Ssa_SharedSecretHash/CSM_E_KEY_SIZE_MISMATCH, CsmKeyManagement_Ssa_SharedSecretHash/CSM_E_KEY_EMPTY]  # This function shall copy parts of a key element from one key to parts of a target key element of a target key.
          6 x arg, all with type=uint32, direction=IN:
            keyElementId  # Holds the identifier of the key element which shall be the source for the copy operation.
            keyElementSourceOffset  # This is the offset of the source key element indicating the start index of the copy operation.
            keyElementTargetOffset  # This is the offset of the destination key element indicating the start index of the copy operation.
            keyElementCopyLength  # Specifies the number of bytes that shall be copied.
            targetKeyId  # Holds the identifier of the key whose key element shall be the destination element.
            targetKeyElementId  # Holds the identifier of the key element which shall be the destination for the copy operation.
        KeyElementGet: possible-error=[CsmKeyManagement_Ssa_SharedSecretHash/E_NOT_OK, CsmKeyManagement_Ssa_SharedSecretHash/CSM_E_BUSY, CsmKeyManagement_Ssa_SharedSecretHash/CSM_E_SMALL_BUFFER, CsmKeyManagement_Ssa_SharedSecretHash/CSM_E_KEY_READ_FAIL, CsmKeyManagement_Ssa_SharedSecretHash/CSM_E_KEY_NOT_AVAILABLE, CsmKeyManagement_Ssa_SharedSecretHash/CSM_E_KEY_EMPTY]  # Retrieves the key element bytes from a specific key element of the key and stores the key element in the provided buffer.
          arg keyElementId: type=uint32, direction=IN  # Holds the identifier of the key element to be read.
          arg keyPtr: type=Csm_KeyDataType_Ssa_SharedSecretHash, direction=OUT, server-argument-impl-policy=USE-ARRAY-BASE-TYPE  # Holds the data to the key element bytes to be written.
          arg keyLength: type=uint32, direction=INOUT  # Contains the number of key element bytes.
        KeyElementSet: possible-error=[CsmKeyManagement_Ssa_SharedSecretHash/E_NOT_OK, CsmKeyManagement_Ssa_SharedSecretHash/CSM_E_BUSY, CsmKeyManagement_Ssa_SharedSecretHash/CSM_E_KEY_WRITE_FAIL, CsmKeyManagement_Ssa_SharedSecretHash/CSM_E_KEY_NOT_AVAILABLE, CsmKeyManagement_Ssa_SharedSecretHash/CSM_E_KEY_SIZE_MISMATCH]  # Sets the given key element bytes to the key.
          arg keyElementId: type=uint32, direction=IN  # Holds the identifier of the key element to be written.
          arg keyPtr: type=Csm_KeyDataType_Ssa_SharedSecretHash, direction=IN, server-argument-impl-policy=USE-ARRAY-BASE-TYPE  # Holds the data to the key element bytes to be processed.
          arg keyLength: type=uint32, direction=IN  # Contains the number of key element bytes.
        KeyExchangeCalcPubVal: possible-error=[CsmKeyManagement_Ssa_SharedSecretHash/E_NOT_OK, CsmKeyManagement_Ssa_SharedSecretHash/CSM_E_BUSY, CsmKeyManagement_Ssa_SharedSecretHash/CSM_E_SMALL_BUFFER, CsmKeyManagement_Ssa_SharedSecretHash/CSM_E_KEY_EMPTY]  # Calculates the public value of the current user for the key exchange and stores the public key in the provided buffer.
          arg publicValuePtr: type=Csm_PublicValueDataType_Ssa_SharedSecretHash, direction=OUT, server-argument-impl-policy=USE-ARRAY-BASE-TYPE  # Holds a pointer to the memory location in which the public value length in bytes is stored. On calling this function, this parameter shall contain the size of the buffer in bytes provided by publicValuePtr. When the request has finished, the actual length of the returned value shall be stored.
          arg publicValueLengthPtr: type=uint32, direction=INOUT  # Contains the pointer to the data where the public value shall be stored.
        KeyExchangeCalcSecret: possible-error=[CsmKeyManagement_Ssa_SharedSecretHash/E_NOT_OK, CsmKeyManagement_Ssa_SharedSecretHash/CSM_E_BUSY, CsmKeyManagement_Ssa_SharedSecretHash/CSM_E_SMALL_BUFFER, CsmKeyManagement_Ssa_SharedSecretHash/CSM_E_KEY_EMPTY]  # Calculates the shared secret key for the key exchange with the key material of the key identified by the keyId and the partner public key. The shared secret key is stored as a key element in the same key.
          arg partnerPublicValuePtr: type=Csm_PublicValueDataType_Ssa_SharedSecretHash, direction=IN, server-argument-impl-policy=USE-ARRAY-BASE-TYPE  # Holds the pointer to the memory location containing the partner's public value.
          arg partnerPublicValueLength: type=uint32, direction=IN  # Contains the number of bytes of the partner public value.
        KeyGenerate: possible-error=[CsmKeyManagement_Ssa_SharedSecretHash/E_NOT_OK, CsmKeyManagement_Ssa_SharedSecretHash/CSM_E_BUSY, CsmKeyManagement_Ssa_SharedSecretHash/CSM_E_KEY_EMPTY]  # Generates new key material and store it in the key identified by keyId.
        KeySetValid: possible-error=[CsmKeyManagement_Ssa_SharedSecretHash/E_NOT_OK, CsmKeyManagement_Ssa_SharedSecretHash/CSM_E_BUSY]  # Sets the given key element bytes to the key.
        RandomSeed: possible-error=[CsmKeyManagement_Ssa_SharedSecretHash/E_NOT_OK, CsmKeyManagement_Ssa_SharedSecretHash/CSM_E_BUSY]  # Feeds a key element with a random seed.
          arg seedPtr: type=Csm_SeedDataTypeSsa_SharedSecretHash, direction=IN, server-argument-impl-policy=USE-ARRAY-BASE-TYPE  # Holds the data which shall be used for the random seed initialization.
          arg seedLength: type=uint32, direction=IN  # Contains the length of the seed in bytes.
      8 x error:
        E_NOT_OK: error-code=1  # The service request failed.
        CSM_E_BUSY: error-code=2  # The service request failed because the service is still busy.
        CSM_E_SMALL_BUFFER: error-code=3  # The service request failed because the provided buffer is too small to store the result.
        CSM_E_KEY_READ_FAIL: error-code=6  # The service request failed because read access was denied.
        CSM_E_KEY_WRITE_FAIL: error-code=7  # The service request failed because write access was denied.
        CSM_E_KEY_NOT_AVAILABLE: error-code=8  # The service request failed because the key is not available.
        CSM_E_KEY_SIZE_MISMATCH: error-code=10  # The service request failed because the key element is not partially accessible and the provided key element length is too short or too long for that key element.
        CSM_E_KEY_EMPTY: error-code=13  # The service request failed because of uninitialized source key element.
    CsmKeyManagement_Ssa_SignatureRamKey  # Interface to execute the key management functions.
      13 x operation:
        CertificateParse: possible-error=[CsmKeyManagement_Ssa_SignatureRamKey/E_NOT_OK, CsmKeyManagement_Ssa_SignatureRamKey/CSM_E_BUSY, CsmKeyManagement_Ssa_SignatureRamKey/CSM_E_KEY_EMPTY]  # This function shall dispatch the certificate parse function to the CRYIF.
        CertificateVerify: possible-error=[CsmKeyManagement_Ssa_SignatureRamKey/E_NOT_OK, CsmKeyManagement_Ssa_SignatureRamKey/CSM_E_BUSY, CsmKeyManagement_Ssa_SignatureRamKey/CSM_E_KEY_EMPTY]  # Verifies the certificate stored in the key referenced by verifyKeyId with the certificate stored in the key referenced by keyId. Note: Only certificates stored in the same Crypto Driver can be verified against each other. If the key element CRYPTO_KE_CERTIFICATE_CURRENT_TIME is used for the verification of the validity period of the certificate indentified by verifyKeyId, it shall have the same format as the timestamp in the certificate.
          arg verifyKeyId: type=uint32, direction=IN  # Holds the identifier of the key containing the certificate to be verified.
          arg verifyPtr: type=Crypto_VerifyResultType, direction=OUT  # Contains the result of the certificate verification.
        KeyCopy: possible-error=[CsmKeyManagement_Ssa_SignatureRamKey/E_NOT_OK, CsmKeyManagement_Ssa_SignatureRamKey/CSM_E_BUSY, CsmKeyManagement_Ssa_SignatureRamKey/CSM_E_SMALL_BUFFER, CsmKeyManagement_Ssa_SignatureRamKey/CSM_E_KEY_READ_FAIL, CsmKeyManagement_Ssa_SignatureRamKey/CSM_E_KEY_WRITE_FAIL, CsmKeyManagement_Ssa_SignatureRamKey/CSM_E_KEY_SIZE_MISMATCH, CsmKeyManagement_Ssa_SignatureRamKey/CSM_E_KEY_EMPTY]  # This function shall copy all key elements from the source key to a target key.
          arg targetKeyId: type=uint32, direction=IN  # Holds the identifier of the key whose key element shall be the destination element.
        KeyDerive: possible-error=[CsmKeyManagement_Ssa_SignatureRamKey/E_NOT_OK, CsmKeyManagement_Ssa_SignatureRamKey/CSM_E_BUSY, CsmKeyManagement_Ssa_SignatureRamKey/CSM_E_KEY_READ_FAIL, CsmKeyManagement_Ssa_SignatureRamKey/CSM_E_KEY_WRITE_FAIL, CsmKeyManagement_Ssa_SignatureRamKey/CSM_E_KEY_SIZE_MISMATCH, CsmKeyManagement_Ssa_SignatureRamKey/CSM_E_KEY_EMPTY]  # Derives a new key by using the key elements in the given key. The given key contains the key elements for the password and salt. The derived key is stored in the key element with the id 1 of the key identified by targetCryptoKeyId.
          arg targetKeyId: type=uint32, direction=IN  # Holds the identifier of the key which is used to store the derived key.
        KeyElementCopy: possible-error=[CsmKeyManagement_Ssa_SignatureRamKey/E_NOT_OK, CsmKeyManagement_Ssa_SignatureRamKey/CSM_E_BUSY, CsmKeyManagement_Ssa_SignatureRamKey/CSM_E_SMALL_BUFFER, CsmKeyManagement_Ssa_SignatureRamKey/CSM_E_KEY_READ_FAIL, CsmKeyManagement_Ssa_SignatureRamKey/CSM_E_KEY_WRITE_FAIL, CsmKeyManagement_Ssa_SignatureRamKey/CSM_E_KEY_SIZE_MISMATCH, CsmKeyManagement_Ssa_SignatureRamKey/CSM_E_KEY_EMPTY]  # This function shall copy a key elements from one key to a target key.
          arg keyElementId: type=uint32, direction=IN  # Holds the identifier of the key element which shall be the source for the copy operation.
          arg targetKeyId: type=uint32, direction=IN  # Holds the identifier of the key whose key element shall be the destination element.
          arg targetKeyElementId: type=uint32, direction=IN  # Holds the identifier of the key element which shall be the destination for the copy operation.
        KeyElementCopyPartial: possible-error=[CsmKeyManagement_Ssa_SignatureRamKey/E_NOT_OK, CsmKeyManagement_Ssa_SignatureRamKey/CSM_E_BUSY, CsmKeyManagement_Ssa_SignatureRamKey/CSM_E_KEY_NOT_AVAILABLE, CsmKeyManagement_Ssa_SignatureRamKey/CSM_E_KEY_READ_FAIL, CsmKeyManagement_Ssa_SignatureRamKey/CSM_E_KEY_WRITE_FAIL, CsmKeyManagement_Ssa_SignatureRamKey/CSM_E_KEY_SIZE_MISMATCH, CsmKeyManagement_Ssa_SignatureRamKey/CSM_E_KEY_EMPTY]  # This function shall copy parts of a key element from one key to parts of a target key element of a target key.
          6 x arg, all with type=uint32, direction=IN:
            keyElementId  # Holds the identifier of the key element which shall be the source for the copy operation.
            keyElementSourceOffset  # This is the offset of the source key element indicating the start index of the copy operation.
            keyElementTargetOffset  # This is the offset of the destination key element indicating the start index of the copy operation.
            keyElementCopyLength  # Specifies the number of bytes that shall be copied.
            targetKeyId  # Holds the identifier of the key whose key element shall be the destination element.
            targetKeyElementId  # Holds the identifier of the key element which shall be the destination for the copy operation.
        KeyElementGet: possible-error=[CsmKeyManagement_Ssa_SignatureRamKey/E_NOT_OK, CsmKeyManagement_Ssa_SignatureRamKey/CSM_E_BUSY, CsmKeyManagement_Ssa_SignatureRamKey/CSM_E_SMALL_BUFFER, CsmKeyManagement_Ssa_SignatureRamKey/CSM_E_KEY_READ_FAIL, CsmKeyManagement_Ssa_SignatureRamKey/CSM_E_KEY_NOT_AVAILABLE, CsmKeyManagement_Ssa_SignatureRamKey/CSM_E_KEY_EMPTY]  # Retrieves the key element bytes from a specific key element of the key and stores the key element in the provided buffer.
          arg keyElementId: type=uint32, direction=IN  # Holds the identifier of the key element to be read.
          arg keyPtr: type=Csm_KeyDataType_Ssa_SignatureRamKey, direction=OUT, server-argument-impl-policy=USE-ARRAY-BASE-TYPE  # Holds the data to the key element bytes to be written.
          arg keyLength: type=uint32, direction=INOUT  # Contains the number of key element bytes.
        KeyElementSet: possible-error=[CsmKeyManagement_Ssa_SignatureRamKey/E_NOT_OK, CsmKeyManagement_Ssa_SignatureRamKey/CSM_E_BUSY, CsmKeyManagement_Ssa_SignatureRamKey/CSM_E_KEY_WRITE_FAIL, CsmKeyManagement_Ssa_SignatureRamKey/CSM_E_KEY_NOT_AVAILABLE, CsmKeyManagement_Ssa_SignatureRamKey/CSM_E_KEY_SIZE_MISMATCH]  # Sets the given key element bytes to the key.
          arg keyElementId: type=uint32, direction=IN  # Holds the identifier of the key element to be written.
          arg keyPtr: type=Csm_KeyDataType_Ssa_SignatureRamKey, direction=IN, server-argument-impl-policy=USE-ARRAY-BASE-TYPE  # Holds the data to the key element bytes to be processed.
          arg keyLength: type=uint32, direction=IN  # Contains the number of key element bytes.
        KeyExchangeCalcPubVal: possible-error=[CsmKeyManagement_Ssa_SignatureRamKey/E_NOT_OK, CsmKeyManagement_Ssa_SignatureRamKey/CSM_E_BUSY, CsmKeyManagement_Ssa_SignatureRamKey/CSM_E_SMALL_BUFFER, CsmKeyManagement_Ssa_SignatureRamKey/CSM_E_KEY_EMPTY]  # Calculates the public value of the current user for the key exchange and stores the public key in the provided buffer.
          arg publicValuePtr: type=Csm_PublicValueDataType_Ssa_SignatureRamKey, direction=OUT, server-argument-impl-policy=USE-ARRAY-BASE-TYPE  # Holds a pointer to the memory location in which the public value length in bytes is stored. On calling this function, this parameter shall contain the size of the buffer in bytes provided by publicValuePtr. When the request has finished, the actual length of the returned value shall be stored.
          arg publicValueLengthPtr: type=uint32, direction=INOUT  # Contains the pointer to the data where the public value shall be stored.
        KeyExchangeCalcSecret: possible-error=[CsmKeyManagement_Ssa_SignatureRamKey/E_NOT_OK, CsmKeyManagement_Ssa_SignatureRamKey/CSM_E_BUSY, CsmKeyManagement_Ssa_SignatureRamKey/CSM_E_SMALL_BUFFER, CsmKeyManagement_Ssa_SignatureRamKey/CSM_E_KEY_EMPTY]  # Calculates the shared secret key for the key exchange with the key material of the key identified by the keyId and the partner public key. The shared secret key is stored as a key element in the same key.
          arg partnerPublicValuePtr: type=Csm_PublicValueDataType_Ssa_SignatureRamKey, direction=IN, server-argument-impl-policy=USE-ARRAY-BASE-TYPE  # Holds the pointer to the memory location containing the partner's public value.
          arg partnerPublicValueLength: type=uint32, direction=IN  # Contains the number of bytes of the partner public value.
        KeyGenerate: possible-error=[CsmKeyManagement_Ssa_SignatureRamKey/E_NOT_OK, CsmKeyManagement_Ssa_SignatureRamKey/CSM_E_BUSY, CsmKeyManagement_Ssa_SignatureRamKey/CSM_E_KEY_EMPTY]  # Generates new key material and store it in the key identified by keyId.
        KeySetValid: possible-error=[CsmKeyManagement_Ssa_SignatureRamKey/E_NOT_OK, CsmKeyManagement_Ssa_SignatureRamKey/CSM_E_BUSY]  # Sets the given key element bytes to the key.
        RandomSeed: possible-error=[CsmKeyManagement_Ssa_SignatureRamKey/E_NOT_OK, CsmKeyManagement_Ssa_SignatureRamKey/CSM_E_BUSY]  # Feeds a key element with a random seed.
          arg seedPtr: type=Csm_SeedDataTypeSsa_SignatureRamKey, direction=IN, server-argument-impl-policy=USE-ARRAY-BASE-TYPE  # Holds the data which shall be used for the random seed initialization.
          arg seedLength: type=uint32, direction=IN  # Contains the length of the seed in bytes.
      8 x error:
        E_NOT_OK: error-code=1  # The service request failed.
        CSM_E_BUSY: error-code=2  # The service request failed because the service is still busy.
        CSM_E_SMALL_BUFFER: error-code=3  # The service request failed because the provided buffer is too small to store the result.
        CSM_E_KEY_READ_FAIL: error-code=6  # The service request failed because read access was denied.
        CSM_E_KEY_WRITE_FAIL: error-code=7  # The service request failed because write access was denied.
        CSM_E_KEY_NOT_AVAILABLE: error-code=8  # The service request failed because the key is not available.
        CSM_E_KEY_SIZE_MISMATCH: error-code=10  # The service request failed because the key element is not partially accessible and the provided key element length is too short or too long for that key element.
        CSM_E_KEY_EMPTY: error-code=13  # The service request failed because of uninitialized source key element.
    CsmKeyManagement_KeyM_SigVerifyKey_TrustModelEcuPeer  # Interface to execute the key management functions.
      13 x operation:
        CertificateParse: possible-error=[CsmKeyManagement_KeyM_SigVerifyKey_TrustModelEcuPeer/E_NOT_OK, CsmKeyManagement_KeyM_SigVerifyKey_TrustModelEcuPeer/CSM_E_BUSY, CsmKeyManagement_KeyM_SigVerifyKey_TrustModelEcuPeer/CSM_E_KEY_EMPTY]  # This function shall dispatch the certificate parse function to the CRYIF.
        CertificateVerify: possible-error=[CsmKeyManagement_KeyM_SigVerifyKey_TrustModelEcuPeer/E_NOT_OK, CsmKeyManagement_KeyM_SigVerifyKey_TrustModelEcuPeer/CSM_E_BUSY, CsmKeyManagement_KeyM_SigVerifyKey_TrustModelEcuPeer/CSM_E_KEY_EMPTY]  # Verifies the certificate stored in the key referenced by verifyKeyId with the certificate stored in the key referenced by keyId. Note: Only certificates stored in the same Crypto Driver can be verified against each other. If the key element CRYPTO_KE_CERTIFICATE_CURRENT_TIME is used for the verification of the validity period of the certificate indentified by verifyKeyId, it shall have the same format as the timestamp in the certificate.
          arg verifyKeyId: type=uint32, direction=IN  # Holds the identifier of the key containing the certificate to be verified.
          arg verifyPtr: type=Crypto_VerifyResultType, direction=OUT  # Contains the result of the certificate verification.
        KeyCopy: possible-error=[CsmKeyManagement_KeyM_SigVerifyKey_TrustModelEcuPeer/E_NOT_OK, CsmKeyManagement_KeyM_SigVerifyKey_TrustModelEcuPeer/CSM_E_BUSY, CsmKeyManagement_KeyM_SigVerifyKey_TrustModelEcuPeer/CSM_E_SMALL_BUFFER, CsmKeyManagement_KeyM_SigVerifyKey_TrustModelEcuPeer/CSM_E_KEY_READ_FAIL, CsmKeyManagement_KeyM_SigVerifyKey_TrustModelEcuPeer/CSM_E_KEY_WRITE_FAIL, CsmKeyManagement_KeyM_SigVerifyKey_TrustModelEcuPeer/CSM_E_KEY_SIZE_MISMATCH, CsmKeyManagement_KeyM_SigVerifyKey_TrustModelEcuPeer/CSM_E_KEY_EMPTY]  # This function shall copy all key elements from the source key to a target key.
          arg targetKeyId: type=uint32, direction=IN  # Holds the identifier of the key whose key element shall be the destination element.
        KeyDerive: possible-error=[CsmKeyManagement_KeyM_SigVerifyKey_TrustModelEcuPeer/E_NOT_OK, CsmKeyManagement_KeyM_SigVerifyKey_TrustModelEcuPeer/CSM_E_BUSY, CsmKeyManagement_KeyM_SigVerifyKey_TrustModelEcuPeer/CSM_E_KEY_READ_FAIL, CsmKeyManagement_KeyM_SigVerifyKey_TrustModelEcuPeer/CSM_E_KEY_WRITE_FAIL, CsmKeyManagement_KeyM_SigVerifyKey_TrustModelEcuPeer/CSM_E_KEY_SIZE_MISMATCH, CsmKeyManagement_KeyM_SigVerifyKey_TrustModelEcuPeer/CSM_E_KEY_EMPTY]  # Derives a new key by using the key elements in the given key. The given key contains the key elements for the password and salt. The derived key is stored in the key element with the id 1 of the key identified by targetCryptoKeyId.
          arg targetKeyId: type=uint32, direction=IN  # Holds the identifier of the key which is used to store the derived key.
        KeyElementCopy: possible-error=[CsmKeyManagement_KeyM_SigVerifyKey_TrustModelEcuPeer/E_NOT_OK, CsmKeyManagement_KeyM_SigVerifyKey_TrustModelEcuPeer/CSM_E_BUSY, CsmKeyManagement_KeyM_SigVerifyKey_TrustModelEcuPeer/CSM_E_SMALL_BUFFER, CsmKeyManagement_KeyM_SigVerifyKey_TrustModelEcuPeer/CSM_E_KEY_READ_FAIL, CsmKeyManagement_KeyM_SigVerifyKey_TrustModelEcuPeer/CSM_E_KEY_WRITE_FAIL, CsmKeyManagement_KeyM_SigVerifyKey_TrustModelEcuPeer/CSM_E_KEY_SIZE_MISMATCH, CsmKeyManagement_KeyM_SigVerifyKey_TrustModelEcuPeer/CSM_E_KEY_EMPTY]  # This function shall copy a key elements from one key to a target key.
          arg keyElementId: type=uint32, direction=IN  # Holds the identifier of the key element which shall be the source for the copy operation.
          arg targetKeyId: type=uint32, direction=IN  # Holds the identifier of the key whose key element shall be the destination element.
          arg targetKeyElementId: type=uint32, direction=IN  # Holds the identifier of the key element which shall be the destination for the copy operation.
        KeyElementCopyPartial: possible-error=[CsmKeyManagement_KeyM_SigVerifyKey_TrustModelEcuPeer/E_NOT_OK, CsmKeyManagement_KeyM_SigVerifyKey_TrustModelEcuPeer/CSM_E_BUSY, CsmKeyManagement_KeyM_SigVerifyKey_TrustModelEcuPeer/CSM_E_KEY_NOT_AVAILABLE, CsmKeyManagement_KeyM_SigVerifyKey_TrustModelEcuPeer/CSM_E_KEY_READ_FAIL, CsmKeyManagement_KeyM_SigVerifyKey_TrustModelEcuPeer/CSM_E_KEY_WRITE_FAIL, CsmKeyManagement_KeyM_SigVerifyKey_TrustModelEcuPeer/CSM_E_KEY_SIZE_MISMATCH, CsmKeyManagement_KeyM_SigVerifyKey_TrustModelEcuPeer/CSM_E_KEY_EMPTY]  # This function shall copy parts of a key element from one key to parts of a target key element of a target key.
          6 x arg, all with type=uint32, direction=IN:
            keyElementId  # Holds the identifier of the key element which shall be the source for the copy operation.
            keyElementSourceOffset  # This is the offset of the source key element indicating the start index of the copy operation.
            keyElementTargetOffset  # This is the offset of the destination key element indicating the start index of the copy operation.
            keyElementCopyLength  # Specifies the number of bytes that shall be copied.
            targetKeyId  # Holds the identifier of the key whose key element shall be the destination element.
            targetKeyElementId  # Holds the identifier of the key element which shall be the destination for the copy operation.
        KeyElementGet: possible-error=[CsmKeyManagement_KeyM_SigVerifyKey_TrustModelEcuPeer/E_NOT_OK, CsmKeyManagement_KeyM_SigVerifyKey_TrustModelEcuPeer/CSM_E_BUSY, CsmKeyManagement_KeyM_SigVerifyKey_TrustModelEcuPeer/CSM_E_SMALL_BUFFER, CsmKeyManagement_KeyM_SigVerifyKey_TrustModelEcuPeer/CSM_E_KEY_READ_FAIL, CsmKeyManagement_KeyM_SigVerifyKey_TrustModelEcuPeer/CSM_E_KEY_NOT_AVAILABLE, CsmKeyManagement_KeyM_SigVerifyKey_TrustModelEcuPeer/CSM_E_KEY_EMPTY]  # Retrieves the key element bytes from a specific key element of the key and stores the key element in the provided buffer.
          arg keyElementId: type=uint32, direction=IN  # Holds the identifier of the key element to be read.
          arg keyPtr: type=Csm_KeyDataType_KeyM_SigVerifyKey_TrustModelEcuPeer, direction=OUT, server-argument-impl-policy=USE-ARRAY-BASE-TYPE  # Holds the data to the key element bytes to be written.
          arg keyLength: type=uint32, direction=INOUT  # Contains the number of key element bytes.
        KeyElementSet: possible-error=[CsmKeyManagement_KeyM_SigVerifyKey_TrustModelEcuPeer/E_NOT_OK, CsmKeyManagement_KeyM_SigVerifyKey_TrustModelEcuPeer/CSM_E_BUSY, CsmKeyManagement_KeyM_SigVerifyKey_TrustModelEcuPeer/CSM_E_KEY_WRITE_FAIL, CsmKeyManagement_KeyM_SigVerifyKey_TrustModelEcuPeer/CSM_E_KEY_NOT_AVAILABLE, CsmKeyManagement_KeyM_SigVerifyKey_TrustModelEcuPeer/CSM_E_KEY_SIZE_MISMATCH]  # Sets the given key element bytes to the key.
          arg keyElementId: type=uint32, direction=IN  # Holds the identifier of the key element to be written.
          arg keyPtr: type=Csm_KeyDataType_KeyM_SigVerifyKey_TrustModelEcuPeer, direction=IN, server-argument-impl-policy=USE-ARRAY-BASE-TYPE  # Holds the data to the key element bytes to be processed.
          arg keyLength: type=uint32, direction=IN  # Contains the number of key element bytes.
        KeyExchangeCalcPubVal: possible-error=[CsmKeyManagement_KeyM_SigVerifyKey_TrustModelEcuPeer/E_NOT_OK, CsmKeyManagement_KeyM_SigVerifyKey_TrustModelEcuPeer/CSM_E_BUSY, CsmKeyManagement_KeyM_SigVerifyKey_TrustModelEcuPeer/CSM_E_SMALL_BUFFER, CsmKeyManagement_KeyM_SigVerifyKey_TrustModelEcuPeer/CSM_E_KEY_EMPTY]  # Calculates the public value of the current user for the key exchange and stores the public key in the provided buffer.
          arg publicValuePtr: type=Csm_PublicValueDataType_KeyM_SigVerifyKey_TrustModelEcuPeer, direction=OUT, server-argument-impl-policy=USE-ARRAY-BASE-TYPE  # Holds a pointer to the memory location in which the public value length in bytes is stored. On calling this function, this parameter shall contain the size of the buffer in bytes provided by publicValuePtr. When the request has finished, the actual length of the returned value shall be stored.
          arg publicValueLengthPtr: type=uint32, direction=INOUT  # Contains the pointer to the data where the public value shall be stored.
        KeyExchangeCalcSecret: possible-error=[CsmKeyManagement_KeyM_SigVerifyKey_TrustModelEcuPeer/E_NOT_OK, CsmKeyManagement_KeyM_SigVerifyKey_TrustModelEcuPeer/CSM_E_BUSY, CsmKeyManagement_KeyM_SigVerifyKey_TrustModelEcuPeer/CSM_E_SMALL_BUFFER, CsmKeyManagement_KeyM_SigVerifyKey_TrustModelEcuPeer/CSM_E_KEY_EMPTY]  # Calculates the shared secret key for the key exchange with the key material of the key identified by the keyId and the partner public key. The shared secret key is stored as a key element in the same key.
          arg partnerPublicValuePtr: type=Csm_PublicValueDataType_KeyM_SigVerifyKey_TrustModelEcuPeer, direction=IN, server-argument-impl-policy=USE-ARRAY-BASE-TYPE  # Holds the pointer to the memory location containing the partner's public value.
          arg partnerPublicValueLength: type=uint32, direction=IN  # Contains the number of bytes of the partner public value.
        KeyGenerate: possible-error=[CsmKeyManagement_KeyM_SigVerifyKey_TrustModelEcuPeer/E_NOT_OK, CsmKeyManagement_KeyM_SigVerifyKey_TrustModelEcuPeer/CSM_E_BUSY, CsmKeyManagement_KeyM_SigVerifyKey_TrustModelEcuPeer/CSM_E_KEY_EMPTY]  # Generates new key material and store it in the key identified by keyId.
        KeySetValid: possible-error=[CsmKeyManagement_KeyM_SigVerifyKey_TrustModelEcuPeer/E_NOT_OK, CsmKeyManagement_KeyM_SigVerifyKey_TrustModelEcuPeer/CSM_E_BUSY]  # Sets the given key element bytes to the key.
        RandomSeed: possible-error=[CsmKeyManagement_KeyM_SigVerifyKey_TrustModelEcuPeer/E_NOT_OK, CsmKeyManagement_KeyM_SigVerifyKey_TrustModelEcuPeer/CSM_E_BUSY]  # Feeds a key element with a random seed.
          arg seedPtr: type=Csm_SeedDataTypeKeyM_SigVerifyKey_TrustModelEcuPeer, direction=IN, server-argument-impl-policy=USE-ARRAY-BASE-TYPE  # Holds the data which shall be used for the random seed initialization.
          arg seedLength: type=uint32, direction=IN  # Contains the length of the seed in bytes.
      8 x error:
        E_NOT_OK: error-code=1  # The service request failed.
        CSM_E_BUSY: error-code=2  # The service request failed because the service is still busy.
        CSM_E_SMALL_BUFFER: error-code=3  # The service request failed because the provided buffer is too small to store the result.
        CSM_E_KEY_READ_FAIL: error-code=6  # The service request failed because read access was denied.
        CSM_E_KEY_WRITE_FAIL: error-code=7  # The service request failed because write access was denied.
        CSM_E_KEY_NOT_AVAILABLE: error-code=8  # The service request failed because the key is not available.
        CSM_E_KEY_SIZE_MISMATCH: error-code=10  # The service request failed because the key element is not partially accessible and the provided key element length is too short or too long for that key element.
        CSM_E_KEY_EMPTY: error-code=13  # The service request failed because of uninitialized source key element.
    CsmKeyManagement_Ssa_SecurityAccessPublicKey  # Interface to execute the key management functions.
      13 x operation:
        CertificateParse: possible-error=[CsmKeyManagement_Ssa_SecurityAccessPublicKey/E_NOT_OK, CsmKeyManagement_Ssa_SecurityAccessPublicKey/CSM_E_BUSY, CsmKeyManagement_Ssa_SecurityAccessPublicKey/CSM_E_KEY_EMPTY]  # This function shall dispatch the certificate parse function to the CRYIF.
        CertificateVerify: possible-error=[CsmKeyManagement_Ssa_SecurityAccessPublicKey/E_NOT_OK, CsmKeyManagement_Ssa_SecurityAccessPublicKey/CSM_E_BUSY, CsmKeyManagement_Ssa_SecurityAccessPublicKey/CSM_E_KEY_EMPTY]  # Verifies the certificate stored in the key referenced by verifyKeyId with the certificate stored in the key referenced by keyId. Note: Only certificates stored in the same Crypto Driver can be verified against each other. If the key element CRYPTO_KE_CERTIFICATE_CURRENT_TIME is used for the verification of the validity period of the certificate indentified by verifyKeyId, it shall have the same format as the timestamp in the certificate.
          arg verifyKeyId: type=uint32, direction=IN  # Holds the identifier of the key containing the certificate to be verified.
          arg verifyPtr: type=Crypto_VerifyResultType, direction=OUT  # Contains the result of the certificate verification.
        KeyCopy: possible-error=[CsmKeyManagement_Ssa_SecurityAccessPublicKey/E_NOT_OK, CsmKeyManagement_Ssa_SecurityAccessPublicKey/CSM_E_BUSY, CsmKeyManagement_Ssa_SecurityAccessPublicKey/CSM_E_SMALL_BUFFER, CsmKeyManagement_Ssa_SecurityAccessPublicKey/CSM_E_KEY_READ_FAIL, CsmKeyManagement_Ssa_SecurityAccessPublicKey/CSM_E_KEY_WRITE_FAIL, CsmKeyManagement_Ssa_SecurityAccessPublicKey/CSM_E_KEY_SIZE_MISMATCH, CsmKeyManagement_Ssa_SecurityAccessPublicKey/CSM_E_KEY_EMPTY]  # This function shall copy all key elements from the source key to a target key.
          arg targetKeyId: type=uint32, direction=IN  # Holds the identifier of the key whose key element shall be the destination element.
        KeyDerive: possible-error=[CsmKeyManagement_Ssa_SecurityAccessPublicKey/E_NOT_OK, CsmKeyManagement_Ssa_SecurityAccessPublicKey/CSM_E_BUSY, CsmKeyManagement_Ssa_SecurityAccessPublicKey/CSM_E_KEY_READ_FAIL, CsmKeyManagement_Ssa_SecurityAccessPublicKey/CSM_E_KEY_WRITE_FAIL, CsmKeyManagement_Ssa_SecurityAccessPublicKey/CSM_E_KEY_SIZE_MISMATCH, CsmKeyManagement_Ssa_SecurityAccessPublicKey/CSM_E_KEY_EMPTY]  # Derives a new key by using the key elements in the given key. The given key contains the key elements for the password and salt. The derived key is stored in the key element with the id 1 of the key identified by targetCryptoKeyId.
          arg targetKeyId: type=uint32, direction=IN  # Holds the identifier of the key which is used to store the derived key.
        KeyElementCopy: possible-error=[CsmKeyManagement_Ssa_SecurityAccessPublicKey/E_NOT_OK, CsmKeyManagement_Ssa_SecurityAccessPublicKey/CSM_E_BUSY, CsmKeyManagement_Ssa_SecurityAccessPublicKey/CSM_E_SMALL_BUFFER, CsmKeyManagement_Ssa_SecurityAccessPublicKey/CSM_E_KEY_READ_FAIL, CsmKeyManagement_Ssa_SecurityAccessPublicKey/CSM_E_KEY_WRITE_FAIL, CsmKeyManagement_Ssa_SecurityAccessPublicKey/CSM_E_KEY_SIZE_MISMATCH, CsmKeyManagement_Ssa_SecurityAccessPublicKey/CSM_E_KEY_EMPTY]  # This function shall copy a key elements from one key to a target key.
          arg keyElementId: type=uint32, direction=IN  # Holds the identifier of the key element which shall be the source for the copy operation.
          arg targetKeyId: type=uint32, direction=IN  # Holds the identifier of the key whose key element shall be the destination element.
          arg targetKeyElementId: type=uint32, direction=IN  # Holds the identifier of the key element which shall be the destination for the copy operation.
        KeyElementCopyPartial: possible-error=[CsmKeyManagement_Ssa_SecurityAccessPublicKey/E_NOT_OK, CsmKeyManagement_Ssa_SecurityAccessPublicKey/CSM_E_BUSY, CsmKeyManagement_Ssa_SecurityAccessPublicKey/CSM_E_KEY_NOT_AVAILABLE, CsmKeyManagement_Ssa_SecurityAccessPublicKey/CSM_E_KEY_READ_FAIL, CsmKeyManagement_Ssa_SecurityAccessPublicKey/CSM_E_KEY_WRITE_FAIL, CsmKeyManagement_Ssa_SecurityAccessPublicKey/CSM_E_KEY_SIZE_MISMATCH, CsmKeyManagement_Ssa_SecurityAccessPublicKey/CSM_E_KEY_EMPTY]  # This function shall copy parts of a key element from one key to parts of a target key element of a target key.
          6 x arg, all with type=uint32, direction=IN:
            keyElementId  # Holds the identifier of the key element which shall be the source for the copy operation.
            keyElementSourceOffset  # This is the offset of the source key element indicating the start index of the copy operation.
            keyElementTargetOffset  # This is the offset of the destination key element indicating the start index of the copy operation.
            keyElementCopyLength  # Specifies the number of bytes that shall be copied.
            targetKeyId  # Holds the identifier of the key whose key element shall be the destination element.
            targetKeyElementId  # Holds the identifier of the key element which shall be the destination for the copy operation.
        KeyElementGet: possible-error=[CsmKeyManagement_Ssa_SecurityAccessPublicKey/E_NOT_OK, CsmKeyManagement_Ssa_SecurityAccessPublicKey/CSM_E_BUSY, CsmKeyManagement_Ssa_SecurityAccessPublicKey/CSM_E_SMALL_BUFFER, CsmKeyManagement_Ssa_SecurityAccessPublicKey/CSM_E_KEY_READ_FAIL, CsmKeyManagement_Ssa_SecurityAccessPublicKey/CSM_E_KEY_NOT_AVAILABLE, CsmKeyManagement_Ssa_SecurityAccessPublicKey/CSM_E_KEY_EMPTY]  # Retrieves the key element bytes from a specific key element of the key and stores the key element in the provided buffer.
          arg keyElementId: type=uint32, direction=IN  # Holds the identifier of the key element to be read.
          arg keyPtr: type=Csm_KeyDataType_Ssa_SecurityAccessPublicKey, direction=OUT, server-argument-impl-policy=USE-ARRAY-BASE-TYPE  # Holds the data to the key element bytes to be written.
          arg keyLength: type=uint32, direction=INOUT  # Contains the number of key element bytes.
        KeyElementSet: possible-error=[CsmKeyManagement_Ssa_SecurityAccessPublicKey/E_NOT_OK, CsmKeyManagement_Ssa_SecurityAccessPublicKey/CSM_E_BUSY, CsmKeyManagement_Ssa_SecurityAccessPublicKey/CSM_E_KEY_WRITE_FAIL, CsmKeyManagement_Ssa_SecurityAccessPublicKey/CSM_E_KEY_NOT_AVAILABLE, CsmKeyManagement_Ssa_SecurityAccessPublicKey/CSM_E_KEY_SIZE_MISMATCH]  # Sets the given key element bytes to the key.
          arg keyElementId: type=uint32, direction=IN  # Holds the identifier of the key element to be written.
          arg keyPtr: type=Csm_KeyDataType_Ssa_SecurityAccessPublicKey, direction=IN, server-argument-impl-policy=USE-ARRAY-BASE-TYPE  # Holds the data to the key element bytes to be processed.
          arg keyLength: type=uint32, direction=IN  # Contains the number of key element bytes.
        KeyExchangeCalcPubVal: possible-error=[CsmKeyManagement_Ssa_SecurityAccessPublicKey/E_NOT_OK, CsmKeyManagement_Ssa_SecurityAccessPublicKey/CSM_E_BUSY, CsmKeyManagement_Ssa_SecurityAccessPublicKey/CSM_E_SMALL_BUFFER, CsmKeyManagement_Ssa_SecurityAccessPublicKey/CSM_E_KEY_EMPTY]  # Calculates the public value of the current user for the key exchange and stores the public key in the provided buffer.
          arg publicValuePtr: type=Csm_PublicValueDataType_Ssa_SecurityAccessPublicKey, direction=OUT, server-argument-impl-policy=USE-ARRAY-BASE-TYPE  # Holds a pointer to the memory location in which the public value length in bytes is stored. On calling this function, this parameter shall contain the size of the buffer in bytes provided by publicValuePtr. When the request has finished, the actual length of the returned value shall be stored.
          arg publicValueLengthPtr: type=uint32, direction=INOUT  # Contains the pointer to the data where the public value shall be stored.
        KeyExchangeCalcSecret: possible-error=[CsmKeyManagement_Ssa_SecurityAccessPublicKey/E_NOT_OK, CsmKeyManagement_Ssa_SecurityAccessPublicKey/CSM_E_BUSY, CsmKeyManagement_Ssa_SecurityAccessPublicKey/CSM_E_SMALL_BUFFER, CsmKeyManagement_Ssa_SecurityAccessPublicKey/CSM_E_KEY_EMPTY]  # Calculates the shared secret key for the key exchange with the key material of the key identified by the keyId and the partner public key. The shared secret key is stored as a key element in the same key.
          arg partnerPublicValuePtr: type=Csm_PublicValueDataType_Ssa_SecurityAccessPublicKey, direction=IN, server-argument-impl-policy=USE-ARRAY-BASE-TYPE  # Holds the pointer to the memory location containing the partner's public value.
          arg partnerPublicValueLength: type=uint32, direction=IN  # Contains the number of bytes of the partner public value.
        KeyGenerate: possible-error=[CsmKeyManagement_Ssa_SecurityAccessPublicKey/E_NOT_OK, CsmKeyManagement_Ssa_SecurityAccessPublicKey/CSM_E_BUSY, CsmKeyManagement_Ssa_SecurityAccessPublicKey/CSM_E_KEY_EMPTY]  # Generates new key material and store it in the key identified by keyId.
        KeySetValid: possible-error=[CsmKeyManagement_Ssa_SecurityAccessPublicKey/E_NOT_OK, CsmKeyManagement_Ssa_SecurityAccessPublicKey/CSM_E_BUSY]  # Sets the given key element bytes to the key.
        RandomSeed: possible-error=[CsmKeyManagement_Ssa_SecurityAccessPublicKey/E_NOT_OK, CsmKeyManagement_Ssa_SecurityAccessPublicKey/CSM_E_BUSY]  # Feeds a key element with a random seed.
          arg seedPtr: type=Csm_SeedDataTypeSsa_SecurityAccessPublicKey, direction=IN, server-argument-impl-policy=USE-ARRAY-BASE-TYPE  # Holds the data which shall be used for the random seed initialization.
          arg seedLength: type=uint32, direction=IN  # Contains the length of the seed in bytes.
      8 x error:
        E_NOT_OK: error-code=1  # The service request failed.
        CSM_E_BUSY: error-code=2  # The service request failed because the service is still busy.
        CSM_E_SMALL_BUFFER: error-code=3  # The service request failed because the provided buffer is too small to store the result.
        CSM_E_KEY_READ_FAIL: error-code=6  # The service request failed because read access was denied.
        CSM_E_KEY_WRITE_FAIL: error-code=7  # The service request failed because write access was denied.
        CSM_E_KEY_NOT_AVAILABLE: error-code=8  # The service request failed because the key is not available.
        CSM_E_KEY_SIZE_MISMATCH: error-code=10  # The service request failed because the key element is not partially accessible and the provided key element length is too short or too long for that key element.
        CSM_E_KEY_EMPTY: error-code=13  # The service request failed because of uninitialized source key element.
    CsmSignatureVerify_SigVerifyEd25519ph_SyncAsync  # A digital signature is a type of asymmetric cryptography. Digital signatures are equivalent to traditional handwritten signatures in many respects. Digital signatures can be used to authenticate the source of messages as well as to prove integrity of signed messages. If a message is digitally signed, any change in the message after signature will invalidate the signature. Furthermore, there is no efficient way to modify a message and its signature to produce a new message with a valid signature.
      operation SignatureVerify: possible-error=[CsmSignatureVerify_SigVerifyEd25519ph_SyncAsync/E_NOT_OK, CsmSignatureVerify_SigVerifyEd25519ph_SyncAsync/CSM_E_BUSY, CsmSignatureVerify_SigVerifyEd25519ph_SyncAsync/CSM_E_SMALL_BUFFER, CsmSignatureVerify_SigVerifyEd25519ph_SyncAsync/CSM_E_KEY_NOT_VALID, CsmSignatureVerify_SigVerifyEd25519ph_SyncAsync/CSM_E_KEY_SIZE_MISMATCH, CsmSignatureVerify_SigVerifyEd25519ph_SyncAsync/CSM_E_KEY_EMPTY]  # This interface shall be used to start the signature verification service of the CSM module.
        5 x arg:
          dataBuffer: type=Csm_SignatureVerifyDataType_SigVerifyEd25519ph_SyncAsync, direction=IN, server-argument-impl-policy=USE-ARRAY-BASE-TYPE  # Holds a pointer to the data for which a signature shall be computed.
          dataLength: type=uint32, direction=IN  # Contains the number of bytes for which the signature shall be computed.
          compareBuffer: type=Csm_SignatureVerifyCompareType_SigVerifyEd25519ph_SyncAsync, direction=IN, server-argument-impl-policy=USE-ARRAY-BASE-TYPE  # Contains the signature to be verified.
          compareLength: type=uint32, direction=IN  # Contains the length of the signature to be verified in bytes.
          verifyResult: type=Crypto_VerifyResultType, direction=OUT  # Holds a pointer to the memory location which will hold the result of the signature verification
      operation CancelJob: possible-error=[CsmSignatureVerify_SigVerifyEd25519ph_SyncAsync/E_NOT_OK, CsmSignatureVerify_SigVerifyEd25519ph_SyncAsync/CSM_E_JOB_CANCELED]  # Cancels the Job.
      7 x error:
        E_NOT_OK: error-code=1  # The service request failed.
        CSM_E_BUSY: error-code=2  # The service request failed because the service is still busy.
        CSM_E_SMALL_BUFFER: error-code=3  # The service request failed because the provided buffer is too small to store the result.
        CSM_E_KEY_NOT_VALID: error-code=9  # The service request failed because the key is not valid.
        CSM_E_KEY_SIZE_MISMATCH: error-code=10  # The service request failed because the key element is not partially accessible and the provided key element length is too short or too long for that key element.
        CSM_E_KEY_EMPTY: error-code=13  # The service request failed because of uninitialized source key element.
        CSM_E_JOB_CANCELED: error-code=12  # The job has been marked to be aborted at the next opportunity. It will be further processed until the job finish notification.
    CsmHash_Sha2_512  # A cryptographic hash function is a deterministic procedure that takes an arbitrary block of data and returns a fixed-size bit string, the hash value, such that an accidental or intentional change to the data will change the hash value. Main properties of hash functions are that it is infeasible to find a message that has a given hash or to find two different messages with the same hash.
      operation Hash: possible-error=[CsmHash_Sha2_512/E_NOT_OK, CsmHash_Sha2_512/CSM_E_BUSY, CsmHash_Sha2_512/CSM_E_SMALL_BUFFER]  # This interface shall be used to start the hash computation service of the CSM module.
        4 x arg:
          dataBuffer: type=Csm_HashDataType_Sha2_512, direction=IN, server-argument-impl-policy=USE-ARRAY-BASE-TYPE  # Holds a pointer to the data for which a hash value shall be computed.
          dataLength: type=uint32, direction=IN  # Contains the number of bytes for which the hash value shall be computed.
          resultBuffer: type=Csm_HashResultType_Sha2_512, direction=OUT, server-argument-impl-policy=USE-ARRAY-BASE-TYPE  # Holds a pointer to the memory location which will hold the hash value. The memory location must have at least the given length.
          resultLength: type=uint32, direction=INOUT  # Holds a pointer to the memory location in which the length information is stored. On calling this function this parameter shall contain the size of the provided buffer. When the request has finished, the actual length of the returned hash value shall be stored.
      operation CancelJob: possible-error=[CsmHash_Sha2_512/E_NOT_OK, CsmHash_Sha2_512/CSM_E_JOB_CANCELED]  # Cancels the Job.
      4 x error:
        E_NOT_OK: error-code=1  # The service request failed.
        CSM_E_BUSY: error-code=2  # The service request failed because the service is still busy.
        CSM_E_SMALL_BUFFER: error-code=3  # The service request failed because the provided buffer is too small to store the result.
        CSM_E_JOB_CANCELED: error-code=12  # The job has been marked to be aborted at the next opportunity. It will be further processed until the job finish notification.
