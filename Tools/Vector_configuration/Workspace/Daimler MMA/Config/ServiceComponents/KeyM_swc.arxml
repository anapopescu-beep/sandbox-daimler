[part 2 of 6: package /MICROSAR/KeyM_swc/Interfaces]
AUTOSAR XML (schema 00049)
package /MICROSAR/KeyM_swc/Interfaces  (continued)
  153 x client server interface, all with is-service=true, service-kind=VENDOR-SPECIFIC:  (continued)
    KeyMCertificateElement_Ssa_TrustModelIntermediateCert_validityNotAfter_003  # Service of the certificate sub module to access certificate elements.
      operation CertificateElementGet: possible-error=[KeyMCertificateElement_Ssa_TrustModelIntermediateCert_validityNotAfter_003/E_NOT_OK, KeyMCertificateElement_Ssa_TrustModelIntermediateCert_validityNotAfter_003/KEYM_E_KEY_CERT_SIZE_MISMATCH, KeyMCertificateElement_Ssa_TrustModelIntermediateCert_validityNotAfter_003/KEYM_E_PARAMETER_MISMATCH, KeyMCertificateElement_Ssa_TrustModelIntermediateCert_validityNotAfter_003/KEYM_E_KEY_CERT_INVALID, KeyMCertificateElement_Ssa_TrustModelIntermediateCert_validityNotAfter_003/KEYM_E_KEY_CERT_EMPTY]  # Provides the content of a specific certificate element. The certificate configuration defines how the certificate submodule can find the element, e.g. by providing the object identifier (OID). This function is used to retrieve this information if only one element is assigned to the respective OID.
        arg CertificateElementData: type=KeyM_CertificateElementType_Ssa_TrustModelIntermediateCert_validityNotAfter_003, direction=OUT, server-argument-impl-policy=USE-ARRAY-BASE-TYPE  # Holds a pointer to the memory location which will hold the certificate element.
        arg CertificateDataLength: type=uint32, direction=OUT  # Contains the length in bytes of certificate element.
      operation CertificateElementGetByIndex: possible-error=[KeyMCertificateElement_Ssa_TrustModelIntermediateCert_validityNotAfter_003/E_NOT_OK, KeyMCertificateElement_Ssa_TrustModelIntermediateCert_validityNotAfter_003/KEYM_E_KEY_CERT_SIZE_MISMATCH, KeyMCertificateElement_Ssa_TrustModelIntermediateCert_validityNotAfter_003/KEYM_E_PARAMETER_MISMATCH, KeyMCertificateElement_Ssa_TrustModelIntermediateCert_validityNotAfter_003/KEYM_E_KEY_CERT_INVALID, KeyMCertificateElement_Ssa_TrustModelIntermediateCert_validityNotAfter_003/KEYM_E_KEY_CERT_EMPTY]  # This operation provides data from a specific certificate element.
        arg Index: type=uint16, direction=IN  # This is the index to dedicated element in the list
        arg CertificateElementData: type=KeyM_CertificateElementType_Ssa_TrustModelIntermediateCert_validityNotAfter_003, direction=OUT, server-argument-impl-policy=USE-ARRAY-BASE-TYPE  # Holds a pointer to the memory location which will hold the certificate element.
        arg CertificateDataLength: type=uint32, direction=OUT  # Contains the length in bytes of certificate element.
      operation CertificateElementGetCount: possible-error=[KeyMCertificateElement_Ssa_TrustModelIntermediateCert_validityNotAfter_003/E_NOT_OK, KeyMCertificateElement_Ssa_TrustModelIntermediateCert_validityNotAfter_003/KEYM_E_KEY_CERT_SIZE_MISMATCH, KeyMCertificateElement_Ssa_TrustModelIntermediateCert_validityNotAfter_003/KEYM_E_PARAMETER_MISMATCH, KeyMCertificateElement_Ssa_TrustModelIntermediateCert_validityNotAfter_003/KEYM_E_KEY_CERT_INVALID, KeyMCertificateElement_Ssa_TrustModelIntermediateCert_validityNotAfter_003/KEYM_E_KEY_CERT_EMPTY]  # This operation returns the amount of items available for a certificate element.
        arg count: type=uint16, direction=OUT  # Number of items available for an element.
      5 x error:
        E_NOT_OK: error-code=1  # The service request failed.
        KEYM_E_KEY_CERT_SIZE_MISMATCH: error-code=4  # The service request failed. Parameter size does not match the expected value.
        KEYM_E_PARAMETER_MISMATCH: error-code=5  # The service request failed. Parameter to function does not provide the expected value.
        KEYM_E_KEY_CERT_EMPTY: error-code=10  # The service request failed. The requested key or certificate is not available, slot is empty.
        KEYM_E_KEY_CERT_INVALID: error-code=6  # The service request failed. Key or certificate is invalid and cannot be used for the operation.
    KeyMCertificateElement_Ssa_TrustModelIntermediateCert_subject_003  # Service of the certificate sub module to access certificate elements.
      operation CertificateElementGet: possible-error=[KeyMCertificateElement_Ssa_TrustModelIntermediateCert_subject_003/E_NOT_OK, KeyMCertificateElement_Ssa_TrustModelIntermediateCert_subject_003/KEYM_E_KEY_CERT_SIZE_MISMATCH, KeyMCertificateElement_Ssa_TrustModelIntermediateCert_subject_003/KEYM_E_PARAMETER_MISMATCH, KeyMCertificateElement_Ssa_TrustModelIntermediateCert_subject_003/KEYM_E_KEY_CERT_INVALID, KeyMCertificateElement_Ssa_TrustModelIntermediateCert_subject_003/KEYM_E_KEY_CERT_EMPTY]  # Provides the content of a specific certificate element. The certificate configuration defines how the certificate submodule can find the element, e.g. by providing the object identifier (OID). This function is used to retrieve this information if only one element is assigned to the respective OID.
        arg CertificateElementData: type=KeyM_CertificateElementType_Ssa_TrustModelIntermediateCert_subject_003, direction=OUT, server-argument-impl-policy=USE-ARRAY-BASE-TYPE  # Holds a pointer to the memory location which will hold the certificate element.
        arg CertificateDataLength: type=uint32, direction=OUT  # Contains the length in bytes of certificate element.
      operation CertificateElementGetByIndex: possible-error=[KeyMCertificateElement_Ssa_TrustModelIntermediateCert_subject_003/E_NOT_OK, KeyMCertificateElement_Ssa_TrustModelIntermediateCert_subject_003/KEYM_E_KEY_CERT_SIZE_MISMATCH, KeyMCertificateElement_Ssa_TrustModelIntermediateCert_subject_003/KEYM_E_PARAMETER_MISMATCH, KeyMCertificateElement_Ssa_TrustModelIntermediateCert_subject_003/KEYM_E_KEY_CERT_INVALID, KeyMCertificateElement_Ssa_TrustModelIntermediateCert_subject_003/KEYM_E_KEY_CERT_EMPTY]  # This operation provides data from a specific certificate element.
        arg Index: type=uint16, direction=IN  # This is the index to dedicated element in the list
        arg CertificateElementData: type=KeyM_CertificateElementType_Ssa_TrustModelIntermediateCert_subject_003, direction=OUT, server-argument-impl-policy=USE-ARRAY-BASE-TYPE  # Holds a pointer to the memory location which will hold the certificate element.
        arg CertificateDataLength: type=uint32, direction=OUT  # Contains the length in bytes of certificate element.
      operation CertificateElementGetCount: possible-error=[KeyMCertificateElement_Ssa_TrustModelIntermediateCert_subject_003/E_NOT_OK, KeyMCertificateElement_Ssa_TrustModelIntermediateCert_subject_003/KEYM_E_KEY_CERT_SIZE_MISMATCH, KeyMCertificateElement_Ssa_TrustModelIntermediateCert_subject_003/KEYM_E_PARAMETER_MISMATCH, KeyMCertificateElement_Ssa_TrustModelIntermediateCert_subject_003/KEYM_E_KEY_CERT_INVALID, KeyMCertificateElement_Ssa_TrustModelIntermediateCert_subject_003/KEYM_E_KEY_CERT_EMPTY]  # This operation returns the amount of items available for a certificate element.
        arg count: type=uint16, direction=OUT  # Number of items available for an element.
      5 x error:
        E_NOT_OK: error-code=1  # The service request failed.
        KEYM_E_KEY_CERT_SIZE_MISMATCH: error-code=4  # The service request failed. Parameter size does not match the expected value.
        KEYM_E_PARAMETER_MISMATCH: error-code=5  # The service request failed. Parameter to function does not provide the expected value.
        KEYM_E_KEY_CERT_EMPTY: error-code=10  # The service request failed. The requested key or certificate is not available, slot is empty.
        KEYM_E_KEY_CERT_INVALID: error-code=6  # The service request failed. Key or certificate is invalid and cannot be used for the operation.
    KeyMCertificateElement_Ssa_TrustModelIntermediateCert_SubjectPublicKeyInfoAlgo_003  # Service of the certificate sub module to access certificate elements.
      operation CertificateElementGet: possible-error=[KeyMCertificateElement_Ssa_TrustModelIntermediateCert_SubjectPublicKeyInfoAlgo_003/E_NOT_OK, KeyMCertificateElement_Ssa_TrustModelIntermediateCert_SubjectPublicKeyInfoAlgo_003/KEYM_E_KEY_CERT_SIZE_MISMATCH, KeyMCertificateElement_Ssa_TrustModelIntermediateCert_SubjectPublicKeyInfoAlgo_003/KEYM_E_PARAMETER_MISMATCH, KeyMCertificateElement_Ssa_TrustModelIntermediateCert_SubjectPublicKeyInfoAlgo_003/KEYM_E_KEY_CERT_INVALID, KeyMCertificateElement_Ssa_TrustModelIntermediateCert_SubjectPublicKeyInfoAlgo_003/KEYM_E_KEY_CERT_EMPTY]  # Provides the content of a specific certificate element. The certificate configuration defines how the certificate submodule can find the element, e.g. by providing the object identifier (OID). This function is used to retrieve this information if only one element is assigned to the respective OID.
        arg CertificateElementData: type=KeyM_CertificateElementType_Ssa_TrustModelIntermediateCert_SubjectPublicKeyInfoAlgo_003, direction=OUT, server-argument-impl-policy=USE-ARRAY-BASE-TYPE  # Holds a pointer to the memory location which will hold the certificate element.
        arg CertificateDataLength: type=uint32, direction=OUT  # Contains the length in bytes of certificate element.
      operation CertificateElementGetByIndex: possible-error=[KeyMCertificateElement_Ssa_TrustModelIntermediateCert_SubjectPublicKeyInfoAlgo_003/E_NOT_OK, KeyMCertificateElement_Ssa_TrustModelIntermediateCert_SubjectPublicKeyInfoAlgo_003/KEYM_E_KEY_CERT_SIZE_MISMATCH, KeyMCertificateElement_Ssa_TrustModelIntermediateCert_SubjectPublicKeyInfoAlgo_003/KEYM_E_PARAMETER_MISMATCH, KeyMCertificateElement_Ssa_TrustModelIntermediateCert_SubjectPublicKeyInfoAlgo_003/KEYM_E_KEY_CERT_INVALID, KeyMCertificateElement_Ssa_TrustModelIntermediateCert_SubjectPublicKeyInfoAlgo_003/KEYM_E_KEY_CERT_EMPTY]  # This operation provides data from a specific certificate element.
        arg Index: type=uint16, direction=IN  # This is the index to dedicated element in the list
        arg CertificateElementData: type=KeyM_CertificateElementType_Ssa_TrustModelIntermediateCert_SubjectPublicKeyInfoAlgo_003, direction=OUT, server-argument-impl-policy=USE-ARRAY-BASE-TYPE  # Holds a pointer to the memory location which will hold the certificate element.
        arg CertificateDataLength: type=uint32, direction=OUT  # Contains the length in bytes of certificate element.
      operation CertificateElementGetCount: possible-error=[KeyMCertificateElement_Ssa_TrustModelIntermediateCert_SubjectPublicKeyInfoAlgo_003/E_NOT_OK, KeyMCertificateElement_Ssa_TrustModelIntermediateCert_SubjectPublicKeyInfoAlgo_003/KEYM_E_KEY_CERT_SIZE_MISMATCH, KeyMCertificateElement_Ssa_TrustModelIntermediateCert_SubjectPublicKeyInfoAlgo_003/KEYM_E_PARAMETER_MISMATCH, KeyMCertificateElement_Ssa_TrustModelIntermediateCert_SubjectPublicKeyInfoAlgo_003/KEYM_E_KEY_CERT_INVALID, KeyMCertificateElement_Ssa_TrustModelIntermediateCert_SubjectPublicKeyInfoAlgo_003/KEYM_E_KEY_CERT_EMPTY]  # This operation returns the amount of items available for a certificate element.
        arg count: type=uint16, direction=OUT  # Number of items available for an element.
      5 x error:
        E_NOT_OK: error-code=1  # The service request failed.
        KEYM_E_KEY_CERT_SIZE_MISMATCH: error-code=4  # The service request failed. Parameter size does not match the expected value.
        KEYM_E_PARAMETER_MISMATCH: error-code=5  # The service request failed. Parameter to function does not provide the expected value.
        KEYM_E_KEY_CERT_EMPTY: error-code=10  # The service request failed. The requested key or certificate is not available, slot is empty.
        KEYM_E_KEY_CERT_INVALID: error-code=6  # The service request failed. Key or certificate is invalid and cannot be used for the operation.
    KeyMCertificateElement_Ssa_TrustModelIntermediateCert_SubjectPublicKeyInfoKey_003  # Service of the certificate sub module to access certificate elements.
      operation CertificateElementGet: possible-error=[KeyMCertificateElement_Ssa_TrustModelIntermediateCert_SubjectPublicKeyInfoKey_003/E_NOT_OK, KeyMCertificateElement_Ssa_TrustModelIntermediateCert_SubjectPublicKeyInfoKey_003/KEYM_E_KEY_CERT_SIZE_MISMATCH, KeyMCertificateElement_Ssa_TrustModelIntermediateCert_SubjectPublicKeyInfoKey_003/KEYM_E_PARAMETER_MISMATCH, KeyMCertificateElement_Ssa_TrustModelIntermediateCert_SubjectPublicKeyInfoKey_003/KEYM_E_KEY_CERT_INVALID, KeyMCertificateElement_Ssa_TrustModelIntermediateCert_SubjectPublicKeyInfoKey_003/KEYM_E_KEY_CERT_EMPTY]  # Provides the content of a specific certificate element. The certificate configuration defines how the certificate submodule can find the element, e.g. by providing the object identifier (OID). This function is used to retrieve this information if only one element is assigned to the respective OID.
        arg CertificateElementData: type=KeyM_CertificateElementType_Ssa_TrustModelIntermediateCert_SubjectPublicKeyInfoKey_003, direction=OUT, server-argument-impl-policy=USE-ARRAY-BASE-TYPE  # Holds a pointer to the memory location which will hold the certificate element.
        arg CertificateDataLength: type=uint32, direction=OUT  # Contains the length in bytes of certificate element.
      operation CertificateElementGetByIndex: possible-error=[KeyMCertificateElement_Ssa_TrustModelIntermediateCert_SubjectPublicKeyInfoKey_003/E_NOT_OK, KeyMCertificateElement_Ssa_TrustModelIntermediateCert_SubjectPublicKeyInfoKey_003/KEYM_E_KEY_CERT_SIZE_MISMATCH, KeyMCertificateElement_Ssa_TrustModelIntermediateCert_SubjectPublicKeyInfoKey_003/KEYM_E_PARAMETER_MISMATCH, KeyMCertificateElement_Ssa_TrustModelIntermediateCert_SubjectPublicKeyInfoKey_003/KEYM_E_KEY_CERT_INVALID, KeyMCertificateElement_Ssa_TrustModelIntermediateCert_SubjectPublicKeyInfoKey_003/KEYM_E_KEY_CERT_EMPTY]  # This operation provides data from a specific certificate element.
        arg Index: type=uint16, direction=IN  # This is the index to dedicated element in the list
        arg CertificateElementData: type=KeyM_CertificateElementType_Ssa_TrustModelIntermediateCert_SubjectPublicKeyInfoKey_003, direction=OUT, server-argument-impl-policy=USE-ARRAY-BASE-TYPE  # Holds a pointer to the memory location which will hold the certificate element.
        arg CertificateDataLength: type=uint32, direction=OUT  # Contains the length in bytes of certificate element.
      operation CertificateElementGetCount: possible-error=[KeyMCertificateElement_Ssa_TrustModelIntermediateCert_SubjectPublicKeyInfoKey_003/E_NOT_OK, KeyMCertificateElement_Ssa_TrustModelIntermediateCert_SubjectPublicKeyInfoKey_003/KEYM_E_KEY_CERT_SIZE_MISMATCH, KeyMCertificateElement_Ssa_TrustModelIntermediateCert_SubjectPublicKeyInfoKey_003/KEYM_E_PARAMETER_MISMATCH, KeyMCertificateElement_Ssa_TrustModelIntermediateCert_SubjectPublicKeyInfoKey_003/KEYM_E_KEY_CERT_INVALID, KeyMCertificateElement_Ssa_TrustModelIntermediateCert_SubjectPublicKeyInfoKey_003/KEYM_E_KEY_CERT_EMPTY]  # This operation returns the amount of items available for a certificate element.
        arg count: type=uint16, direction=OUT  # Number of items available for an element.
      5 x error:
        E_NOT_OK: error-code=1  # The service request failed.
        KEYM_E_KEY_CERT_SIZE_MISMATCH: error-code=4  # The service request failed. Parameter size does not match the expected value.
        KEYM_E_PARAMETER_MISMATCH: error-code=5  # The service request failed. Parameter to function does not provide the expected value.
        KEYM_E_KEY_CERT_EMPTY: error-code=10  # The service request failed. The requested key or certificate is not available, slot is empty.
        KEYM_E_KEY_CERT_INVALID: error-code=6  # The service request failed. Key or certificate is invalid and cannot be used for the operation.
    KeyMCertificateElement_Ssa_TrustModelIntermediateCert_Issuer_003  # Service of the certificate sub module to access certificate elements.
      operation CertificateElementGet: possible-error=[KeyMCertificateElement_Ssa_TrustModelIntermediateCert_Issuer_003/E_NOT_OK, KeyMCertificateElement_Ssa_TrustModelIntermediateCert_Issuer_003/KEYM_E_KEY_CERT_SIZE_MISMATCH, KeyMCertificateElement_Ssa_TrustModelIntermediateCert_Issuer_003/KEYM_E_PARAMETER_MISMATCH, KeyMCertificateElement_Ssa_TrustModelIntermediateCert_Issuer_003/KEYM_E_KEY_CERT_INVALID, KeyMCertificateElement_Ssa_TrustModelIntermediateCert_Issuer_003/KEYM_E_KEY_CERT_EMPTY]  # Provides the content of a specific certificate element. The certificate configuration defines how the certificate submodule can find the element, e.g. by providing the object identifier (OID). This function is used to retrieve this information if only one element is assigned to the respective OID.
        arg CertificateElementData: type=KeyM_CertificateElementType_Ssa_TrustModelIntermediateCert_Issuer_003, direction=OUT, server-argument-impl-policy=USE-ARRAY-BASE-TYPE  # Holds a pointer to the memory location which will hold the certificate element.
        arg CertificateDataLength: type=uint32, direction=OUT  # Contains the length in bytes of certificate element.
      operation CertificateElementGetByIndex: possible-error=[KeyMCertificateElement_Ssa_TrustModelIntermediateCert_Issuer_003/E_NOT_OK, KeyMCertificateElement_Ssa_TrustModelIntermediateCert_Issuer_003/KEYM_E_KEY_CERT_SIZE_MISMATCH, KeyMCertificateElement_Ssa_TrustModelIntermediateCert_Issuer_003/KEYM_E_PARAMETER_MISMATCH, KeyMCertificateElement_Ssa_TrustModelIntermediateCert_Issuer_003/KEYM_E_KEY_CERT_INVALID, KeyMCertificateElement_Ssa_TrustModelIntermediateCert_Issuer_003/KEYM_E_KEY_CERT_EMPTY]  # This operation provides data from a specific certificate element.
        arg Index: type=uint16, direction=IN  # This is the index to dedicated element in the list
        arg CertificateElementData: type=KeyM_CertificateElementType_Ssa_TrustModelIntermediateCert_Issuer_003, direction=OUT, server-argument-impl-policy=USE-ARRAY-BASE-TYPE  # Holds a pointer to the memory location which will hold the certificate element.
        arg CertificateDataLength: type=uint32, direction=OUT  # Contains the length in bytes of certificate element.
      operation CertificateElementGetCount: possible-error=[KeyMCertificateElement_Ssa_TrustModelIntermediateCert_Issuer_003/E_NOT_OK, KeyMCertificateElement_Ssa_TrustModelIntermediateCert_Issuer_003/KEYM_E_KEY_CERT_SIZE_MISMATCH, KeyMCertificateElement_Ssa_TrustModelIntermediateCert_Issuer_003/KEYM_E_PARAMETER_MISMATCH, KeyMCertificateElement_Ssa_TrustModelIntermediateCert_Issuer_003/KEYM_E_KEY_CERT_INVALID, KeyMCertificateElement_Ssa_TrustModelIntermediateCert_Issuer_003/KEYM_E_KEY_CERT_EMPTY]  # This operation returns the amount of items available for a certificate element.
        arg count: type=uint16, direction=OUT  # Number of items available for an element.
      5 x error:
        E_NOT_OK: error-code=1  # The service request failed.
        KEYM_E_KEY_CERT_SIZE_MISMATCH: error-code=4  # The service request failed. Parameter size does not match the expected value.
        KEYM_E_PARAMETER_MISMATCH: error-code=5  # The service request failed. Parameter to function does not provide the expected value.
        KEYM_E_KEY_CERT_EMPTY: error-code=10  # The service request failed. The requested key or certificate is not available, slot is empty.
        KEYM_E_KEY_CERT_INVALID: error-code=6  # The service request failed. Key or certificate is invalid and cannot be used for the operation.
    KeyMCertificateElement_Ssa_TrustModelIntermediateCert_signatureAlgorithm_003  # Service of the certificate sub module to access certificate elements.
      operation CertificateElementGet: possible-error=[KeyMCertificateElement_Ssa_TrustModelIntermediateCert_signatureAlgorithm_003/E_NOT_OK, KeyMCertificateElement_Ssa_TrustModelIntermediateCert_signatureAlgorithm_003/KEYM_E_KEY_CERT_SIZE_MISMATCH, KeyMCertificateElement_Ssa_TrustModelIntermediateCert_signatureAlgorithm_003/KEYM_E_PARAMETER_MISMATCH, KeyMCertificateElement_Ssa_TrustModelIntermediateCert_signatureAlgorithm_003/KEYM_E_KEY_CERT_INVALID, KeyMCertificateElement_Ssa_TrustModelIntermediateCert_signatureAlgorithm_003/KEYM_E_KEY_CERT_EMPTY]  # Provides the content of a specific certificate element. The certificate configuration defines how the certificate submodule can find the element, e.g. by providing the object identifier (OID). This function is used to retrieve this information if only one element is assigned to the respective OID.
        arg CertificateElementData: type=KeyM_CertificateElementType_Ssa_TrustModelIntermediateCert_signatureAlgorithm_003, direction=OUT, server-argument-impl-policy=USE-ARRAY-BASE-TYPE  # Holds a pointer to the memory location which will hold the certificate element.
        arg CertificateDataLength: type=uint32, direction=OUT  # Contains the length in bytes of certificate element.
      operation CertificateElementGetByIndex: possible-error=[KeyMCertificateElement_Ssa_TrustModelIntermediateCert_signatureAlgorithm_003/E_NOT_OK, KeyMCertificateElement_Ssa_TrustModelIntermediateCert_signatureAlgorithm_003/KEYM_E_KEY_CERT_SIZE_MISMATCH, KeyMCertificateElement_Ssa_TrustModelIntermediateCert_signatureAlgorithm_003/KEYM_E_PARAMETER_MISMATCH, KeyMCertificateElement_Ssa_TrustModelIntermediateCert_signatureAlgorithm_003/KEYM_E_KEY_CERT_INVALID, KeyMCertificateElement_Ssa_TrustModelIntermediateCert_signatureAlgorithm_003/KEYM_E_KEY_CERT_EMPTY]  # This operation provides data from a specific certificate element.
        arg Index: type=uint16, direction=IN  # This is the index to dedicated element in the list
        arg CertificateElementData: type=KeyM_CertificateElementType_Ssa_TrustModelIntermediateCert_signatureAlgorithm_003, direction=OUT, server-argument-impl-policy=USE-ARRAY-BASE-TYPE  # Holds a pointer to the memory location which will hold the certificate element.
        arg CertificateDataLength: type=uint32, direction=OUT  # Contains the length in bytes of certificate element.
      operation CertificateElementGetCount: possible-error=[KeyMCertificateElement_Ssa_TrustModelIntermediateCert_signatureAlgorithm_003/E_NOT_OK, KeyMCertificateElement_Ssa_TrustModelIntermediateCert_signatureAlgorithm_003/KEYM_E_KEY_CERT_SIZE_MISMATCH, KeyMCertificateElement_Ssa_TrustModelIntermediateCert_signatureAlgorithm_003/KEYM_E_PARAMETER_MISMATCH, KeyMCertificateElement_Ssa_TrustModelIntermediateCert_signatureAlgorithm_003/KEYM_E_KEY_CERT_INVALID, KeyMCertificateElement_Ssa_TrustModelIntermediateCert_signatureAlgorithm_003/KEYM_E_KEY_CERT_EMPTY]  # This operation returns the amount of items available for a certificate element.
        arg count: type=uint16, direction=OUT  # Number of items available for an element.
      5 x error:
        E_NOT_OK: error-code=1  # The service request failed.
        KEYM_E_KEY_CERT_SIZE_MISMATCH: error-code=4  # The service request failed. Parameter size does not match the expected value.
        KEYM_E_PARAMETER_MISMATCH: error-code=5  # The service request failed. Parameter to function does not provide the expected value.
        KEYM_E_KEY_CERT_EMPTY: error-code=10  # The service request failed. The requested key or certificate is not available, slot is empty.
        KEYM_E_KEY_CERT_INVALID: error-code=6  # The service request failed. Key or certificate is invalid and cannot be used for the operation.
    KeyMCertificateElement_Ssa_TrustModelIntermediateCert_signatureValue_003  # Service of the certificate sub module to access certificate elements.
      operation CertificateElementGet: possible-error=[KeyMCertificateElement_Ssa_TrustModelIntermediateCert_signatureValue_003/E_NOT_OK, KeyMCertificateElement_Ssa_TrustModelIntermediateCert_signatureValue_003/KEYM_E_KEY_CERT_SIZE_MISMATCH, KeyMCertificateElement_Ssa_TrustModelIntermediateCert_signatureValue_003/KEYM_E_PARAMETER_MISMATCH, KeyMCertificateElement_Ssa_TrustModelIntermediateCert_signatureValue_003/KEYM_E_KEY_CERT_INVALID, KeyMCertificateElement_Ssa_TrustModelIntermediateCert_signatureValue_003/KEYM_E_KEY_CERT_EMPTY]  # Provides the content of a specific certificate element. The certificate configuration defines how the certificate submodule can find the element, e.g. by providing the object identifier (OID). This function is used to retrieve this information if only one element is assigned to the respective OID.
        arg CertificateElementData: type=KeyM_CertificateElementType_Ssa_TrustModelIntermediateCert_signatureValue_003, direction=OUT, server-argument-impl-policy=USE-ARRAY-BASE-TYPE  # Holds a pointer to the memory location which will hold the certificate element.
        arg CertificateDataLength: type=uint32, direction=OUT  # Contains the length in bytes of certificate element.
      operation CertificateElementGetByIndex: possible-error=[KeyMCertificateElement_Ssa_TrustModelIntermediateCert_signatureValue_003/E_NOT_OK, KeyMCertificateElement_Ssa_TrustModelIntermediateCert_signatureValue_003/KEYM_E_KEY_CERT_SIZE_MISMATCH, KeyMCertificateElement_Ssa_TrustModelIntermediateCert_signatureValue_003/KEYM_E_PARAMETER_MISMATCH, KeyMCertificateElement_Ssa_TrustModelIntermediateCert_signatureValue_003/KEYM_E_KEY_CERT_INVALID, KeyMCertificateElement_Ssa_TrustModelIntermediateCert_signatureValue_003/KEYM_E_KEY_CERT_EMPTY]  # This operation provides data from a specific certificate element.
        arg Index: type=uint16, direction=IN  # This is the index to dedicated element in the list
        arg CertificateElementData: type=KeyM_CertificateElementType_Ssa_TrustModelIntermediateCert_signatureValue_003, direction=OUT, server-argument-impl-policy=USE-ARRAY-BASE-TYPE  # Holds a pointer to the memory location which will hold the certificate element.
        arg CertificateDataLength: type=uint32, direction=OUT  # Contains the length in bytes of certificate element.
      operation CertificateElementGetCount: possible-error=[KeyMCertificateElement_Ssa_TrustModelIntermediateCert_signatureValue_003/E_NOT_OK, KeyMCertificateElement_Ssa_TrustModelIntermediateCert_signatureValue_003/KEYM_E_KEY_CERT_SIZE_MISMATCH, KeyMCertificateElement_Ssa_TrustModelIntermediateCert_signatureValue_003/KEYM_E_PARAMETER_MISMATCH, KeyMCertificateElement_Ssa_TrustModelIntermediateCert_signatureValue_003/KEYM_E_KEY_CERT_INVALID, KeyMCertificateElement_Ssa_TrustModelIntermediateCert_signatureValue_003/KEYM_E_KEY_CERT_EMPTY]  # This operation returns the amount of items available for a certificate element.
        arg count: type=uint16, direction=OUT  # Number of items available for an element.
      5 x error:
        E_NOT_OK: error-code=1  # The service request failed.
        KEYM_E_KEY_CERT_SIZE_MISMATCH: error-code=4  # The service request failed. Parameter size does not match the expected value.
        KEYM_E_PARAMETER_MISMATCH: error-code=5  # The service request failed. Parameter to function does not provide the expected value.
        KEYM_E_KEY_CERT_EMPTY: error-code=10  # The service request failed. The requested key or certificate is not available, slot is empty.
        KEYM_E_KEY_CERT_INVALID: error-code=6  # The service request failed. Key or certificate is invalid and cannot be used for the operation.
    KeyMCertificate_Ssa_TrustModelBackendCert  # Service of Certificate sub module
      4 x operation:
        GetCertificate: possible-error=[KeyMCertificate_Ssa_TrustModelBackendCert/E_NOT_OK, KeyMCertificate_Ssa_TrustModelBackendCert/KEYM_E_KEY_CERT_SIZE_MISMATCH, KeyMCertificate_Ssa_TrustModelBackendCert/KEYM_E_PARAMETER_MISMATCH, KeyMCertificate_Ssa_TrustModelBackendCert/KEYM_E_KEY_CERT_READ_FAIL, KeyMCertificate_Ssa_TrustModelBackendCert/KEYM_E_KEY_CERT_EMPTY]  # Read certificate data from the certificate sub module
          arg Certificate: type=KeyM_CertificateType_Ssa_TrustModelBackendCert, direction=OUT  # Holds a pointer to the memory location which will hold the Certificate.
        GetStatus: possible-error=KeyMCertificate_Ssa_TrustModelBackendCert/E_NOT_OK  # Provides the status of a certificate.
          arg Status: type=KeyM_CertificateStatusType, direction=OUT  # Holds a pointer to the memory location which will hold the Certificate Status.
        SetCertificate: possible-error=[KeyMCertificate_Ssa_TrustModelBackendCert/E_NOT_OK, KeyMCertificate_Ssa_TrustModelBackendCert/KEYM_E_KEY_CERT_SIZE_MISMATCH, KeyMCertificate_Ssa_TrustModelBackendCert/KEYM_E_PARAMETER_MISMATCH, KeyMCertificate_Ssa_TrustModelBackendCert/KEYM_E_KEY_CERT_WRITE_FAIL]  # Provides certificate data to be processed by the certificate sub module.
          arg Certificate: type=KeyM_CertificateType_Ssa_TrustModelBackendCert, direction=IN  # Holds a pointer to Certificate.
        VerifyCertificate: possible-error=[KeyMCertificate_Ssa_TrustModelBackendCert/E_NOT_OK, KeyMCertificate_Ssa_TrustModelBackendCert/KEYM_E_BUSY, KeyMCertificate_Ssa_TrustModelBackendCert/KEYM_E_KEY_CERT_SIZE_MISMATCH, KeyMCertificate_Ssa_TrustModelBackendCert/KEYM_E_PARAMETER_MISMATCH, KeyMCertificate_Ssa_TrustModelBackendCert/KEYM_E_KEY_CERT_EMPTY, KeyMCertificate_Ssa_TrustModelBackendCert/KEYM_E_CERT_INVALID_CHAIN_OF_TRUST]  # Verify certificate data from the certificate sub module .
      8 x error:
        E_NOT_OK: error-code=1  # The service request failed.
        KEYM_E_BUSY: error-code=2  # The service request failed. Key management is busy with other operations.
        KEYM_E_KEY_CERT_SIZE_MISMATCH: error-code=4  # The service request failed. Parameter size does not match the expected value.
        KEYM_E_PARAMETER_MISMATCH: error-code=5  # The service request failed. Parameter to function does not provide the expected value.
        KEYM_E_KEY_CERT_WRITE_FAIL: error-code=7  # The service request failed. Certificate or key write operation failed.
        KEYM_E_KEY_CERT_READ_FAIL: error-code=9  # The service request failed. Certificate or key could not be provided due to a read or permission failure.
        KEYM_E_KEY_CERT_EMPTY: error-code=10  # The service request failed. The requested key or certificate is not available, slot is empty.
        KEYM_E_CERT_INVALID_CHAIN_OF_TRUST: error-code=11  # The service request failed. Certificate verification failed - Invalid Chain of Trust.
    KeyMCertificateExtended_Ssa_TrustModelBackendCert  # Services of Certificate sub module that extend the standard AUTOSAR services
      operation ServiceCertificate: possible-error=[KeyMCertificateExtended_Ssa_TrustModelBackendCert/E_NOT_OK, KeyMCertificateExtended_Ssa_TrustModelBackendCert/KEYM_E_BUSY, KeyMCertificateExtended_Ssa_TrustModelBackendCert/KEYM_E_KEY_CERT_SIZE_MISMATCH, KeyMCertificateExtended_Ssa_TrustModelBackendCert/KEYM_E_PARAMETER_MISMATCH, KeyMCertificateExtended_Ssa_TrustModelBackendCert/KEYM_E_KEY_CERT_EMPTY, KeyMCertificateExtended_Ssa_TrustModelBackendCert/KEYM_E_CERT_INVALID_CHAIN_OF_TRUST]  # Handle certificate operation request in the certificate sub module.
        5 x arg, all with direction=IN:
          Service: type=KeyM_ServiceCertificateType  # Provides the type of service the key manager has to perform.
          RequestData: type=KeyM_ConstDataPtrType  # Information that comes along with the request.
          RequestDataLength: type=uint32  # Length of data in the RequestData array.
          ResponseData: type=KeyM_DataPtrType  # Pointer to array in which the request response data will be stored upon request completion.
          ResponseDataLength: type=uint32  # Max number of bytes available in ResponseDataPtr.
      operation CsrElementSet: possible-error=[KeyMCertificateExtended_Ssa_TrustModelBackendCert/E_NOT_OK, KeyMCertificateExtended_Ssa_TrustModelBackendCert/KEYM_E_PARAMETER_MISMATCH]  # To be used before calling GenerateCertificationRequestInfo. Adds an data to the certificate for which a signing request shall be build.
        4 x arg, all with direction=IN:
          CertElementId: type=KeyM_CertElementIdType  # Element ID of the element that shall be added
          EncodingType: type=KeyM_CsrEncodingType  # Encoding type of the CSR element
          ElementData: type=KeyM_ConstDataPtrType  # Data of the element that shall be added
          ElementDataLength: type=uint32  # Length of ElementData data in the ElementData array
      6 x error:
        E_NOT_OK: error-code=1  # The service request failed.
        KEYM_E_BUSY: error-code=2  # The service request failed. Key management is busy with other operations.
        KEYM_E_KEY_CERT_SIZE_MISMATCH: error-code=4  # The service request failed. Parameter size does not match the expected value.
        KEYM_E_PARAMETER_MISMATCH: error-code=5  # The service request failed. Parameter to function does not provide the expected value.
        KEYM_E_KEY_CERT_EMPTY: error-code=10  # The service request failed. The requested key or certificate is not available, slot is empty.
        KEYM_E_CERT_INVALID_CHAIN_OF_TRUST: error-code=11  # The service request failed. Certificate verification failed - Invalid Chain of Trust.
    KeyMCertificateElement_Ssa_TrustModelBackendCert_ext_authKeyId_002  # Service of the certificate sub module to access certificate elements.
      operation CertificateElementGet: possible-error=[KeyMCertificateElement_Ssa_TrustModelBackendCert_ext_authKeyId_002/E_NOT_OK, KeyMCertificateElement_Ssa_TrustModelBackendCert_ext_authKeyId_002/KEYM_E_KEY_CERT_SIZE_MISMATCH, KeyMCertificateElement_Ssa_TrustModelBackendCert_ext_authKeyId_002/KEYM_E_PARAMETER_MISMATCH, KeyMCertificateElement_Ssa_TrustModelBackendCert_ext_authKeyId_002/KEYM_E_KEY_CERT_INVALID, KeyMCertificateElement_Ssa_TrustModelBackendCert_ext_authKeyId_002/KEYM_E_KEY_CERT_EMPTY]  # Provides the content of a specific certificate element. The certificate configuration defines how the certificate submodule can find the element, e.g. by providing the object identifier (OID). This function is used to retrieve this information if only one element is assigned to the respective OID.
        arg CertificateElementData: type=KeyM_CertificateElementType_Ssa_TrustModelBackendCert_ext_authKeyId_002, direction=OUT, server-argument-impl-policy=USE-ARRAY-BASE-TYPE  # Holds a pointer to the memory location which will hold the certificate element.
        arg CertificateDataLength: type=uint32, direction=OUT  # Contains the length in bytes of certificate element.
      operation CertificateElementGetByIndex: possible-error=[KeyMCertificateElement_Ssa_TrustModelBackendCert_ext_authKeyId_002/E_NOT_OK, KeyMCertificateElement_Ssa_TrustModelBackendCert_ext_authKeyId_002/KEYM_E_KEY_CERT_SIZE_MISMATCH, KeyMCertificateElement_Ssa_TrustModelBackendCert_ext_authKeyId_002/KEYM_E_PARAMETER_MISMATCH, KeyMCertificateElement_Ssa_TrustModelBackendCert_ext_authKeyId_002/KEYM_E_KEY_CERT_INVALID, KeyMCertificateElement_Ssa_TrustModelBackendCert_ext_authKeyId_002/KEYM_E_KEY_CERT_EMPTY]  # This operation provides data from a specific certificate element.
        arg Index: type=uint16, direction=IN  # This is the index to dedicated element in the list
        arg CertificateElementData: type=KeyM_CertificateElementType_Ssa_TrustModelBackendCert_ext_authKeyId_002, direction=OUT, server-argument-impl-policy=USE-ARRAY-BASE-TYPE  # Holds a pointer to the memory location which will hold the certificate element.
        arg CertificateDataLength: type=uint32, direction=OUT  # Contains the length in bytes of certificate element.
      operation CertificateElementGetCount: possible-error=[KeyMCertificateElement_Ssa_TrustModelBackendCert_ext_authKeyId_002/E_NOT_OK, KeyMCertificateElement_Ssa_TrustModelBackendCert_ext_authKeyId_002/KEYM_E_KEY_CERT_SIZE_MISMATCH, KeyMCertificateElement_Ssa_TrustModelBackendCert_ext_authKeyId_002/KEYM_E_PARAMETER_MISMATCH, KeyMCertificateElement_Ssa_TrustModelBackendCert_ext_authKeyId_002/KEYM_E_KEY_CERT_INVALID, KeyMCertificateElement_Ssa_TrustModelBackendCert_ext_authKeyId_002/KEYM_E_KEY_CERT_EMPTY]  # This operation returns the amount of items available for a certificate element.
        arg count: type=uint16, direction=OUT  # Number of items available for an element.
      5 x error:
        E_NOT_OK: error-code=1  # The service request failed.
        KEYM_E_KEY_CERT_SIZE_MISMATCH: error-code=4  # The service request failed. Parameter size does not match the expected value.
        KEYM_E_PARAMETER_MISMATCH: error-code=5  # The service request failed. Parameter to function does not provide the expected value.
        KEYM_E_KEY_CERT_EMPTY: error-code=10  # The service request failed. The requested key or certificate is not available, slot is empty.
        KEYM_E_KEY_CERT_INVALID: error-code=6  # The service request failed. Key or certificate is invalid and cannot be used for the operation.
    KeyMCertificateElement_Ssa_TrustModelBackendCert_ext_subKeyId_002  # Service of the certificate sub module to access certificate elements.
      operation CertificateElementGet: possible-error=[KeyMCertificateElement_Ssa_TrustModelBackendCert_ext_subKeyId_002/E_NOT_OK, KeyMCertificateElement_Ssa_TrustModelBackendCert_ext_subKeyId_002/KEYM_E_KEY_CERT_SIZE_MISMATCH, KeyMCertificateElement_Ssa_TrustModelBackendCert_ext_subKeyId_002/KEYM_E_PARAMETER_MISMATCH, KeyMCertificateElement_Ssa_TrustModelBackendCert_ext_subKeyId_002/KEYM_E_KEY_CERT_INVALID, KeyMCertificateElement_Ssa_TrustModelBackendCert_ext_subKeyId_002/KEYM_E_KEY_CERT_EMPTY]  # Provides the content of a specific certificate element. The certificate configuration defines how the certificate submodule can find the element, e.g. by providing the object identifier (OID). This function is used to retrieve this information if only one element is assigned to the respective OID.
        arg CertificateElementData: type=KeyM_CertificateElementType_Ssa_TrustModelBackendCert_ext_subKeyId_002, direction=OUT, server-argument-impl-policy=USE-ARRAY-BASE-TYPE  # Holds a pointer to the memory location which will hold the certificate element.
        arg CertificateDataLength: type=uint32, direction=OUT  # Contains the length in bytes of certificate element.
      operation CertificateElementGetByIndex: possible-error=[KeyMCertificateElement_Ssa_TrustModelBackendCert_ext_subKeyId_002/E_NOT_OK, KeyMCertificateElement_Ssa_TrustModelBackendCert_ext_subKeyId_002/KEYM_E_KEY_CERT_SIZE_MISMATCH, KeyMCertificateElement_Ssa_TrustModelBackendCert_ext_subKeyId_002/KEYM_E_PARAMETER_MISMATCH, KeyMCertificateElement_Ssa_TrustModelBackendCert_ext_subKeyId_002/KEYM_E_KEY_CERT_INVALID, KeyMCertificateElement_Ssa_TrustModelBackendCert_ext_subKeyId_002/KEYM_E_KEY_CERT_EMPTY]  # This operation provides data from a specific certificate element.
        arg Index: type=uint16, direction=IN  # This is the index to dedicated element in the list
        arg CertificateElementData: type=KeyM_CertificateElementType_Ssa_TrustModelBackendCert_ext_subKeyId_002, direction=OUT, server-argument-impl-policy=USE-ARRAY-BASE-TYPE  # Holds a pointer to the memory location which will hold the certificate element.
        arg CertificateDataLength: type=uint32, direction=OUT  # Contains the length in bytes of certificate element.
      operation CertificateElementGetCount: possible-error=[KeyMCertificateElement_Ssa_TrustModelBackendCert_ext_subKeyId_002/E_NOT_OK, KeyMCertificateElement_Ssa_TrustModelBackendCert_ext_subKeyId_002/KEYM_E_KEY_CERT_SIZE_MISMATCH, KeyMCertificateElement_Ssa_TrustModelBackendCert_ext_subKeyId_002/KEYM_E_PARAMETER_MISMATCH, KeyMCertificateElement_Ssa_TrustModelBackendCert_ext_subKeyId_002/KEYM_E_KEY_CERT_INVALID, KeyMCertificateElement_Ssa_TrustModelBackendCert_ext_subKeyId_002/KEYM_E_KEY_CERT_EMPTY]  # This operation returns the amount of items available for a certificate element.
        arg count: type=uint16, direction=OUT  # Number of items available for an element.
      5 x error:
        E_NOT_OK: error-code=1  # The service request failed.
        KEYM_E_KEY_CERT_SIZE_MISMATCH: error-code=4  # The service request failed. Parameter size does not match the expected value.
        KEYM_E_PARAMETER_MISMATCH: error-code=5  # The service request failed. Parameter to function does not provide the expected value.
        KEYM_E_KEY_CERT_EMPTY: error-code=10  # The service request failed. The requested key or certificate is not available, slot is empty.
        KEYM_E_KEY_CERT_INVALID: error-code=6  # The service request failed. Key or certificate is invalid and cannot be used for the operation.
    KeyMCertificateElement_Ssa_TrustModelBackendCert_ext_basicConstraints_002  # Service of the certificate sub module to access certificate elements.
      operation CertificateElementGet: possible-error=[KeyMCertificateElement_Ssa_TrustModelBackendCert_ext_basicConstraints_002/E_NOT_OK, KeyMCertificateElement_Ssa_TrustModelBackendCert_ext_basicConstraints_002/KEYM_E_KEY_CERT_SIZE_MISMATCH, KeyMCertificateElement_Ssa_TrustModelBackendCert_ext_basicConstraints_002/KEYM_E_PARAMETER_MISMATCH, KeyMCertificateElement_Ssa_TrustModelBackendCert_ext_basicConstraints_002/KEYM_E_KEY_CERT_INVALID, KeyMCertificateElement_Ssa_TrustModelBackendCert_ext_basicConstraints_002/KEYM_E_KEY_CERT_EMPTY]  # Provides the content of a specific certificate element. The certificate configuration defines how the certificate submodule can find the element, e.g. by providing the object identifier (OID). This function is used to retrieve this information if only one element is assigned to the respective OID.
        arg CertificateElementData: type=KeyM_CertificateElementType_Ssa_TrustModelBackendCert_ext_basicConstraints_002, direction=OUT, server-argument-impl-policy=USE-ARRAY-BASE-TYPE  # Holds a pointer to the memory location which will hold the certificate element.
        arg CertificateDataLength: type=uint32, direction=OUT  # Contains the length in bytes of certificate element.
      operation CertificateElementGetByIndex: possible-error=[KeyMCertificateElement_Ssa_TrustModelBackendCert_ext_basicConstraints_002/E_NOT_OK, KeyMCertificateElement_Ssa_TrustModelBackendCert_ext_basicConstraints_002/KEYM_E_KEY_CERT_SIZE_MISMATCH, KeyMCertificateElement_Ssa_TrustModelBackendCert_ext_basicConstraints_002/KEYM_E_PARAMETER_MISMATCH, KeyMCertificateElement_Ssa_TrustModelBackendCert_ext_basicConstraints_002/KEYM_E_KEY_CERT_INVALID, KeyMCertificateElement_Ssa_TrustModelBackendCert_ext_basicConstraints_002/KEYM_E_KEY_CERT_EMPTY]  # This operation provides data from a specific certificate element.
        arg Index: type=uint16, direction=IN  # This is the index to dedicated element in the list
        arg CertificateElementData: type=KeyM_CertificateElementType_Ssa_TrustModelBackendCert_ext_basicConstraints_002, direction=OUT, server-argument-impl-policy=USE-ARRAY-BASE-TYPE  # Holds a pointer to the memory location which will hold the certificate element.
        arg CertificateDataLength: type=uint32, direction=OUT  # Contains the length in bytes of certificate element.
      operation CertificateElementGetCount: possible-error=[KeyMCertificateElement_Ssa_TrustModelBackendCert_ext_basicConstraints_002/E_NOT_OK, KeyMCertificateElement_Ssa_TrustModelBackendCert_ext_basicConstraints_002/KEYM_E_KEY_CERT_SIZE_MISMATCH, KeyMCertificateElement_Ssa_TrustModelBackendCert_ext_basicConstraints_002/KEYM_E_PARAMETER_MISMATCH, KeyMCertificateElement_Ssa_TrustModelBackendCert_ext_basicConstraints_002/KEYM_E_KEY_CERT_INVALID, KeyMCertificateElement_Ssa_TrustModelBackendCert_ext_basicConstraints_002/KEYM_E_KEY_CERT_EMPTY]  # This operation returns the amount of items available for a certificate element.
        arg count: type=uint16, direction=OUT  # Number of items available for an element.
      5 x error:
        E_NOT_OK: error-code=1  # The service request failed.
        KEYM_E_KEY_CERT_SIZE_MISMATCH: error-code=4  # The service request failed. Parameter size does not match the expected value.
        KEYM_E_PARAMETER_MISMATCH: error-code=5  # The service request failed. Parameter to function does not provide the expected value.
        KEYM_E_KEY_CERT_EMPTY: error-code=10  # The service request failed. The requested key or certificate is not available, slot is empty.
        KEYM_E_KEY_CERT_INVALID: error-code=6  # The service request failed. Key or certificate is invalid and cannot be used for the operation.
    KeyMCertificateElement_Ssa_TrustModelBackendCert_ext_keyUsage_002  # Service of the certificate sub module to access certificate elements.
      operation CertificateElementGet: possible-error=[KeyMCertificateElement_Ssa_TrustModelBackendCert_ext_keyUsage_002/E_NOT_OK, KeyMCertificateElement_Ssa_TrustModelBackendCert_ext_keyUsage_002/KEYM_E_KEY_CERT_SIZE_MISMATCH, KeyMCertificateElement_Ssa_TrustModelBackendCert_ext_keyUsage_002/KEYM_E_PARAMETER_MISMATCH, KeyMCertificateElement_Ssa_TrustModelBackendCert_ext_keyUsage_002/KEYM_E_KEY_CERT_INVALID, KeyMCertificateElement_Ssa_TrustModelBackendCert_ext_keyUsage_002/KEYM_E_KEY_CERT_EMPTY]  # Provides the content of a specific certificate element. The certificate configuration defines how the certificate submodule can find the element, e.g. by providing the object identifier (OID). This function is used to retrieve this information if only one element is assigned to the respective OID.
        arg CertificateElementData: type=KeyM_CertificateElementType_Ssa_TrustModelBackendCert_ext_keyUsage_002, direction=OUT, server-argument-impl-policy=USE-ARRAY-BASE-TYPE  # Holds a pointer to the memory location which will hold the certificate element.
        arg CertificateDataLength: type=uint32, direction=OUT  # Contains the length in bytes of certificate element.
      operation CertificateElementGetByIndex: possible-error=[KeyMCertificateElement_Ssa_TrustModelBackendCert_ext_keyUsage_002/E_NOT_OK, KeyMCertificateElement_Ssa_TrustModelBackendCert_ext_keyUsage_002/KEYM_E_KEY_CERT_SIZE_MISMATCH, KeyMCertificateElement_Ssa_TrustModelBackendCert_ext_keyUsage_002/KEYM_E_PARAMETER_MISMATCH, KeyMCertificateElement_Ssa_TrustModelBackendCert_ext_keyUsage_002/KEYM_E_KEY_CERT_INVALID, KeyMCertificateElement_Ssa_TrustModelBackendCert_ext_keyUsage_002/KEYM_E_KEY_CERT_EMPTY]  # This operation provides data from a specific certificate element.
        arg Index: type=uint16, direction=IN  # This is the index to dedicated element in the list
        arg CertificateElementData: type=KeyM_CertificateElementType_Ssa_TrustModelBackendCert_ext_keyUsage_002, direction=OUT, server-argument-impl-policy=USE-ARRAY-BASE-TYPE  # Holds a pointer to the memory location which will hold the certificate element.
        arg CertificateDataLength: type=uint32, direction=OUT  # Contains the length in bytes of certificate element.
      operation CertificateElementGetCount: possible-error=[KeyMCertificateElement_Ssa_TrustModelBackendCert_ext_keyUsage_002/E_NOT_OK, KeyMCertificateElement_Ssa_TrustModelBackendCert_ext_keyUsage_002/KEYM_E_KEY_CERT_SIZE_MISMATCH, KeyMCertificateElement_Ssa_TrustModelBackendCert_ext_keyUsage_002/KEYM_E_PARAMETER_MISMATCH, KeyMCertificateElement_Ssa_TrustModelBackendCert_ext_keyUsage_002/KEYM_E_KEY_CERT_INVALID, KeyMCertificateElement_Ssa_TrustModelBackendCert_ext_keyUsage_002/KEYM_E_KEY_CERT_EMPTY]  # This operation returns the amount of items available for a certificate element.
        arg count: type=uint16, direction=OUT  # Number of items available for an element.
      5 x error:
        E_NOT_OK: error-code=1  # The service request failed.
        KEYM_E_KEY_CERT_SIZE_MISMATCH: error-code=4  # The service request failed. Parameter size does not match the expected value.
        KEYM_E_PARAMETER_MISMATCH: error-code=5  # The service request failed. Parameter to function does not provide the expected value.
        KEYM_E_KEY_CERT_EMPTY: error-code=10  # The service request failed. The requested key or certificate is not available, slot is empty.
        KEYM_E_KEY_CERT_INVALID: error-code=6  # The service request failed. Key or certificate is invalid and cannot be used for the operation.
    KeyMCertificateElement_Ssa_TrustModelBackendCert_ext_pkiRole_002  # Service of the certificate sub module to access certificate elements.
      operation CertificateElementGet: possible-error=[KeyMCertificateElement_Ssa_TrustModelBackendCert_ext_pkiRole_002/E_NOT_OK, KeyMCertificateElement_Ssa_TrustModelBackendCert_ext_pkiRole_002/KEYM_E_KEY_CERT_SIZE_MISMATCH, KeyMCertificateElement_Ssa_TrustModelBackendCert_ext_pkiRole_002/KEYM_E_PARAMETER_MISMATCH, KeyMCertificateElement_Ssa_TrustModelBackendCert_ext_pkiRole_002/KEYM_E_KEY_CERT_INVALID, KeyMCertificateElement_Ssa_TrustModelBackendCert_ext_pkiRole_002/KEYM_E_KEY_CERT_EMPTY]  # Provides the content of a specific certificate element. The certificate configuration defines how the certificate submodule can find the element, e.g. by providing the object identifier (OID). This function is used to retrieve this information if only one element is assigned to the respective OID.
        arg CertificateElementData: type=KeyM_CertificateElementType_Ssa_TrustModelBackendCert_ext_pkiRole_002, direction=OUT, server-argument-impl-policy=USE-ARRAY-BASE-TYPE  # Holds a pointer to the memory location which will hold the certificate element.
        arg CertificateDataLength: type=uint32, direction=OUT  # Contains the length in bytes of certificate element.
      operation CertificateElementGetByIndex: possible-error=[KeyMCertificateElement_Ssa_TrustModelBackendCert_ext_pkiRole_002/E_NOT_OK, KeyMCertificateElement_Ssa_TrustModelBackendCert_ext_pkiRole_002/KEYM_E_KEY_CERT_SIZE_MISMATCH, KeyMCertificateElement_Ssa_TrustModelBackendCert_ext_pkiRole_002/KEYM_E_PARAMETER_MISMATCH, KeyMCertificateElement_Ssa_TrustModelBackendCert_ext_pkiRole_002/KEYM_E_KEY_CERT_INVALID, KeyMCertificateElement_Ssa_TrustModelBackendCert_ext_pkiRole_002/KEYM_E_KEY_CERT_EMPTY]  # This operation provides data from a specific certificate element.
        arg Index: type=uint16, direction=IN  # This is the index to dedicated element in the list
        arg CertificateElementData: type=KeyM_CertificateElementType_Ssa_TrustModelBackendCert_ext_pkiRole_002, direction=OUT, server-argument-impl-policy=USE-ARRAY-BASE-TYPE  # Holds a pointer to the memory location which will hold the certificate element.
        arg CertificateDataLength: type=uint32, direction=OUT  # Contains the length in bytes of certificate element.
      operation CertificateElementGetCount: possible-error=[KeyMCertificateElement_Ssa_TrustModelBackendCert_ext_pkiRole_002/E_NOT_OK, KeyMCertificateElement_Ssa_TrustModelBackendCert_ext_pkiRole_002/KEYM_E_KEY_CERT_SIZE_MISMATCH, KeyMCertificateElement_Ssa_TrustModelBackendCert_ext_pkiRole_002/KEYM_E_PARAMETER_MISMATCH, KeyMCertificateElement_Ssa_TrustModelBackendCert_ext_pkiRole_002/KEYM_E_KEY_CERT_INVALID, KeyMCertificateElement_Ssa_TrustModelBackendCert_ext_pkiRole_002/KEYM_E_KEY_CERT_EMPTY]  # This operation returns the amount of items available for a certificate element.
        arg count: type=uint16, direction=OUT  # Number of items available for an element.
      5 x error:
        E_NOT_OK: error-code=1  # The service request failed.
        KEYM_E_KEY_CERT_SIZE_MISMATCH: error-code=4  # The service request failed. Parameter size does not match the expected value.
        KEYM_E_PARAMETER_MISMATCH: error-code=5  # The service request failed. Parameter to function does not provide the expected value.
        KEYM_E_KEY_CERT_EMPTY: error-code=10  # The service request failed. The requested key or certificate is not available, slot is empty.
        KEYM_E_KEY_CERT_INVALID: error-code=6  # The service request failed. Key or certificate is invalid and cannot be used for the operation.
    KeyMCertificateElement_Ssa_TrustModelBackendCert_Version_002  # Service of the certificate sub module to access certificate elements.
      operation CertificateElementGet: possible-error=[KeyMCertificateElement_Ssa_TrustModelBackendCert_Version_002/E_NOT_OK, KeyMCertificateElement_Ssa_TrustModelBackendCert_Version_002/KEYM_E_KEY_CERT_SIZE_MISMATCH, KeyMCertificateElement_Ssa_TrustModelBackendCert_Version_002/KEYM_E_PARAMETER_MISMATCH, KeyMCertificateElement_Ssa_TrustModelBackendCert_Version_002/KEYM_E_KEY_CERT_INVALID, KeyMCertificateElement_Ssa_TrustModelBackendCert_Version_002/KEYM_E_KEY_CERT_EMPTY]  # Provides the content of a specific certificate element. The certificate configuration defines how the certificate submodule can find the element, e.g. by providing the object identifier (OID). This function is used to retrieve this information if only one element is assigned to the respective OID.
        arg CertificateElementData: type=KeyM_CertificateElementType_Ssa_TrustModelBackendCert_Version_002, direction=OUT, server-argument-impl-policy=USE-ARRAY-BASE-TYPE  # Holds a pointer to the memory location which will hold the certificate element.
        arg CertificateDataLength: type=uint32, direction=OUT  # Contains the length in bytes of certificate element.
      operation CertificateElementGetByIndex: possible-error=[KeyMCertificateElement_Ssa_TrustModelBackendCert_Version_002/E_NOT_OK, KeyMCertificateElement_Ssa_TrustModelBackendCert_Version_002/KEYM_E_KEY_CERT_SIZE_MISMATCH, KeyMCertificateElement_Ssa_TrustModelBackendCert_Version_002/KEYM_E_PARAMETER_MISMATCH, KeyMCertificateElement_Ssa_TrustModelBackendCert_Version_002/KEYM_E_KEY_CERT_INVALID, KeyMCertificateElement_Ssa_TrustModelBackendCert_Version_002/KEYM_E_KEY_CERT_EMPTY]  # This operation provides data from a specific certificate element.
        arg Index: type=uint16, direction=IN  # This is the index to dedicated element in the list
        arg CertificateElementData: type=KeyM_CertificateElementType_Ssa_TrustModelBackendCert_Version_002, direction=OUT, server-argument-impl-policy=USE-ARRAY-BASE-TYPE  # Holds a pointer to the memory location which will hold the certificate element.
        arg CertificateDataLength: type=uint32, direction=OUT  # Contains the length in bytes of certificate element.
      operation CertificateElementGetCount: possible-error=[KeyMCertificateElement_Ssa_TrustModelBackendCert_Version_002/E_NOT_OK, KeyMCertificateElement_Ssa_TrustModelBackendCert_Version_002/KEYM_E_KEY_CERT_SIZE_MISMATCH, KeyMCertificateElement_Ssa_TrustModelBackendCert_Version_002/KEYM_E_PARAMETER_MISMATCH, KeyMCertificateElement_Ssa_TrustModelBackendCert_Version_002/KEYM_E_KEY_CERT_INVALID, KeyMCertificateElement_Ssa_TrustModelBackendCert_Version_002/KEYM_E_KEY_CERT_EMPTY]  # This operation returns the amount of items available for a certificate element.
        arg count: type=uint16, direction=OUT  # Number of items available for an element.
      5 x error:
        E_NOT_OK: error-code=1  # The service request failed.
        KEYM_E_KEY_CERT_SIZE_MISMATCH: error-code=4  # The service request failed. Parameter size does not match the expected value.
        KEYM_E_PARAMETER_MISMATCH: error-code=5  # The service request failed. Parameter to function does not provide the expected value.
        KEYM_E_KEY_CERT_EMPTY: error-code=10  # The service request failed. The requested key or certificate is not available, slot is empty.
        KEYM_E_KEY_CERT_INVALID: error-code=6  # The service request failed. Key or certificate is invalid and cannot be used for the operation.
    KeyMCertificateElement_Ssa_TrustModelBackendCert_SerialNo_002  # Service of the certificate sub module to access certificate elements.
      operation CertificateElementGet: possible-error=[KeyMCertificateElement_Ssa_TrustModelBackendCert_SerialNo_002/E_NOT_OK, KeyMCertificateElement_Ssa_TrustModelBackendCert_SerialNo_002/KEYM_E_KEY_CERT_SIZE_MISMATCH, KeyMCertificateElement_Ssa_TrustModelBackendCert_SerialNo_002/KEYM_E_PARAMETER_MISMATCH, KeyMCertificateElement_Ssa_TrustModelBackendCert_SerialNo_002/KEYM_E_KEY_CERT_INVALID, KeyMCertificateElement_Ssa_TrustModelBackendCert_SerialNo_002/KEYM_E_KEY_CERT_EMPTY]  # Provides the content of a specific certificate element. The certificate configuration defines how the certificate submodule can find the element, e.g. by providing the object identifier (OID). This function is used to retrieve this information if only one element is assigned to the respective OID.
        arg CertificateElementData: type=KeyM_CertificateElementType_Ssa_TrustModelBackendCert_SerialNo_002, direction=OUT, server-argument-impl-policy=USE-ARRAY-BASE-TYPE  # Holds a pointer to the memory location which will hold the certificate element.
        arg CertificateDataLength: type=uint32, direction=OUT  # Contains the length in bytes of certificate element.
      operation CertificateElementGetByIndex: possible-error=[KeyMCertificateElement_Ssa_TrustModelBackendCert_SerialNo_002/E_NOT_OK, KeyMCertificateElement_Ssa_TrustModelBackendCert_SerialNo_002/KEYM_E_KEY_CERT_SIZE_MISMATCH, KeyMCertificateElement_Ssa_TrustModelBackendCert_SerialNo_002/KEYM_E_PARAMETER_MISMATCH, KeyMCertificateElement_Ssa_TrustModelBackendCert_SerialNo_002/KEYM_E_KEY_CERT_INVALID, KeyMCertificateElement_Ssa_TrustModelBackendCert_SerialNo_002/KEYM_E_KEY_CERT_EMPTY]  # This operation provides data from a specific certificate element.
        arg Index: type=uint16, direction=IN  # This is the index to dedicated element in the list
        arg CertificateElementData: type=KeyM_CertificateElementType_Ssa_TrustModelBackendCert_SerialNo_002, direction=OUT, server-argument-impl-policy=USE-ARRAY-BASE-TYPE  # Holds a pointer to the memory location which will hold the certificate element.
        arg CertificateDataLength: type=uint32, direction=OUT  # Contains the length in bytes of certificate element.
      operation CertificateElementGetCount: possible-error=[KeyMCertificateElement_Ssa_TrustModelBackendCert_SerialNo_002/E_NOT_OK, KeyMCertificateElement_Ssa_TrustModelBackendCert_SerialNo_002/KEYM_E_KEY_CERT_SIZE_MISMATCH, KeyMCertificateElement_Ssa_TrustModelBackendCert_SerialNo_002/KEYM_E_PARAMETER_MISMATCH, KeyMCertificateElement_Ssa_TrustModelBackendCert_SerialNo_002/KEYM_E_KEY_CERT_INVALID, KeyMCertificateElement_Ssa_TrustModelBackendCert_SerialNo_002/KEYM_E_KEY_CERT_EMPTY]  # This operation returns the amount of items available for a certificate element.
        arg count: type=uint16, direction=OUT  # Number of items available for an element.
      5 x error:
        E_NOT_OK: error-code=1  # The service request failed.
        KEYM_E_KEY_CERT_SIZE_MISMATCH: error-code=4  # The service request failed. Parameter size does not match the expected value.
        KEYM_E_PARAMETER_MISMATCH: error-code=5  # The service request failed. Parameter to function does not provide the expected value.
        KEYM_E_KEY_CERT_EMPTY: error-code=10  # The service request failed. The requested key or certificate is not available, slot is empty.
        KEYM_E_KEY_CERT_INVALID: error-code=6  # The service request failed. Key or certificate is invalid and cannot be used for the operation.
    KeyMCertificateElement_Ssa_TrustModelBackendCert_SigAlgoId_002  # Service of the certificate sub module to access certificate elements.
      operation CertificateElementGet: possible-error=[KeyMCertificateElement_Ssa_TrustModelBackendCert_SigAlgoId_002/E_NOT_OK, KeyMCertificateElement_Ssa_TrustModelBackendCert_SigAlgoId_002/KEYM_E_KEY_CERT_SIZE_MISMATCH, KeyMCertificateElement_Ssa_TrustModelBackendCert_SigAlgoId_002/KEYM_E_PARAMETER_MISMATCH, KeyMCertificateElement_Ssa_TrustModelBackendCert_SigAlgoId_002/KEYM_E_KEY_CERT_INVALID, KeyMCertificateElement_Ssa_TrustModelBackendCert_SigAlgoId_002/KEYM_E_KEY_CERT_EMPTY]  # Provides the content of a specific certificate element. The certificate configuration defines how the certificate submodule can find the element, e.g. by providing the object identifier (OID). This function is used to retrieve this information if only one element is assigned to the respective OID.
        arg CertificateElementData: type=KeyM_CertificateElementType_Ssa_TrustModelBackendCert_SigAlgoId_002, direction=OUT, server-argument-impl-policy=USE-ARRAY-BASE-TYPE  # Holds a pointer to the memory location which will hold the certificate element.
        arg CertificateDataLength: type=uint32, direction=OUT  # Contains the length in bytes of certificate element.
      operation CertificateElementGetByIndex: possible-error=[KeyMCertificateElement_Ssa_TrustModelBackendCert_SigAlgoId_002/E_NOT_OK, KeyMCertificateElement_Ssa_TrustModelBackendCert_SigAlgoId_002/KEYM_E_KEY_CERT_SIZE_MISMATCH, KeyMCertificateElement_Ssa_TrustModelBackendCert_SigAlgoId_002/KEYM_E_PARAMETER_MISMATCH, KeyMCertificateElement_Ssa_TrustModelBackendCert_SigAlgoId_002/KEYM_E_KEY_CERT_INVALID, KeyMCertificateElement_Ssa_TrustModelBackendCert_SigAlgoId_002/KEYM_E_KEY_CERT_EMPTY]  # This operation provides data from a specific certificate element.
        arg Index: type=uint16, direction=IN  # This is the index to dedicated element in the list
        arg CertificateElementData: type=KeyM_CertificateElementType_Ssa_TrustModelBackendCert_SigAlgoId_002, direction=OUT, server-argument-impl-policy=USE-ARRAY-BASE-TYPE  # Holds a pointer to the memory location which will hold the certificate element.
        arg CertificateDataLength: type=uint32, direction=OUT  # Contains the length in bytes of certificate element.
      operation CertificateElementGetCount: possible-error=[KeyMCertificateElement_Ssa_TrustModelBackendCert_SigAlgoId_002/E_NOT_OK, KeyMCertificateElement_Ssa_TrustModelBackendCert_SigAlgoId_002/KEYM_E_KEY_CERT_SIZE_MISMATCH, KeyMCertificateElement_Ssa_TrustModelBackendCert_SigAlgoId_002/KEYM_E_PARAMETER_MISMATCH, KeyMCertificateElement_Ssa_TrustModelBackendCert_SigAlgoId_002/KEYM_E_KEY_CERT_INVALID, KeyMCertificateElement_Ssa_TrustModelBackendCert_SigAlgoId_002/KEYM_E_KEY_CERT_EMPTY]  # This operation returns the amount of items available for a certificate element.
        arg count: type=uint16, direction=OUT  # Number of items available for an element.
      5 x error:
        E_NOT_OK: error-code=1  # The service request failed.
        KEYM_E_KEY_CERT_SIZE_MISMATCH: error-code=4  # The service request failed. Parameter size does not match the expected value.
        KEYM_E_PARAMETER_MISMATCH: error-code=5  # The service request failed. Parameter to function does not provide the expected value.
        KEYM_E_KEY_CERT_EMPTY: error-code=10  # The service request failed. The requested key or certificate is not available, slot is empty.
        KEYM_E_KEY_CERT_INVALID: error-code=6  # The service request failed. Key or certificate is invalid and cannot be used for the operation.
    KeyMCertificateElement_Ssa_TrustModelBackendCert_validityNotBefore_002  # Service of the certificate sub module to access certificate elements.
      operation CertificateElementGet: possible-error=[KeyMCertificateElement_Ssa_TrustModelBackendCert_validityNotBefore_002/E_NOT_OK, KeyMCertificateElement_Ssa_TrustModelBackendCert_validityNotBefore_002/KEYM_E_KEY_CERT_SIZE_MISMATCH, KeyMCertificateElement_Ssa_TrustModelBackendCert_validityNotBefore_002/KEYM_E_PARAMETER_MISMATCH, KeyMCertificateElement_Ssa_TrustModelBackendCert_validityNotBefore_002/KEYM_E_KEY_CERT_INVALID, KeyMCertificateElement_Ssa_TrustModelBackendCert_validityNotBefore_002/KEYM_E_KEY_CERT_EMPTY]  # Provides the content of a specific certificate element. The certificate configuration defines how the certificate submodule can find the element, e.g. by providing the object identifier (OID). This function is used to retrieve this information if only one element is assigned to the respective OID.
        arg CertificateElementData: type=KeyM_CertificateElementType_Ssa_TrustModelBackendCert_validityNotBefore_002, direction=OUT, server-argument-impl-policy=USE-ARRAY-BASE-TYPE  # Holds a pointer to the memory location which will hold the certificate element.
        arg CertificateDataLength: type=uint32, direction=OUT  # Contains the length in bytes of certificate element.
      operation CertificateElementGetByIndex: possible-error=[KeyMCertificateElement_Ssa_TrustModelBackendCert_validityNotBefore_002/E_NOT_OK, KeyMCertificateElement_Ssa_TrustModelBackendCert_validityNotBefore_002/KEYM_E_KEY_CERT_SIZE_MISMATCH, KeyMCertificateElement_Ssa_TrustModelBackendCert_validityNotBefore_002/KEYM_E_PARAMETER_MISMATCH, KeyMCertificateElement_Ssa_TrustModelBackendCert_validityNotBefore_002/KEYM_E_KEY_CERT_INVALID, KeyMCertificateElement_Ssa_TrustModelBackendCert_validityNotBefore_002/KEYM_E_KEY_CERT_EMPTY]  # This operation provides data from a specific certificate element.
        arg Index: type=uint16, direction=IN  # This is the index to dedicated element in the list
        arg CertificateElementData: type=KeyM_CertificateElementType_Ssa_TrustModelBackendCert_validityNotBefore_002, direction=OUT, server-argument-impl-policy=USE-ARRAY-BASE-TYPE  # Holds a pointer to the memory location which will hold the certificate element.
        arg CertificateDataLength: type=uint32, direction=OUT  # Contains the length in bytes of certificate element.
      operation CertificateElementGetCount: possible-error=[KeyMCertificateElement_Ssa_TrustModelBackendCert_validityNotBefore_002/E_NOT_OK, KeyMCertificateElement_Ssa_TrustModelBackendCert_validityNotBefore_002/KEYM_E_KEY_CERT_SIZE_MISMATCH, KeyMCertificateElement_Ssa_TrustModelBackendCert_validityNotBefore_002/KEYM_E_PARAMETER_MISMATCH, KeyMCertificateElement_Ssa_TrustModelBackendCert_validityNotBefore_002/KEYM_E_KEY_CERT_INVALID, KeyMCertificateElement_Ssa_TrustModelBackendCert_validityNotBefore_002/KEYM_E_KEY_CERT_EMPTY]  # This operation returns the amount of items available for a certificate element.
        arg count: type=uint16, direction=OUT  # Number of items available for an element.
      5 x error:
        E_NOT_OK: error-code=1  # The service request failed.
        KEYM_E_KEY_CERT_SIZE_MISMATCH: error-code=4  # The service request failed. Parameter size does not match the expected value.
        KEYM_E_PARAMETER_MISMATCH: error-code=5  # The service request failed. Parameter to function does not provide the expected value.
        KEYM_E_KEY_CERT_EMPTY: error-code=10  # The service request failed. The requested key or certificate is not available, slot is empty.
        KEYM_E_KEY_CERT_INVALID: error-code=6  # The service request failed. Key or certificate is invalid and cannot be used for the operation.
    KeyMCertificateElement_Ssa_TrustModelBackendCert_validityNotAfter_002  # Service of the certificate sub module to access certificate elements.
      operation CertificateElementGet: possible-error=[KeyMCertificateElement_Ssa_TrustModelBackendCert_validityNotAfter_002/E_NOT_OK, KeyMCertificateElement_Ssa_TrustModelBackendCert_validityNotAfter_002/KEYM_E_KEY_CERT_SIZE_MISMATCH, KeyMCertificateElement_Ssa_TrustModelBackendCert_validityNotAfter_002/KEYM_E_PARAMETER_MISMATCH, KeyMCertificateElement_Ssa_TrustModelBackendCert_validityNotAfter_002/KEYM_E_KEY_CERT_INVALID, KeyMCertificateElement_Ssa_TrustModelBackendCert_validityNotAfter_002/KEYM_E_KEY_CERT_EMPTY]  # Provides the content of a specific certificate element. The certificate configuration defines how the certificate submodule can find the element, e.g. by providing the object identifier (OID). This function is used to retrieve this information if only one element is assigned to the respective OID.
        arg CertificateElementData: type=KeyM_CertificateElementType_Ssa_TrustModelBackendCert_validityNotAfter_002, direction=OUT, server-argument-impl-policy=USE-ARRAY-BASE-TYPE  # Holds a pointer to the memory location which will hold the certificate element.
        arg CertificateDataLength: type=uint32, direction=OUT  # Contains the length in bytes of certificate element.
      operation CertificateElementGetByIndex: possible-error=[KeyMCertificateElement_Ssa_TrustModelBackendCert_validityNotAfter_002/E_NOT_OK, KeyMCertificateElement_Ssa_TrustModelBackendCert_validityNotAfter_002/KEYM_E_KEY_CERT_SIZE_MISMATCH, KeyMCertificateElement_Ssa_TrustModelBackendCert_validityNotAfter_002/KEYM_E_PARAMETER_MISMATCH, KeyMCertificateElement_Ssa_TrustModelBackendCert_validityNotAfter_002/KEYM_E_KEY_CERT_INVALID, KeyMCertificateElement_Ssa_TrustModelBackendCert_validityNotAfter_002/KEYM_E_KEY_CERT_EMPTY]  # This operation provides data from a specific certificate element.
        arg Index: type=uint16, direction=IN  # This is the index to dedicated element in the list
        arg CertificateElementData: type=KeyM_CertificateElementType_Ssa_TrustModelBackendCert_validityNotAfter_002, direction=OUT, server-argument-impl-policy=USE-ARRAY-BASE-TYPE  # Holds a pointer to the memory location which will hold the certificate element.
        arg CertificateDataLength: type=uint32, direction=OUT  # Contains the length in bytes of certificate element.
      operation CertificateElementGetCount: possible-error=[KeyMCertificateElement_Ssa_TrustModelBackendCert_validityNotAfter_002/E_NOT_OK, KeyMCertificateElement_Ssa_TrustModelBackendCert_validityNotAfter_002/KEYM_E_KEY_CERT_SIZE_MISMATCH, KeyMCertificateElement_Ssa_TrustModelBackendCert_validityNotAfter_002/KEYM_E_PARAMETER_MISMATCH, KeyMCertificateElement_Ssa_TrustModelBackendCert_validityNotAfter_002/KEYM_E_KEY_CERT_INVALID, KeyMCertificateElement_Ssa_TrustModelBackendCert_validityNotAfter_002/KEYM_E_KEY_CERT_EMPTY]  # This operation returns the amount of items available for a certificate element.
        arg count: type=uint16, direction=OUT  # Number of items available for an element.
      5 x error:
        E_NOT_OK: error-code=1  # The service request failed.
        KEYM_E_KEY_CERT_SIZE_MISMATCH: error-code=4  # The service request failed. Parameter size does not match the expected value.
        KEYM_E_PARAMETER_MISMATCH: error-code=5  # The service request failed. Parameter to function does not provide the expected value.
        KEYM_E_KEY_CERT_EMPTY: error-code=10  # The service request failed. The requested key or certificate is not available, slot is empty.
        KEYM_E_KEY_CERT_INVALID: error-code=6  # The service request failed. Key or certificate is invalid and cannot be used for the operation.
    KeyMCertificateElement_Ssa_TrustModelBackendCert_subject_002  # Service of the certificate sub module to access certificate elements.
      operation CertificateElementGet: possible-error=[KeyMCertificateElement_Ssa_TrustModelBackendCert_subject_002/E_NOT_OK, KeyMCertificateElement_Ssa_TrustModelBackendCert_subject_002/KEYM_E_KEY_CERT_SIZE_MISMATCH, KeyMCertificateElement_Ssa_TrustModelBackendCert_subject_002/KEYM_E_PARAMETER_MISMATCH, KeyMCertificateElement_Ssa_TrustModelBackendCert_subject_002/KEYM_E_KEY_CERT_INVALID, KeyMCertificateElement_Ssa_TrustModelBackendCert_subject_002/KEYM_E_KEY_CERT_EMPTY]  # Provides the content of a specific certificate element. The certificate configuration defines how the certificate submodule can find the element, e.g. by providing the object identifier (OID). This function is used to retrieve this information if only one element is assigned to the respective OID.
        arg CertificateElementData: type=KeyM_CertificateElementType_Ssa_TrustModelBackendCert_subject_002, direction=OUT, server-argument-impl-policy=USE-ARRAY-BASE-TYPE  # Holds a pointer to the memory location which will hold the certificate element.
        arg CertificateDataLength: type=uint32, direction=OUT  # Contains the length in bytes of certificate element.
      operation CertificateElementGetByIndex: possible-error=[KeyMCertificateElement_Ssa_TrustModelBackendCert_subject_002/E_NOT_OK, KeyMCertificateElement_Ssa_TrustModelBackendCert_subject_002/KEYM_E_KEY_CERT_SIZE_MISMATCH, KeyMCertificateElement_Ssa_TrustModelBackendCert_subject_002/KEYM_E_PARAMETER_MISMATCH, KeyMCertificateElement_Ssa_TrustModelBackendCert_subject_002/KEYM_E_KEY_CERT_INVALID, KeyMCertificateElement_Ssa_TrustModelBackendCert_subject_002/KEYM_E_KEY_CERT_EMPTY]  # This operation provides data from a specific certificate element.
        arg Index: type=uint16, direction=IN  # This is the index to dedicated element in the list
        arg CertificateElementData: type=KeyM_CertificateElementType_Ssa_TrustModelBackendCert_subject_002, direction=OUT, server-argument-impl-policy=USE-ARRAY-BASE-TYPE  # Holds a pointer to the memory location which will hold the certificate element.
        arg CertificateDataLength: type=uint32, direction=OUT  # Contains the length in bytes of certificate element.
      operation CertificateElementGetCount: possible-error=[KeyMCertificateElement_Ssa_TrustModelBackendCert_subject_002/E_NOT_OK, KeyMCertificateElement_Ssa_TrustModelBackendCert_subject_002/KEYM_E_KEY_CERT_SIZE_MISMATCH, KeyMCertificateElement_Ssa_TrustModelBackendCert_subject_002/KEYM_E_PARAMETER_MISMATCH, KeyMCertificateElement_Ssa_TrustModelBackendCert_subject_002/KEYM_E_KEY_CERT_INVALID, KeyMCertificateElement_Ssa_TrustModelBackendCert_subject_002/KEYM_E_KEY_CERT_EMPTY]  # This operation returns the amount of items available for a certificate element.
        arg count: type=uint16, direction=OUT  # Number of items available for an element.
      5 x error:
        E_NOT_OK: error-code=1  # The service request failed.
        KEYM_E_KEY_CERT_SIZE_MISMATCH: error-code=4  # The service request failed. Parameter size does not match the expected value.
        KEYM_E_PARAMETER_MISMATCH: error-code=5  # The service request failed. Parameter to function does not provide the expected value.
        KEYM_E_KEY_CERT_EMPTY: error-code=10  # The service request failed. The requested key or certificate is not available, slot is empty.
        KEYM_E_KEY_CERT_INVALID: error-code=6  # The service request failed. Key or certificate is invalid and cannot be used for the operation.
    KeyMCertificateElement_Ssa_TrustModelBackendCert_SubjectPublicKeyInfoAlgo_002  # Service of the certificate sub module to access certificate elements.
      operation CertificateElementGet: possible-error=[KeyMCertificateElement_Ssa_TrustModelBackendCert_SubjectPublicKeyInfoAlgo_002/E_NOT_OK, KeyMCertificateElement_Ssa_TrustModelBackendCert_SubjectPublicKeyInfoAlgo_002/KEYM_E_KEY_CERT_SIZE_MISMATCH, KeyMCertificateElement_Ssa_TrustModelBackendCert_SubjectPublicKeyInfoAlgo_002/KEYM_E_PARAMETER_MISMATCH, KeyMCertificateElement_Ssa_TrustModelBackendCert_SubjectPublicKeyInfoAlgo_002/KEYM_E_KEY_CERT_INVALID, KeyMCertificateElement_Ssa_TrustModelBackendCert_SubjectPublicKeyInfoAlgo_002/KEYM_E_KEY_CERT_EMPTY]  # Provides the content of a specific certificate element. The certificate configuration defines how the certificate submodule can find the element, e.g. by providing the object identifier (OID). This function is used to retrieve this information if only one element is assigned to the respective OID.
        arg CertificateElementData: type=KeyM_CertificateElementType_Ssa_TrustModelBackendCert_SubjectPublicKeyInfoAlgo_002, direction=OUT, server-argument-impl-policy=USE-ARRAY-BASE-TYPE  # Holds a pointer to the memory location which will hold the certificate element.
        arg CertificateDataLength: type=uint32, direction=OUT  # Contains the length in bytes of certificate element.
      operation CertificateElementGetByIndex: possible-error=[KeyMCertificateElement_Ssa_TrustModelBackendCert_SubjectPublicKeyInfoAlgo_002/E_NOT_OK, KeyMCertificateElement_Ssa_TrustModelBackendCert_SubjectPublicKeyInfoAlgo_002/KEYM_E_KEY_CERT_SIZE_MISMATCH, KeyMCertificateElement_Ssa_TrustModelBackendCert_SubjectPublicKeyInfoAlgo_002/KEYM_E_PARAMETER_MISMATCH, KeyMCertificateElement_Ssa_TrustModelBackendCert_SubjectPublicKeyInfoAlgo_002/KEYM_E_KEY_CERT_INVALID, KeyMCertificateElement_Ssa_TrustModelBackendCert_SubjectPublicKeyInfoAlgo_002/KEYM_E_KEY_CERT_EMPTY]  # This operation provides data from a specific certificate element.
        arg Index: type=uint16, direction=IN  # This is the index to dedicated element in the list
        arg CertificateElementData: type=KeyM_CertificateElementType_Ssa_TrustModelBackendCert_SubjectPublicKeyInfoAlgo_002, direction=OUT, server-argument-impl-policy=USE-ARRAY-BASE-TYPE  # Holds a pointer to the memory location which will hold the certificate element.
        arg CertificateDataLength: type=uint32, direction=OUT  # Contains the length in bytes of certificate element.
      operation CertificateElementGetCount: possible-error=[KeyMCertificateElement_Ssa_TrustModelBackendCert_SubjectPublicKeyInfoAlgo_002/E_NOT_OK, KeyMCertificateElement_Ssa_TrustModelBackendCert_SubjectPublicKeyInfoAlgo_002/KEYM_E_KEY_CERT_SIZE_MISMATCH, KeyMCertificateElement_Ssa_TrustModelBackendCert_SubjectPublicKeyInfoAlgo_002/KEYM_E_PARAMETER_MISMATCH, KeyMCertificateElement_Ssa_TrustModelBackendCert_SubjectPublicKeyInfoAlgo_002/KEYM_E_KEY_CERT_INVALID, KeyMCertificateElement_Ssa_TrustModelBackendCert_SubjectPublicKeyInfoAlgo_002/KEYM_E_KEY_CERT_EMPTY]  # This operation returns the amount of items available for a certificate element.
        arg count: type=uint16, direction=OUT  # Number of items available for an element.
      5 x error:
        E_NOT_OK: error-code=1  # The service request failed.
        KEYM_E_KEY_CERT_SIZE_MISMATCH: error-code=4  # The service request failed. Parameter size does not match the expected value.
        KEYM_E_PARAMETER_MISMATCH: error-code=5  # The service request failed. Parameter to function does not provide the expected value.
        KEYM_E_KEY_CERT_EMPTY: error-code=10  # The service request failed. The requested key or certificate is not available, slot is empty.
        KEYM_E_KEY_CERT_INVALID: error-code=6  # The service request failed. Key or certificate is invalid and cannot be used for the operation.
    KeyMCertificateElement_Ssa_TrustModelBackendCert_SubjectPublicKeyInfoKey_002  # Service of the certificate sub module to access certificate elements.
      operation CertificateElementGet: possible-error=[KeyMCertificateElement_Ssa_TrustModelBackendCert_SubjectPublicKeyInfoKey_002/E_NOT_OK, KeyMCertificateElement_Ssa_TrustModelBackendCert_SubjectPublicKeyInfoKey_002/KEYM_E_KEY_CERT_SIZE_MISMATCH, KeyMCertificateElement_Ssa_TrustModelBackendCert_SubjectPublicKeyInfoKey_002/KEYM_E_PARAMETER_MISMATCH, KeyMCertificateElement_Ssa_TrustModelBackendCert_SubjectPublicKeyInfoKey_002/KEYM_E_KEY_CERT_INVALID, KeyMCertificateElement_Ssa_TrustModelBackendCert_SubjectPublicKeyInfoKey_002/KEYM_E_KEY_CERT_EMPTY]  # Provides the content of a specific certificate element. The certificate configuration defines how the certificate submodule can find the element, e.g. by providing the object identifier (OID). This function is used to retrieve this information if only one element is assigned to the respective OID.
        arg CertificateElementData: type=KeyM_CertificateElementType_Ssa_TrustModelBackendCert_SubjectPublicKeyInfoKey_002, direction=OUT, server-argument-impl-policy=USE-ARRAY-BASE-TYPE  # Holds a pointer to the memory location which will hold the certificate element.
        arg CertificateDataLength: type=uint32, direction=OUT  # Contains the length in bytes of certificate element.
      operation CertificateElementGetByIndex: possible-error=[KeyMCertificateElement_Ssa_TrustModelBackendCert_SubjectPublicKeyInfoKey_002/E_NOT_OK, KeyMCertificateElement_Ssa_TrustModelBackendCert_SubjectPublicKeyInfoKey_002/KEYM_E_KEY_CERT_SIZE_MISMATCH, KeyMCertificateElement_Ssa_TrustModelBackendCert_SubjectPublicKeyInfoKey_002/KEYM_E_PARAMETER_MISMATCH, KeyMCertificateElement_Ssa_TrustModelBackendCert_SubjectPublicKeyInfoKey_002/KEYM_E_KEY_CERT_INVALID, KeyMCertificateElement_Ssa_TrustModelBackendCert_SubjectPublicKeyInfoKey_002/KEYM_E_KEY_CERT_EMPTY]  # This operation provides data from a specific certificate element.
        arg Index: type=uint16, direction=IN  # This is the index to dedicated element in the list
        arg CertificateElementData: type=KeyM_CertificateElementType_Ssa_TrustModelBackendCert_SubjectPublicKeyInfoKey_002, direction=OUT, server-argument-impl-policy=USE-ARRAY-BASE-TYPE  # Holds a pointer to the memory location which will hold the certificate element.
        arg CertificateDataLength: type=uint32, direction=OUT  # Contains the length in bytes of certificate element.
      operation CertificateElementGetCount: possible-error=[KeyMCertificateElement_Ssa_TrustModelBackendCert_SubjectPublicKeyInfoKey_002/E_NOT_OK, KeyMCertificateElement_Ssa_TrustModelBackendCert_SubjectPublicKeyInfoKey_002/KEYM_E_KEY_CERT_SIZE_MISMATCH, KeyMCertificateElement_Ssa_TrustModelBackendCert_SubjectPublicKeyInfoKey_002/KEYM_E_PARAMETER_MISMATCH, KeyMCertificateElement_Ssa_TrustModelBackendCert_SubjectPublicKeyInfoKey_002/KEYM_E_KEY_CERT_INVALID, KeyMCertificateElement_Ssa_TrustModelBackendCert_SubjectPublicKeyInfoKey_002/KEYM_E_KEY_CERT_EMPTY]  # This operation returns the amount of items available for a certificate element.
        arg count: type=uint16, direction=OUT  # Number of items available for an element.
      5 x error:
        E_NOT_OK: error-code=1  # The service request failed.
        KEYM_E_KEY_CERT_SIZE_MISMATCH: error-code=4  # The service request failed. Parameter size does not match the expected value.
        KEYM_E_PARAMETER_MISMATCH: error-code=5  # The service request failed. Parameter to function does not provide the expected value.
        KEYM_E_KEY_CERT_EMPTY: error-code=10  # The service request failed. The requested key or certificate is not available, slot is empty.
        KEYM_E_KEY_CERT_INVALID: error-code=6  # The service request failed. Key or certificate is invalid and cannot be used for the operation.
    KeyMCertificateElement_Ssa_TrustModelBackendCert_Issuer_002  # Service of the certificate sub module to access certificate elements.
      operation CertificateElementGet: possible-error=[KeyMCertificateElement_Ssa_TrustModelBackendCert_Issuer_002/E_NOT_OK, KeyMCertificateElement_Ssa_TrustModelBackendCert_Issuer_002/KEYM_E_KEY_CERT_SIZE_MISMATCH, KeyMCertificateElement_Ssa_TrustModelBackendCert_Issuer_002/KEYM_E_PARAMETER_MISMATCH, KeyMCertificateElement_Ssa_TrustModelBackendCert_Issuer_002/KEYM_E_KEY_CERT_INVALID, KeyMCertificateElement_Ssa_TrustModelBackendCert_Issuer_002/KEYM_E_KEY_CERT_EMPTY]  # Provides the content of a specific certificate element. The certificate configuration defines how the certificate submodule can find the element, e.g. by providing the object identifier (OID). This function is used to retrieve this information if only one element is assigned to the respective OID.
        arg CertificateElementData: type=KeyM_CertificateElementType_Ssa_TrustModelBackendCert_Issuer_002, direction=OUT, server-argument-impl-policy=USE-ARRAY-BASE-TYPE  # Holds a pointer to the memory location which will hold the certificate element.
        arg CertificateDataLength: type=uint32, direction=OUT  # Contains the length in bytes of certificate element.
      operation CertificateElementGetByIndex: possible-error=[KeyMCertificateElement_Ssa_TrustModelBackendCert_Issuer_002/E_NOT_OK, KeyMCertificateElement_Ssa_TrustModelBackendCert_Issuer_002/KEYM_E_KEY_CERT_SIZE_MISMATCH, KeyMCertificateElement_Ssa_TrustModelBackendCert_Issuer_002/KEYM_E_PARAMETER_MISMATCH, KeyMCertificateElement_Ssa_TrustModelBackendCert_Issuer_002/KEYM_E_KEY_CERT_INVALID, KeyMCertificateElement_Ssa_TrustModelBackendCert_Issuer_002/KEYM_E_KEY_CERT_EMPTY]  # This operation provides data from a specific certificate element.
        arg Index: type=uint16, direction=IN  # This is the index to dedicated element in the list
        arg CertificateElementData: type=KeyM_CertificateElementType_Ssa_TrustModelBackendCert_Issuer_002, direction=OUT, server-argument-impl-policy=USE-ARRAY-BASE-TYPE  # Holds a pointer to the memory location which will hold the certificate element.
        arg CertificateDataLength: type=uint32, direction=OUT  # Contains the length in bytes of certificate element.
      operation CertificateElementGetCount: possible-error=[KeyMCertificateElement_Ssa_TrustModelBackendCert_Issuer_002/E_NOT_OK, KeyMCertificateElement_Ssa_TrustModelBackendCert_Issuer_002/KEYM_E_KEY_CERT_SIZE_MISMATCH, KeyMCertificateElement_Ssa_TrustModelBackendCert_Issuer_002/KEYM_E_PARAMETER_MISMATCH, KeyMCertificateElement_Ssa_TrustModelBackendCert_Issuer_002/KEYM_E_KEY_CERT_INVALID, KeyMCertificateElement_Ssa_TrustModelBackendCert_Issuer_002/KEYM_E_KEY_CERT_EMPTY]  # This operation returns the amount of items available for a certificate element.
        arg count: type=uint16, direction=OUT  # Number of items available for an element.
      5 x error:
        E_NOT_OK: error-code=1  # The service request failed.
        KEYM_E_KEY_CERT_SIZE_MISMATCH: error-code=4  # The service request failed. Parameter size does not match the expected value.
        KEYM_E_PARAMETER_MISMATCH: error-code=5  # The service request failed. Parameter to function does not provide the expected value.
        KEYM_E_KEY_CERT_EMPTY: error-code=10  # The service request failed. The requested key or certificate is not available, slot is empty.
        KEYM_E_KEY_CERT_INVALID: error-code=6  # The service request failed. Key or certificate is invalid and cannot be used for the operation.
    KeyMCertificateElement_Ssa_TrustModelBackendCert_signatureAlgorithm_002  # Service of the certificate sub module to access certificate elements.
      operation CertificateElementGet: possible-error=[KeyMCertificateElement_Ssa_TrustModelBackendCert_signatureAlgorithm_002/E_NOT_OK, KeyMCertificateElement_Ssa_TrustModelBackendCert_signatureAlgorithm_002/KEYM_E_KEY_CERT_SIZE_MISMATCH, KeyMCertificateElement_Ssa_TrustModelBackendCert_signatureAlgorithm_002/KEYM_E_PARAMETER_MISMATCH, KeyMCertificateElement_Ssa_TrustModelBackendCert_signatureAlgorithm_002/KEYM_E_KEY_CERT_INVALID, KeyMCertificateElement_Ssa_TrustModelBackendCert_signatureAlgorithm_002/KEYM_E_KEY_CERT_EMPTY]  # Provides the content of a specific certificate element. The certificate configuration defines how the certificate submodule can find the element, e.g. by providing the object identifier (OID). This function is used to retrieve this information if only one element is assigned to the respective OID.
        arg CertificateElementData: type=KeyM_CertificateElementType_Ssa_TrustModelBackendCert_signatureAlgorithm_002, direction=OUT, server-argument-impl-policy=USE-ARRAY-BASE-TYPE  # Holds a pointer to the memory location which will hold the certificate element.
        arg CertificateDataLength: type=uint32, direction=OUT  # Contains the length in bytes of certificate element.
      operation CertificateElementGetByIndex: possible-error=[KeyMCertificateElement_Ssa_TrustModelBackendCert_signatureAlgorithm_002/E_NOT_OK, KeyMCertificateElement_Ssa_TrustModelBackendCert_signatureAlgorithm_002/KEYM_E_KEY_CERT_SIZE_MISMATCH, KeyMCertificateElement_Ssa_TrustModelBackendCert_signatureAlgorithm_002/KEYM_E_PARAMETER_MISMATCH, KeyMCertificateElement_Ssa_TrustModelBackendCert_signatureAlgorithm_002/KEYM_E_KEY_CERT_INVALID, KeyMCertificateElement_Ssa_TrustModelBackendCert_signatureAlgorithm_002/KEYM_E_KEY_CERT_EMPTY]  # This operation provides data from a specific certificate element.
        arg Index: type=uint16, direction=IN  # This is the index to dedicated element in the list
        arg CertificateElementData: type=KeyM_CertificateElementType_Ssa_TrustModelBackendCert_signatureAlgorithm_002, direction=OUT, server-argument-impl-policy=USE-ARRAY-BASE-TYPE  # Holds a pointer to the memory location which will hold the certificate element.
        arg CertificateDataLength: type=uint32, direction=OUT  # Contains the length in bytes of certificate element.
      operation CertificateElementGetCount: possible-error=[KeyMCertificateElement_Ssa_TrustModelBackendCert_signatureAlgorithm_002/E_NOT_OK, KeyMCertificateElement_Ssa_TrustModelBackendCert_signatureAlgorithm_002/KEYM_E_KEY_CERT_SIZE_MISMATCH, KeyMCertificateElement_Ssa_TrustModelBackendCert_signatureAlgorithm_002/KEYM_E_PARAMETER_MISMATCH, KeyMCertificateElement_Ssa_TrustModelBackendCert_signatureAlgorithm_002/KEYM_E_KEY_CERT_INVALID, KeyMCertificateElement_Ssa_TrustModelBackendCert_signatureAlgorithm_002/KEYM_E_KEY_CERT_EMPTY]  # This operation returns the amount of items available for a certificate element.
        arg count: type=uint16, direction=OUT  # Number of items available for an element.
      5 x error:
        E_NOT_OK: error-code=1  # The service request failed.
        KEYM_E_KEY_CERT_SIZE_MISMATCH: error-code=4  # The service request failed. Parameter size does not match the expected value.
        KEYM_E_PARAMETER_MISMATCH: error-code=5  # The service request failed. Parameter to function does not provide the expected value.
        KEYM_E_KEY_CERT_EMPTY: error-code=10  # The service request failed. The requested key or certificate is not available, slot is empty.
        KEYM_E_KEY_CERT_INVALID: error-code=6  # The service request failed. Key or certificate is invalid and cannot be used for the operation.
    KeyMCertificateElement_Ssa_TrustModelBackendCert_signatureValue_002  # Service of the certificate sub module to access certificate elements.
      operation CertificateElementGet: possible-error=[KeyMCertificateElement_Ssa_TrustModelBackendCert_signatureValue_002/E_NOT_OK, KeyMCertificateElement_Ssa_TrustModelBackendCert_signatureValue_002/KEYM_E_KEY_CERT_SIZE_MISMATCH, KeyMCertificateElement_Ssa_TrustModelBackendCert_signatureValue_002/KEYM_E_PARAMETER_MISMATCH, KeyMCertificateElement_Ssa_TrustModelBackendCert_signatureValue_002/KEYM_E_KEY_CERT_INVALID, KeyMCertificateElement_Ssa_TrustModelBackendCert_signatureValue_002/KEYM_E_KEY_CERT_EMPTY]  # Provides the content of a specific certificate element. The certificate configuration defines how the certificate submodule can find the element, e.g. by providing the object identifier (OID). This function is used to retrieve this information if only one element is assigned to the respective OID.
        arg CertificateElementData: type=KeyM_CertificateElementType_Ssa_TrustModelBackendCert_signatureValue_002, direction=OUT, server-argument-impl-policy=USE-ARRAY-BASE-TYPE  # Holds a pointer to the memory location which will hold the certificate element.
        arg CertificateDataLength: type=uint32, direction=OUT  # Contains the length in bytes of certificate element.
      operation CertificateElementGetByIndex: possible-error=[KeyMCertificateElement_Ssa_TrustModelBackendCert_signatureValue_002/E_NOT_OK, KeyMCertificateElement_Ssa_TrustModelBackendCert_signatureValue_002/KEYM_E_KEY_CERT_SIZE_MISMATCH, KeyMCertificateElement_Ssa_TrustModelBackendCert_signatureValue_002/KEYM_E_PARAMETER_MISMATCH, KeyMCertificateElement_Ssa_TrustModelBackendCert_signatureValue_002/KEYM_E_KEY_CERT_INVALID, KeyMCertificateElement_Ssa_TrustModelBackendCert_signatureValue_002/KEYM_E_KEY_CERT_EMPTY]  # This operation provides data from a specific certificate element.
        arg Index: type=uint16, direction=IN  # This is the index to dedicated element in the list
        arg CertificateElementData: type=KeyM_CertificateElementType_Ssa_TrustModelBackendCert_signatureValue_002, direction=OUT, server-argument-impl-policy=USE-ARRAY-BASE-TYPE  # Holds a pointer to the memory location which will hold the certificate element.
        arg CertificateDataLength: type=uint32, direction=OUT  # Contains the length in bytes of certificate element.
      operation CertificateElementGetCount: possible-error=[KeyMCertificateElement_Ssa_TrustModelBackendCert_signatureValue_002/E_NOT_OK, KeyMCertificateElement_Ssa_TrustModelBackendCert_signatureValue_002/KEYM_E_KEY_CERT_SIZE_MISMATCH, KeyMCertificateElement_Ssa_TrustModelBackendCert_signatureValue_002/KEYM_E_PARAMETER_MISMATCH, KeyMCertificateElement_Ssa_TrustModelBackendCert_signatureValue_002/KEYM_E_KEY_CERT_INVALID, KeyMCertificateElement_Ssa_TrustModelBackendCert_signatureValue_002/KEYM_E_KEY_CERT_EMPTY]  # This operation returns the amount of items available for a certificate element.
        arg count: type=uint16, direction=OUT  # Number of items available for an element.
      5 x error:
        E_NOT_OK: error-code=1  # The service request failed.
        KEYM_E_KEY_CERT_SIZE_MISMATCH: error-code=4  # The service request failed. Parameter size does not match the expected value.
        KEYM_E_PARAMETER_MISMATCH: error-code=5  # The service request failed. Parameter to function does not provide the expected value.
        KEYM_E_KEY_CERT_EMPTY: error-code=10  # The service request failed. The requested key or certificate is not available, slot is empty.
        KEYM_E_KEY_CERT_INVALID: error-code=6  # The service request failed. Key or certificate is invalid and cannot be used for the operation.
    KeyMCertificate_Ssa_TrustModelEcuPeerCert  # Service of Certificate sub module
      4 x operation:
        GetCertificate: possible-error=[KeyMCertificate_Ssa_TrustModelEcuPeerCert/E_NOT_OK, KeyMCertificate_Ssa_TrustModelEcuPeerCert/KEYM_E_KEY_CERT_SIZE_MISMATCH, KeyMCertificate_Ssa_TrustModelEcuPeerCert/KEYM_E_PARAMETER_MISMATCH, KeyMCertificate_Ssa_TrustModelEcuPeerCert/KEYM_E_KEY_CERT_READ_FAIL, KeyMCertificate_Ssa_TrustModelEcuPeerCert/KEYM_E_KEY_CERT_EMPTY]  # Read certificate data from the certificate sub module
          arg Certificate: type=KeyM_CertificateType_Ssa_TrustModelEcuPeerCert, direction=OUT  # Holds a pointer to the memory location which will hold the Certificate.
        GetStatus: possible-error=KeyMCertificate_Ssa_TrustModelEcuPeerCert/E_NOT_OK  # Provides the status of a certificate.
          arg Status: type=KeyM_CertificateStatusType, direction=OUT  # Holds a pointer to the memory location which will hold the Certificate Status.
        SetCertificate: possible-error=[KeyMCertificate_Ssa_TrustModelEcuPeerCert/E_NOT_OK, KeyMCertificate_Ssa_TrustModelEcuPeerCert/KEYM_E_KEY_CERT_SIZE_MISMATCH, KeyMCertificate_Ssa_TrustModelEcuPeerCert/KEYM_E_PARAMETER_MISMATCH, KeyMCertificate_Ssa_TrustModelEcuPeerCert/KEYM_E_KEY_CERT_WRITE_FAIL]  # Provides certificate data to be processed by the certificate sub module.
          arg Certificate: type=KeyM_CertificateType_Ssa_TrustModelEcuPeerCert, direction=IN  # Holds a pointer to Certificate.
        VerifyCertificate: possible-error=[KeyMCertificate_Ssa_TrustModelEcuPeerCert/E_NOT_OK, KeyMCertificate_Ssa_TrustModelEcuPeerCert/KEYM_E_BUSY, KeyMCertificate_Ssa_TrustModelEcuPeerCert/KEYM_E_KEY_CERT_SIZE_MISMATCH, KeyMCertificate_Ssa_TrustModelEcuPeerCert/KEYM_E_PARAMETER_MISMATCH, KeyMCertificate_Ssa_TrustModelEcuPeerCert/KEYM_E_KEY_CERT_EMPTY, KeyMCertificate_Ssa_TrustModelEcuPeerCert/KEYM_E_CERT_INVALID_CHAIN_OF_TRUST]  # Verify certificate data from the certificate sub module .
      8 x error:
        E_NOT_OK: error-code=1  # The service request failed.
        KEYM_E_BUSY: error-code=2  # The service request failed. Key management is busy with other operations.
        KEYM_E_KEY_CERT_SIZE_MISMATCH: error-code=4  # The service request failed. Parameter size does not match the expected value.
        KEYM_E_PARAMETER_MISMATCH: error-code=5  # The service request failed. Parameter to function does not provide the expected value.
        KEYM_E_KEY_CERT_WRITE_FAIL: error-code=7  # The service request failed. Certificate or key write operation failed.
        KEYM_E_KEY_CERT_READ_FAIL: error-code=9  # The service request failed. Certificate or key could not be provided due to a read or permission failure.
        KEYM_E_KEY_CERT_EMPTY: error-code=10  # The service request failed. The requested key or certificate is not available, slot is empty.
        KEYM_E_CERT_INVALID_CHAIN_OF_TRUST: error-code=11  # The service request failed. Certificate verification failed - Invalid Chain of Trust.
    KeyMCertificateExtended_Ssa_TrustModelEcuPeerCert  # Services of Certificate sub module that extend the standard AUTOSAR services
      operation ServiceCertificate: possible-error=[KeyMCertificateExtended_Ssa_TrustModelEcuPeerCert/E_NOT_OK, KeyMCertificateExtended_Ssa_TrustModelEcuPeerCert/KEYM_E_BUSY, KeyMCertificateExtended_Ssa_TrustModelEcuPeerCert/KEYM_E_KEY_CERT_SIZE_MISMATCH, KeyMCertificateExtended_Ssa_TrustModelEcuPeerCert/KEYM_E_PARAMETER_MISMATCH, KeyMCertificateExtended_Ssa_TrustModelEcuPeerCert/KEYM_E_KEY_CERT_EMPTY, KeyMCertificateExtended_Ssa_TrustModelEcuPeerCert/KEYM_E_CERT_INVALID_CHAIN_OF_TRUST]  # Handle certificate operation request in the certificate sub module.
        5 x arg, all with direction=IN:
          Service: type=KeyM_ServiceCertificateType  # Provides the type of service the key manager has to perform.
          RequestData: type=KeyM_ConstDataPtrType  # Information that comes along with the request.
          RequestDataLength: type=uint32  # Length of data in the RequestData array.
          ResponseData: type=KeyM_DataPtrType  # Pointer to array in which the request response data will be stored upon request completion.
          ResponseDataLength: type=uint32  # Max number of bytes available in ResponseDataPtr.
      operation CsrElementSet: possible-error=[KeyMCertificateExtended_Ssa_TrustModelEcuPeerCert/E_NOT_OK, KeyMCertificateExtended_Ssa_TrustModelEcuPeerCert/KEYM_E_PARAMETER_MISMATCH]  # To be used before calling GenerateCertificationRequestInfo. Adds an data to the certificate for which a signing request shall be build.
        4 x arg, all with direction=IN:
          CertElementId: type=KeyM_CertElementIdType  # Element ID of the element that shall be added
          EncodingType: type=KeyM_CsrEncodingType  # Encoding type of the CSR element
          ElementData: type=KeyM_ConstDataPtrType  # Data of the element that shall be added
          ElementDataLength: type=uint32  # Length of ElementData data in the ElementData array
      6 x error:
        E_NOT_OK: error-code=1  # The service request failed.
        KEYM_E_BUSY: error-code=2  # The service request failed. Key management is busy with other operations.
        KEYM_E_KEY_CERT_SIZE_MISMATCH: error-code=4  # The service request failed. Parameter size does not match the expected value.
        KEYM_E_PARAMETER_MISMATCH: error-code=5  # The service request failed. Parameter to function does not provide the expected value.
        KEYM_E_KEY_CERT_EMPTY: error-code=10  # The service request failed. The requested key or certificate is not available, slot is empty.
        KEYM_E_CERT_INVALID_CHAIN_OF_TRUST: error-code=11  # The service request failed. Certificate verification failed - Invalid Chain of Trust.
    KeyMCertificateElement_Ssa_TrustModelEcuPeerCert_ext_authKeyId_006  # Service of the certificate sub module to access certificate elements.
      operation CertificateElementGet: possible-error=[KeyMCertificateElement_Ssa_TrustModelEcuPeerCert_ext_authKeyId_006/E_NOT_OK, KeyMCertificateElement_Ssa_TrustModelEcuPeerCert_ext_authKeyId_006/KEYM_E_KEY_CERT_SIZE_MISMATCH, KeyMCertificateElement_Ssa_TrustModelEcuPeerCert_ext_authKeyId_006/KEYM_E_PARAMETER_MISMATCH, KeyMCertificateElement_Ssa_TrustModelEcuPeerCert_ext_authKeyId_006/KEYM_E_KEY_CERT_INVALID, KeyMCertificateElement_Ssa_TrustModelEcuPeerCert_ext_authKeyId_006/KEYM_E_KEY_CERT_EMPTY]  # Provides the content of a specific certificate element. The certificate configuration defines how the certificate submodule can find the element, e.g. by providing the object identifier (OID). This function is used to retrieve this information if only one element is assigned to the respective OID.
        arg CertificateElementData: type=KeyM_CertificateElementType_Ssa_TrustModelEcuPeerCert_ext_authKeyId_006, direction=OUT, server-argument-impl-policy=USE-ARRAY-BASE-TYPE  # Holds a pointer to the memory location which will hold the certificate element.
        arg CertificateDataLength: type=uint32, direction=OUT  # Contains the length in bytes of certificate element.
      operation CertificateElementGetByIndex: possible-error=[KeyMCertificateElement_Ssa_TrustModelEcuPeerCert_ext_authKeyId_006/E_NOT_OK, KeyMCertificateElement_Ssa_TrustModelEcuPeerCert_ext_authKeyId_006/KEYM_E_KEY_CERT_SIZE_MISMATCH, KeyMCertificateElement_Ssa_TrustModelEcuPeerCert_ext_authKeyId_006/KEYM_E_PARAMETER_MISMATCH, KeyMCertificateElement_Ssa_TrustModelEcuPeerCert_ext_authKeyId_006/KEYM_E_KEY_CERT_INVALID, KeyMCertificateElement_Ssa_TrustModelEcuPeerCert_ext_authKeyId_006/KEYM_E_KEY_CERT_EMPTY]  # This operation provides data from a specific certificate element.
        arg Index: type=uint16, direction=IN  # This is the index to dedicated element in the list
        arg CertificateElementData: type=KeyM_CertificateElementType_Ssa_TrustModelEcuPeerCert_ext_authKeyId_006, direction=OUT, server-argument-impl-policy=USE-ARRAY-BASE-TYPE  # Holds a pointer to the memory location which will hold the certificate element.
        arg CertificateDataLength: type=uint32, direction=OUT  # Contains the length in bytes of certificate element.
      operation CertificateElementGetCount: possible-error=[KeyMCertificateElement_Ssa_TrustModelEcuPeerCert_ext_authKeyId_006/E_NOT_OK, KeyMCertificateElement_Ssa_TrustModelEcuPeerCert_ext_authKeyId_006/KEYM_E_KEY_CERT_SIZE_MISMATCH, KeyMCertificateElement_Ssa_TrustModelEcuPeerCert_ext_authKeyId_006/KEYM_E_PARAMETER_MISMATCH, KeyMCertificateElement_Ssa_TrustModelEcuPeerCert_ext_authKeyId_006/KEYM_E_KEY_CERT_INVALID, KeyMCertificateElement_Ssa_TrustModelEcuPeerCert_ext_authKeyId_006/KEYM_E_KEY_CERT_EMPTY]  # This operation returns the amount of items available for a certificate element.
        arg count: type=uint16, direction=OUT  # Number of items available for an element.
      5 x error:
        E_NOT_OK: error-code=1  # The service request failed.
        KEYM_E_KEY_CERT_SIZE_MISMATCH: error-code=4  # The service request failed. Parameter size does not match the expected value.
        KEYM_E_PARAMETER_MISMATCH: error-code=5  # The service request failed. Parameter to function does not provide the expected value.
        KEYM_E_KEY_CERT_EMPTY: error-code=10  # The service request failed. The requested key or certificate is not available, slot is empty.
        KEYM_E_KEY_CERT_INVALID: error-code=6  # The service request failed. Key or certificate is invalid and cannot be used for the operation.
    KeyMCertificateElement_Ssa_TrustModelEcuPeerCert_ext_subKeyId_006  # Service of the certificate sub module to access certificate elements.
      operation CertificateElementGet: possible-error=[KeyMCertificateElement_Ssa_TrustModelEcuPeerCert_ext_subKeyId_006/E_NOT_OK, KeyMCertificateElement_Ssa_TrustModelEcuPeerCert_ext_subKeyId_006/KEYM_E_KEY_CERT_SIZE_MISMATCH, KeyMCertificateElement_Ssa_TrustModelEcuPeerCert_ext_subKeyId_006/KEYM_E_PARAMETER_MISMATCH, KeyMCertificateElement_Ssa_TrustModelEcuPeerCert_ext_subKeyId_006/KEYM_E_KEY_CERT_INVALID, KeyMCertificateElement_Ssa_TrustModelEcuPeerCert_ext_subKeyId_006/KEYM_E_KEY_CERT_EMPTY]  # Provides the content of a specific certificate element. The certificate configuration defines how the certificate submodule can find the element, e.g. by providing the object identifier (OID). This function is used to retrieve this information if only one element is assigned to the respective OID.
        arg CertificateElementData: type=KeyM_CertificateElementType_Ssa_TrustModelEcuPeerCert_ext_subKeyId_006, direction=OUT, server-argument-impl-policy=USE-ARRAY-BASE-TYPE  # Holds a pointer to the memory location which will hold the certificate element.
        arg CertificateDataLength: type=uint32, direction=OUT  # Contains the length in bytes of certificate element.
      operation CertificateElementGetByIndex: possible-error=[KeyMCertificateElement_Ssa_TrustModelEcuPeerCert_ext_subKeyId_006/E_NOT_OK, KeyMCertificateElement_Ssa_TrustModelEcuPeerCert_ext_subKeyId_006/KEYM_E_KEY_CERT_SIZE_MISMATCH, KeyMCertificateElement_Ssa_TrustModelEcuPeerCert_ext_subKeyId_006/KEYM_E_PARAMETER_MISMATCH, KeyMCertificateElement_Ssa_TrustModelEcuPeerCert_ext_subKeyId_006/KEYM_E_KEY_CERT_INVALID, KeyMCertificateElement_Ssa_TrustModelEcuPeerCert_ext_subKeyId_006/KEYM_E_KEY_CERT_EMPTY]  # This operation provides data from a specific certificate element.
        arg Index: type=uint16, direction=IN  # This is the index to dedicated element in the list
        arg CertificateElementData: type=KeyM_CertificateElementType_Ssa_TrustModelEcuPeerCert_ext_subKeyId_006, direction=OUT, server-argument-impl-policy=USE-ARRAY-BASE-TYPE  # Holds a pointer to the memory location which will hold the certificate element.
        arg CertificateDataLength: type=uint32, direction=OUT  # Contains the length in bytes of certificate element.
      operation CertificateElementGetCount: possible-error=[KeyMCertificateElement_Ssa_TrustModelEcuPeerCert_ext_subKeyId_006/E_NOT_OK, KeyMCertificateElement_Ssa_TrustModelEcuPeerCert_ext_subKeyId_006/KEYM_E_KEY_CERT_SIZE_MISMATCH, KeyMCertificateElement_Ssa_TrustModelEcuPeerCert_ext_subKeyId_006/KEYM_E_PARAMETER_MISMATCH, KeyMCertificateElement_Ssa_TrustModelEcuPeerCert_ext_subKeyId_006/KEYM_E_KEY_CERT_INVALID, KeyMCertificateElement_Ssa_TrustModelEcuPeerCert_ext_subKeyId_006/KEYM_E_KEY_CERT_EMPTY]  # This operation returns the amount of items available for a certificate element.
        arg count: type=uint16, direction=OUT  # Number of items available for an element.
      5 x error:
        E_NOT_OK: error-code=1  # The service request failed.
        KEYM_E_KEY_CERT_SIZE_MISMATCH: error-code=4  # The service request failed. Parameter size does not match the expected value.
        KEYM_E_PARAMETER_MISMATCH: error-code=5  # The service request failed. Parameter to function does not provide the expected value.
        KEYM_E_KEY_CERT_EMPTY: error-code=10  # The service request failed. The requested key or certificate is not available, slot is empty.
        KEYM_E_KEY_CERT_INVALID: error-code=6  # The service request failed. Key or certificate is invalid and cannot be used for the operation.
    KeyMCertificateElement_Ssa_TrustModelEcuPeerCert_ext_keyUsage_006  # Service of the certificate sub module to access certificate elements.
      operation CertificateElementGet: possible-error=[KeyMCertificateElement_Ssa_TrustModelEcuPeerCert_ext_keyUsage_006/E_NOT_OK, KeyMCertificateElement_Ssa_TrustModelEcuPeerCert_ext_keyUsage_006/KEYM_E_KEY_CERT_SIZE_MISMATCH, KeyMCertificateElement_Ssa_TrustModelEcuPeerCert_ext_keyUsage_006/KEYM_E_PARAMETER_MISMATCH, KeyMCertificateElement_Ssa_TrustModelEcuPeerCert_ext_keyUsage_006/KEYM_E_KEY_CERT_INVALID, KeyMCertificateElement_Ssa_TrustModelEcuPeerCert_ext_keyUsage_006/KEYM_E_KEY_CERT_EMPTY]  # Provides the content of a specific certificate element. The certificate configuration defines how the certificate submodule can find the element, e.g. by providing the object identifier (OID). This function is used to retrieve this information if only one element is assigned to the respective OID.
        arg CertificateElementData: type=KeyM_CertificateElementType_Ssa_TrustModelEcuPeerCert_ext_keyUsage_006, direction=OUT, server-argument-impl-policy=USE-ARRAY-BASE-TYPE  # Holds a pointer to the memory location which will hold the certificate element.
        arg CertificateDataLength: type=uint32, direction=OUT  # Contains the length in bytes of certificate element.
      operation CertificateElementGetByIndex: possible-error=[KeyMCertificateElement_Ssa_TrustModelEcuPeerCert_ext_keyUsage_006/E_NOT_OK, KeyMCertificateElement_Ssa_TrustModelEcuPeerCert_ext_keyUsage_006/KEYM_E_KEY_CERT_SIZE_MISMATCH, KeyMCertificateElement_Ssa_TrustModelEcuPeerCert_ext_keyUsage_006/KEYM_E_PARAMETER_MISMATCH, KeyMCertificateElement_Ssa_TrustModelEcuPeerCert_ext_keyUsage_006/KEYM_E_KEY_CERT_INVALID, KeyMCertificateElement_Ssa_TrustModelEcuPeerCert_ext_keyUsage_006/KEYM_E_KEY_CERT_EMPTY]  # This operation provides data from a specific certificate element.
        arg Index: type=uint16, direction=IN  # This is the index to dedicated element in the list
        arg CertificateElementData: type=KeyM_CertificateElementType_Ssa_TrustModelEcuPeerCert_ext_keyUsage_006, direction=OUT, server-argument-impl-policy=USE-ARRAY-BASE-TYPE  # Holds a pointer to the memory location which will hold the certificate element.
        arg CertificateDataLength: type=uint32, direction=OUT  # Contains the length in bytes of certificate element.
      operation CertificateElementGetCount: possible-error=[KeyMCertificateElement_Ssa_TrustModelEcuPeerCert_ext_keyUsage_006/E_NOT_OK, KeyMCertificateElement_Ssa_TrustModelEcuPeerCert_ext_keyUsage_006/KEYM_E_KEY_CERT_SIZE_MISMATCH, KeyMCertificateElement_Ssa_TrustModelEcuPeerCert_ext_keyUsage_006/KEYM_E_PARAMETER_MISMATCH, KeyMCertificateElement_Ssa_TrustModelEcuPeerCert_ext_keyUsage_006/KEYM_E_KEY_CERT_INVALID, KeyMCertificateElement_Ssa_TrustModelEcuPeerCert_ext_keyUsage_006/KEYM_E_KEY_CERT_EMPTY]  # This operation returns the amount of items available for a certificate element.
        arg count: type=uint16, direction=OUT  # Number of items available for an element.
      5 x error:
        E_NOT_OK: error-code=1  # The service request failed.
        KEYM_E_KEY_CERT_SIZE_MISMATCH: error-code=4  # The service request failed. Parameter size does not match the expected value.
        KEYM_E_PARAMETER_MISMATCH: error-code=5  # The service request failed. Parameter to function does not provide the expected value.
        KEYM_E_KEY_CERT_EMPTY: error-code=10  # The service request failed. The requested key or certificate is not available, slot is empty.
        KEYM_E_KEY_CERT_INVALID: error-code=6  # The service request failed. Key or certificate is invalid and cannot be used for the operation.
    KeyMCertificateElement_Ssa_TrustModelEcuPeerCert_Version_006  # Service of the certificate sub module to access certificate elements.
      operation CertificateElementGet: possible-error=[KeyMCertificateElement_Ssa_TrustModelEcuPeerCert_Version_006/E_NOT_OK, KeyMCertificateElement_Ssa_TrustModelEcuPeerCert_Version_006/KEYM_E_KEY_CERT_SIZE_MISMATCH, KeyMCertificateElement_Ssa_TrustModelEcuPeerCert_Version_006/KEYM_E_PARAMETER_MISMATCH, KeyMCertificateElement_Ssa_TrustModelEcuPeerCert_Version_006/KEYM_E_KEY_CERT_INVALID, KeyMCertificateElement_Ssa_TrustModelEcuPeerCert_Version_006/KEYM_E_KEY_CERT_EMPTY]  # Provides the content of a specific certificate element. The certificate configuration defines how the certificate submodule can find the element, e.g. by providing the object identifier (OID). This function is used to retrieve this information if only one element is assigned to the respective OID.
        arg CertificateElementData: type=KeyM_CertificateElementType_Ssa_TrustModelEcuPeerCert_Version_006, direction=OUT, server-argument-impl-policy=USE-ARRAY-BASE-TYPE  # Holds a pointer to the memory location which will hold the certificate element.
        arg CertificateDataLength: type=uint32, direction=OUT  # Contains the length in bytes of certificate element.
      operation CertificateElementGetByIndex: possible-error=[KeyMCertificateElement_Ssa_TrustModelEcuPeerCert_Version_006/E_NOT_OK, KeyMCertificateElement_Ssa_TrustModelEcuPeerCert_Version_006/KEYM_E_KEY_CERT_SIZE_MISMATCH, KeyMCertificateElement_Ssa_TrustModelEcuPeerCert_Version_006/KEYM_E_PARAMETER_MISMATCH, KeyMCertificateElement_Ssa_TrustModelEcuPeerCert_Version_006/KEYM_E_KEY_CERT_INVALID, KeyMCertificateElement_Ssa_TrustModelEcuPeerCert_Version_006/KEYM_E_KEY_CERT_EMPTY]  # This operation provides data from a specific certificate element.
        arg Index: type=uint16, direction=IN  # This is the index to dedicated element in the list
        arg CertificateElementData: type=KeyM_CertificateElementType_Ssa_TrustModelEcuPeerCert_Version_006, direction=OUT, server-argument-impl-policy=USE-ARRAY-BASE-TYPE  # Holds a pointer to the memory location which will hold the certificate element.
        arg CertificateDataLength: type=uint32, direction=OUT  # Contains the length in bytes of certificate element.
      operation CertificateElementGetCount: possible-error=[KeyMCertificateElement_Ssa_TrustModelEcuPeerCert_Version_006/E_NOT_OK, KeyMCertificateElement_Ssa_TrustModelEcuPeerCert_Version_006/KEYM_E_KEY_CERT_SIZE_MISMATCH, KeyMCertificateElement_Ssa_TrustModelEcuPeerCert_Version_006/KEYM_E_PARAMETER_MISMATCH, KeyMCertificateElement_Ssa_TrustModelEcuPeerCert_Version_006/KEYM_E_KEY_CERT_INVALID, KeyMCertificateElement_Ssa_TrustModelEcuPeerCert_Version_006/KEYM_E_KEY_CERT_EMPTY]  # This operation returns the amount of items available for a certificate element.
        arg count: type=uint16, direction=OUT  # Number of items available for an element.
      5 x error:
        E_NOT_OK: error-code=1  # The service request failed.
        KEYM_E_KEY_CERT_SIZE_MISMATCH: error-code=4  # The service request failed. Parameter size does not match the expected value.
        KEYM_E_PARAMETER_MISMATCH: error-code=5  # The service request failed. Parameter to function does not provide the expected value.
        KEYM_E_KEY_CERT_EMPTY: error-code=10  # The service request failed. The requested key or certificate is not available, slot is empty.
        KEYM_E_KEY_CERT_INVALID: error-code=6  # The service request failed. Key or certificate is invalid and cannot be used for the operation.
    KeyMCertificateElement_Ssa_TrustModelEcuPeerCert_SerialNo_006  # Service of the certificate sub module to access certificate elements.
      operation CertificateElementGet: possible-error=[KeyMCertificateElement_Ssa_TrustModelEcuPeerCert_SerialNo_006/E_NOT_OK, KeyMCertificateElement_Ssa_TrustModelEcuPeerCert_SerialNo_006/KEYM_E_KEY_CERT_SIZE_MISMATCH, KeyMCertificateElement_Ssa_TrustModelEcuPeerCert_SerialNo_006/KEYM_E_PARAMETER_MISMATCH, KeyMCertificateElement_Ssa_TrustModelEcuPeerCert_SerialNo_006/KEYM_E_KEY_CERT_INVALID, KeyMCertificateElement_Ssa_TrustModelEcuPeerCert_SerialNo_006/KEYM_E_KEY_CERT_EMPTY]  # Provides the content of a specific certificate element. The certificate configuration defines how the certificate submodule can find the element, e.g. by providing the object identifier (OID). This function is used to retrieve this information if only one element is assigned to the respective OID.
        arg CertificateElementData: type=KeyM_CertificateElementType_Ssa_TrustModelEcuPeerCert_SerialNo_006, direction=OUT, server-argument-impl-policy=USE-ARRAY-BASE-TYPE  # Holds a pointer to the memory location which will hold the certificate element.
        arg CertificateDataLength: type=uint32, direction=OUT  # Contains the length in bytes of certificate element.
      operation CertificateElementGetByIndex: possible-error=[KeyMCertificateElement_Ssa_TrustModelEcuPeerCert_SerialNo_006/E_NOT_OK, KeyMCertificateElement_Ssa_TrustModelEcuPeerCert_SerialNo_006/KEYM_E_KEY_CERT_SIZE_MISMATCH, KeyMCertificateElement_Ssa_TrustModelEcuPeerCert_SerialNo_006/KEYM_E_PARAMETER_MISMATCH, KeyMCertificateElement_Ssa_TrustModelEcuPeerCert_SerialNo_006/KEYM_E_KEY_CERT_INVALID, KeyMCertificateElement_Ssa_TrustModelEcuPeerCert_SerialNo_006/KEYM_E_KEY_CERT_EMPTY]  # This operation provides data from a specific certificate element.
        arg Index: type=uint16, direction=IN  # This is the index to dedicated element in the list
        arg CertificateElementData: type=KeyM_CertificateElementType_Ssa_TrustModelEcuPeerCert_SerialNo_006, direction=OUT, server-argument-impl-policy=USE-ARRAY-BASE-TYPE  # Holds a pointer to the memory location which will hold the certificate element.
        arg CertificateDataLength: type=uint32, direction=OUT  # Contains the length in bytes of certificate element.
      operation CertificateElementGetCount: possible-error=[KeyMCertificateElement_Ssa_TrustModelEcuPeerCert_SerialNo_006/E_NOT_OK, KeyMCertificateElement_Ssa_TrustModelEcuPeerCert_SerialNo_006/KEYM_E_KEY_CERT_SIZE_MISMATCH, KeyMCertificateElement_Ssa_TrustModelEcuPeerCert_SerialNo_006/KEYM_E_PARAMETER_MISMATCH, KeyMCertificateElement_Ssa_TrustModelEcuPeerCert_SerialNo_006/KEYM_E_KEY_CERT_INVALID, KeyMCertificateElement_Ssa_TrustModelEcuPeerCert_SerialNo_006/KEYM_E_KEY_CERT_EMPTY]  # This operation returns the amount of items available for a certificate element.
        arg count: type=uint16, direction=OUT  # Number of items available for an element.
      5 x error:
        E_NOT_OK: error-code=1  # The service request failed.
        KEYM_E_KEY_CERT_SIZE_MISMATCH: error-code=4  # The service request failed. Parameter size does not match the expected value.
        KEYM_E_PARAMETER_MISMATCH: error-code=5  # The service request failed. Parameter to function does not provide the expected value.
        KEYM_E_KEY_CERT_EMPTY: error-code=10  # The service request failed. The requested key or certificate is not available, slot is empty.
        KEYM_E_KEY_CERT_INVALID: error-code=6  # The service request failed. Key or certificate is invalid and cannot be used for the operation.
    KeyMCertificateElement_Ssa_TrustModelEcuPeerCert_SigAlgoId_006  # Service of the certificate sub module to access certificate elements.
      operation CertificateElementGet: possible-error=[KeyMCertificateElement_Ssa_TrustModelEcuPeerCert_SigAlgoId_006/E_NOT_OK, KeyMCertificateElement_Ssa_TrustModelEcuPeerCert_SigAlgoId_006/KEYM_E_KEY_CERT_SIZE_MISMATCH, KeyMCertificateElement_Ssa_TrustModelEcuPeerCert_SigAlgoId_006/KEYM_E_PARAMETER_MISMATCH, KeyMCertificateElement_Ssa_TrustModelEcuPeerCert_SigAlgoId_006/KEYM_E_KEY_CERT_INVALID, KeyMCertificateElement_Ssa_TrustModelEcuPeerCert_SigAlgoId_006/KEYM_E_KEY_CERT_EMPTY]  # Provides the content of a specific certificate element. The certificate configuration defines how the certificate submodule can find the element, e.g. by providing the object identifier (OID). This function is used to retrieve this information if only one element is assigned to the respective OID.
        arg CertificateElementData: type=KeyM_CertificateElementType_Ssa_TrustModelEcuPeerCert_SigAlgoId_006, direction=OUT, server-argument-impl-policy=USE-ARRAY-BASE-TYPE  # Holds a pointer to the memory location which will hold the certificate element.
        arg CertificateDataLength: type=uint32, direction=OUT  # Contains the length in bytes of certificate element.
      operation CertificateElementGetByIndex: possible-error=[KeyMCertificateElement_Ssa_TrustModelEcuPeerCert_SigAlgoId_006/E_NOT_OK, KeyMCertificateElement_Ssa_TrustModelEcuPeerCert_SigAlgoId_006/KEYM_E_KEY_CERT_SIZE_MISMATCH, KeyMCertificateElement_Ssa_TrustModelEcuPeerCert_SigAlgoId_006/KEYM_E_PARAMETER_MISMATCH, KeyMCertificateElement_Ssa_TrustModelEcuPeerCert_SigAlgoId_006/KEYM_E_KEY_CERT_INVALID, KeyMCertificateElement_Ssa_TrustModelEcuPeerCert_SigAlgoId_006/KEYM_E_KEY_CERT_EMPTY]  # This operation provides data from a specific certificate element.
        arg Index: type=uint16, direction=IN  # This is the index to dedicated element in the list
        arg CertificateElementData: type=KeyM_CertificateElementType_Ssa_TrustModelEcuPeerCert_SigAlgoId_006, direction=OUT, server-argument-impl-policy=USE-ARRAY-BASE-TYPE  # Holds a pointer to the memory location which will hold the certificate element.
        arg CertificateDataLength: type=uint32, direction=OUT  # Contains the length in bytes of certificate element.
      operation CertificateElementGetCount: possible-error=[KeyMCertificateElement_Ssa_TrustModelEcuPeerCert_SigAlgoId_006/E_NOT_OK, KeyMCertificateElement_Ssa_TrustModelEcuPeerCert_SigAlgoId_006/KEYM_E_KEY_CERT_SIZE_MISMATCH, KeyMCertificateElement_Ssa_TrustModelEcuPeerCert_SigAlgoId_006/KEYM_E_PARAMETER_MISMATCH, KeyMCertificateElement_Ssa_TrustModelEcuPeerCert_SigAlgoId_006/KEYM_E_KEY_CERT_INVALID, KeyMCertificateElement_Ssa_TrustModelEcuPeerCert_SigAlgoId_006/KEYM_E_KEY_CERT_EMPTY]  # This operation returns the amount of items available for a certificate element.
        arg count: type=uint16, direction=OUT  # Number of items available for an element.
      5 x error:
        E_NOT_OK: error-code=1  # The service request failed.
        KEYM_E_KEY_CERT_SIZE_MISMATCH: error-code=4  # The service request failed. Parameter size does not match the expected value.
        KEYM_E_PARAMETER_MISMATCH: error-code=5  # The service request failed. Parameter to function does not provide the expected value.
        KEYM_E_KEY_CERT_EMPTY: error-code=10  # The service request failed. The requested key or certificate is not available, slot is empty.
        KEYM_E_KEY_CERT_INVALID: error-code=6  # The service request failed. Key or certificate is invalid and cannot be used for the operation.
    KeyMCertificateElement_Ssa_TrustModelEcuPeerCert_validityNotBefore_006  # Service of the certificate sub module to access certificate elements.
      operation CertificateElementGet: possible-error=[KeyMCertificateElement_Ssa_TrustModelEcuPeerCert_validityNotBefore_006/E_NOT_OK, KeyMCertificateElement_Ssa_TrustModelEcuPeerCert_validityNotBefore_006/KEYM_E_KEY_CERT_SIZE_MISMATCH, KeyMCertificateElement_Ssa_TrustModelEcuPeerCert_validityNotBefore_006/KEYM_E_PARAMETER_MISMATCH, KeyMCertificateElement_Ssa_TrustModelEcuPeerCert_validityNotBefore_006/KEYM_E_KEY_CERT_INVALID, KeyMCertificateElement_Ssa_TrustModelEcuPeerCert_validityNotBefore_006/KEYM_E_KEY_CERT_EMPTY]  # Provides the content of a specific certificate element. The certificate configuration defines how the certificate submodule can find the element, e.g. by providing the object identifier (OID). This function is used to retrieve this information if only one element is assigned to the respective OID.
        arg CertificateElementData: type=KeyM_CertificateElementType_Ssa_TrustModelEcuPeerCert_validityNotBefore_006, direction=OUT, server-argument-impl-policy=USE-ARRAY-BASE-TYPE  # Holds a pointer to the memory location which will hold the certificate element.
        arg CertificateDataLength: type=uint32, direction=OUT  # Contains the length in bytes of certificate element.
      operation CertificateElementGetByIndex: possible-error=[KeyMCertificateElement_Ssa_TrustModelEcuPeerCert_validityNotBefore_006/E_NOT_OK, KeyMCertificateElement_Ssa_TrustModelEcuPeerCert_validityNotBefore_006/KEYM_E_KEY_CERT_SIZE_MISMATCH, KeyMCertificateElement_Ssa_TrustModelEcuPeerCert_validityNotBefore_006/KEYM_E_PARAMETER_MISMATCH, KeyMCertificateElement_Ssa_TrustModelEcuPeerCert_validityNotBefore_006/KEYM_E_KEY_CERT_INVALID, KeyMCertificateElement_Ssa_TrustModelEcuPeerCert_validityNotBefore_006/KEYM_E_KEY_CERT_EMPTY]  # This operation provides data from a specific certificate element.
        arg Index: type=uint16, direction=IN  # This is the index to dedicated element in the list
        arg CertificateElementData: type=KeyM_CertificateElementType_Ssa_TrustModelEcuPeerCert_validityNotBefore_006, direction=OUT, server-argument-impl-policy=USE-ARRAY-BASE-TYPE  # Holds a pointer to the memory location which will hold the certificate element.
        arg CertificateDataLength: type=uint32, direction=OUT  # Contains the length in bytes of certificate element.
      operation CertificateElementGetCount: possible-error=[KeyMCertificateElement_Ssa_TrustModelEcuPeerCert_validityNotBefore_006/E_NOT_OK, KeyMCertificateElement_Ssa_TrustModelEcuPeerCert_validityNotBefore_006/KEYM_E_KEY_CERT_SIZE_MISMATCH, KeyMCertificateElement_Ssa_TrustModelEcuPeerCert_validityNotBefore_006/KEYM_E_PARAMETER_MISMATCH, KeyMCertificateElement_Ssa_TrustModelEcuPeerCert_validityNotBefore_006/KEYM_E_KEY_CERT_INVALID, KeyMCertificateElement_Ssa_TrustModelEcuPeerCert_validityNotBefore_006/KEYM_E_KEY_CERT_EMPTY]  # This operation returns the amount of items available for a certificate element.
        arg count: type=uint16, direction=OUT  # Number of items available for an element.
      5 x error:
        E_NOT_OK: error-code=1  # The service request failed.
        KEYM_E_KEY_CERT_SIZE_MISMATCH: error-code=4  # The service request failed. Parameter size does not match the expected value.
        KEYM_E_PARAMETER_MISMATCH: error-code=5  # The service request failed. Parameter to function does not provide the expected value.
        KEYM_E_KEY_CERT_EMPTY: error-code=10  # The service request failed. The requested key or certificate is not available, slot is empty.
        KEYM_E_KEY_CERT_INVALID: error-code=6  # The service request failed. Key or certificate is invalid and cannot be used for the operation.
    KeyMCertificateElement_Ssa_TrustModelEcuPeerCert_validityNotAfter_006  # Service of the certificate sub module to access certificate elements.
      operation CertificateElementGet: possible-error=[KeyMCertificateElement_Ssa_TrustModelEcuPeerCert_validityNotAfter_006/E_NOT_OK, KeyMCertificateElement_Ssa_TrustModelEcuPeerCert_validityNotAfter_006/KEYM_E_KEY_CERT_SIZE_MISMATCH, KeyMCertificateElement_Ssa_TrustModelEcuPeerCert_validityNotAfter_006/KEYM_E_PARAMETER_MISMATCH, KeyMCertificateElement_Ssa_TrustModelEcuPeerCert_validityNotAfter_006/KEYM_E_KEY_CERT_INVALID, KeyMCertificateElement_Ssa_TrustModelEcuPeerCert_validityNotAfter_006/KEYM_E_KEY_CERT_EMPTY]  # Provides the content of a specific certificate element. The certificate configuration defines how the certificate submodule can find the element, e.g. by providing the object identifier (OID). This function is used to retrieve this information if only one element is assigned to the respective OID.
        arg CertificateElementData: type=KeyM_CertificateElementType_Ssa_TrustModelEcuPeerCert_validityNotAfter_006, direction=OUT, server-argument-impl-policy=USE-ARRAY-BASE-TYPE  # Holds a pointer to the memory location which will hold the certificate element.
        arg CertificateDataLength: type=uint32, direction=OUT  # Contains the length in bytes of certificate element.
      operation CertificateElementGetByIndex: possible-error=[KeyMCertificateElement_Ssa_TrustModelEcuPeerCert_validityNotAfter_006/E_NOT_OK, KeyMCertificateElement_Ssa_TrustModelEcuPeerCert_validityNotAfter_006/KEYM_E_KEY_CERT_SIZE_MISMATCH, KeyMCertificateElement_Ssa_TrustModelEcuPeerCert_validityNotAfter_006/KEYM_E_PARAMETER_MISMATCH, KeyMCertificateElement_Ssa_TrustModelEcuPeerCert_validityNotAfter_006/KEYM_E_KEY_CERT_INVALID, KeyMCertificateElement_Ssa_TrustModelEcuPeerCert_validityNotAfter_006/KEYM_E_KEY_CERT_EMPTY]  # This operation provides data from a specific certificate element.
        arg Index: type=uint16, direction=IN  # This is the index to dedicated element in the list
        arg CertificateElementData: type=KeyM_CertificateElementType_Ssa_TrustModelEcuPeerCert_validityNotAfter_006, direction=OUT, server-argument-impl-policy=USE-ARRAY-BASE-TYPE  # Holds a pointer to the memory location which will hold the certificate element.
        arg CertificateDataLength: type=uint32, direction=OUT  # Contains the length in bytes of certificate element.
      operation CertificateElementGetCount: possible-error=[KeyMCertificateElement_Ssa_TrustModelEcuPeerCert_validityNotAfter_006/E_NOT_OK, KeyMCertificateElement_Ssa_TrustModelEcuPeerCert_validityNotAfter_006/KEYM_E_KEY_CERT_SIZE_MISMATCH, KeyMCertificateElement_Ssa_TrustModelEcuPeerCert_validityNotAfter_006/KEYM_E_PARAMETER_MISMATCH, KeyMCertificateElement_Ssa_TrustModelEcuPeerCert_validityNotAfter_006/KEYM_E_KEY_CERT_INVALID, KeyMCertificateElement_Ssa_TrustModelEcuPeerCert_validityNotAfter_006/KEYM_E_KEY_CERT_EMPTY]  # This operation returns the amount of items available for a certificate element.
        arg count: type=uint16, direction=OUT  # Number of items available for an element.
      5 x error:
        E_NOT_OK: error-code=1  # The service request failed.
        KEYM_E_KEY_CERT_SIZE_MISMATCH: error-code=4  # The service request failed. Parameter size does not match the expected value.
        KEYM_E_PARAMETER_MISMATCH: error-code=5  # The service request failed. Parameter to function does not provide the expected value.
        KEYM_E_KEY_CERT_EMPTY: error-code=10  # The service request failed. The requested key or certificate is not available, slot is empty.
        KEYM_E_KEY_CERT_INVALID: error-code=6  # The service request failed. Key or certificate is invalid and cannot be used for the operation.
    KeyMCertificateElement_Ssa_TrustModelEcuPeerCert_subject_006  # Service of the certificate sub module to access certificate elements.
      operation CertificateElementGet: possible-error=[KeyMCertificateElement_Ssa_TrustModelEcuPeerCert_subject_006/E_NOT_OK, KeyMCertificateElement_Ssa_TrustModelEcuPeerCert_subject_006/KEYM_E_KEY_CERT_SIZE_MISMATCH, KeyMCertificateElement_Ssa_TrustModelEcuPeerCert_subject_006/KEYM_E_PARAMETER_MISMATCH, KeyMCertificateElement_Ssa_TrustModelEcuPeerCert_subject_006/KEYM_E_KEY_CERT_INVALID, KeyMCertificateElement_Ssa_TrustModelEcuPeerCert_subject_006/KEYM_E_KEY_CERT_EMPTY]  # Provides the content of a specific certificate element. The certificate configuration defines how the certificate submodule can find the element, e.g. by providing the object identifier (OID). This function is used to retrieve this information if only one element is assigned to the respective OID.
        arg CertificateElementData: type=KeyM_CertificateElementType_Ssa_TrustModelEcuPeerCert_subject_006, direction=OUT, server-argument-impl-policy=USE-ARRAY-BASE-TYPE  # Holds a pointer to the memory location which will hold the certificate element.
        arg CertificateDataLength: type=uint32, direction=OUT  # Contains the length in bytes of certificate element.
      operation CertificateElementGetByIndex: possible-error=[KeyMCertificateElement_Ssa_TrustModelEcuPeerCert_subject_006/E_NOT_OK, KeyMCertificateElement_Ssa_TrustModelEcuPeerCert_subject_006/KEYM_E_KEY_CERT_SIZE_MISMATCH, KeyMCertificateElement_Ssa_TrustModelEcuPeerCert_subject_006/KEYM_E_PARAMETER_MISMATCH, KeyMCertificateElement_Ssa_TrustModelEcuPeerCert_subject_006/KEYM_E_KEY_CERT_INVALID, KeyMCertificateElement_Ssa_TrustModelEcuPeerCert_subject_006/KEYM_E_KEY_CERT_EMPTY]  # This operation provides data from a specific certificate element.
        arg Index: type=uint16, direction=IN  # This is the index to dedicated element in the list
        arg CertificateElementData: type=KeyM_CertificateElementType_Ssa_TrustModelEcuPeerCert_subject_006, direction=OUT, server-argument-impl-policy=USE-ARRAY-BASE-TYPE  # Holds a pointer to the memory location which will hold the certificate element.
        arg CertificateDataLength: type=uint32, direction=OUT  # Contains the length in bytes of certificate element.
      operation CertificateElementGetCount: possible-error=[KeyMCertificateElement_Ssa_TrustModelEcuPeerCert_subject_006/E_NOT_OK, KeyMCertificateElement_Ssa_TrustModelEcuPeerCert_subject_006/KEYM_E_KEY_CERT_SIZE_MISMATCH, KeyMCertificateElement_Ssa_TrustModelEcuPeerCert_subject_006/KEYM_E_PARAMETER_MISMATCH, KeyMCertificateElement_Ssa_TrustModelEcuPeerCert_subject_006/KEYM_E_KEY_CERT_INVALID, KeyMCertificateElement_Ssa_TrustModelEcuPeerCert_subject_006/KEYM_E_KEY_CERT_EMPTY]  # This operation returns the amount of items available for a certificate element.
        arg count: type=uint16, direction=OUT  # Number of items available for an element.
      5 x error:
        E_NOT_OK: error-code=1  # The service request failed.
        KEYM_E_KEY_CERT_SIZE_MISMATCH: error-code=4  # The service request failed. Parameter size does not match the expected value.
        KEYM_E_PARAMETER_MISMATCH: error-code=5  # The service request failed. Parameter to function does not provide the expected value.
        KEYM_E_KEY_CERT_EMPTY: error-code=10  # The service request failed. The requested key or certificate is not available, slot is empty.
        KEYM_E_KEY_CERT_INVALID: error-code=6  # The service request failed. Key or certificate is invalid and cannot be used for the operation.
    KeyMCertificateElement_Ssa_TrustModelEcuPeerCert_SubjectPublicKeyInfoAlgo_006  # Service of the certificate sub module to access certificate elements.
      operation CertificateElementGet: possible-error=[KeyMCertificateElement_Ssa_TrustModelEcuPeerCert_SubjectPublicKeyInfoAlgo_006/E_NOT_OK, KeyMCertificateElement_Ssa_TrustModelEcuPeerCert_SubjectPublicKeyInfoAlgo_006/KEYM_E_KEY_CERT_SIZE_MISMATCH, KeyMCertificateElement_Ssa_TrustModelEcuPeerCert_SubjectPublicKeyInfoAlgo_006/KEYM_E_PARAMETER_MISMATCH, KeyMCertificateElement_Ssa_TrustModelEcuPeerCert_SubjectPublicKeyInfoAlgo_006/KEYM_E_KEY_CERT_INVALID, KeyMCertificateElement_Ssa_TrustModelEcuPeerCert_SubjectPublicKeyInfoAlgo_006/KEYM_E_KEY_CERT_EMPTY]  # Provides the content of a specific certificate element. The certificate configuration defines how the certificate submodule can find the element, e.g. by providing the object identifier (OID). This function is used to retrieve this information if only one element is assigned to the respective OID.
        arg CertificateElementData: type=KeyM_CertificateElementType_Ssa_TrustModelEcuPeerCert_SubjectPublicKeyInfoAlgo_006, direction=OUT, server-argument-impl-policy=USE-ARRAY-BASE-TYPE  # Holds a pointer to the memory location which will hold the certificate element.
        arg CertificateDataLength: type=uint32, direction=OUT  # Contains the length in bytes of certificate element.
      operation CertificateElementGetByIndex: possible-error=[KeyMCertificateElement_Ssa_TrustModelEcuPeerCert_SubjectPublicKeyInfoAlgo_006/E_NOT_OK, KeyMCertificateElement_Ssa_TrustModelEcuPeerCert_SubjectPublicKeyInfoAlgo_006/KEYM_E_KEY_CERT_SIZE_MISMATCH, KeyMCertificateElement_Ssa_TrustModelEcuPeerCert_SubjectPublicKeyInfoAlgo_006/KEYM_E_PARAMETER_MISMATCH, KeyMCertificateElement_Ssa_TrustModelEcuPeerCert_SubjectPublicKeyInfoAlgo_006/KEYM_E_KEY_CERT_INVALID, KeyMCertificateElement_Ssa_TrustModelEcuPeerCert_SubjectPublicKeyInfoAlgo_006/KEYM_E_KEY_CERT_EMPTY]  # This operation provides data from a specific certificate element.
        arg Index: type=uint16, direction=IN  # This is the index to dedicated element in the list
        arg CertificateElementData: type=KeyM_CertificateElementType_Ssa_TrustModelEcuPeerCert_SubjectPublicKeyInfoAlgo_006, direction=OUT, server-argument-impl-policy=USE-ARRAY-BASE-TYPE  # Holds a pointer to the memory location which will hold the certificate element.
        arg CertificateDataLength: type=uint32, direction=OUT  # Contains the length in bytes of certificate element.
      operation CertificateElementGetCount: possible-error=[KeyMCertificateElement_Ssa_TrustModelEcuPeerCert_SubjectPublicKeyInfoAlgo_006/E_NOT_OK, KeyMCertificateElement_Ssa_TrustModelEcuPeerCert_SubjectPublicKeyInfoAlgo_006/KEYM_E_KEY_CERT_SIZE_MISMATCH, KeyMCertificateElement_Ssa_TrustModelEcuPeerCert_SubjectPublicKeyInfoAlgo_006/KEYM_E_PARAMETER_MISMATCH, KeyMCertificateElement_Ssa_TrustModelEcuPeerCert_SubjectPublicKeyInfoAlgo_006/KEYM_E_KEY_CERT_INVALID, KeyMCertificateElement_Ssa_TrustModelEcuPeerCert_SubjectPublicKeyInfoAlgo_006/KEYM_E_KEY_CERT_EMPTY]  # This operation returns the amount of items available for a certificate element.
        arg count: type=uint16, direction=OUT  # Number of items available for an element.
      5 x error:
        E_NOT_OK: error-code=1  # The service request failed.
        KEYM_E_KEY_CERT_SIZE_MISMATCH: error-code=4  # The service request failed. Parameter size does not match the expected value.
        KEYM_E_PARAMETER_MISMATCH: error-code=5  # The service request failed. Parameter to function does not provide the expected value.
        KEYM_E_KEY_CERT_EMPTY: error-code=10  # The service request failed. The requested key or certificate is not available, slot is empty.
        KEYM_E_KEY_CERT_INVALID: error-code=6  # The service request failed. Key or certificate is invalid and cannot be used for the operation.
    KeyMCertificateElement_Ssa_TrustModelEcuPeerCert_SubjectPublicKeyInfoKey_006  # Service of the certificate sub module to access certificate elements.
      operation CertificateElementGet: possible-error=[KeyMCertificateElement_Ssa_TrustModelEcuPeerCert_SubjectPublicKeyInfoKey_006/E_NOT_OK, KeyMCertificateElement_Ssa_TrustModelEcuPeerCert_SubjectPublicKeyInfoKey_006/KEYM_E_KEY_CERT_SIZE_MISMATCH, KeyMCertificateElement_Ssa_TrustModelEcuPeerCert_SubjectPublicKeyInfoKey_006/KEYM_E_PARAMETER_MISMATCH, KeyMCertificateElement_Ssa_TrustModelEcuPeerCert_SubjectPublicKeyInfoKey_006/KEYM_E_KEY_CERT_INVALID, KeyMCertificateElement_Ssa_TrustModelEcuPeerCert_SubjectPublicKeyInfoKey_006/KEYM_E_KEY_CERT_EMPTY]  # Provides the content of a specific certificate element. The certificate configuration defines how the certificate submodule can find the element, e.g. by providing the object identifier (OID). This function is used to retrieve this information if only one element is assigned to the respective OID.
        arg CertificateElementData: type=KeyM_CertificateElementType_Ssa_TrustModelEcuPeerCert_SubjectPublicKeyInfoKey_006, direction=OUT, server-argument-impl-policy=USE-ARRAY-BASE-TYPE  # Holds a pointer to the memory location which will hold the certificate element.
        arg CertificateDataLength: type=uint32, direction=OUT  # Contains the length in bytes of certificate element.
      operation CertificateElementGetByIndex: possible-error=[KeyMCertificateElement_Ssa_TrustModelEcuPeerCert_SubjectPublicKeyInfoKey_006/E_NOT_OK, KeyMCertificateElement_Ssa_TrustModelEcuPeerCert_SubjectPublicKeyInfoKey_006/KEYM_E_KEY_CERT_SIZE_MISMATCH, KeyMCertificateElement_Ssa_TrustModelEcuPeerCert_SubjectPublicKeyInfoKey_006/KEYM_E_PARAMETER_MISMATCH, KeyMCertificateElement_Ssa_TrustModelEcuPeerCert_SubjectPublicKeyInfoKey_006/KEYM_E_KEY_CERT_INVALID, KeyMCertificateElement_Ssa_TrustModelEcuPeerCert_SubjectPublicKeyInfoKey_006/KEYM_E_KEY_CERT_EMPTY]  # This operation provides data from a specific certificate element.
        arg Index: type=uint16, direction=IN  # This is the index to dedicated element in the list
        arg CertificateElementData: type=KeyM_CertificateElementType_Ssa_TrustModelEcuPeerCert_SubjectPublicKeyInfoKey_006, direction=OUT, server-argument-impl-policy=USE-ARRAY-BASE-TYPE  # Holds a pointer to the memory location which will hold the certificate element.
        arg CertificateDataLength: type=uint32, direction=OUT  # Contains the length in bytes of certificate element.
      operation CertificateElementGetCount: possible-error=[KeyMCertificateElement_Ssa_TrustModelEcuPeerCert_SubjectPublicKeyInfoKey_006/E_NOT_OK, KeyMCertificateElement_Ssa_TrustModelEcuPeerCert_SubjectPublicKeyInfoKey_006/KEYM_E_KEY_CERT_SIZE_MISMATCH, KeyMCertificateElement_Ssa_TrustModelEcuPeerCert_SubjectPublicKeyInfoKey_006/KEYM_E_PARAMETER_MISMATCH, KeyMCertificateElement_Ssa_TrustModelEcuPeerCert_SubjectPublicKeyInfoKey_006/KEYM_E_KEY_CERT_INVALID, KeyMCertificateElement_Ssa_TrustModelEcuPeerCert_SubjectPublicKeyInfoKey_006/KEYM_E_KEY_CERT_EMPTY]  # This operation returns the amount of items available for a certificate element.
        arg count: type=uint16, direction=OUT  # Number of items available for an element.
      5 x error:
        E_NOT_OK: error-code=1  # The service request failed.
        KEYM_E_KEY_CERT_SIZE_MISMATCH: error-code=4  # The service request failed. Parameter size does not match the expected value.
        KEYM_E_PARAMETER_MISMATCH: error-code=5  # The service request failed. Parameter to function does not provide the expected value.
        KEYM_E_KEY_CERT_EMPTY: error-code=10  # The service request failed. The requested key or certificate is not available, slot is empty.
        KEYM_E_KEY_CERT_INVALID: error-code=6  # The service request failed. Key or certificate is invalid and cannot be used for the operation.
    KeyMCertificateElement_Ssa_TrustModelEcuPeerCert_Issuer_006  # Service of the certificate sub module to access certificate elements.
      operation CertificateElementGet: possible-error=[KeyMCertificateElement_Ssa_TrustModelEcuPeerCert_Issuer_006/E_NOT_OK, KeyMCertificateElement_Ssa_TrustModelEcuPeerCert_Issuer_006/KEYM_E_KEY_CERT_SIZE_MISMATCH, KeyMCertificateElement_Ssa_TrustModelEcuPeerCert_Issuer_006/KEYM_E_PARAMETER_MISMATCH, KeyMCertificateElement_Ssa_TrustModelEcuPeerCert_Issuer_006/KEYM_E_KEY_CERT_INVALID, KeyMCertificateElement_Ssa_TrustModelEcuPeerCert_Issuer_006/KEYM_E_KEY_CERT_EMPTY]  # Provides the content of a specific certificate element. The certificate configuration defines how the certificate submodule can find the element, e.g. by providing the object identifier (OID). This function is used to retrieve this information if only one element is assigned to the respective OID.
        arg CertificateElementData: type=KeyM_CertificateElementType_Ssa_TrustModelEcuPeerCert_Issuer_006, direction=OUT, server-argument-impl-policy=USE-ARRAY-BASE-TYPE  # Holds a pointer to the memory location which will hold the certificate element.
        arg CertificateDataLength: type=uint32, direction=OUT  # Contains the length in bytes of certificate element.
      operation CertificateElementGetByIndex: possible-error=[KeyMCertificateElement_Ssa_TrustModelEcuPeerCert_Issuer_006/E_NOT_OK, KeyMCertificateElement_Ssa_TrustModelEcuPeerCert_Issuer_006/KEYM_E_KEY_CERT_SIZE_MISMATCH, KeyMCertificateElement_Ssa_TrustModelEcuPeerCert_Issuer_006/KEYM_E_PARAMETER_MISMATCH, KeyMCertificateElement_Ssa_TrustModelEcuPeerCert_Issuer_006/KEYM_E_KEY_CERT_INVALID, KeyMCertificateElement_Ssa_TrustModelEcuPeerCert_Issuer_006/KEYM_E_KEY_CERT_EMPTY]  # This operation provides data from a specific certificate element.
        arg Index: type=uint16, direction=IN  # This is the index to dedicated element in the list
        arg CertificateElementData: type=KeyM_CertificateElementType_Ssa_TrustModelEcuPeerCert_Issuer_006, direction=OUT, server-argument-impl-policy=USE-ARRAY-BASE-TYPE  # Holds a pointer to the memory location which will hold the certificate element.
        arg CertificateDataLength: type=uint32, direction=OUT  # Contains the length in bytes of certificate element.
      operation CertificateElementGetCount: possible-error=[KeyMCertificateElement_Ssa_TrustModelEcuPeerCert_Issuer_006/E_NOT_OK, KeyMCertificateElement_Ssa_TrustModelEcuPeerCert_Issuer_006/KEYM_E_KEY_CERT_SIZE_MISMATCH, KeyMCertificateElement_Ssa_TrustModelEcuPeerCert_Issuer_006/KEYM_E_PARAMETER_MISMATCH, KeyMCertificateElement_Ssa_TrustModelEcuPeerCert_Issuer_006/KEYM_E_KEY_CERT_INVALID, KeyMCertificateElement_Ssa_TrustModelEcuPeerCert_Issuer_006/KEYM_E_KEY_CERT_EMPTY]  # This operation returns the amount of items available for a certificate element.
        arg count: type=uint16, direction=OUT  # Number of items available for an element.
      5 x error:
        E_NOT_OK: error-code=1  # The service request failed.
        KEYM_E_KEY_CERT_SIZE_MISMATCH: error-code=4  # The service request failed. Parameter size does not match the expected value.
        KEYM_E_PARAMETER_MISMATCH: error-code=5  # The service request failed. Parameter to function does not provide the expected value.
        KEYM_E_KEY_CERT_EMPTY: error-code=10  # The service request failed. The requested key or certificate is not available, slot is empty.
        KEYM_E_KEY_CERT_INVALID: error-code=6  # The service request failed. Key or certificate is invalid and cannot be used for the operation.
    KeyMCertificateElement_Ssa_TrustModelEcuPeerCert_signatureAlgorithm_006  # Service of the certificate sub module to access certificate elements.
      operation CertificateElementGet: possible-error=[KeyMCertificateElement_Ssa_TrustModelEcuPeerCert_signatureAlgorithm_006/E_NOT_OK, KeyMCertificateElement_Ssa_TrustModelEcuPeerCert_signatureAlgorithm_006/KEYM_E_KEY_CERT_SIZE_MISMATCH, KeyMCertificateElement_Ssa_TrustModelEcuPeerCert_signatureAlgorithm_006/KEYM_E_PARAMETER_MISMATCH, KeyMCertificateElement_Ssa_TrustModelEcuPeerCert_signatureAlgorithm_006/KEYM_E_KEY_CERT_INVALID, KeyMCertificateElement_Ssa_TrustModelEcuPeerCert_signatureAlgorithm_006/KEYM_E_KEY_CERT_EMPTY]  # Provides the content of a specific certificate element. The certificate configuration defines how the certificate submodule can find the element, e.g. by providing the object identifier (OID). This function is used to retrieve this information if only one element is assigned to the respective OID.
        arg CertificateElementData: type=KeyM_CertificateElementType_Ssa_TrustModelEcuPeerCert_signatureAlgorithm_006, direction=OUT, server-argument-impl-policy=USE-ARRAY-BASE-TYPE  # Holds a pointer to the memory location which will hold the certificate element.
        arg CertificateDataLength: type=uint32, direction=OUT  # Contains the length in bytes of certificate element.
      operation CertificateElementGetByIndex: possible-error=[KeyMCertificateElement_Ssa_TrustModelEcuPeerCert_signatureAlgorithm_006/E_NOT_OK, KeyMCertificateElement_Ssa_TrustModelEcuPeerCert_signatureAlgorithm_006/KEYM_E_KEY_CERT_SIZE_MISMATCH, KeyMCertificateElement_Ssa_TrustModelEcuPeerCert_signatureAlgorithm_006/KEYM_E_PARAMETER_MISMATCH, KeyMCertificateElement_Ssa_TrustModelEcuPeerCert_signatureAlgorithm_006/KEYM_E_KEY_CERT_INVALID, KeyMCertificateElement_Ssa_TrustModelEcuPeerCert_signatureAlgorithm_006/KEYM_E_KEY_CERT_EMPTY]  # This operation provides data from a specific certificate element.
        arg Index: type=uint16, direction=IN  # This is the index to dedicated element in the list
        arg CertificateElementData: type=KeyM_CertificateElementType_Ssa_TrustModelEcuPeerCert_signatureAlgorithm_006, direction=OUT, server-argument-impl-policy=USE-ARRAY-BASE-TYPE  # Holds a pointer to the memory location which will hold the certificate element.
        arg CertificateDataLength: type=uint32, direction=OUT  # Contains the length in bytes of certificate element.
      operation CertificateElementGetCount: possible-error=[KeyMCertificateElement_Ssa_TrustModelEcuPeerCert_signatureAlgorithm_006/E_NOT_OK, KeyMCertificateElement_Ssa_TrustModelEcuPeerCert_signatureAlgorithm_006/KEYM_E_KEY_CERT_SIZE_MISMATCH, KeyMCertificateElement_Ssa_TrustModelEcuPeerCert_signatureAlgorithm_006/KEYM_E_PARAMETER_MISMATCH, KeyMCertificateElement_Ssa_TrustModelEcuPeerCert_signatureAlgorithm_006/KEYM_E_KEY_CERT_INVALID, KeyMCertificateElement_Ssa_TrustModelEcuPeerCert_signatureAlgorithm_006/KEYM_E_KEY_CERT_EMPTY]  # This operation returns the amount of items available for a certificate element.
        arg count: type=uint16, direction=OUT  # Number of items available for an element.
      5 x error:
        E_NOT_OK: error-code=1  # The service request failed.
        KEYM_E_KEY_CERT_SIZE_MISMATCH: error-code=4  # The service request failed. Parameter size does not match the expected value.
        KEYM_E_PARAMETER_MISMATCH: error-code=5  # The service request failed. Parameter to function does not provide the expected value.
        KEYM_E_KEY_CERT_EMPTY: error-code=10  # The service request failed. The requested key or certificate is not available, slot is empty.
        KEYM_E_KEY_CERT_INVALID: error-code=6  # The service request failed. Key or certificate is invalid and cannot be used for the operation.
    KeyMCertificateElement_Ssa_TrustModelEcuPeerCert_signatureValue_006  # Service of the certificate sub module to access certificate elements.
      operation CertificateElementGet: possible-error=[KeyMCertificateElement_Ssa_TrustModelEcuPeerCert_signatureValue_006/E_NOT_OK, KeyMCertificateElement_Ssa_TrustModelEcuPeerCert_signatureValue_006/KEYM_E_KEY_CERT_SIZE_MISMATCH, KeyMCertificateElement_Ssa_TrustModelEcuPeerCert_signatureValue_006/KEYM_E_PARAMETER_MISMATCH, KeyMCertificateElement_Ssa_TrustModelEcuPeerCert_signatureValue_006/KEYM_E_KEY_CERT_INVALID, KeyMCertificateElement_Ssa_TrustModelEcuPeerCert_signatureValue_006/KEYM_E_KEY_CERT_EMPTY]  # Provides the content of a specific certificate element. The certificate configuration defines how the certificate submodule can find the element, e.g. by providing the object identifier (OID). This function is used to retrieve this information if only one element is assigned to the respective OID.
        arg CertificateElementData: type=KeyM_CertificateElementType_Ssa_TrustModelEcuPeerCert_signatureValue_006, direction=OUT, server-argument-impl-policy=USE-ARRAY-BASE-TYPE  # Holds a pointer to the memory location which will hold the certificate element.
        arg CertificateDataLength: type=uint32, direction=OUT  # Contains the length in bytes of certificate element.
      operation CertificateElementGetByIndex: possible-error=[KeyMCertificateElement_Ssa_TrustModelEcuPeerCert_signatureValue_006/E_NOT_OK, KeyMCertificateElement_Ssa_TrustModelEcuPeerCert_signatureValue_006/KEYM_E_KEY_CERT_SIZE_MISMATCH, KeyMCertificateElement_Ssa_TrustModelEcuPeerCert_signatureValue_006/KEYM_E_PARAMETER_MISMATCH, KeyMCertificateElement_Ssa_TrustModelEcuPeerCert_signatureValue_006/KEYM_E_KEY_CERT_INVALID, KeyMCertificateElement_Ssa_TrustModelEcuPeerCert_signatureValue_006/KEYM_E_KEY_CERT_EMPTY]  # This operation provides data from a specific certificate element.
        arg Index: type=uint16, direction=IN  # This is the index to dedicated element in the list
        arg CertificateElementData: type=KeyM_CertificateElementType_Ssa_TrustModelEcuPeerCert_signatureValue_006, direction=OUT, server-argument-impl-policy=USE-ARRAY-BASE-TYPE  # Holds a pointer to the memory location which will hold the certificate element.
        arg CertificateDataLength: type=uint32, direction=OUT  # Contains the length in bytes of certificate element.
      operation CertificateElementGetCount: possible-error=[KeyMCertificateElement_Ssa_TrustModelEcuPeerCert_signatureValue_006/E_NOT_OK, KeyMCertificateElement_Ssa_TrustModelEcuPeerCert_signatureValue_006/KEYM_E_KEY_CERT_SIZE_MISMATCH, KeyMCertificateElement_Ssa_TrustModelEcuPeerCert_signatureValue_006/KEYM_E_PARAMETER_MISMATCH, KeyMCertificateElement_Ssa_TrustModelEcuPeerCert_signatureValue_006/KEYM_E_KEY_CERT_INVALID, KeyMCertificateElement_Ssa_TrustModelEcuPeerCert_signatureValue_006/KEYM_E_KEY_CERT_EMPTY]  # This operation returns the amount of items available for a certificate element.
        arg count: type=uint16, direction=OUT  # Number of items available for an element.
      5 x error:
        E_NOT_OK: error-code=1  # The service request failed.
        KEYM_E_KEY_CERT_SIZE_MISMATCH: error-code=4  # The service request failed. Parameter size does not match the expected value.
        KEYM_E_PARAMETER_MISMATCH: error-code=5  # The service request failed. Parameter to function does not provide the expected value.
        KEYM_E_KEY_CERT_EMPTY: error-code=10  # The service request failed. The requested key or certificate is not available, slot is empty.
        KEYM_E_KEY_CERT_INVALID: error-code=6  # The service request failed. Key or certificate is invalid and cannot be used for the operation.
    KeyMCertificateElement_Ssa_TrustModelEcuPeerCert_ext_uniqueECUID_006  # Service of the certificate sub module to access certificate elements.
      operation CertificateElementGet: possible-error=[KeyMCertificateElement_Ssa_TrustModelEcuPeerCert_ext_uniqueECUID_006/E_NOT_OK, KeyMCertificateElement_Ssa_TrustModelEcuPeerCert_ext_uniqueECUID_006/KEYM_E_KEY_CERT_SIZE_MISMATCH, KeyMCertificateElement_Ssa_TrustModelEcuPeerCert_ext_uniqueECUID_006/KEYM_E_PARAMETER_MISMATCH, KeyMCertificateElement_Ssa_TrustModelEcuPeerCert_ext_uniqueECUID_006/KEYM_E_KEY_CERT_INVALID, KeyMCertificateElement_Ssa_TrustModelEcuPeerCert_ext_uniqueECUID_006/KEYM_E_KEY_CERT_EMPTY]  # Provides the content of a specific certificate element. The certificate configuration defines how the certificate submodule can find the element, e.g. by providing the object identifier (OID). This function is used to retrieve this information if only one element is assigned to the respective OID.
        arg CertificateElementData: type=KeyM_CertificateElementType_Ssa_TrustModelEcuPeerCert_ext_uniqueECUID_006, direction=OUT, server-argument-impl-policy=USE-ARRAY-BASE-TYPE  # Holds a pointer to the memory location which will hold the certificate element.
        arg CertificateDataLength: type=uint32, direction=OUT  # Contains the length in bytes of certificate element.
      operation CertificateElementGetByIndex: possible-error=[KeyMCertificateElement_Ssa_TrustModelEcuPeerCert_ext_uniqueECUID_006/E_NOT_OK, KeyMCertificateElement_Ssa_TrustModelEcuPeerCert_ext_uniqueECUID_006/KEYM_E_KEY_CERT_SIZE_MISMATCH, KeyMCertificateElement_Ssa_TrustModelEcuPeerCert_ext_uniqueECUID_006/KEYM_E_PARAMETER_MISMATCH, KeyMCertificateElement_Ssa_TrustModelEcuPeerCert_ext_uniqueECUID_006/KEYM_E_KEY_CERT_INVALID, KeyMCertificateElement_Ssa_TrustModelEcuPeerCert_ext_uniqueECUID_006/KEYM_E_KEY_CERT_EMPTY]  # This operation provides data from a specific certificate element.
        arg Index: type=uint16, direction=IN  # This is the index to dedicated element in the list
        arg CertificateElementData: type=KeyM_CertificateElementType_Ssa_TrustModelEcuPeerCert_ext_uniqueECUID_006, direction=OUT, server-argument-impl-policy=USE-ARRAY-BASE-TYPE  # Holds a pointer to the memory location which will hold the certificate element.
        arg CertificateDataLength: type=uint32, direction=OUT  # Contains the length in bytes of certificate element.
      operation CertificateElementGetCount: possible-error=[KeyMCertificateElement_Ssa_TrustModelEcuPeerCert_ext_uniqueECUID_006/E_NOT_OK, KeyMCertificateElement_Ssa_TrustModelEcuPeerCert_ext_uniqueECUID_006/KEYM_E_KEY_CERT_SIZE_MISMATCH, KeyMCertificateElement_Ssa_TrustModelEcuPeerCert_ext_uniqueECUID_006/KEYM_E_PARAMETER_MISMATCH, KeyMCertificateElement_Ssa_TrustModelEcuPeerCert_ext_uniqueECUID_006/KEYM_E_KEY_CERT_INVALID, KeyMCertificateElement_Ssa_TrustModelEcuPeerCert_ext_uniqueECUID_006/KEYM_E_KEY_CERT_EMPTY]  # This operation returns the amount of items available for a certificate element.
        arg count: type=uint16, direction=OUT  # Number of items available for an element.
      5 x error:
        E_NOT_OK: error-code=1  # The service request failed.
        KEYM_E_KEY_CERT_SIZE_MISMATCH: error-code=4  # The service request failed. Parameter size does not match the expected value.
        KEYM_E_PARAMETER_MISMATCH: error-code=5  # The service request failed. Parameter to function does not provide the expected value.
        KEYM_E_KEY_CERT_EMPTY: error-code=10  # The service request failed. The requested key or certificate is not available, slot is empty.
        KEYM_E_KEY_CERT_INVALID: error-code=6  # The service request failed. Key or certificate is invalid and cannot be used for the operation.
    KeyMCertificateElement_Ssa_TrustModelEcuPeerCert_ext_specialEcu_006  # Service of the certificate sub module to access certificate elements.
      operation CertificateElementGet: possible-error=[KeyMCertificateElement_Ssa_TrustModelEcuPeerCert_ext_specialEcu_006/E_NOT_OK, KeyMCertificateElement_Ssa_TrustModelEcuPeerCert_ext_specialEcu_006/KEYM_E_KEY_CERT_SIZE_MISMATCH, KeyMCertificateElement_Ssa_TrustModelEcuPeerCert_ext_specialEcu_006/KEYM_E_PARAMETER_MISMATCH, KeyMCertificateElement_Ssa_TrustModelEcuPeerCert_ext_specialEcu_006/KEYM_E_KEY_CERT_INVALID, KeyMCertificateElement_Ssa_TrustModelEcuPeerCert_ext_specialEcu_006/KEYM_E_KEY_CERT_EMPTY]  # Provides the content of a specific certificate element. The certificate configuration defines how the certificate submodule can find the element, e.g. by providing the object identifier (OID). This function is used to retrieve this information if only one element is assigned to the respective OID.
        arg CertificateElementData: type=KeyM_CertificateElementType_Ssa_TrustModelEcuPeerCert_ext_specialEcu_006, direction=OUT, server-argument-impl-policy=USE-ARRAY-BASE-TYPE  # Holds a pointer to the memory location which will hold the certificate element.
        arg CertificateDataLength: type=uint32, direction=OUT  # Contains the length in bytes of certificate element.
      operation CertificateElementGetByIndex: possible-error=[KeyMCertificateElement_Ssa_TrustModelEcuPeerCert_ext_specialEcu_006/E_NOT_OK, KeyMCertificateElement_Ssa_TrustModelEcuPeerCert_ext_specialEcu_006/KEYM_E_KEY_CERT_SIZE_MISMATCH, KeyMCertificateElement_Ssa_TrustModelEcuPeerCert_ext_specialEcu_006/KEYM_E_PARAMETER_MISMATCH, KeyMCertificateElement_Ssa_TrustModelEcuPeerCert_ext_specialEcu_006/KEYM_E_KEY_CERT_INVALID, KeyMCertificateElement_Ssa_TrustModelEcuPeerCert_ext_specialEcu_006/KEYM_E_KEY_CERT_EMPTY]  # This operation provides data from a specific certificate element.
        arg Index: type=uint16, direction=IN  # This is the index to dedicated element in the list
        arg CertificateElementData: type=KeyM_CertificateElementType_Ssa_TrustModelEcuPeerCert_ext_specialEcu_006, direction=OUT, server-argument-impl-policy=USE-ARRAY-BASE-TYPE  # Holds a pointer to the memory location which will hold the certificate element.
        arg CertificateDataLength: type=uint32, direction=OUT  # Contains the length in bytes of certificate element.
      operation CertificateElementGetCount: possible-error=[KeyMCertificateElement_Ssa_TrustModelEcuPeerCert_ext_specialEcu_006/E_NOT_OK, KeyMCertificateElement_Ssa_TrustModelEcuPeerCert_ext_specialEcu_006/KEYM_E_KEY_CERT_SIZE_MISMATCH, KeyMCertificateElement_Ssa_TrustModelEcuPeerCert_ext_specialEcu_006/KEYM_E_PARAMETER_MISMATCH, KeyMCertificateElement_Ssa_TrustModelEcuPeerCert_ext_specialEcu_006/KEYM_E_KEY_CERT_INVALID, KeyMCertificateElement_Ssa_TrustModelEcuPeerCert_ext_specialEcu_006/KEYM_E_KEY_CERT_EMPTY]  # This operation returns the amount of items available for a certificate element.
        arg count: type=uint16, direction=OUT  # Number of items available for an element.
      5 x error:
        E_NOT_OK: error-code=1  # The service request failed.
        KEYM_E_KEY_CERT_SIZE_MISMATCH: error-code=4  # The service request failed. Parameter size does not match the expected value.
        KEYM_E_PARAMETER_MISMATCH: error-code=5  # The service request failed. Parameter to function does not provide the expected value.
        KEYM_E_KEY_CERT_EMPTY: error-code=10  # The service request failed. The requested key or certificate is not available, slot is empty.
        KEYM_E_KEY_CERT_INVALID: error-code=6  # The service request failed. Key or certificate is invalid and cannot be used for the operation.
