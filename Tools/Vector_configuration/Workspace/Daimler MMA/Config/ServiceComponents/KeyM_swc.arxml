[part 1 of 6: packages /MICROSAR/KeyM_swc/DataTypes to /MICROSAR/KeyM_swc/Interfaces]
AUTOSAR XML (schema 00049)
package /MICROSAR/KeyM_swc/DataTypes
  163 x impl type:
    KeyM_CertElementIdType: implementation-data-type=uint16  # Certificate Element handle
    KeyM_CertificateIdType: implementation-data-type=uint16  # Certificate handle
    KeyM_const_CryptoKeyDataType: category=DATA_REFERENCE, sw-pointer-target-props={target-category=TYPE_REFERENCE, implementation-data-type=uint8, sw-impl-policy=CONST}  # Byte-pointer to the input or output data.
    KeyM_CryptoKeyDataType: category=DATA_REFERENCE, sw-pointer-target-props={target-category=TYPE_REFERENCE, implementation-data-type=uint8}  # Byte-pointer to the input or output data.
    KeyM_ConstDataPtrType: category=DATA_REFERENCE, sw-pointer-target-props={target-category=TYPE_REFERENCE, implementation-data-type=uint8, sw-impl-policy=CONST}  # Byte-pointer to the input or output data.
    KeyM_DataPtrType: category=DATA_REFERENCE, sw-pointer-target-props={target-category=TYPE_REFERENCE, implementation-data-type=uint8}  # Byte-pointer to the input or output data.
    KeyM_LengthPtrType: category=DATA_REFERENCE, sw-pointer-target-props={target-category=TYPE_REFERENCE, implementation-data-type=uint32}  # Byte-pointer to the input or output data.
    KeyM_CsrEncodingType: compu {0=KEYM_CSR_ENCODING_NONE, 1=KEYM_CSR_ENCODING_DER}, range raw 0..1, implementation-data-type=uint8  # KeyM CSR element encoding type.
    KeyM_ServiceCertificateType: compu {1=KEYM_SERVICE_CERT_REQUEST_CSR, 2=KEYM_SERVICE_CERT_UPDATE_SIGNED_CSR, 3=KEYM_SERVICE_CERT_SET_ROOT, 4=KEYM_SERVICE_CERT_UPDATE_ROOT, 5=KEYM_SERVICE_CERT_SET_INTERMEDIATE, 6=KEYM_SERVICE_CERT_UPDATE_INTERMEDIATE, 7=KEYM_SERVICE_CERT_UPDATE_CRL}, range raw 1..7, implementation-data-type=uint8  # KeyM module service type.
    KeyM_CertificateStatusType:  # KeyM module specific return values for certificate status.
      compu {0=KEYM_CERTIFICATE_VALID, 1=KEYM_CERTIFICATE_INVALID, 2=KEYM_CERTIFICATE_NOT_PARSED, 3=KEYM_CERTIFICATE_PARSED_NOT_VALIDATED, 4=KEYM_CERTIFICATE_NOT_AVAILABLE, 5=KEYM_E_CERTIFICATE_VALIDITY_PERIOD_FAIL, 6=KEYM_E_CERTIFICATE_SIGNATURE_FAIL, 7=KEYM_E_CERTIFICATE_INVALID_CHAIN_OF_TRUST, 8=KEYM_E_CERTIFICATE_INVALID_TYPE, 9=KEYM_E_CERTIFICATE_INVALID_FORMAT, 10=KEYM_E_CERTIFICATE_INVALID_CONTENT, 11=KEYM_E_CERTIFICATE_REVOKED}
      range raw 0..11
      implementation-data-type=uint8
    KeyM_ResultType: compu {0=KEYM_RT_OK, 1=KEYM_RT_NOT_OK, 2=KEYM_RT_KEY_CERT_INVALID, 3=KEYM_RT_KEY_CERT_WRITE_FAIL, 4=KEYM_RT_KEY_CERT_UPDATE_FAIL, 5=KEYM_RT_CERT_INVALID_CHAIN_OF_TRUST}, range raw 0..5, implementation-data-type=uint8  # KeyM module specific return values for certificate status.
    KeyM_CertificateDataType_Ssa_TrustModelEcuCert: category=ARRAY, sw-calibration-access=READ-ONLY  # Array long enough to store data
      element KeyM_CertificateDataType_Ssa_TrustModelEcuCertElement: array-size=1000, array-size-semantics=VARIABLE-SIZE, implementation-data-type=uint8
    KeyM_CertificateType_Ssa_TrustModelEcuCert: category=STRUCTURE  # This structure is used to exchange certificate data through interface functions.
      element certDataLength: implementation-data-type=uint32
      element certData: implementation-data-type=KeyM_CertificateDataType_Ssa_TrustModelEcuCert
    KeyM_CertificateElementType_Ssa_TrustModelEcuCert_ext_subKeyId_005: category=ARRAY, sw-calibration-access=READ-ONLY  # Used as Buffer for service.
      element KeyM_CertificateElementType_Ssa_TrustModelEcuCert_ext_subKeyId_005Element: array-size=20, array-size-semantics=FIXED-SIZE, implementation-data-type=uint8
    KeyM_CertificateElementType_Ssa_TrustModelEcuCert_ext_keyUsage_005: category=ARRAY, sw-calibration-access=READ-ONLY  # Used as Buffer for service.
      element KeyM_CertificateElementType_Ssa_TrustModelEcuCert_ext_keyUsage_005Element: array-size=1, array-size-semantics=FIXED-SIZE, implementation-data-type=uint8
    KeyM_CertificateElementType_Ssa_TrustModelEcuCert_Version_005: category=ARRAY, sw-calibration-access=READ-ONLY  # Used as Buffer for service.
      element KeyM_CertificateElementType_Ssa_TrustModelEcuCert_Version_005Element: array-size=1, array-size-semantics=FIXED-SIZE, implementation-data-type=uint8
    KeyM_CertificateElementType_Ssa_TrustModelEcuCert_SerialNo_005: category=ARRAY, sw-calibration-access=READ-ONLY  # Used as Buffer for service.
      element KeyM_CertificateElementType_Ssa_TrustModelEcuCert_SerialNo_005Element: array-size=16, array-size-semantics=FIXED-SIZE, implementation-data-type=uint8
    KeyM_CertificateElementType_Ssa_TrustModelEcuCert_SubjectPublicKeyInfoKey_005: category=ARRAY, sw-calibration-access=READ-ONLY  # Used as Buffer for service.
      element KeyM_CertificateElementType_Ssa_TrustModelEcuCert_SubjectPublicKeyInfoKey_005Element: array-size=33, array-size-semantics=FIXED-SIZE, implementation-data-type=uint8
    KeyM_CertificateElementType_Ssa_TrustModelEcuCert_signatureValue_005: category=ARRAY, sw-calibration-access=READ-ONLY  # Used as Buffer for service.
      element KeyM_CertificateElementType_Ssa_TrustModelEcuCert_signatureValue_005Element: array-size=65, array-size-semantics=FIXED-SIZE, implementation-data-type=uint8
    KeyM_CertificateElementType_Ssa_TrustModelEcuCert_ext_specialEcu_005: category=ARRAY, sw-calibration-access=READ-ONLY  # Used as Buffer for service.
      element KeyM_CertificateElementType_Ssa_TrustModelEcuCert_ext_specialEcu_005Element: array-size=1, array-size-semantics=FIXED-SIZE, implementation-data-type=uint8
    KeyM_CertificateDataType_Ssa_TrustModelIntermediateCert: category=ARRAY, sw-calibration-access=READ-ONLY  # Array long enough to store data
      element KeyM_CertificateDataType_Ssa_TrustModelIntermediateCertElement: array-size=1000, array-size-semantics=VARIABLE-SIZE, implementation-data-type=uint8
    KeyM_CertificateType_Ssa_TrustModelIntermediateCert: category=STRUCTURE  # This structure is used to exchange certificate data through interface functions.
      element certDataLength: implementation-data-type=uint32
      element certData: implementation-data-type=KeyM_CertificateDataType_Ssa_TrustModelIntermediateCert
    KeyM_CertificateElementType_Ssa_TrustModelIntermediateCert_ext_subKeyId_003: category=ARRAY, sw-calibration-access=READ-ONLY  # Used as Buffer for service.
      element KeyM_CertificateElementType_Ssa_TrustModelIntermediateCert_ext_subKeyId_003Element: array-size=20, array-size-semantics=FIXED-SIZE, implementation-data-type=uint8
    KeyM_CertificateElementType_Ssa_TrustModelIntermediateCert_ext_basicConstraints_003: category=ARRAY, sw-calibration-access=READ-ONLY  # Used as Buffer for service.
      element KeyM_CertificateElementType_Ssa_TrustModelIntermediateCert_ext_basicConstraints_003Element: array-size=1, array-size-semantics=FIXED-SIZE, implementation-data-type=uint8
    KeyM_CertificateElementType_Ssa_TrustModelIntermediateCert_ext_keyUsage_003: category=ARRAY, sw-calibration-access=READ-ONLY  # Used as Buffer for service.
      element KeyM_CertificateElementType_Ssa_TrustModelIntermediateCert_ext_keyUsage_003Element: array-size=1, array-size-semantics=FIXED-SIZE, implementation-data-type=uint8
    KeyM_CertificateElementType_Ssa_TrustModelIntermediateCert_ext_pkiRole_003: category=ARRAY, sw-calibration-access=READ-ONLY  # Used as Buffer for service.
      element KeyM_CertificateElementType_Ssa_TrustModelIntermediateCert_ext_pkiRole_003Element: array-size=1, array-size-semantics=FIXED-SIZE, implementation-data-type=uint8
    KeyM_CertificateElementType_Ssa_TrustModelIntermediateCert_Version_003: category=ARRAY, sw-calibration-access=READ-ONLY  # Used as Buffer for service.
      element KeyM_CertificateElementType_Ssa_TrustModelIntermediateCert_Version_003Element: array-size=1, array-size-semantics=FIXED-SIZE, implementation-data-type=uint8
    KeyM_CertificateElementType_Ssa_TrustModelIntermediateCert_SerialNo_003: category=ARRAY, sw-calibration-access=READ-ONLY  # Used as Buffer for service.
      element KeyM_CertificateElementType_Ssa_TrustModelIntermediateCert_SerialNo_003Element: array-size=16, array-size-semantics=FIXED-SIZE, implementation-data-type=uint8
    KeyM_CertificateElementType_Ssa_TrustModelIntermediateCert_SubjectPublicKeyInfoKey_003: category=ARRAY, sw-calibration-access=READ-ONLY  # Used as Buffer for service.
      element KeyM_CertificateElementType_Ssa_TrustModelIntermediateCert_SubjectPublicKeyInfoKey_003Element: array-size=33, array-size-semantics=FIXED-SIZE, implementation-data-type=uint8
    KeyM_CertificateElementType_Ssa_TrustModelIntermediateCert_signatureValue_003: category=ARRAY, sw-calibration-access=READ-ONLY  # Used as Buffer for service.
      element KeyM_CertificateElementType_Ssa_TrustModelIntermediateCert_signatureValue_003Element: array-size=65, array-size-semantics=FIXED-SIZE, implementation-data-type=uint8
    KeyM_CertificateDataType_Ssa_TrustModelBackendCert: category=ARRAY, sw-calibration-access=READ-ONLY  # Array long enough to store data
      element KeyM_CertificateDataType_Ssa_TrustModelBackendCertElement: array-size=1000, array-size-semantics=VARIABLE-SIZE, implementation-data-type=uint8
    KeyM_CertificateType_Ssa_TrustModelBackendCert: category=STRUCTURE  # This structure is used to exchange certificate data through interface functions.
      element certDataLength: implementation-data-type=uint32
      element certData: implementation-data-type=KeyM_CertificateDataType_Ssa_TrustModelBackendCert
    KeyM_CertificateElementType_Ssa_TrustModelBackendCert_ext_subKeyId_002: category=ARRAY, sw-calibration-access=READ-ONLY  # Used as Buffer for service.
      element KeyM_CertificateElementType_Ssa_TrustModelBackendCert_ext_subKeyId_002Element: array-size=20, array-size-semantics=FIXED-SIZE, implementation-data-type=uint8
    KeyM_CertificateElementType_Ssa_TrustModelBackendCert_ext_basicConstraints_002: category=ARRAY, sw-calibration-access=READ-ONLY  # Used as Buffer for service.
      element KeyM_CertificateElementType_Ssa_TrustModelBackendCert_ext_basicConstraints_002Element: array-size=1, array-size-semantics=FIXED-SIZE, implementation-data-type=uint8
    KeyM_CertificateElementType_Ssa_TrustModelBackendCert_ext_keyUsage_002: category=ARRAY, sw-calibration-access=READ-ONLY  # Used as Buffer for service.
      element KeyM_CertificateElementType_Ssa_TrustModelBackendCert_ext_keyUsage_002Element: array-size=1, array-size-semantics=FIXED-SIZE, implementation-data-type=uint8
    KeyM_CertificateElementType_Ssa_TrustModelBackendCert_ext_pkiRole_002: category=ARRAY, sw-calibration-access=READ-ONLY  # Used as Buffer for service.
      element KeyM_CertificateElementType_Ssa_TrustModelBackendCert_ext_pkiRole_002Element: array-size=1, array-size-semantics=FIXED-SIZE, implementation-data-type=uint8
    KeyM_CertificateElementType_Ssa_TrustModelBackendCert_Version_002: category=ARRAY, sw-calibration-access=READ-ONLY  # Used as Buffer for service.
      element KeyM_CertificateElementType_Ssa_TrustModelBackendCert_Version_002Element: array-size=1, array-size-semantics=FIXED-SIZE, implementation-data-type=uint8
    KeyM_CertificateElementType_Ssa_TrustModelBackendCert_SerialNo_002: category=ARRAY, sw-calibration-access=READ-ONLY  # Used as Buffer for service.
      element KeyM_CertificateElementType_Ssa_TrustModelBackendCert_SerialNo_002Element: array-size=16, array-size-semantics=FIXED-SIZE, implementation-data-type=uint8
    KeyM_CertificateElementType_Ssa_TrustModelBackendCert_SubjectPublicKeyInfoKey_002: category=ARRAY, sw-calibration-access=READ-ONLY  # Used as Buffer for service.
      element KeyM_CertificateElementType_Ssa_TrustModelBackendCert_SubjectPublicKeyInfoKey_002Element: array-size=33, array-size-semantics=FIXED-SIZE, implementation-data-type=uint8
    KeyM_CertificateElementType_Ssa_TrustModelBackendCert_signatureValue_002: category=ARRAY, sw-calibration-access=READ-ONLY  # Used as Buffer for service.
      element KeyM_CertificateElementType_Ssa_TrustModelBackendCert_signatureValue_002Element: array-size=65, array-size-semantics=FIXED-SIZE, implementation-data-type=uint8
    KeyM_CertificateDataType_Ssa_TrustModelEcuPeerCert: category=ARRAY, sw-calibration-access=READ-ONLY  # Array long enough to store data
      element KeyM_CertificateDataType_Ssa_TrustModelEcuPeerCertElement: array-size=1000, array-size-semantics=VARIABLE-SIZE, implementation-data-type=uint8
    KeyM_CertificateType_Ssa_TrustModelEcuPeerCert: category=STRUCTURE  # This structure is used to exchange certificate data through interface functions.
      element certDataLength: implementation-data-type=uint32
      element certData: implementation-data-type=KeyM_CertificateDataType_Ssa_TrustModelEcuPeerCert
    KeyM_CertificateElementType_Ssa_TrustModelEcuPeerCert_ext_subKeyId_006: category=ARRAY, sw-calibration-access=READ-ONLY  # Used as Buffer for service.
      element KeyM_CertificateElementType_Ssa_TrustModelEcuPeerCert_ext_subKeyId_006Element: array-size=20, array-size-semantics=FIXED-SIZE, implementation-data-type=uint8
    KeyM_CertificateElementType_Ssa_TrustModelEcuPeerCert_ext_keyUsage_006: category=ARRAY, sw-calibration-access=READ-ONLY  # Used as Buffer for service.
      element KeyM_CertificateElementType_Ssa_TrustModelEcuPeerCert_ext_keyUsage_006Element: array-size=1, array-size-semantics=FIXED-SIZE, implementation-data-type=uint8
    KeyM_CertificateElementType_Ssa_TrustModelEcuPeerCert_Version_006: category=ARRAY, sw-calibration-access=READ-ONLY  # Used as Buffer for service.
      element KeyM_CertificateElementType_Ssa_TrustModelEcuPeerCert_Version_006Element: array-size=1, array-size-semantics=FIXED-SIZE, implementation-data-type=uint8
    KeyM_CertificateElementType_Ssa_TrustModelEcuPeerCert_SerialNo_006: category=ARRAY, sw-calibration-access=READ-ONLY  # Used as Buffer for service.
      element KeyM_CertificateElementType_Ssa_TrustModelEcuPeerCert_SerialNo_006Element: array-size=16, array-size-semantics=FIXED-SIZE, implementation-data-type=uint8
    KeyM_CertificateElementType_Ssa_TrustModelEcuPeerCert_SubjectPublicKeyInfoKey_006: category=ARRAY, sw-calibration-access=READ-ONLY  # Used as Buffer for service.
      element KeyM_CertificateElementType_Ssa_TrustModelEcuPeerCert_SubjectPublicKeyInfoKey_006Element: array-size=33, array-size-semantics=FIXED-SIZE, implementation-data-type=uint8
    KeyM_CertificateElementType_Ssa_TrustModelEcuPeerCert_signatureValue_006: category=ARRAY, sw-calibration-access=READ-ONLY  # Used as Buffer for service.
      element KeyM_CertificateElementType_Ssa_TrustModelEcuPeerCert_signatureValue_006Element: array-size=65, array-size-semantics=FIXED-SIZE, implementation-data-type=uint8
    KeyM_CertificateElementType_Ssa_TrustModelEcuPeerCert_ext_specialEcu_006: category=ARRAY, sw-calibration-access=READ-ONLY  # Used as Buffer for service.
      element KeyM_CertificateElementType_Ssa_TrustModelEcuPeerCert_ext_specialEcu_006Element: array-size=1, array-size-semantics=FIXED-SIZE, implementation-data-type=uint8
    KeyM_CertificateDataType_Ssa_TrustModelBackendPeerCert: category=ARRAY, sw-calibration-access=READ-ONLY  # Array long enough to store data
      element KeyM_CertificateDataType_Ssa_TrustModelBackendPeerCertElement: array-size=1000, array-size-semantics=VARIABLE-SIZE, implementation-data-type=uint8
    KeyM_CertificateType_Ssa_TrustModelBackendPeerCert: category=STRUCTURE  # This structure is used to exchange certificate data through interface functions.
      element certDataLength: implementation-data-type=uint32
      element certData: implementation-data-type=KeyM_CertificateDataType_Ssa_TrustModelBackendPeerCert
    KeyM_CertificateElementType_Ssa_TrustModelBackendPeerCert_ext_subKeyId_004: category=ARRAY, sw-calibration-access=READ-ONLY  # Used as Buffer for service.
      element KeyM_CertificateElementType_Ssa_TrustModelBackendPeerCert_ext_subKeyId_004Element: array-size=20, array-size-semantics=FIXED-SIZE, implementation-data-type=uint8
    KeyM_CertificateElementType_Ssa_TrustModelBackendPeerCert_ext_basicConstraints_004: category=ARRAY, sw-calibration-access=READ-ONLY  # Used as Buffer for service.
      element KeyM_CertificateElementType_Ssa_TrustModelBackendPeerCert_ext_basicConstraints_004Element: array-size=1, array-size-semantics=FIXED-SIZE, implementation-data-type=uint8
    KeyM_CertificateElementType_Ssa_TrustModelBackendPeerCert_ext_keyUsage_004: category=ARRAY, sw-calibration-access=READ-ONLY  # Used as Buffer for service.
      element KeyM_CertificateElementType_Ssa_TrustModelBackendPeerCert_ext_keyUsage_004Element: array-size=1, array-size-semantics=FIXED-SIZE, implementation-data-type=uint8
    KeyM_CertificateElementType_Ssa_TrustModelBackendPeerCert_ext_pkiRole_004: category=ARRAY, sw-calibration-access=READ-ONLY  # Used as Buffer for service.
      element KeyM_CertificateElementType_Ssa_TrustModelBackendPeerCert_ext_pkiRole_004Element: array-size=1, array-size-semantics=FIXED-SIZE, implementation-data-type=uint8
    KeyM_CertificateElementType_Ssa_TrustModelBackendPeerCert_Version_004: category=ARRAY, sw-calibration-access=READ-ONLY  # Used as Buffer for service.
      element KeyM_CertificateElementType_Ssa_TrustModelBackendPeerCert_Version_004Element: array-size=1, array-size-semantics=FIXED-SIZE, implementation-data-type=uint8
    KeyM_CertificateElementType_Ssa_TrustModelBackendPeerCert_SerialNo_004: category=ARRAY, sw-calibration-access=READ-ONLY  # Used as Buffer for service.
      element KeyM_CertificateElementType_Ssa_TrustModelBackendPeerCert_SerialNo_004Element: array-size=16, array-size-semantics=FIXED-SIZE, implementation-data-type=uint8
    KeyM_CertificateElementType_Ssa_TrustModelBackendPeerCert_SubjectPublicKeyInfoKey_004: category=ARRAY, sw-calibration-access=READ-ONLY  # Used as Buffer for service.
      element KeyM_CertificateElementType_Ssa_TrustModelBackendPeerCert_SubjectPublicKeyInfoKey_004Element: array-size=33, array-size-semantics=FIXED-SIZE, implementation-data-type=uint8
    KeyM_CertificateElementType_Ssa_TrustModelBackendPeerCert_Issuer_004: category=ARRAY, sw-calibration-access=READ-ONLY  # Used as Buffer for service.
      element KeyM_CertificateElementType_Ssa_TrustModelBackendPeerCert_Issuer_004Element: array-size=10, array-size-semantics=FIXED-SIZE, implementation-data-type=uint8
    KeyM_CertificateElementType_Ssa_TrustModelBackendPeerCert_signatureValue_004: category=ARRAY, sw-calibration-access=READ-ONLY  # Used as Buffer for service.
      element KeyM_CertificateElementType_Ssa_TrustModelBackendPeerCert_signatureValue_004Element: array-size=65, array-size-semantics=FIXED-SIZE, implementation-data-type=uint8
    KeyM_CertificateDataType_Ssa_TrustModelIntermediatePeerCert: category=ARRAY, sw-calibration-access=READ-ONLY  # Array long enough to store data
      element KeyM_CertificateDataType_Ssa_TrustModelIntermediatePeerCertElement: array-size=1000, array-size-semantics=VARIABLE-SIZE, implementation-data-type=uint8
    KeyM_CertificateType_Ssa_TrustModelIntermediatePeerCert: category=STRUCTURE  # This structure is used to exchange certificate data through interface functions.
      element certDataLength: implementation-data-type=uint32
      element certData: implementation-data-type=KeyM_CertificateDataType_Ssa_TrustModelIntermediatePeerCert
    KeyM_CertificateElementType_Ssa_TrustModelIntermediatePeerCert_ext_subKeyId_007: category=ARRAY, sw-calibration-access=READ-ONLY  # Used as Buffer for service.
      element KeyM_CertificateElementType_Ssa_TrustModelIntermediatePeerCert_ext_subKeyId_007Element: array-size=20, array-size-semantics=FIXED-SIZE, implementation-data-type=uint8
    KeyM_CertificateElementType_Ssa_TrustModelIntermediatePeerCert_ext_basicConstraints_005: category=ARRAY, sw-calibration-access=READ-ONLY  # Used as Buffer for service.
      element KeyM_CertificateElementType_Ssa_TrustModelIntermediatePeerCert_ext_basicConstraints_005Element: array-size=1, array-size-semantics=FIXED-SIZE, implementation-data-type=uint8
    KeyM_CertificateElementType_Ssa_TrustModelIntermediatePeerCert_ext_keyUsage_007: category=ARRAY, sw-calibration-access=READ-ONLY  # Used as Buffer for service.
      element KeyM_CertificateElementType_Ssa_TrustModelIntermediatePeerCert_ext_keyUsage_007Element: array-size=1, array-size-semantics=FIXED-SIZE, implementation-data-type=uint8
    KeyM_CertificateElementType_Ssa_TrustModelIntermediatePeerCert_Version_007: category=ARRAY, sw-calibration-access=READ-ONLY  # Used as Buffer for service.
      element KeyM_CertificateElementType_Ssa_TrustModelIntermediatePeerCert_Version_007Element: array-size=1, array-size-semantics=FIXED-SIZE, implementation-data-type=uint8
    KeyM_CertificateElementType_Ssa_TrustModelIntermediatePeerCert_SerialNo_007: category=ARRAY, sw-calibration-access=READ-ONLY  # Used as Buffer for service.
      element KeyM_CertificateElementType_Ssa_TrustModelIntermediatePeerCert_SerialNo_007Element: array-size=16, array-size-semantics=FIXED-SIZE, implementation-data-type=uint8
    KeyM_CertificateElementType_Ssa_TrustModelIntermediatePeerCert_SubjectPublicKeyInfoKey_007: category=ARRAY, sw-calibration-access=READ-ONLY  # Used as Buffer for service.
      element KeyM_CertificateElementType_Ssa_TrustModelIntermediatePeerCert_SubjectPublicKeyInfoKey_007Element: array-size=33, array-size-semantics=FIXED-SIZE, implementation-data-type=uint8
    KeyM_CertificateElementType_Ssa_TrustModelIntermediatePeerCert_signatureValue_007: category=ARRAY, sw-calibration-access=READ-ONLY  # Used as Buffer for service.
      element KeyM_CertificateElementType_Ssa_TrustModelIntermediatePeerCert_signatureValue_007Element: array-size=65, array-size-semantics=FIXED-SIZE, implementation-data-type=uint8
    KeyM_CertificateDataType_Ssa_TrustModelEcuCsr: category=ARRAY, sw-calibration-access=READ-ONLY  # Array long enough to store data
      element KeyM_CertificateDataType_Ssa_TrustModelEcuCsrElement: array-size=1000, array-size-semantics=VARIABLE-SIZE, implementation-data-type=uint8
    KeyM_CertificateType_Ssa_TrustModelEcuCsr: category=STRUCTURE  # This structure is used to exchange certificate data through interface functions.
      element certDataLength: implementation-data-type=uint32
      element certData: implementation-data-type=KeyM_CertificateDataType_Ssa_TrustModelEcuCsr
    KeyM_CertificateElementType_Ssa_TrustModelEcuCsr_ext_authKeyId_008: category=ARRAY, sw-calibration-access=READ-ONLY  # Used as Buffer for service.
      element KeyM_CertificateElementType_Ssa_TrustModelEcuCsr_ext_authKeyId_008Element: array-size=1, array-size-semantics=FIXED-SIZE, implementation-data-type=uint8
    KeyM_CertificateElementType_Ssa_TrustModelEcuCsr_ext_subKeyId_008: category=ARRAY, sw-calibration-access=READ-ONLY  # Used as Buffer for service.
      element KeyM_CertificateElementType_Ssa_TrustModelEcuCsr_ext_subKeyId_008Element: array-size=20, array-size-semantics=FIXED-SIZE, implementation-data-type=uint8
    KeyM_CertificateElementType_Ssa_TrustModelEcuCsr_ext_keyUsage_008: category=ARRAY, sw-calibration-access=READ-ONLY  # Used as Buffer for service.
      element KeyM_CertificateElementType_Ssa_TrustModelEcuCsr_ext_keyUsage_008Element: array-size=1, array-size-semantics=FIXED-SIZE, implementation-data-type=uint8
    KeyM_CertificateElementType_Ssa_TrustModelEcuCsr_ext_pkiRole_008: category=ARRAY, sw-calibration-access=READ-ONLY  # Used as Buffer for service.
      element KeyM_CertificateElementType_Ssa_TrustModelEcuCsr_ext_pkiRole_008Element: array-size=1, array-size-semantics=FIXED-SIZE, implementation-data-type=uint8
    KeyM_CertificateElementType_Ssa_TrustModelEcuCsr_Version_008: category=ARRAY, sw-calibration-access=READ-ONLY  # Used as Buffer for service.
      element KeyM_CertificateElementType_Ssa_TrustModelEcuCsr_Version_008Element: array-size=1, array-size-semantics=FIXED-SIZE, implementation-data-type=uint8
    KeyM_CertificateElementType_Ssa_TrustModelEcuCsr_SerialNo_008: category=ARRAY, sw-calibration-access=READ-ONLY  # Used as Buffer for service.
      element KeyM_CertificateElementType_Ssa_TrustModelEcuCsr_SerialNo_008Element: array-size=16, array-size-semantics=FIXED-SIZE, implementation-data-type=uint8
    KeyM_CertificateElementType_Ssa_TrustModelEcuCsr_SigAlgoId_008: category=ARRAY, sw-calibration-access=READ-ONLY  # Used as Buffer for service.
      element KeyM_CertificateElementType_Ssa_TrustModelEcuCsr_SigAlgoId_008Element: array-size=1, array-size-semantics=FIXED-SIZE, implementation-data-type=uint8
    KeyM_CertificateElementType_Ssa_TrustModelEcuCsr_validityNotBefore_008: category=ARRAY, sw-calibration-access=READ-ONLY  # Used as Buffer for service.
      element KeyM_CertificateElementType_Ssa_TrustModelEcuCsr_validityNotBefore_008Element: array-size=1, array-size-semantics=FIXED-SIZE, implementation-data-type=uint8
    KeyM_CertificateElementType_Ssa_TrustModelEcuCsr_validityNotAfter_008: category=ARRAY, sw-calibration-access=READ-ONLY  # Used as Buffer for service.
      element KeyM_CertificateElementType_Ssa_TrustModelEcuCsr_validityNotAfter_008Element: array-size=1, array-size-semantics=FIXED-SIZE, implementation-data-type=uint8
    KeyM_CertificateElementType_Ssa_TrustModelEcuCsr_subject_008: category=ARRAY, sw-calibration-access=READ-ONLY  # Used as Buffer for service.
      element KeyM_CertificateElementType_Ssa_TrustModelEcuCsr_subject_008Element: array-size=10, array-size-semantics=FIXED-SIZE, implementation-data-type=uint8
    KeyM_CertificateElementType_Ssa_TrustModelEcuCsr_SubjectPublicKeyInfoAlgo_008: category=ARRAY, sw-calibration-access=READ-ONLY  # Used as Buffer for service.
      element KeyM_CertificateElementType_Ssa_TrustModelEcuCsr_SubjectPublicKeyInfoAlgo_008Element: array-size=1, array-size-semantics=FIXED-SIZE, implementation-data-type=uint8
    KeyM_CertificateElementType_Ssa_TrustModelEcuCsr_SubjectPublicKeyInfoKey_008: category=ARRAY, sw-calibration-access=READ-ONLY  # Used as Buffer for service.
      element KeyM_CertificateElementType_Ssa_TrustModelEcuCsr_SubjectPublicKeyInfoKey_008Element: array-size=33, array-size-semantics=FIXED-SIZE, implementation-data-type=uint8
    KeyM_CertificateElementType_Ssa_TrustModelEcuCsr_Issuer_008: category=ARRAY, sw-calibration-access=READ-ONLY  # Used as Buffer for service.
      element KeyM_CertificateElementType_Ssa_TrustModelEcuCsr_Issuer_008Element: array-size=10, array-size-semantics=FIXED-SIZE, implementation-data-type=uint8
    KeyM_CertificateElementType_Ssa_TrustModelEcuCsr_signatureAlgorithm_008: category=ARRAY, sw-calibration-access=READ-ONLY  # Used as Buffer for service.
      element KeyM_CertificateElementType_Ssa_TrustModelEcuCsr_signatureAlgorithm_008Element: array-size=1, array-size-semantics=FIXED-SIZE, implementation-data-type=uint8
    KeyM_CertificateElementType_Ssa_TrustModelEcuCsr_signatureValue_008: category=ARRAY, sw-calibration-access=READ-ONLY  # Used as Buffer for service.
      element KeyM_CertificateElementType_Ssa_TrustModelEcuCsr_signatureValue_008Element: array-size=65, array-size-semantics=FIXED-SIZE, implementation-data-type=uint8
    KeyM_CertificateElementType_Ssa_TrustModelEcuCsr_ext_uniqueECUID_007: category=ARRAY, sw-calibration-access=READ-ONLY  # Used as Buffer for service.
      element KeyM_CertificateElementType_Ssa_TrustModelEcuCsr_ext_uniqueECUID_007Element: array-size=1, array-size-semantics=FIXED-SIZE, implementation-data-type=uint8
    KeyM_CertificateElementType_Ssa_TrustModelEcuCsr_ext_specialEcu_007: category=ARRAY, sw-calibration-access=READ-ONLY  # Used as Buffer for service.
      element KeyM_CertificateElementType_Ssa_TrustModelEcuCsr_ext_specialEcu_007Element: array-size=1, array-size-semantics=FIXED-SIZE, implementation-data-type=uint8
    KeyM_CertificateElementType_Ssa_TrustModelEcuCsr_ext_extKeyUsage_007: category=ARRAY, sw-calibration-access=READ-ONLY  # Used as Buffer for service.
      element KeyM_CertificateElementType_Ssa_TrustModelEcuCsr_ext_extKeyUsage_007Element: array-size=1, array-size-semantics=FIXED-SIZE, implementation-data-type=uint8
    KeyM_CertificateElementType_Ssa_TrustModelEcuCsr_ext_extKeyUsage_oid1_007: category=ARRAY, sw-calibration-access=READ-ONLY  # Used as Buffer for service.
      element KeyM_CertificateElementType_Ssa_TrustModelEcuCsr_ext_extKeyUsage_oid1_007Element: array-size=1, array-size-semantics=FIXED-SIZE, implementation-data-type=uint8
    KeyM_CertificateElementType_Ssa_TrustModelEcuCsr_ext_extKeyUsage_oid2_007: category=ARRAY, sw-calibration-access=READ-ONLY  # Used as Buffer for service.
      element KeyM_CertificateElementType_Ssa_TrustModelEcuCsr_ext_extKeyUsage_oid2_007Element: array-size=1, array-size-semantics=FIXED-SIZE, implementation-data-type=uint8
    KeyM_CertificateElementType_Ssa_TrustModelEcuCsr_ext_extKeyUsage_oid3_007: category=ARRAY, sw-calibration-access=READ-ONLY  # Used as Buffer for service.
      element KeyM_CertificateElementType_Ssa_TrustModelEcuCsr_ext_extKeyUsage_oid3_007Element: array-size=1, array-size-semantics=FIXED-SIZE, implementation-data-type=uint8
    KeyM_CertificateDataType_Ssa_TrustModelRootCert: category=ARRAY, sw-calibration-access=READ-ONLY  # Array long enough to store data
      element KeyM_CertificateDataType_Ssa_TrustModelRootCertElement: array-size=1000, array-size-semantics=VARIABLE-SIZE, implementation-data-type=uint8
    KeyM_CertificateType_Ssa_TrustModelRootCert: category=STRUCTURE  # This structure is used to exchange certificate data through interface functions.
      element certDataLength: implementation-data-type=uint32
      element certData: implementation-data-type=KeyM_CertificateDataType_Ssa_TrustModelRootCert
    KeyM_CertificateElementType_Ssa_TrustModelRootCert_Version: category=ARRAY, sw-calibration-access=READ-ONLY  # Used as Buffer for service.
      element KeyM_CertificateElementType_Ssa_TrustModelRootCert_VersionElement: array-size=1, array-size-semantics=FIXED-SIZE, implementation-data-type=uint8
    KeyM_CertificateElementType_Ssa_TrustModelRootCert_SerialNo: category=ARRAY, sw-calibration-access=READ-ONLY  # Used as Buffer for service.
      element KeyM_CertificateElementType_Ssa_TrustModelRootCert_SerialNoElement: array-size=16, array-size-semantics=FIXED-SIZE, implementation-data-type=uint8
    KeyM_CertificateElementType_Ssa_TrustModelRootCert_SubjectPublicKeyInfoKey: category=ARRAY, sw-calibration-access=READ-ONLY  # Used as Buffer for service.
      element KeyM_CertificateElementType_Ssa_TrustModelRootCert_SubjectPublicKeyInfoKeyElement: array-size=33, array-size-semantics=FIXED-SIZE, implementation-data-type=uint8
    KeyM_CertificateElementType_Ssa_TrustModelRootCert_signatureValue: category=ARRAY, sw-calibration-access=READ-ONLY  # Used as Buffer for service.
      element KeyM_CertificateElementType_Ssa_TrustModelRootCert_signatureValueElement: array-size=65, array-size-semantics=FIXED-SIZE, implementation-data-type=uint8
    KeyM_CertificateElementType_Ssa_TrustModelRootCert_ext_subKeyId: category=ARRAY, sw-calibration-access=READ-ONLY  # Used as Buffer for service.
      element KeyM_CertificateElementType_Ssa_TrustModelRootCert_ext_subKeyIdElement: array-size=20, array-size-semantics=FIXED-SIZE, implementation-data-type=uint8
    KeyM_CertificateElementType_Ssa_TrustModelRootCert_ext_basicConstraints: category=ARRAY, sw-calibration-access=READ-ONLY  # Used as Buffer for service.
      element KeyM_CertificateElementType_Ssa_TrustModelRootCert_ext_basicConstraintsElement: array-size=1, array-size-semantics=FIXED-SIZE, implementation-data-type=uint8
    KeyM_CertificateElementType_Ssa_TrustModelRootCert_ext_pkiRole: category=ARRAY, sw-calibration-access=READ-ONLY  # Used as Buffer for service.
      element KeyM_CertificateElementType_Ssa_TrustModelRootCert_ext_pkiRoleElement: array-size=1, array-size-semantics=FIXED-SIZE, implementation-data-type=uint8
    KeyM_CertificateElementType_Ssa_TrustModelEcuCert_ext_pkiRole_006: category=ARRAY, sw-calibration-access=READ-ONLY  # Used as Buffer for service.
      element KeyM_CertificateElementType_Ssa_TrustModelEcuCert_ext_pkiRole_006Element: array-size=1, array-size-semantics=FIXED-SIZE, implementation-data-type=uint8
    KeyM_CertificateElementType_Ssa_TrustModelIntermediatePeerCert_ext_pkiRole_005: category=ARRAY, sw-calibration-access=READ-ONLY  # Used as Buffer for service.
      element KeyM_CertificateElementType_Ssa_TrustModelIntermediatePeerCert_ext_pkiRole_005Element: array-size=1, array-size-semantics=FIXED-SIZE, implementation-data-type=uint8
    KeyM_CertificateElementType_Ssa_TrustModelBackendCert_validityNotAfter_002: category=ARRAY, sw-calibration-access=READ-ONLY  # Used as Buffer for service.
      element KeyM_CertificateElementType_Ssa_TrustModelBackendCert_validityNotAfter_002Element: array-size=15, array-size-semantics=FIXED-SIZE, implementation-data-type=uint8
    KeyM_CertificateElementType_Ssa_TrustModelBackendCert_ext_authKeyId_002: category=ARRAY, sw-calibration-access=READ-ONLY  # Used as Buffer for service.
      element KeyM_CertificateElementType_Ssa_TrustModelBackendCert_ext_authKeyId_002Element: array-size=20, array-size-semantics=FIXED-SIZE, implementation-data-type=uint8
    KeyM_CertificateElementType_Ssa_TrustModelBackendCert_SigAlgoId_002: category=ARRAY, sw-calibration-access=READ-ONLY  # Used as Buffer for service.
      element KeyM_CertificateElementType_Ssa_TrustModelBackendCert_SigAlgoId_002Element: array-size=3, array-size-semantics=FIXED-SIZE, implementation-data-type=uint8
    KeyM_CertificateElementType_Ssa_TrustModelBackendCert_validityNotBefore_002: category=ARRAY, sw-calibration-access=READ-ONLY  # Used as Buffer for service.
      element KeyM_CertificateElementType_Ssa_TrustModelBackendCert_validityNotBefore_002Element: array-size=13, array-size-semantics=FIXED-SIZE, implementation-data-type=uint8
    KeyM_CertificateElementType_Ssa_TrustModelBackendCert_SubjectPublicKeyInfoAlgo_002: category=ARRAY, sw-calibration-access=READ-ONLY  # Used as Buffer for service.
      element KeyM_CertificateElementType_Ssa_TrustModelBackendCert_SubjectPublicKeyInfoAlgo_002Element: array-size=3, array-size-semantics=FIXED-SIZE, implementation-data-type=uint8
    KeyM_CertificateElementType_Ssa_TrustModelBackendCert_signatureAlgorithm_002: category=ARRAY, sw-calibration-access=READ-ONLY  # Used as Buffer for service.
      element KeyM_CertificateElementType_Ssa_TrustModelBackendCert_signatureAlgorithm_002Element: array-size=3, array-size-semantics=FIXED-SIZE, implementation-data-type=uint8
    KeyM_CertificateElementType_Ssa_TrustModelEcuCert_ext_authKeyId_005: category=ARRAY, sw-calibration-access=READ-ONLY  # Used as Buffer for service.
      element KeyM_CertificateElementType_Ssa_TrustModelEcuCert_ext_authKeyId_005Element: array-size=20, array-size-semantics=FIXED-SIZE, implementation-data-type=uint8
    KeyM_CertificateElementType_Ssa_TrustModelEcuCert_SigAlgoId_005: category=ARRAY, sw-calibration-access=READ-ONLY  # Used as Buffer for service.
      element KeyM_CertificateElementType_Ssa_TrustModelEcuCert_SigAlgoId_005Element: array-size=3, array-size-semantics=FIXED-SIZE, implementation-data-type=uint8
    KeyM_CertificateElementType_Ssa_TrustModelEcuCert_validityNotBefore_005: category=ARRAY, sw-calibration-access=READ-ONLY  # Used as Buffer for service.
      element KeyM_CertificateElementType_Ssa_TrustModelEcuCert_validityNotBefore_005Element: array-size=13, array-size-semantics=FIXED-SIZE, implementation-data-type=uint8
    KeyM_CertificateElementType_Ssa_TrustModelEcuCert_validityNotAfter_005: category=ARRAY, sw-calibration-access=READ-ONLY  # Used as Buffer for service.
      element KeyM_CertificateElementType_Ssa_TrustModelEcuCert_validityNotAfter_005Element: array-size=15, array-size-semantics=FIXED-SIZE, implementation-data-type=uint8
    KeyM_CertificateElementType_Ssa_TrustModelEcuCert_SubjectPublicKeyInfoAlgo_005: category=ARRAY, sw-calibration-access=READ-ONLY  # Used as Buffer for service.
      element KeyM_CertificateElementType_Ssa_TrustModelEcuCert_SubjectPublicKeyInfoAlgo_005Element: array-size=3, array-size-semantics=FIXED-SIZE, implementation-data-type=uint8
    KeyM_CertificateElementType_Ssa_TrustModelEcuCert_signatureAlgorithm_005: category=ARRAY, sw-calibration-access=READ-ONLY  # Used as Buffer for service.
      element KeyM_CertificateElementType_Ssa_TrustModelEcuCert_signatureAlgorithm_005Element: array-size=3, array-size-semantics=FIXED-SIZE, implementation-data-type=uint8
    KeyM_CertificateElementType_Ssa_TrustModelIntermediateCert_ext_authKeyId_003: category=ARRAY, sw-calibration-access=READ-ONLY  # Used as Buffer for service.
      element KeyM_CertificateElementType_Ssa_TrustModelIntermediateCert_ext_authKeyId_003Element: array-size=20, array-size-semantics=FIXED-SIZE, implementation-data-type=uint8
    KeyM_CertificateElementType_Ssa_TrustModelIntermediateCert_SigAlgoId_003: category=ARRAY, sw-calibration-access=READ-ONLY  # Used as Buffer for service.
      element KeyM_CertificateElementType_Ssa_TrustModelIntermediateCert_SigAlgoId_003Element: array-size=3, array-size-semantics=FIXED-SIZE, implementation-data-type=uint8
    KeyM_CertificateElementType_Ssa_TrustModelIntermediateCert_validityNotBefore_003: category=ARRAY, sw-calibration-access=READ-ONLY  # Used as Buffer for service.
      element KeyM_CertificateElementType_Ssa_TrustModelIntermediateCert_validityNotBefore_003Element: array-size=13, array-size-semantics=FIXED-SIZE, implementation-data-type=uint8
    KeyM_CertificateElementType_Ssa_TrustModelIntermediateCert_validityNotAfter_003: category=ARRAY, sw-calibration-access=READ-ONLY  # Used as Buffer for service.
      element KeyM_CertificateElementType_Ssa_TrustModelIntermediateCert_validityNotAfter_003Element: array-size=15, array-size-semantics=FIXED-SIZE, implementation-data-type=uint8
    KeyM_CertificateElementType_Ssa_TrustModelIntermediateCert_SubjectPublicKeyInfoAlgo_003: category=ARRAY, sw-calibration-access=READ-ONLY  # Used as Buffer for service.
      element KeyM_CertificateElementType_Ssa_TrustModelIntermediateCert_SubjectPublicKeyInfoAlgo_003Element: array-size=3, array-size-semantics=FIXED-SIZE, implementation-data-type=uint8
    KeyM_CertificateElementType_Ssa_TrustModelIntermediateCert_Issuer_003: category=ARRAY, sw-calibration-access=READ-ONLY  # Used as Buffer for service.
      element KeyM_CertificateElementType_Ssa_TrustModelIntermediateCert_Issuer_003Element: array-size=15, array-size-semantics=FIXED-SIZE, implementation-data-type=uint8
    KeyM_CertificateElementType_Ssa_TrustModelIntermediateCert_signatureAlgorithm_003: category=ARRAY, sw-calibration-access=READ-ONLY  # Used as Buffer for service.
      element KeyM_CertificateElementType_Ssa_TrustModelIntermediateCert_signatureAlgorithm_003Element: array-size=3, array-size-semantics=FIXED-SIZE, implementation-data-type=uint8
    KeyM_CertificateElementType_Ssa_TrustModelRootCert_ext_authKeyId_009: category=ARRAY, sw-calibration-access=READ-ONLY  # Used as Buffer for service.
      element KeyM_CertificateElementType_Ssa_TrustModelRootCert_ext_authKeyId_009Element: array-size=20, array-size-semantics=FIXED-SIZE, implementation-data-type=uint8
    KeyM_CertificateElementType_Ssa_TrustModelRootCert_SigAlgoId: category=ARRAY, sw-calibration-access=READ-ONLY  # Used as Buffer for service.
      element KeyM_CertificateElementType_Ssa_TrustModelRootCert_SigAlgoIdElement: array-size=3, array-size-semantics=FIXED-SIZE, implementation-data-type=uint8
    KeyM_CertificateElementType_Ssa_TrustModelRootCert_validityNotBefore: category=ARRAY, sw-calibration-access=READ-ONLY  # Used as Buffer for service.
      element KeyM_CertificateElementType_Ssa_TrustModelRootCert_validityNotBeforeElement: array-size=13, array-size-semantics=FIXED-SIZE, implementation-data-type=uint8
    KeyM_CertificateElementType_Ssa_TrustModelRootCert_SubjectPublicKeyInfoAlgo: category=ARRAY, sw-calibration-access=READ-ONLY  # Used as Buffer for service.
      element KeyM_CertificateElementType_Ssa_TrustModelRootCert_SubjectPublicKeyInfoAlgoElement: array-size=3, array-size-semantics=FIXED-SIZE, implementation-data-type=uint8
    KeyM_CertificateElementType_Ssa_TrustModelRootCert_signatureAlgorithm: category=ARRAY, sw-calibration-access=READ-ONLY  # Used as Buffer for service.
      element KeyM_CertificateElementType_Ssa_TrustModelRootCert_signatureAlgorithmElement: array-size=3, array-size-semantics=FIXED-SIZE, implementation-data-type=uint8
    KeyM_CertificateElementType_Ssa_TrustModelEcuPeerCert_ext_authKeyId_006: category=ARRAY, sw-calibration-access=READ-ONLY  # Used as Buffer for service.
      element KeyM_CertificateElementType_Ssa_TrustModelEcuPeerCert_ext_authKeyId_006Element: array-size=20, array-size-semantics=FIXED-SIZE, implementation-data-type=uint8
    KeyM_CertificateElementType_Ssa_TrustModelEcuPeerCert_SigAlgoId_006: category=ARRAY, sw-calibration-access=READ-ONLY  # Used as Buffer for service.
      element KeyM_CertificateElementType_Ssa_TrustModelEcuPeerCert_SigAlgoId_006Element: array-size=3, array-size-semantics=FIXED-SIZE, implementation-data-type=uint8
    KeyM_CertificateElementType_Ssa_TrustModelEcuPeerCert_validityNotBefore_006: category=ARRAY, sw-calibration-access=READ-ONLY  # Used as Buffer for service.
      element KeyM_CertificateElementType_Ssa_TrustModelEcuPeerCert_validityNotBefore_006Element: array-size=13, array-size-semantics=FIXED-SIZE, implementation-data-type=uint8
    KeyM_CertificateElementType_Ssa_TrustModelEcuPeerCert_validityNotAfter_006: category=ARRAY, sw-calibration-access=READ-ONLY  # Used as Buffer for service.
      element KeyM_CertificateElementType_Ssa_TrustModelEcuPeerCert_validityNotAfter_006Element: array-size=15, array-size-semantics=FIXED-SIZE, implementation-data-type=uint8
    KeyM_CertificateElementType_Ssa_TrustModelEcuPeerCert_subject_006: category=ARRAY, sw-calibration-access=READ-ONLY  # Used as Buffer for service.
      element KeyM_CertificateElementType_Ssa_TrustModelEcuPeerCert_subject_006Element: array-size=48, array-size-semantics=FIXED-SIZE, implementation-data-type=uint8
    KeyM_CertificateElementType_Ssa_TrustModelEcuPeerCert_SubjectPublicKeyInfoAlgo_006: category=ARRAY, sw-calibration-access=READ-ONLY  # Used as Buffer for service.
      element KeyM_CertificateElementType_Ssa_TrustModelEcuPeerCert_SubjectPublicKeyInfoAlgo_006Element: array-size=3, array-size-semantics=FIXED-SIZE, implementation-data-type=uint8
    KeyM_CertificateElementType_Ssa_TrustModelEcuPeerCert_Issuer_006: category=ARRAY, sw-calibration-access=READ-ONLY  # Used as Buffer for service.
      element KeyM_CertificateElementType_Ssa_TrustModelEcuPeerCert_Issuer_006Element: array-size=20, array-size-semantics=FIXED-SIZE, implementation-data-type=uint8
    KeyM_CertificateElementType_Ssa_TrustModelEcuPeerCert_signatureAlgorithm_006: category=ARRAY, sw-calibration-access=READ-ONLY  # Used as Buffer for service.
      element KeyM_CertificateElementType_Ssa_TrustModelEcuPeerCert_signatureAlgorithm_006Element: array-size=3, array-size-semantics=FIXED-SIZE, implementation-data-type=uint8
    KeyM_CertificateElementType_Ssa_TrustModelEcuPeerCert_ext_uniqueECUID_006: category=ARRAY, sw-calibration-access=READ-ONLY  # Used as Buffer for service.
      element KeyM_CertificateElementType_Ssa_TrustModelEcuPeerCert_ext_uniqueECUID_006Element: array-size=12, array-size-semantics=FIXED-SIZE, implementation-data-type=uint8
    KeyM_CertificateElementType_Ssa_TrustModelBackendPeerCert_ext_authKeyId_004: category=ARRAY, sw-calibration-access=READ-ONLY  # Used as Buffer for service.
      element KeyM_CertificateElementType_Ssa_TrustModelBackendPeerCert_ext_authKeyId_004Element: array-size=20, array-size-semantics=FIXED-SIZE, implementation-data-type=uint8
    KeyM_CertificateElementType_Ssa_TrustModelBackendPeerCert_SigAlgoId_004: category=ARRAY, sw-calibration-access=READ-ONLY  # Used as Buffer for service.
      element KeyM_CertificateElementType_Ssa_TrustModelBackendPeerCert_SigAlgoId_004Element: array-size=3, array-size-semantics=FIXED-SIZE, implementation-data-type=uint8
    KeyM_CertificateElementType_Ssa_TrustModelBackendPeerCert_validityNotBefore_004: category=ARRAY, sw-calibration-access=READ-ONLY  # Used as Buffer for service.
      element KeyM_CertificateElementType_Ssa_TrustModelBackendPeerCert_validityNotBefore_004Element: array-size=13, array-size-semantics=FIXED-SIZE, implementation-data-type=uint8
    KeyM_CertificateElementType_Ssa_TrustModelBackendPeerCert_validityNotAfter_004: category=ARRAY, sw-calibration-access=READ-ONLY  # Used as Buffer for service.
      element KeyM_CertificateElementType_Ssa_TrustModelBackendPeerCert_validityNotAfter_004Element: array-size=15, array-size-semantics=FIXED-SIZE, implementation-data-type=uint8
    KeyM_CertificateElementType_Ssa_TrustModelBackendPeerCert_subject_004: category=ARRAY, sw-calibration-access=READ-ONLY  # Used as Buffer for service.
      element KeyM_CertificateElementType_Ssa_TrustModelBackendPeerCert_subject_004Element: array-size=15, array-size-semantics=FIXED-SIZE, implementation-data-type=uint8
    KeyM_CertificateElementType_Ssa_TrustModelBackendPeerCert_SubjectPublicKeyInfoAlgo_004: category=ARRAY, sw-calibration-access=READ-ONLY  # Used as Buffer for service.
      element KeyM_CertificateElementType_Ssa_TrustModelBackendPeerCert_SubjectPublicKeyInfoAlgo_004Element: array-size=3, array-size-semantics=FIXED-SIZE, implementation-data-type=uint8
    KeyM_CertificateElementType_Ssa_TrustModelBackendPeerCert_signatureAlgorithm_004: category=ARRAY, sw-calibration-access=READ-ONLY  # Used as Buffer for service.
      element KeyM_CertificateElementType_Ssa_TrustModelBackendPeerCert_signatureAlgorithm_004Element: array-size=3, array-size-semantics=FIXED-SIZE, implementation-data-type=uint8
    KeyM_CertificateElementType_Ssa_TrustModelIntermediatePeerCert_ext_authKeyId_007: category=ARRAY, sw-calibration-access=READ-ONLY  # Used as Buffer for service.
      element KeyM_CertificateElementType_Ssa_TrustModelIntermediatePeerCert_ext_authKeyId_007Element: array-size=20, array-size-semantics=FIXED-SIZE, implementation-data-type=uint8
    KeyM_CertificateElementType_Ssa_TrustModelIntermediatePeerCert_SigAlgoId_007: category=ARRAY, sw-calibration-access=READ-ONLY  # Used as Buffer for service.
      element KeyM_CertificateElementType_Ssa_TrustModelIntermediatePeerCert_SigAlgoId_007Element: array-size=3, array-size-semantics=FIXED-SIZE, implementation-data-type=uint8
    KeyM_CertificateElementType_Ssa_TrustModelIntermediatePeerCert_validityNotBefore_007: category=ARRAY, sw-calibration-access=READ-ONLY  # Used as Buffer for service.
      element KeyM_CertificateElementType_Ssa_TrustModelIntermediatePeerCert_validityNotBefore_007Element: array-size=13, array-size-semantics=FIXED-SIZE, implementation-data-type=uint8
    KeyM_CertificateElementType_Ssa_TrustModelIntermediatePeerCert_validityNotAfter_007: category=ARRAY, sw-calibration-access=READ-ONLY  # Used as Buffer for service.
      element KeyM_CertificateElementType_Ssa_TrustModelIntermediatePeerCert_validityNotAfter_007Element: array-size=15, array-size-semantics=FIXED-SIZE, implementation-data-type=uint8
    KeyM_CertificateElementType_Ssa_TrustModelIntermediatePeerCert_subject_007: category=ARRAY, sw-calibration-access=READ-ONLY  # Used as Buffer for service.
      element KeyM_CertificateElementType_Ssa_TrustModelIntermediatePeerCert_subject_007Element: array-size=20, array-size-semantics=FIXED-SIZE, implementation-data-type=uint8
    KeyM_CertificateElementType_Ssa_TrustModelIntermediatePeerCert_SubjectPublicKeyInfoAlgo_007: category=ARRAY, sw-calibration-access=READ-ONLY  # Used as Buffer for service.
      element KeyM_CertificateElementType_Ssa_TrustModelIntermediatePeerCert_SubjectPublicKeyInfoAlgo_007Element: array-size=3, array-size-semantics=FIXED-SIZE, implementation-data-type=uint8
    KeyM_CertificateElementType_Ssa_TrustModelIntermediatePeerCert_Issuer_007: category=ARRAY, sw-calibration-access=READ-ONLY  # Used as Buffer for service.
      element KeyM_CertificateElementType_Ssa_TrustModelIntermediatePeerCert_Issuer_007Element: array-size=15, array-size-semantics=FIXED-SIZE, implementation-data-type=uint8
    KeyM_CertificateElementType_Ssa_TrustModelIntermediatePeerCert_signatureAlgorithm_007: category=ARRAY, sw-calibration-access=READ-ONLY  # Used as Buffer for service.
      element KeyM_CertificateElementType_Ssa_TrustModelIntermediatePeerCert_signatureAlgorithm_007Element: array-size=3, array-size-semantics=FIXED-SIZE, implementation-data-type=uint8
    KeyM_CertificateElementType_Ssa_TrustModelRootCert_validityNotAfter: category=ARRAY, sw-calibration-access=READ-ONLY  # Used as Buffer for service.
      element KeyM_CertificateElementType_Ssa_TrustModelRootCert_validityNotAfterElement: array-size=15, array-size-semantics=FIXED-SIZE, implementation-data-type=uint8
    KeyM_CertificateElementType_Ssa_TrustModelRootCert_subject: category=ARRAY, sw-calibration-access=READ-ONLY  # Used as Buffer for service.
      element KeyM_CertificateElementType_Ssa_TrustModelRootCert_subjectElement: array-size=30, array-size-semantics=FIXED-SIZE, implementation-data-type=uint8
    KeyM_CertificateElementType_Ssa_TrustModelRootCert_Issuer: category=ARRAY, sw-calibration-access=READ-ONLY  # Used as Buffer for service.
      element KeyM_CertificateElementType_Ssa_TrustModelRootCert_IssuerElement: array-size=15, array-size-semantics=FIXED-SIZE, implementation-data-type=uint8
    KeyM_CertificateElementType_Ssa_TrustModelRootCert_ext_keyUsage: category=ARRAY, sw-calibration-access=READ-ONLY  # Used as Buffer for service.
      element KeyM_CertificateElementType_Ssa_TrustModelRootCert_ext_keyUsageElement: array-size=2, array-size-semantics=FIXED-SIZE, implementation-data-type=uint8
    KeyM_CertificateElementType_Ssa_TrustModelBackendCert_subject_002: category=ARRAY, sw-calibration-access=READ-ONLY  # Used as Buffer for service.
      element KeyM_CertificateElementType_Ssa_TrustModelBackendCert_subject_002Element: array-size=30, array-size-semantics=FIXED-SIZE, implementation-data-type=uint8
    KeyM_CertificateElementType_Ssa_TrustModelBackendCert_Issuer_002: category=ARRAY, sw-calibration-access=READ-ONLY  # Used as Buffer for service.
      element KeyM_CertificateElementType_Ssa_TrustModelBackendCert_Issuer_002Element: array-size=15, array-size-semantics=FIXED-SIZE, implementation-data-type=uint8
    KeyM_CertificateElementType_Ssa_TrustModelEcuCert_ext_uniqueECUID_005: category=ARRAY, sw-calibration-access=READ-ONLY  # Used as Buffer for service.
      element KeyM_CertificateElementType_Ssa_TrustModelEcuCert_ext_uniqueECUID_005Element: array-size=170, array-size-semantics=FIXED-SIZE, implementation-data-type=uint8
    KeyM_CertificateElementType_Ssa_TrustModelEcuCert_Issuer_005: category=ARRAY, sw-calibration-access=READ-ONLY  # Used as Buffer for service.
      element KeyM_CertificateElementType_Ssa_TrustModelEcuCert_Issuer_005Element: array-size=15, array-size-semantics=FIXED-SIZE, implementation-data-type=uint8
    KeyM_CertificateElementType_Ssa_TrustModelEcuCert_subject_005: category=ARRAY, sw-calibration-access=READ-ONLY  # Used as Buffer for service.
      element KeyM_CertificateElementType_Ssa_TrustModelEcuCert_subject_005Element: array-size=30, array-size-semantics=FIXED-SIZE, implementation-data-type=uint8
    KeyM_CertificateElementType_Ssa_TrustModelIntermediateCert_subject_003: category=ARRAY, sw-calibration-access=READ-ONLY  # Used as Buffer for service.
      element KeyM_CertificateElementType_Ssa_TrustModelIntermediateCert_subject_003Element: array-size=30, array-size-semantics=FIXED-SIZE, implementation-data-type=uint8
    KeyM_CertDataPointerType: category=DATA_REFERENCE, sw-pointer-target-props={target-category=TYPE_REFERENCE, implementation-data-type=uint8}  # Byte-pointer to the data of the certificate
    KeyM_CertDataType: category=STRUCTURE  # This structure is used to exchange certificate data through interface functions.
      element certDataLength: implementation-data-type=uint32
      element certData: implementation-data-type=KeyM_CertDataPointerType
package /MICROSAR/KeyM_swc/Interfaces
  153 x client server interface, all with is-service=true, service-kind=VENDOR-SPECIFIC:
    KeyMCertificate_Ssa_TrustModelEcuCert  # Service of Certificate sub module
      4 x operation:
        GetCertificate: possible-error=[KeyMCertificate_Ssa_TrustModelEcuCert/E_NOT_OK, KeyMCertificate_Ssa_TrustModelEcuCert/KEYM_E_KEY_CERT_SIZE_MISMATCH, KeyMCertificate_Ssa_TrustModelEcuCert/KEYM_E_PARAMETER_MISMATCH, KeyMCertificate_Ssa_TrustModelEcuCert/KEYM_E_KEY_CERT_READ_FAIL, KeyMCertificate_Ssa_TrustModelEcuCert/KEYM_E_KEY_CERT_EMPTY]  # Read certificate data from the certificate sub module
          arg Certificate: type=KeyM_CertificateType_Ssa_TrustModelEcuCert, direction=OUT  # Holds a pointer to the memory location which will hold the Certificate.
        GetStatus: possible-error=KeyMCertificate_Ssa_TrustModelEcuCert/E_NOT_OK  # Provides the status of a certificate.
          arg Status: type=KeyM_CertificateStatusType, direction=OUT  # Holds a pointer to the memory location which will hold the Certificate Status.
        SetCertificate: possible-error=[KeyMCertificate_Ssa_TrustModelEcuCert/E_NOT_OK, KeyMCertificate_Ssa_TrustModelEcuCert/KEYM_E_KEY_CERT_SIZE_MISMATCH, KeyMCertificate_Ssa_TrustModelEcuCert/KEYM_E_PARAMETER_MISMATCH, KeyMCertificate_Ssa_TrustModelEcuCert/KEYM_E_KEY_CERT_WRITE_FAIL]  # Provides certificate data to be processed by the certificate sub module.
          arg Certificate: type=KeyM_CertificateType_Ssa_TrustModelEcuCert, direction=IN  # Holds a pointer to Certificate.
        VerifyCertificate: possible-error=[KeyMCertificate_Ssa_TrustModelEcuCert/E_NOT_OK, KeyMCertificate_Ssa_TrustModelEcuCert/KEYM_E_BUSY, KeyMCertificate_Ssa_TrustModelEcuCert/KEYM_E_KEY_CERT_SIZE_MISMATCH, KeyMCertificate_Ssa_TrustModelEcuCert/KEYM_E_PARAMETER_MISMATCH, KeyMCertificate_Ssa_TrustModelEcuCert/KEYM_E_KEY_CERT_EMPTY, KeyMCertificate_Ssa_TrustModelEcuCert/KEYM_E_CERT_INVALID_CHAIN_OF_TRUST]  # Verify certificate data from the certificate sub module .
      8 x error:
        E_NOT_OK: error-code=1  # The service request failed.
        KEYM_E_BUSY: error-code=2  # The service request failed. Key management is busy with other operations.
        KEYM_E_KEY_CERT_SIZE_MISMATCH: error-code=4  # The service request failed. Parameter size does not match the expected value.
        KEYM_E_PARAMETER_MISMATCH: error-code=5  # The service request failed. Parameter to function does not provide the expected value.
        KEYM_E_KEY_CERT_WRITE_FAIL: error-code=7  # The service request failed. Certificate or key write operation failed.
        KEYM_E_KEY_CERT_READ_FAIL: error-code=9  # The service request failed. Certificate or key could not be provided due to a read or permission failure.
        KEYM_E_KEY_CERT_EMPTY: error-code=10  # The service request failed. The requested key or certificate is not available, slot is empty.
        KEYM_E_CERT_INVALID_CHAIN_OF_TRUST: error-code=11  # The service request failed. Certificate verification failed - Invalid Chain of Trust.
    KeyMCertificateExtended_Ssa_TrustModelEcuCert  # Services of Certificate sub module that extend the standard AUTOSAR services
      operation ServiceCertificate: possible-error=[KeyMCertificateExtended_Ssa_TrustModelEcuCert/E_NOT_OK, KeyMCertificateExtended_Ssa_TrustModelEcuCert/KEYM_E_BUSY, KeyMCertificateExtended_Ssa_TrustModelEcuCert/KEYM_E_KEY_CERT_SIZE_MISMATCH, KeyMCertificateExtended_Ssa_TrustModelEcuCert/KEYM_E_PARAMETER_MISMATCH, KeyMCertificateExtended_Ssa_TrustModelEcuCert/KEYM_E_KEY_CERT_EMPTY, KeyMCertificateExtended_Ssa_TrustModelEcuCert/KEYM_E_CERT_INVALID_CHAIN_OF_TRUST]  # Handle certificate operation request in the certificate sub module.
        5 x arg, all with direction=IN:
          Service: type=KeyM_ServiceCertificateType  # Provides the type of service the key manager has to perform.
          RequestData: type=KeyM_ConstDataPtrType  # Information that comes along with the request.
          RequestDataLength: type=uint32  # Length of data in the RequestData array.
          ResponseData: type=KeyM_DataPtrType  # Pointer to array in which the request response data will be stored upon request completion.
          ResponseDataLength: type=uint32  # Max number of bytes available in ResponseDataPtr.
      operation CsrElementSet: possible-error=[KeyMCertificateExtended_Ssa_TrustModelEcuCert/E_NOT_OK, KeyMCertificateExtended_Ssa_TrustModelEcuCert/KEYM_E_PARAMETER_MISMATCH]  # To be used before calling GenerateCertificationRequestInfo. Adds an data to the certificate for which a signing request shall be build.
        4 x arg, all with direction=IN:
          CertElementId: type=KeyM_CertElementIdType  # Element ID of the element that shall be added
          EncodingType: type=KeyM_CsrEncodingType  # Encoding type of the CSR element
          ElementData: type=KeyM_ConstDataPtrType  # Data of the element that shall be added
          ElementDataLength: type=uint32  # Length of ElementData data in the ElementData array
      6 x error:
        E_NOT_OK: error-code=1  # The service request failed.
        KEYM_E_BUSY: error-code=2  # The service request failed. Key management is busy with other operations.
        KEYM_E_KEY_CERT_SIZE_MISMATCH: error-code=4  # The service request failed. Parameter size does not match the expected value.
        KEYM_E_PARAMETER_MISMATCH: error-code=5  # The service request failed. Parameter to function does not provide the expected value.
        KEYM_E_KEY_CERT_EMPTY: error-code=10  # The service request failed. The requested key or certificate is not available, slot is empty.
        KEYM_E_CERT_INVALID_CHAIN_OF_TRUST: error-code=11  # The service request failed. Certificate verification failed - Invalid Chain of Trust.
    KeyMCertificateNotification  # This service interface provides callbacks for certificate management operations.
      operation CertificateVerifyCallbackNotification  # Notifies the application that a certificate verification has been finished.
        arg Result: type=KeyM_CertificateStatusType, direction=IN  # Contains information about the result of the operation.
      operation ServiceCertificateCallbackNotification  # Notifies the application that the certificate service operation has been finished. This function is used by the certificate submodule. This callback is only provided if KeyMServiceCertificateFunctionEnabled is set to TRUE.
        arg Result: type=KeyM_ResultType, direction=IN  # Contains information about the result of the operation.
        arg ResponseDataLength: type=uint16, direction=IN  # Contains the length in Bytes of the response data
        arg ResponseData: type=KeyM_const_CryptoKeyDataType, direction=IN  # Memory location of the response data. Only guaranteed to be valid if ResponseDataLength > 0.
    KeyMCertificateElement_Ssa_TrustModelEcuCert_ext_authKeyId_005  # Service of the certificate sub module to access certificate elements.
      operation CertificateElementGet: possible-error=[KeyMCertificateElement_Ssa_TrustModelEcuCert_ext_authKeyId_005/E_NOT_OK, KeyMCertificateElement_Ssa_TrustModelEcuCert_ext_authKeyId_005/KEYM_E_KEY_CERT_SIZE_MISMATCH, KeyMCertificateElement_Ssa_TrustModelEcuCert_ext_authKeyId_005/KEYM_E_PARAMETER_MISMATCH, KeyMCertificateElement_Ssa_TrustModelEcuCert_ext_authKeyId_005/KEYM_E_KEY_CERT_INVALID, KeyMCertificateElement_Ssa_TrustModelEcuCert_ext_authKeyId_005/KEYM_E_KEY_CERT_EMPTY]  # Provides the content of a specific certificate element. The certificate configuration defines how the certificate submodule can find the element, e.g. by providing the object identifier (OID). This function is used to retrieve this information if only one element is assigned to the respective OID.
        arg CertificateElementData: type=KeyM_CertificateElementType_Ssa_TrustModelEcuCert_ext_authKeyId_005, direction=OUT, server-argument-impl-policy=USE-ARRAY-BASE-TYPE  # Holds a pointer to the memory location which will hold the certificate element.
        arg CertificateDataLength: type=uint32, direction=OUT  # Contains the length in bytes of certificate element.
      operation CertificateElementGetByIndex: possible-error=[KeyMCertificateElement_Ssa_TrustModelEcuCert_ext_authKeyId_005/E_NOT_OK, KeyMCertificateElement_Ssa_TrustModelEcuCert_ext_authKeyId_005/KEYM_E_KEY_CERT_SIZE_MISMATCH, KeyMCertificateElement_Ssa_TrustModelEcuCert_ext_authKeyId_005/KEYM_E_PARAMETER_MISMATCH, KeyMCertificateElement_Ssa_TrustModelEcuCert_ext_authKeyId_005/KEYM_E_KEY_CERT_INVALID, KeyMCertificateElement_Ssa_TrustModelEcuCert_ext_authKeyId_005/KEYM_E_KEY_CERT_EMPTY]  # This operation provides data from a specific certificate element.
        arg Index: type=uint16, direction=IN  # This is the index to dedicated element in the list
        arg CertificateElementData: type=KeyM_CertificateElementType_Ssa_TrustModelEcuCert_ext_authKeyId_005, direction=OUT, server-argument-impl-policy=USE-ARRAY-BASE-TYPE  # Holds a pointer to the memory location which will hold the certificate element.
        arg CertificateDataLength: type=uint32, direction=OUT  # Contains the length in bytes of certificate element.
      operation CertificateElementGetCount: possible-error=[KeyMCertificateElement_Ssa_TrustModelEcuCert_ext_authKeyId_005/E_NOT_OK, KeyMCertificateElement_Ssa_TrustModelEcuCert_ext_authKeyId_005/KEYM_E_KEY_CERT_SIZE_MISMATCH, KeyMCertificateElement_Ssa_TrustModelEcuCert_ext_authKeyId_005/KEYM_E_PARAMETER_MISMATCH, KeyMCertificateElement_Ssa_TrustModelEcuCert_ext_authKeyId_005/KEYM_E_KEY_CERT_INVALID, KeyMCertificateElement_Ssa_TrustModelEcuCert_ext_authKeyId_005/KEYM_E_KEY_CERT_EMPTY]  # This operation returns the amount of items available for a certificate element.
        arg count: type=uint16, direction=OUT  # Number of items available for an element.
      5 x error:
        E_NOT_OK: error-code=1  # The service request failed.
        KEYM_E_KEY_CERT_SIZE_MISMATCH: error-code=4  # The service request failed. Parameter size does not match the expected value.
        KEYM_E_PARAMETER_MISMATCH: error-code=5  # The service request failed. Parameter to function does not provide the expected value.
        KEYM_E_KEY_CERT_EMPTY: error-code=10  # The service request failed. The requested key or certificate is not available, slot is empty.
        KEYM_E_KEY_CERT_INVALID: error-code=6  # The service request failed. Key or certificate is invalid and cannot be used for the operation.
    KeyMCertificateElement_Ssa_TrustModelEcuCert_ext_subKeyId_005  # Service of the certificate sub module to access certificate elements.
      operation CertificateElementGet: possible-error=[KeyMCertificateElement_Ssa_TrustModelEcuCert_ext_subKeyId_005/E_NOT_OK, KeyMCertificateElement_Ssa_TrustModelEcuCert_ext_subKeyId_005/KEYM_E_KEY_CERT_SIZE_MISMATCH, KeyMCertificateElement_Ssa_TrustModelEcuCert_ext_subKeyId_005/KEYM_E_PARAMETER_MISMATCH, KeyMCertificateElement_Ssa_TrustModelEcuCert_ext_subKeyId_005/KEYM_E_KEY_CERT_INVALID, KeyMCertificateElement_Ssa_TrustModelEcuCert_ext_subKeyId_005/KEYM_E_KEY_CERT_EMPTY]  # Provides the content of a specific certificate element. The certificate configuration defines how the certificate submodule can find the element, e.g. by providing the object identifier (OID). This function is used to retrieve this information if only one element is assigned to the respective OID.
        arg CertificateElementData: type=KeyM_CertificateElementType_Ssa_TrustModelEcuCert_ext_subKeyId_005, direction=OUT, server-argument-impl-policy=USE-ARRAY-BASE-TYPE  # Holds a pointer to the memory location which will hold the certificate element.
        arg CertificateDataLength: type=uint32, direction=OUT  # Contains the length in bytes of certificate element.
      operation CertificateElementGetByIndex: possible-error=[KeyMCertificateElement_Ssa_TrustModelEcuCert_ext_subKeyId_005/E_NOT_OK, KeyMCertificateElement_Ssa_TrustModelEcuCert_ext_subKeyId_005/KEYM_E_KEY_CERT_SIZE_MISMATCH, KeyMCertificateElement_Ssa_TrustModelEcuCert_ext_subKeyId_005/KEYM_E_PARAMETER_MISMATCH, KeyMCertificateElement_Ssa_TrustModelEcuCert_ext_subKeyId_005/KEYM_E_KEY_CERT_INVALID, KeyMCertificateElement_Ssa_TrustModelEcuCert_ext_subKeyId_005/KEYM_E_KEY_CERT_EMPTY]  # This operation provides data from a specific certificate element.
        arg Index: type=uint16, direction=IN  # This is the index to dedicated element in the list
        arg CertificateElementData: type=KeyM_CertificateElementType_Ssa_TrustModelEcuCert_ext_subKeyId_005, direction=OUT, server-argument-impl-policy=USE-ARRAY-BASE-TYPE  # Holds a pointer to the memory location which will hold the certificate element.
        arg CertificateDataLength: type=uint32, direction=OUT  # Contains the length in bytes of certificate element.
      operation CertificateElementGetCount: possible-error=[KeyMCertificateElement_Ssa_TrustModelEcuCert_ext_subKeyId_005/E_NOT_OK, KeyMCertificateElement_Ssa_TrustModelEcuCert_ext_subKeyId_005/KEYM_E_KEY_CERT_SIZE_MISMATCH, KeyMCertificateElement_Ssa_TrustModelEcuCert_ext_subKeyId_005/KEYM_E_PARAMETER_MISMATCH, KeyMCertificateElement_Ssa_TrustModelEcuCert_ext_subKeyId_005/KEYM_E_KEY_CERT_INVALID, KeyMCertificateElement_Ssa_TrustModelEcuCert_ext_subKeyId_005/KEYM_E_KEY_CERT_EMPTY]  # This operation returns the amount of items available for a certificate element.
        arg count: type=uint16, direction=OUT  # Number of items available for an element.
      5 x error:
        E_NOT_OK: error-code=1  # The service request failed.
        KEYM_E_KEY_CERT_SIZE_MISMATCH: error-code=4  # The service request failed. Parameter size does not match the expected value.
        KEYM_E_PARAMETER_MISMATCH: error-code=5  # The service request failed. Parameter to function does not provide the expected value.
        KEYM_E_KEY_CERT_EMPTY: error-code=10  # The service request failed. The requested key or certificate is not available, slot is empty.
        KEYM_E_KEY_CERT_INVALID: error-code=6  # The service request failed. Key or certificate is invalid and cannot be used for the operation.
    KeyMCertificateElement_Ssa_TrustModelEcuCert_ext_keyUsage_005  # Service of the certificate sub module to access certificate elements.
      operation CertificateElementGet: possible-error=[KeyMCertificateElement_Ssa_TrustModelEcuCert_ext_keyUsage_005/E_NOT_OK, KeyMCertificateElement_Ssa_TrustModelEcuCert_ext_keyUsage_005/KEYM_E_KEY_CERT_SIZE_MISMATCH, KeyMCertificateElement_Ssa_TrustModelEcuCert_ext_keyUsage_005/KEYM_E_PARAMETER_MISMATCH, KeyMCertificateElement_Ssa_TrustModelEcuCert_ext_keyUsage_005/KEYM_E_KEY_CERT_INVALID, KeyMCertificateElement_Ssa_TrustModelEcuCert_ext_keyUsage_005/KEYM_E_KEY_CERT_EMPTY]  # Provides the content of a specific certificate element. The certificate configuration defines how the certificate submodule can find the element, e.g. by providing the object identifier (OID). This function is used to retrieve this information if only one element is assigned to the respective OID.
        arg CertificateElementData: type=KeyM_CertificateElementType_Ssa_TrustModelEcuCert_ext_keyUsage_005, direction=OUT, server-argument-impl-policy=USE-ARRAY-BASE-TYPE  # Holds a pointer to the memory location which will hold the certificate element.
        arg CertificateDataLength: type=uint32, direction=OUT  # Contains the length in bytes of certificate element.
      operation CertificateElementGetByIndex: possible-error=[KeyMCertificateElement_Ssa_TrustModelEcuCert_ext_keyUsage_005/E_NOT_OK, KeyMCertificateElement_Ssa_TrustModelEcuCert_ext_keyUsage_005/KEYM_E_KEY_CERT_SIZE_MISMATCH, KeyMCertificateElement_Ssa_TrustModelEcuCert_ext_keyUsage_005/KEYM_E_PARAMETER_MISMATCH, KeyMCertificateElement_Ssa_TrustModelEcuCert_ext_keyUsage_005/KEYM_E_KEY_CERT_INVALID, KeyMCertificateElement_Ssa_TrustModelEcuCert_ext_keyUsage_005/KEYM_E_KEY_CERT_EMPTY]  # This operation provides data from a specific certificate element.
        arg Index: type=uint16, direction=IN  # This is the index to dedicated element in the list
        arg CertificateElementData: type=KeyM_CertificateElementType_Ssa_TrustModelEcuCert_ext_keyUsage_005, direction=OUT, server-argument-impl-policy=USE-ARRAY-BASE-TYPE  # Holds a pointer to the memory location which will hold the certificate element.
        arg CertificateDataLength: type=uint32, direction=OUT  # Contains the length in bytes of certificate element.
      operation CertificateElementGetCount: possible-error=[KeyMCertificateElement_Ssa_TrustModelEcuCert_ext_keyUsage_005/E_NOT_OK, KeyMCertificateElement_Ssa_TrustModelEcuCert_ext_keyUsage_005/KEYM_E_KEY_CERT_SIZE_MISMATCH, KeyMCertificateElement_Ssa_TrustModelEcuCert_ext_keyUsage_005/KEYM_E_PARAMETER_MISMATCH, KeyMCertificateElement_Ssa_TrustModelEcuCert_ext_keyUsage_005/KEYM_E_KEY_CERT_INVALID, KeyMCertificateElement_Ssa_TrustModelEcuCert_ext_keyUsage_005/KEYM_E_KEY_CERT_EMPTY]  # This operation returns the amount of items available for a certificate element.
        arg count: type=uint16, direction=OUT  # Number of items available for an element.
      5 x error:
        E_NOT_OK: error-code=1  # The service request failed.
        KEYM_E_KEY_CERT_SIZE_MISMATCH: error-code=4  # The service request failed. Parameter size does not match the expected value.
        KEYM_E_PARAMETER_MISMATCH: error-code=5  # The service request failed. Parameter to function does not provide the expected value.
        KEYM_E_KEY_CERT_EMPTY: error-code=10  # The service request failed. The requested key or certificate is not available, slot is empty.
        KEYM_E_KEY_CERT_INVALID: error-code=6  # The service request failed. Key or certificate is invalid and cannot be used for the operation.
    KeyMCertificateElement_Ssa_TrustModelEcuCert_Version_005  # Service of the certificate sub module to access certificate elements.
      operation CertificateElementGet: possible-error=[KeyMCertificateElement_Ssa_TrustModelEcuCert_Version_005/E_NOT_OK, KeyMCertificateElement_Ssa_TrustModelEcuCert_Version_005/KEYM_E_KEY_CERT_SIZE_MISMATCH, KeyMCertificateElement_Ssa_TrustModelEcuCert_Version_005/KEYM_E_PARAMETER_MISMATCH, KeyMCertificateElement_Ssa_TrustModelEcuCert_Version_005/KEYM_E_KEY_CERT_INVALID, KeyMCertificateElement_Ssa_TrustModelEcuCert_Version_005/KEYM_E_KEY_CERT_EMPTY]  # Provides the content of a specific certificate element. The certificate configuration defines how the certificate submodule can find the element, e.g. by providing the object identifier (OID). This function is used to retrieve this information if only one element is assigned to the respective OID.
        arg CertificateElementData: type=KeyM_CertificateElementType_Ssa_TrustModelEcuCert_Version_005, direction=OUT, server-argument-impl-policy=USE-ARRAY-BASE-TYPE  # Holds a pointer to the memory location which will hold the certificate element.
        arg CertificateDataLength: type=uint32, direction=OUT  # Contains the length in bytes of certificate element.
      operation CertificateElementGetByIndex: possible-error=[KeyMCertificateElement_Ssa_TrustModelEcuCert_Version_005/E_NOT_OK, KeyMCertificateElement_Ssa_TrustModelEcuCert_Version_005/KEYM_E_KEY_CERT_SIZE_MISMATCH, KeyMCertificateElement_Ssa_TrustModelEcuCert_Version_005/KEYM_E_PARAMETER_MISMATCH, KeyMCertificateElement_Ssa_TrustModelEcuCert_Version_005/KEYM_E_KEY_CERT_INVALID, KeyMCertificateElement_Ssa_TrustModelEcuCert_Version_005/KEYM_E_KEY_CERT_EMPTY]  # This operation provides data from a specific certificate element.
        arg Index: type=uint16, direction=IN  # This is the index to dedicated element in the list
        arg CertificateElementData: type=KeyM_CertificateElementType_Ssa_TrustModelEcuCert_Version_005, direction=OUT, server-argument-impl-policy=USE-ARRAY-BASE-TYPE  # Holds a pointer to the memory location which will hold the certificate element.
        arg CertificateDataLength: type=uint32, direction=OUT  # Contains the length in bytes of certificate element.
      operation CertificateElementGetCount: possible-error=[KeyMCertificateElement_Ssa_TrustModelEcuCert_Version_005/E_NOT_OK, KeyMCertificateElement_Ssa_TrustModelEcuCert_Version_005/KEYM_E_KEY_CERT_SIZE_MISMATCH, KeyMCertificateElement_Ssa_TrustModelEcuCert_Version_005/KEYM_E_PARAMETER_MISMATCH, KeyMCertificateElement_Ssa_TrustModelEcuCert_Version_005/KEYM_E_KEY_CERT_INVALID, KeyMCertificateElement_Ssa_TrustModelEcuCert_Version_005/KEYM_E_KEY_CERT_EMPTY]  # This operation returns the amount of items available for a certificate element.
        arg count: type=uint16, direction=OUT  # Number of items available for an element.
      5 x error:
        E_NOT_OK: error-code=1  # The service request failed.
        KEYM_E_KEY_CERT_SIZE_MISMATCH: error-code=4  # The service request failed. Parameter size does not match the expected value.
        KEYM_E_PARAMETER_MISMATCH: error-code=5  # The service request failed. Parameter to function does not provide the expected value.
        KEYM_E_KEY_CERT_EMPTY: error-code=10  # The service request failed. The requested key or certificate is not available, slot is empty.
        KEYM_E_KEY_CERT_INVALID: error-code=6  # The service request failed. Key or certificate is invalid and cannot be used for the operation.
    KeyMCertificateElement_Ssa_TrustModelEcuCert_SerialNo_005  # Service of the certificate sub module to access certificate elements.
      operation CertificateElementGet: possible-error=[KeyMCertificateElement_Ssa_TrustModelEcuCert_SerialNo_005/E_NOT_OK, KeyMCertificateElement_Ssa_TrustModelEcuCert_SerialNo_005/KEYM_E_KEY_CERT_SIZE_MISMATCH, KeyMCertificateElement_Ssa_TrustModelEcuCert_SerialNo_005/KEYM_E_PARAMETER_MISMATCH, KeyMCertificateElement_Ssa_TrustModelEcuCert_SerialNo_005/KEYM_E_KEY_CERT_INVALID, KeyMCertificateElement_Ssa_TrustModelEcuCert_SerialNo_005/KEYM_E_KEY_CERT_EMPTY]  # Provides the content of a specific certificate element. The certificate configuration defines how the certificate submodule can find the element, e.g. by providing the object identifier (OID). This function is used to retrieve this information if only one element is assigned to the respective OID.
        arg CertificateElementData: type=KeyM_CertificateElementType_Ssa_TrustModelEcuCert_SerialNo_005, direction=OUT, server-argument-impl-policy=USE-ARRAY-BASE-TYPE  # Holds a pointer to the memory location which will hold the certificate element.
        arg CertificateDataLength: type=uint32, direction=OUT  # Contains the length in bytes of certificate element.
      operation CertificateElementGetByIndex: possible-error=[KeyMCertificateElement_Ssa_TrustModelEcuCert_SerialNo_005/E_NOT_OK, KeyMCertificateElement_Ssa_TrustModelEcuCert_SerialNo_005/KEYM_E_KEY_CERT_SIZE_MISMATCH, KeyMCertificateElement_Ssa_TrustModelEcuCert_SerialNo_005/KEYM_E_PARAMETER_MISMATCH, KeyMCertificateElement_Ssa_TrustModelEcuCert_SerialNo_005/KEYM_E_KEY_CERT_INVALID, KeyMCertificateElement_Ssa_TrustModelEcuCert_SerialNo_005/KEYM_E_KEY_CERT_EMPTY]  # This operation provides data from a specific certificate element.
        arg Index: type=uint16, direction=IN  # This is the index to dedicated element in the list
        arg CertificateElementData: type=KeyM_CertificateElementType_Ssa_TrustModelEcuCert_SerialNo_005, direction=OUT, server-argument-impl-policy=USE-ARRAY-BASE-TYPE  # Holds a pointer to the memory location which will hold the certificate element.
        arg CertificateDataLength: type=uint32, direction=OUT  # Contains the length in bytes of certificate element.
      operation CertificateElementGetCount: possible-error=[KeyMCertificateElement_Ssa_TrustModelEcuCert_SerialNo_005/E_NOT_OK, KeyMCertificateElement_Ssa_TrustModelEcuCert_SerialNo_005/KEYM_E_KEY_CERT_SIZE_MISMATCH, KeyMCertificateElement_Ssa_TrustModelEcuCert_SerialNo_005/KEYM_E_PARAMETER_MISMATCH, KeyMCertificateElement_Ssa_TrustModelEcuCert_SerialNo_005/KEYM_E_KEY_CERT_INVALID, KeyMCertificateElement_Ssa_TrustModelEcuCert_SerialNo_005/KEYM_E_KEY_CERT_EMPTY]  # This operation returns the amount of items available for a certificate element.
        arg count: type=uint16, direction=OUT  # Number of items available for an element.
      5 x error:
        E_NOT_OK: error-code=1  # The service request failed.
        KEYM_E_KEY_CERT_SIZE_MISMATCH: error-code=4  # The service request failed. Parameter size does not match the expected value.
        KEYM_E_PARAMETER_MISMATCH: error-code=5  # The service request failed. Parameter to function does not provide the expected value.
        KEYM_E_KEY_CERT_EMPTY: error-code=10  # The service request failed. The requested key or certificate is not available, slot is empty.
        KEYM_E_KEY_CERT_INVALID: error-code=6  # The service request failed. Key or certificate is invalid and cannot be used for the operation.
    KeyMCertificateElement_Ssa_TrustModelEcuCert_SigAlgoId_005  # Service of the certificate sub module to access certificate elements.
      operation CertificateElementGet: possible-error=[KeyMCertificateElement_Ssa_TrustModelEcuCert_SigAlgoId_005/E_NOT_OK, KeyMCertificateElement_Ssa_TrustModelEcuCert_SigAlgoId_005/KEYM_E_KEY_CERT_SIZE_MISMATCH, KeyMCertificateElement_Ssa_TrustModelEcuCert_SigAlgoId_005/KEYM_E_PARAMETER_MISMATCH, KeyMCertificateElement_Ssa_TrustModelEcuCert_SigAlgoId_005/KEYM_E_KEY_CERT_INVALID, KeyMCertificateElement_Ssa_TrustModelEcuCert_SigAlgoId_005/KEYM_E_KEY_CERT_EMPTY]  # Provides the content of a specific certificate element. The certificate configuration defines how the certificate submodule can find the element, e.g. by providing the object identifier (OID). This function is used to retrieve this information if only one element is assigned to the respective OID.
        arg CertificateElementData: type=KeyM_CertificateElementType_Ssa_TrustModelEcuCert_SigAlgoId_005, direction=OUT, server-argument-impl-policy=USE-ARRAY-BASE-TYPE  # Holds a pointer to the memory location which will hold the certificate element.
        arg CertificateDataLength: type=uint32, direction=OUT  # Contains the length in bytes of certificate element.
      operation CertificateElementGetByIndex: possible-error=[KeyMCertificateElement_Ssa_TrustModelEcuCert_SigAlgoId_005/E_NOT_OK, KeyMCertificateElement_Ssa_TrustModelEcuCert_SigAlgoId_005/KEYM_E_KEY_CERT_SIZE_MISMATCH, KeyMCertificateElement_Ssa_TrustModelEcuCert_SigAlgoId_005/KEYM_E_PARAMETER_MISMATCH, KeyMCertificateElement_Ssa_TrustModelEcuCert_SigAlgoId_005/KEYM_E_KEY_CERT_INVALID, KeyMCertificateElement_Ssa_TrustModelEcuCert_SigAlgoId_005/KEYM_E_KEY_CERT_EMPTY]  # This operation provides data from a specific certificate element.
        arg Index: type=uint16, direction=IN  # This is the index to dedicated element in the list
        arg CertificateElementData: type=KeyM_CertificateElementType_Ssa_TrustModelEcuCert_SigAlgoId_005, direction=OUT, server-argument-impl-policy=USE-ARRAY-BASE-TYPE  # Holds a pointer to the memory location which will hold the certificate element.
        arg CertificateDataLength: type=uint32, direction=OUT  # Contains the length in bytes of certificate element.
      operation CertificateElementGetCount: possible-error=[KeyMCertificateElement_Ssa_TrustModelEcuCert_SigAlgoId_005/E_NOT_OK, KeyMCertificateElement_Ssa_TrustModelEcuCert_SigAlgoId_005/KEYM_E_KEY_CERT_SIZE_MISMATCH, KeyMCertificateElement_Ssa_TrustModelEcuCert_SigAlgoId_005/KEYM_E_PARAMETER_MISMATCH, KeyMCertificateElement_Ssa_TrustModelEcuCert_SigAlgoId_005/KEYM_E_KEY_CERT_INVALID, KeyMCertificateElement_Ssa_TrustModelEcuCert_SigAlgoId_005/KEYM_E_KEY_CERT_EMPTY]  # This operation returns the amount of items available for a certificate element.
        arg count: type=uint16, direction=OUT  # Number of items available for an element.
      5 x error:
        E_NOT_OK: error-code=1  # The service request failed.
        KEYM_E_KEY_CERT_SIZE_MISMATCH: error-code=4  # The service request failed. Parameter size does not match the expected value.
        KEYM_E_PARAMETER_MISMATCH: error-code=5  # The service request failed. Parameter to function does not provide the expected value.
        KEYM_E_KEY_CERT_EMPTY: error-code=10  # The service request failed. The requested key or certificate is not available, slot is empty.
        KEYM_E_KEY_CERT_INVALID: error-code=6  # The service request failed. Key or certificate is invalid and cannot be used for the operation.
    KeyMCertificateElement_Ssa_TrustModelEcuCert_validityNotBefore_005  # Service of the certificate sub module to access certificate elements.
      operation CertificateElementGet: possible-error=[KeyMCertificateElement_Ssa_TrustModelEcuCert_validityNotBefore_005/E_NOT_OK, KeyMCertificateElement_Ssa_TrustModelEcuCert_validityNotBefore_005/KEYM_E_KEY_CERT_SIZE_MISMATCH, KeyMCertificateElement_Ssa_TrustModelEcuCert_validityNotBefore_005/KEYM_E_PARAMETER_MISMATCH, KeyMCertificateElement_Ssa_TrustModelEcuCert_validityNotBefore_005/KEYM_E_KEY_CERT_INVALID, KeyMCertificateElement_Ssa_TrustModelEcuCert_validityNotBefore_005/KEYM_E_KEY_CERT_EMPTY]  # Provides the content of a specific certificate element. The certificate configuration defines how the certificate submodule can find the element, e.g. by providing the object identifier (OID). This function is used to retrieve this information if only one element is assigned to the respective OID.
        arg CertificateElementData: type=KeyM_CertificateElementType_Ssa_TrustModelEcuCert_validityNotBefore_005, direction=OUT, server-argument-impl-policy=USE-ARRAY-BASE-TYPE  # Holds a pointer to the memory location which will hold the certificate element.
        arg CertificateDataLength: type=uint32, direction=OUT  # Contains the length in bytes of certificate element.
      operation CertificateElementGetByIndex: possible-error=[KeyMCertificateElement_Ssa_TrustModelEcuCert_validityNotBefore_005/E_NOT_OK, KeyMCertificateElement_Ssa_TrustModelEcuCert_validityNotBefore_005/KEYM_E_KEY_CERT_SIZE_MISMATCH, KeyMCertificateElement_Ssa_TrustModelEcuCert_validityNotBefore_005/KEYM_E_PARAMETER_MISMATCH, KeyMCertificateElement_Ssa_TrustModelEcuCert_validityNotBefore_005/KEYM_E_KEY_CERT_INVALID, KeyMCertificateElement_Ssa_TrustModelEcuCert_validityNotBefore_005/KEYM_E_KEY_CERT_EMPTY]  # This operation provides data from a specific certificate element.
        arg Index: type=uint16, direction=IN  # This is the index to dedicated element in the list
        arg CertificateElementData: type=KeyM_CertificateElementType_Ssa_TrustModelEcuCert_validityNotBefore_005, direction=OUT, server-argument-impl-policy=USE-ARRAY-BASE-TYPE  # Holds a pointer to the memory location which will hold the certificate element.
        arg CertificateDataLength: type=uint32, direction=OUT  # Contains the length in bytes of certificate element.
      operation CertificateElementGetCount: possible-error=[KeyMCertificateElement_Ssa_TrustModelEcuCert_validityNotBefore_005/E_NOT_OK, KeyMCertificateElement_Ssa_TrustModelEcuCert_validityNotBefore_005/KEYM_E_KEY_CERT_SIZE_MISMATCH, KeyMCertificateElement_Ssa_TrustModelEcuCert_validityNotBefore_005/KEYM_E_PARAMETER_MISMATCH, KeyMCertificateElement_Ssa_TrustModelEcuCert_validityNotBefore_005/KEYM_E_KEY_CERT_INVALID, KeyMCertificateElement_Ssa_TrustModelEcuCert_validityNotBefore_005/KEYM_E_KEY_CERT_EMPTY]  # This operation returns the amount of items available for a certificate element.
        arg count: type=uint16, direction=OUT  # Number of items available for an element.
      5 x error:
        E_NOT_OK: error-code=1  # The service request failed.
        KEYM_E_KEY_CERT_SIZE_MISMATCH: error-code=4  # The service request failed. Parameter size does not match the expected value.
        KEYM_E_PARAMETER_MISMATCH: error-code=5  # The service request failed. Parameter to function does not provide the expected value.
        KEYM_E_KEY_CERT_EMPTY: error-code=10  # The service request failed. The requested key or certificate is not available, slot is empty.
        KEYM_E_KEY_CERT_INVALID: error-code=6  # The service request failed. Key or certificate is invalid and cannot be used for the operation.
    KeyMCertificateElement_Ssa_TrustModelEcuCert_validityNotAfter_005  # Service of the certificate sub module to access certificate elements.
      operation CertificateElementGet: possible-error=[KeyMCertificateElement_Ssa_TrustModelEcuCert_validityNotAfter_005/E_NOT_OK, KeyMCertificateElement_Ssa_TrustModelEcuCert_validityNotAfter_005/KEYM_E_KEY_CERT_SIZE_MISMATCH, KeyMCertificateElement_Ssa_TrustModelEcuCert_validityNotAfter_005/KEYM_E_PARAMETER_MISMATCH, KeyMCertificateElement_Ssa_TrustModelEcuCert_validityNotAfter_005/KEYM_E_KEY_CERT_INVALID, KeyMCertificateElement_Ssa_TrustModelEcuCert_validityNotAfter_005/KEYM_E_KEY_CERT_EMPTY]  # Provides the content of a specific certificate element. The certificate configuration defines how the certificate submodule can find the element, e.g. by providing the object identifier (OID). This function is used to retrieve this information if only one element is assigned to the respective OID.
        arg CertificateElementData: type=KeyM_CertificateElementType_Ssa_TrustModelEcuCert_validityNotAfter_005, direction=OUT, server-argument-impl-policy=USE-ARRAY-BASE-TYPE  # Holds a pointer to the memory location which will hold the certificate element.
        arg CertificateDataLength: type=uint32, direction=OUT  # Contains the length in bytes of certificate element.
      operation CertificateElementGetByIndex: possible-error=[KeyMCertificateElement_Ssa_TrustModelEcuCert_validityNotAfter_005/E_NOT_OK, KeyMCertificateElement_Ssa_TrustModelEcuCert_validityNotAfter_005/KEYM_E_KEY_CERT_SIZE_MISMATCH, KeyMCertificateElement_Ssa_TrustModelEcuCert_validityNotAfter_005/KEYM_E_PARAMETER_MISMATCH, KeyMCertificateElement_Ssa_TrustModelEcuCert_validityNotAfter_005/KEYM_E_KEY_CERT_INVALID, KeyMCertificateElement_Ssa_TrustModelEcuCert_validityNotAfter_005/KEYM_E_KEY_CERT_EMPTY]  # This operation provides data from a specific certificate element.
        arg Index: type=uint16, direction=IN  # This is the index to dedicated element in the list
        arg CertificateElementData: type=KeyM_CertificateElementType_Ssa_TrustModelEcuCert_validityNotAfter_005, direction=OUT, server-argument-impl-policy=USE-ARRAY-BASE-TYPE  # Holds a pointer to the memory location which will hold the certificate element.
        arg CertificateDataLength: type=uint32, direction=OUT  # Contains the length in bytes of certificate element.
      operation CertificateElementGetCount: possible-error=[KeyMCertificateElement_Ssa_TrustModelEcuCert_validityNotAfter_005/E_NOT_OK, KeyMCertificateElement_Ssa_TrustModelEcuCert_validityNotAfter_005/KEYM_E_KEY_CERT_SIZE_MISMATCH, KeyMCertificateElement_Ssa_TrustModelEcuCert_validityNotAfter_005/KEYM_E_PARAMETER_MISMATCH, KeyMCertificateElement_Ssa_TrustModelEcuCert_validityNotAfter_005/KEYM_E_KEY_CERT_INVALID, KeyMCertificateElement_Ssa_TrustModelEcuCert_validityNotAfter_005/KEYM_E_KEY_CERT_EMPTY]  # This operation returns the amount of items available for a certificate element.
        arg count: type=uint16, direction=OUT  # Number of items available for an element.
      5 x error:
        E_NOT_OK: error-code=1  # The service request failed.
        KEYM_E_KEY_CERT_SIZE_MISMATCH: error-code=4  # The service request failed. Parameter size does not match the expected value.
        KEYM_E_PARAMETER_MISMATCH: error-code=5  # The service request failed. Parameter to function does not provide the expected value.
        KEYM_E_KEY_CERT_EMPTY: error-code=10  # The service request failed. The requested key or certificate is not available, slot is empty.
        KEYM_E_KEY_CERT_INVALID: error-code=6  # The service request failed. Key or certificate is invalid and cannot be used for the operation.
    KeyMCertificateElement_Ssa_TrustModelEcuCert_subject_005  # Service of the certificate sub module to access certificate elements.
      operation CertificateElementGet: possible-error=[KeyMCertificateElement_Ssa_TrustModelEcuCert_subject_005/E_NOT_OK, KeyMCertificateElement_Ssa_TrustModelEcuCert_subject_005/KEYM_E_KEY_CERT_SIZE_MISMATCH, KeyMCertificateElement_Ssa_TrustModelEcuCert_subject_005/KEYM_E_PARAMETER_MISMATCH, KeyMCertificateElement_Ssa_TrustModelEcuCert_subject_005/KEYM_E_KEY_CERT_INVALID, KeyMCertificateElement_Ssa_TrustModelEcuCert_subject_005/KEYM_E_KEY_CERT_EMPTY]  # Provides the content of a specific certificate element. The certificate configuration defines how the certificate submodule can find the element, e.g. by providing the object identifier (OID). This function is used to retrieve this information if only one element is assigned to the respective OID.
        arg CertificateElementData: type=KeyM_CertificateElementType_Ssa_TrustModelEcuCert_subject_005, direction=OUT, server-argument-impl-policy=USE-ARRAY-BASE-TYPE  # Holds a pointer to the memory location which will hold the certificate element.
        arg CertificateDataLength: type=uint32, direction=OUT  # Contains the length in bytes of certificate element.
      operation CertificateElementGetByIndex: possible-error=[KeyMCertificateElement_Ssa_TrustModelEcuCert_subject_005/E_NOT_OK, KeyMCertificateElement_Ssa_TrustModelEcuCert_subject_005/KEYM_E_KEY_CERT_SIZE_MISMATCH, KeyMCertificateElement_Ssa_TrustModelEcuCert_subject_005/KEYM_E_PARAMETER_MISMATCH, KeyMCertificateElement_Ssa_TrustModelEcuCert_subject_005/KEYM_E_KEY_CERT_INVALID, KeyMCertificateElement_Ssa_TrustModelEcuCert_subject_005/KEYM_E_KEY_CERT_EMPTY]  # This operation provides data from a specific certificate element.
        arg Index: type=uint16, direction=IN  # This is the index to dedicated element in the list
        arg CertificateElementData: type=KeyM_CertificateElementType_Ssa_TrustModelEcuCert_subject_005, direction=OUT, server-argument-impl-policy=USE-ARRAY-BASE-TYPE  # Holds a pointer to the memory location which will hold the certificate element.
        arg CertificateDataLength: type=uint32, direction=OUT  # Contains the length in bytes of certificate element.
      operation CertificateElementGetCount: possible-error=[KeyMCertificateElement_Ssa_TrustModelEcuCert_subject_005/E_NOT_OK, KeyMCertificateElement_Ssa_TrustModelEcuCert_subject_005/KEYM_E_KEY_CERT_SIZE_MISMATCH, KeyMCertificateElement_Ssa_TrustModelEcuCert_subject_005/KEYM_E_PARAMETER_MISMATCH, KeyMCertificateElement_Ssa_TrustModelEcuCert_subject_005/KEYM_E_KEY_CERT_INVALID, KeyMCertificateElement_Ssa_TrustModelEcuCert_subject_005/KEYM_E_KEY_CERT_EMPTY]  # This operation returns the amount of items available for a certificate element.
        arg count: type=uint16, direction=OUT  # Number of items available for an element.
      5 x error:
        E_NOT_OK: error-code=1  # The service request failed.
        KEYM_E_KEY_CERT_SIZE_MISMATCH: error-code=4  # The service request failed. Parameter size does not match the expected value.
        KEYM_E_PARAMETER_MISMATCH: error-code=5  # The service request failed. Parameter to function does not provide the expected value.
        KEYM_E_KEY_CERT_EMPTY: error-code=10  # The service request failed. The requested key or certificate is not available, slot is empty.
        KEYM_E_KEY_CERT_INVALID: error-code=6  # The service request failed. Key or certificate is invalid and cannot be used for the operation.
    KeyMCertificateElement_Ssa_TrustModelEcuCert_SubjectPublicKeyInfoAlgo_005  # Service of the certificate sub module to access certificate elements.
      operation CertificateElementGet: possible-error=[KeyMCertificateElement_Ssa_TrustModelEcuCert_SubjectPublicKeyInfoAlgo_005/E_NOT_OK, KeyMCertificateElement_Ssa_TrustModelEcuCert_SubjectPublicKeyInfoAlgo_005/KEYM_E_KEY_CERT_SIZE_MISMATCH, KeyMCertificateElement_Ssa_TrustModelEcuCert_SubjectPublicKeyInfoAlgo_005/KEYM_E_PARAMETER_MISMATCH, KeyMCertificateElement_Ssa_TrustModelEcuCert_SubjectPublicKeyInfoAlgo_005/KEYM_E_KEY_CERT_INVALID, KeyMCertificateElement_Ssa_TrustModelEcuCert_SubjectPublicKeyInfoAlgo_005/KEYM_E_KEY_CERT_EMPTY]  # Provides the content of a specific certificate element. The certificate configuration defines how the certificate submodule can find the element, e.g. by providing the object identifier (OID). This function is used to retrieve this information if only one element is assigned to the respective OID.
        arg CertificateElementData: type=KeyM_CertificateElementType_Ssa_TrustModelEcuCert_SubjectPublicKeyInfoAlgo_005, direction=OUT, server-argument-impl-policy=USE-ARRAY-BASE-TYPE  # Holds a pointer to the memory location which will hold the certificate element.
        arg CertificateDataLength: type=uint32, direction=OUT  # Contains the length in bytes of certificate element.
      operation CertificateElementGetByIndex: possible-error=[KeyMCertificateElement_Ssa_TrustModelEcuCert_SubjectPublicKeyInfoAlgo_005/E_NOT_OK, KeyMCertificateElement_Ssa_TrustModelEcuCert_SubjectPublicKeyInfoAlgo_005/KEYM_E_KEY_CERT_SIZE_MISMATCH, KeyMCertificateElement_Ssa_TrustModelEcuCert_SubjectPublicKeyInfoAlgo_005/KEYM_E_PARAMETER_MISMATCH, KeyMCertificateElement_Ssa_TrustModelEcuCert_SubjectPublicKeyInfoAlgo_005/KEYM_E_KEY_CERT_INVALID, KeyMCertificateElement_Ssa_TrustModelEcuCert_SubjectPublicKeyInfoAlgo_005/KEYM_E_KEY_CERT_EMPTY]  # This operation provides data from a specific certificate element.
        arg Index: type=uint16, direction=IN  # This is the index to dedicated element in the list
        arg CertificateElementData: type=KeyM_CertificateElementType_Ssa_TrustModelEcuCert_SubjectPublicKeyInfoAlgo_005, direction=OUT, server-argument-impl-policy=USE-ARRAY-BASE-TYPE  # Holds a pointer to the memory location which will hold the certificate element.
        arg CertificateDataLength: type=uint32, direction=OUT  # Contains the length in bytes of certificate element.
      operation CertificateElementGetCount: possible-error=[KeyMCertificateElement_Ssa_TrustModelEcuCert_SubjectPublicKeyInfoAlgo_005/E_NOT_OK, KeyMCertificateElement_Ssa_TrustModelEcuCert_SubjectPublicKeyInfoAlgo_005/KEYM_E_KEY_CERT_SIZE_MISMATCH, KeyMCertificateElement_Ssa_TrustModelEcuCert_SubjectPublicKeyInfoAlgo_005/KEYM_E_PARAMETER_MISMATCH, KeyMCertificateElement_Ssa_TrustModelEcuCert_SubjectPublicKeyInfoAlgo_005/KEYM_E_KEY_CERT_INVALID, KeyMCertificateElement_Ssa_TrustModelEcuCert_SubjectPublicKeyInfoAlgo_005/KEYM_E_KEY_CERT_EMPTY]  # This operation returns the amount of items available for a certificate element.
        arg count: type=uint16, direction=OUT  # Number of items available for an element.
      5 x error:
        E_NOT_OK: error-code=1  # The service request failed.
        KEYM_E_KEY_CERT_SIZE_MISMATCH: error-code=4  # The service request failed. Parameter size does not match the expected value.
        KEYM_E_PARAMETER_MISMATCH: error-code=5  # The service request failed. Parameter to function does not provide the expected value.
        KEYM_E_KEY_CERT_EMPTY: error-code=10  # The service request failed. The requested key or certificate is not available, slot is empty.
        KEYM_E_KEY_CERT_INVALID: error-code=6  # The service request failed. Key or certificate is invalid and cannot be used for the operation.
    KeyMCertificateElement_Ssa_TrustModelEcuCert_SubjectPublicKeyInfoKey_005  # Service of the certificate sub module to access certificate elements.
      operation CertificateElementGet: possible-error=[KeyMCertificateElement_Ssa_TrustModelEcuCert_SubjectPublicKeyInfoKey_005/E_NOT_OK, KeyMCertificateElement_Ssa_TrustModelEcuCert_SubjectPublicKeyInfoKey_005/KEYM_E_KEY_CERT_SIZE_MISMATCH, KeyMCertificateElement_Ssa_TrustModelEcuCert_SubjectPublicKeyInfoKey_005/KEYM_E_PARAMETER_MISMATCH, KeyMCertificateElement_Ssa_TrustModelEcuCert_SubjectPublicKeyInfoKey_005/KEYM_E_KEY_CERT_INVALID, KeyMCertificateElement_Ssa_TrustModelEcuCert_SubjectPublicKeyInfoKey_005/KEYM_E_KEY_CERT_EMPTY]  # Provides the content of a specific certificate element. The certificate configuration defines how the certificate submodule can find the element, e.g. by providing the object identifier (OID). This function is used to retrieve this information if only one element is assigned to the respective OID.
        arg CertificateElementData: type=KeyM_CertificateElementType_Ssa_TrustModelEcuCert_SubjectPublicKeyInfoKey_005, direction=OUT, server-argument-impl-policy=USE-ARRAY-BASE-TYPE  # Holds a pointer to the memory location which will hold the certificate element.
        arg CertificateDataLength: type=uint32, direction=OUT  # Contains the length in bytes of certificate element.
      operation CertificateElementGetByIndex: possible-error=[KeyMCertificateElement_Ssa_TrustModelEcuCert_SubjectPublicKeyInfoKey_005/E_NOT_OK, KeyMCertificateElement_Ssa_TrustModelEcuCert_SubjectPublicKeyInfoKey_005/KEYM_E_KEY_CERT_SIZE_MISMATCH, KeyMCertificateElement_Ssa_TrustModelEcuCert_SubjectPublicKeyInfoKey_005/KEYM_E_PARAMETER_MISMATCH, KeyMCertificateElement_Ssa_TrustModelEcuCert_SubjectPublicKeyInfoKey_005/KEYM_E_KEY_CERT_INVALID, KeyMCertificateElement_Ssa_TrustModelEcuCert_SubjectPublicKeyInfoKey_005/KEYM_E_KEY_CERT_EMPTY]  # This operation provides data from a specific certificate element.
        arg Index: type=uint16, direction=IN  # This is the index to dedicated element in the list
        arg CertificateElementData: type=KeyM_CertificateElementType_Ssa_TrustModelEcuCert_SubjectPublicKeyInfoKey_005, direction=OUT, server-argument-impl-policy=USE-ARRAY-BASE-TYPE  # Holds a pointer to the memory location which will hold the certificate element.
        arg CertificateDataLength: type=uint32, direction=OUT  # Contains the length in bytes of certificate element.
      operation CertificateElementGetCount: possible-error=[KeyMCertificateElement_Ssa_TrustModelEcuCert_SubjectPublicKeyInfoKey_005/E_NOT_OK, KeyMCertificateElement_Ssa_TrustModelEcuCert_SubjectPublicKeyInfoKey_005/KEYM_E_KEY_CERT_SIZE_MISMATCH, KeyMCertificateElement_Ssa_TrustModelEcuCert_SubjectPublicKeyInfoKey_005/KEYM_E_PARAMETER_MISMATCH, KeyMCertificateElement_Ssa_TrustModelEcuCert_SubjectPublicKeyInfoKey_005/KEYM_E_KEY_CERT_INVALID, KeyMCertificateElement_Ssa_TrustModelEcuCert_SubjectPublicKeyInfoKey_005/KEYM_E_KEY_CERT_EMPTY]  # This operation returns the amount of items available for a certificate element.
        arg count: type=uint16, direction=OUT  # Number of items available for an element.
      5 x error:
        E_NOT_OK: error-code=1  # The service request failed.
        KEYM_E_KEY_CERT_SIZE_MISMATCH: error-code=4  # The service request failed. Parameter size does not match the expected value.
        KEYM_E_PARAMETER_MISMATCH: error-code=5  # The service request failed. Parameter to function does not provide the expected value.
        KEYM_E_KEY_CERT_EMPTY: error-code=10  # The service request failed. The requested key or certificate is not available, slot is empty.
        KEYM_E_KEY_CERT_INVALID: error-code=6  # The service request failed. Key or certificate is invalid and cannot be used for the operation.
    KeyMCertificateElement_Ssa_TrustModelEcuCert_Issuer_005  # Service of the certificate sub module to access certificate elements.
      operation CertificateElementGet: possible-error=[KeyMCertificateElement_Ssa_TrustModelEcuCert_Issuer_005/E_NOT_OK, KeyMCertificateElement_Ssa_TrustModelEcuCert_Issuer_005/KEYM_E_KEY_CERT_SIZE_MISMATCH, KeyMCertificateElement_Ssa_TrustModelEcuCert_Issuer_005/KEYM_E_PARAMETER_MISMATCH, KeyMCertificateElement_Ssa_TrustModelEcuCert_Issuer_005/KEYM_E_KEY_CERT_INVALID, KeyMCertificateElement_Ssa_TrustModelEcuCert_Issuer_005/KEYM_E_KEY_CERT_EMPTY]  # Provides the content of a specific certificate element. The certificate configuration defines how the certificate submodule can find the element, e.g. by providing the object identifier (OID). This function is used to retrieve this information if only one element is assigned to the respective OID.
        arg CertificateElementData: type=KeyM_CertificateElementType_Ssa_TrustModelEcuCert_Issuer_005, direction=OUT, server-argument-impl-policy=USE-ARRAY-BASE-TYPE  # Holds a pointer to the memory location which will hold the certificate element.
        arg CertificateDataLength: type=uint32, direction=OUT  # Contains the length in bytes of certificate element.
      operation CertificateElementGetByIndex: possible-error=[KeyMCertificateElement_Ssa_TrustModelEcuCert_Issuer_005/E_NOT_OK, KeyMCertificateElement_Ssa_TrustModelEcuCert_Issuer_005/KEYM_E_KEY_CERT_SIZE_MISMATCH, KeyMCertificateElement_Ssa_TrustModelEcuCert_Issuer_005/KEYM_E_PARAMETER_MISMATCH, KeyMCertificateElement_Ssa_TrustModelEcuCert_Issuer_005/KEYM_E_KEY_CERT_INVALID, KeyMCertificateElement_Ssa_TrustModelEcuCert_Issuer_005/KEYM_E_KEY_CERT_EMPTY]  # This operation provides data from a specific certificate element.
        arg Index: type=uint16, direction=IN  # This is the index to dedicated element in the list
        arg CertificateElementData: type=KeyM_CertificateElementType_Ssa_TrustModelEcuCert_Issuer_005, direction=OUT, server-argument-impl-policy=USE-ARRAY-BASE-TYPE  # Holds a pointer to the memory location which will hold the certificate element.
        arg CertificateDataLength: type=uint32, direction=OUT  # Contains the length in bytes of certificate element.
      operation CertificateElementGetCount: possible-error=[KeyMCertificateElement_Ssa_TrustModelEcuCert_Issuer_005/E_NOT_OK, KeyMCertificateElement_Ssa_TrustModelEcuCert_Issuer_005/KEYM_E_KEY_CERT_SIZE_MISMATCH, KeyMCertificateElement_Ssa_TrustModelEcuCert_Issuer_005/KEYM_E_PARAMETER_MISMATCH, KeyMCertificateElement_Ssa_TrustModelEcuCert_Issuer_005/KEYM_E_KEY_CERT_INVALID, KeyMCertificateElement_Ssa_TrustModelEcuCert_Issuer_005/KEYM_E_KEY_CERT_EMPTY]  # This operation returns the amount of items available for a certificate element.
        arg count: type=uint16, direction=OUT  # Number of items available for an element.
      5 x error:
        E_NOT_OK: error-code=1  # The service request failed.
        KEYM_E_KEY_CERT_SIZE_MISMATCH: error-code=4  # The service request failed. Parameter size does not match the expected value.
        KEYM_E_PARAMETER_MISMATCH: error-code=5  # The service request failed. Parameter to function does not provide the expected value.
        KEYM_E_KEY_CERT_EMPTY: error-code=10  # The service request failed. The requested key or certificate is not available, slot is empty.
        KEYM_E_KEY_CERT_INVALID: error-code=6  # The service request failed. Key or certificate is invalid and cannot be used for the operation.
    KeyMCertificateElement_Ssa_TrustModelEcuCert_signatureAlgorithm_005  # Service of the certificate sub module to access certificate elements.
      operation CertificateElementGet: possible-error=[KeyMCertificateElement_Ssa_TrustModelEcuCert_signatureAlgorithm_005/E_NOT_OK, KeyMCertificateElement_Ssa_TrustModelEcuCert_signatureAlgorithm_005/KEYM_E_KEY_CERT_SIZE_MISMATCH, KeyMCertificateElement_Ssa_TrustModelEcuCert_signatureAlgorithm_005/KEYM_E_PARAMETER_MISMATCH, KeyMCertificateElement_Ssa_TrustModelEcuCert_signatureAlgorithm_005/KEYM_E_KEY_CERT_INVALID, KeyMCertificateElement_Ssa_TrustModelEcuCert_signatureAlgorithm_005/KEYM_E_KEY_CERT_EMPTY]  # Provides the content of a specific certificate element. The certificate configuration defines how the certificate submodule can find the element, e.g. by providing the object identifier (OID). This function is used to retrieve this information if only one element is assigned to the respective OID.
        arg CertificateElementData: type=KeyM_CertificateElementType_Ssa_TrustModelEcuCert_signatureAlgorithm_005, direction=OUT, server-argument-impl-policy=USE-ARRAY-BASE-TYPE  # Holds a pointer to the memory location which will hold the certificate element.
        arg CertificateDataLength: type=uint32, direction=OUT  # Contains the length in bytes of certificate element.
      operation CertificateElementGetByIndex: possible-error=[KeyMCertificateElement_Ssa_TrustModelEcuCert_signatureAlgorithm_005/E_NOT_OK, KeyMCertificateElement_Ssa_TrustModelEcuCert_signatureAlgorithm_005/KEYM_E_KEY_CERT_SIZE_MISMATCH, KeyMCertificateElement_Ssa_TrustModelEcuCert_signatureAlgorithm_005/KEYM_E_PARAMETER_MISMATCH, KeyMCertificateElement_Ssa_TrustModelEcuCert_signatureAlgorithm_005/KEYM_E_KEY_CERT_INVALID, KeyMCertificateElement_Ssa_TrustModelEcuCert_signatureAlgorithm_005/KEYM_E_KEY_CERT_EMPTY]  # This operation provides data from a specific certificate element.
        arg Index: type=uint16, direction=IN  # This is the index to dedicated element in the list
        arg CertificateElementData: type=KeyM_CertificateElementType_Ssa_TrustModelEcuCert_signatureAlgorithm_005, direction=OUT, server-argument-impl-policy=USE-ARRAY-BASE-TYPE  # Holds a pointer to the memory location which will hold the certificate element.
        arg CertificateDataLength: type=uint32, direction=OUT  # Contains the length in bytes of certificate element.
      operation CertificateElementGetCount: possible-error=[KeyMCertificateElement_Ssa_TrustModelEcuCert_signatureAlgorithm_005/E_NOT_OK, KeyMCertificateElement_Ssa_TrustModelEcuCert_signatureAlgorithm_005/KEYM_E_KEY_CERT_SIZE_MISMATCH, KeyMCertificateElement_Ssa_TrustModelEcuCert_signatureAlgorithm_005/KEYM_E_PARAMETER_MISMATCH, KeyMCertificateElement_Ssa_TrustModelEcuCert_signatureAlgorithm_005/KEYM_E_KEY_CERT_INVALID, KeyMCertificateElement_Ssa_TrustModelEcuCert_signatureAlgorithm_005/KEYM_E_KEY_CERT_EMPTY]  # This operation returns the amount of items available for a certificate element.
        arg count: type=uint16, direction=OUT  # Number of items available for an element.
      5 x error:
        E_NOT_OK: error-code=1  # The service request failed.
        KEYM_E_KEY_CERT_SIZE_MISMATCH: error-code=4  # The service request failed. Parameter size does not match the expected value.
        KEYM_E_PARAMETER_MISMATCH: error-code=5  # The service request failed. Parameter to function does not provide the expected value.
        KEYM_E_KEY_CERT_EMPTY: error-code=10  # The service request failed. The requested key or certificate is not available, slot is empty.
        KEYM_E_KEY_CERT_INVALID: error-code=6  # The service request failed. Key or certificate is invalid and cannot be used for the operation.
    KeyMCertificateElement_Ssa_TrustModelEcuCert_signatureValue_005  # Service of the certificate sub module to access certificate elements.
      operation CertificateElementGet: possible-error=[KeyMCertificateElement_Ssa_TrustModelEcuCert_signatureValue_005/E_NOT_OK, KeyMCertificateElement_Ssa_TrustModelEcuCert_signatureValue_005/KEYM_E_KEY_CERT_SIZE_MISMATCH, KeyMCertificateElement_Ssa_TrustModelEcuCert_signatureValue_005/KEYM_E_PARAMETER_MISMATCH, KeyMCertificateElement_Ssa_TrustModelEcuCert_signatureValue_005/KEYM_E_KEY_CERT_INVALID, KeyMCertificateElement_Ssa_TrustModelEcuCert_signatureValue_005/KEYM_E_KEY_CERT_EMPTY]  # Provides the content of a specific certificate element. The certificate configuration defines how the certificate submodule can find the element, e.g. by providing the object identifier (OID). This function is used to retrieve this information if only one element is assigned to the respective OID.
        arg CertificateElementData: type=KeyM_CertificateElementType_Ssa_TrustModelEcuCert_signatureValue_005, direction=OUT, server-argument-impl-policy=USE-ARRAY-BASE-TYPE  # Holds a pointer to the memory location which will hold the certificate element.
        arg CertificateDataLength: type=uint32, direction=OUT  # Contains the length in bytes of certificate element.
      operation CertificateElementGetByIndex: possible-error=[KeyMCertificateElement_Ssa_TrustModelEcuCert_signatureValue_005/E_NOT_OK, KeyMCertificateElement_Ssa_TrustModelEcuCert_signatureValue_005/KEYM_E_KEY_CERT_SIZE_MISMATCH, KeyMCertificateElement_Ssa_TrustModelEcuCert_signatureValue_005/KEYM_E_PARAMETER_MISMATCH, KeyMCertificateElement_Ssa_TrustModelEcuCert_signatureValue_005/KEYM_E_KEY_CERT_INVALID, KeyMCertificateElement_Ssa_TrustModelEcuCert_signatureValue_005/KEYM_E_KEY_CERT_EMPTY]  # This operation provides data from a specific certificate element.
        arg Index: type=uint16, direction=IN  # This is the index to dedicated element in the list
        arg CertificateElementData: type=KeyM_CertificateElementType_Ssa_TrustModelEcuCert_signatureValue_005, direction=OUT, server-argument-impl-policy=USE-ARRAY-BASE-TYPE  # Holds a pointer to the memory location which will hold the certificate element.
        arg CertificateDataLength: type=uint32, direction=OUT  # Contains the length in bytes of certificate element.
      operation CertificateElementGetCount: possible-error=[KeyMCertificateElement_Ssa_TrustModelEcuCert_signatureValue_005/E_NOT_OK, KeyMCertificateElement_Ssa_TrustModelEcuCert_signatureValue_005/KEYM_E_KEY_CERT_SIZE_MISMATCH, KeyMCertificateElement_Ssa_TrustModelEcuCert_signatureValue_005/KEYM_E_PARAMETER_MISMATCH, KeyMCertificateElement_Ssa_TrustModelEcuCert_signatureValue_005/KEYM_E_KEY_CERT_INVALID, KeyMCertificateElement_Ssa_TrustModelEcuCert_signatureValue_005/KEYM_E_KEY_CERT_EMPTY]  # This operation returns the amount of items available for a certificate element.
        arg count: type=uint16, direction=OUT  # Number of items available for an element.
      5 x error:
        E_NOT_OK: error-code=1  # The service request failed.
        KEYM_E_KEY_CERT_SIZE_MISMATCH: error-code=4  # The service request failed. Parameter size does not match the expected value.
        KEYM_E_PARAMETER_MISMATCH: error-code=5  # The service request failed. Parameter to function does not provide the expected value.
        KEYM_E_KEY_CERT_EMPTY: error-code=10  # The service request failed. The requested key or certificate is not available, slot is empty.
        KEYM_E_KEY_CERT_INVALID: error-code=6  # The service request failed. Key or certificate is invalid and cannot be used for the operation.
    KeyMCertificateElement_Ssa_TrustModelEcuCert_ext_uniqueECUID_005  # Service of the certificate sub module to access certificate elements.
      operation CertificateElementGet: possible-error=[KeyMCertificateElement_Ssa_TrustModelEcuCert_ext_uniqueECUID_005/E_NOT_OK, KeyMCertificateElement_Ssa_TrustModelEcuCert_ext_uniqueECUID_005/KEYM_E_KEY_CERT_SIZE_MISMATCH, KeyMCertificateElement_Ssa_TrustModelEcuCert_ext_uniqueECUID_005/KEYM_E_PARAMETER_MISMATCH, KeyMCertificateElement_Ssa_TrustModelEcuCert_ext_uniqueECUID_005/KEYM_E_KEY_CERT_INVALID, KeyMCertificateElement_Ssa_TrustModelEcuCert_ext_uniqueECUID_005/KEYM_E_KEY_CERT_EMPTY]  # Provides the content of a specific certificate element. The certificate configuration defines how the certificate submodule can find the element, e.g. by providing the object identifier (OID). This function is used to retrieve this information if only one element is assigned to the respective OID.
        arg CertificateElementData: type=KeyM_CertificateElementType_Ssa_TrustModelEcuCert_ext_uniqueECUID_005, direction=OUT, server-argument-impl-policy=USE-ARRAY-BASE-TYPE  # Holds a pointer to the memory location which will hold the certificate element.
        arg CertificateDataLength: type=uint32, direction=OUT  # Contains the length in bytes of certificate element.
      operation CertificateElementGetByIndex: possible-error=[KeyMCertificateElement_Ssa_TrustModelEcuCert_ext_uniqueECUID_005/E_NOT_OK, KeyMCertificateElement_Ssa_TrustModelEcuCert_ext_uniqueECUID_005/KEYM_E_KEY_CERT_SIZE_MISMATCH, KeyMCertificateElement_Ssa_TrustModelEcuCert_ext_uniqueECUID_005/KEYM_E_PARAMETER_MISMATCH, KeyMCertificateElement_Ssa_TrustModelEcuCert_ext_uniqueECUID_005/KEYM_E_KEY_CERT_INVALID, KeyMCertificateElement_Ssa_TrustModelEcuCert_ext_uniqueECUID_005/KEYM_E_KEY_CERT_EMPTY]  # This operation provides data from a specific certificate element.
        arg Index: type=uint16, direction=IN  # This is the index to dedicated element in the list
        arg CertificateElementData: type=KeyM_CertificateElementType_Ssa_TrustModelEcuCert_ext_uniqueECUID_005, direction=OUT, server-argument-impl-policy=USE-ARRAY-BASE-TYPE  # Holds a pointer to the memory location which will hold the certificate element.
        arg CertificateDataLength: type=uint32, direction=OUT  # Contains the length in bytes of certificate element.
      operation CertificateElementGetCount: possible-error=[KeyMCertificateElement_Ssa_TrustModelEcuCert_ext_uniqueECUID_005/E_NOT_OK, KeyMCertificateElement_Ssa_TrustModelEcuCert_ext_uniqueECUID_005/KEYM_E_KEY_CERT_SIZE_MISMATCH, KeyMCertificateElement_Ssa_TrustModelEcuCert_ext_uniqueECUID_005/KEYM_E_PARAMETER_MISMATCH, KeyMCertificateElement_Ssa_TrustModelEcuCert_ext_uniqueECUID_005/KEYM_E_KEY_CERT_INVALID, KeyMCertificateElement_Ssa_TrustModelEcuCert_ext_uniqueECUID_005/KEYM_E_KEY_CERT_EMPTY]  # This operation returns the amount of items available for a certificate element.
        arg count: type=uint16, direction=OUT  # Number of items available for an element.
      5 x error:
        E_NOT_OK: error-code=1  # The service request failed.
        KEYM_E_KEY_CERT_SIZE_MISMATCH: error-code=4  # The service request failed. Parameter size does not match the expected value.
        KEYM_E_PARAMETER_MISMATCH: error-code=5  # The service request failed. Parameter to function does not provide the expected value.
        KEYM_E_KEY_CERT_EMPTY: error-code=10  # The service request failed. The requested key or certificate is not available, slot is empty.
        KEYM_E_KEY_CERT_INVALID: error-code=6  # The service request failed. Key or certificate is invalid and cannot be used for the operation.
    KeyMCertificateElement_Ssa_TrustModelEcuCert_ext_specialEcu_005  # Service of the certificate sub module to access certificate elements.
      operation CertificateElementGet: possible-error=[KeyMCertificateElement_Ssa_TrustModelEcuCert_ext_specialEcu_005/E_NOT_OK, KeyMCertificateElement_Ssa_TrustModelEcuCert_ext_specialEcu_005/KEYM_E_KEY_CERT_SIZE_MISMATCH, KeyMCertificateElement_Ssa_TrustModelEcuCert_ext_specialEcu_005/KEYM_E_PARAMETER_MISMATCH, KeyMCertificateElement_Ssa_TrustModelEcuCert_ext_specialEcu_005/KEYM_E_KEY_CERT_INVALID, KeyMCertificateElement_Ssa_TrustModelEcuCert_ext_specialEcu_005/KEYM_E_KEY_CERT_EMPTY]  # Provides the content of a specific certificate element. The certificate configuration defines how the certificate submodule can find the element, e.g. by providing the object identifier (OID). This function is used to retrieve this information if only one element is assigned to the respective OID.
        arg CertificateElementData: type=KeyM_CertificateElementType_Ssa_TrustModelEcuCert_ext_specialEcu_005, direction=OUT, server-argument-impl-policy=USE-ARRAY-BASE-TYPE  # Holds a pointer to the memory location which will hold the certificate element.
        arg CertificateDataLength: type=uint32, direction=OUT  # Contains the length in bytes of certificate element.
      operation CertificateElementGetByIndex: possible-error=[KeyMCertificateElement_Ssa_TrustModelEcuCert_ext_specialEcu_005/E_NOT_OK, KeyMCertificateElement_Ssa_TrustModelEcuCert_ext_specialEcu_005/KEYM_E_KEY_CERT_SIZE_MISMATCH, KeyMCertificateElement_Ssa_TrustModelEcuCert_ext_specialEcu_005/KEYM_E_PARAMETER_MISMATCH, KeyMCertificateElement_Ssa_TrustModelEcuCert_ext_specialEcu_005/KEYM_E_KEY_CERT_INVALID, KeyMCertificateElement_Ssa_TrustModelEcuCert_ext_specialEcu_005/KEYM_E_KEY_CERT_EMPTY]  # This operation provides data from a specific certificate element.
        arg Index: type=uint16, direction=IN  # This is the index to dedicated element in the list
        arg CertificateElementData: type=KeyM_CertificateElementType_Ssa_TrustModelEcuCert_ext_specialEcu_005, direction=OUT, server-argument-impl-policy=USE-ARRAY-BASE-TYPE  # Holds a pointer to the memory location which will hold the certificate element.
        arg CertificateDataLength: type=uint32, direction=OUT  # Contains the length in bytes of certificate element.
      operation CertificateElementGetCount: possible-error=[KeyMCertificateElement_Ssa_TrustModelEcuCert_ext_specialEcu_005/E_NOT_OK, KeyMCertificateElement_Ssa_TrustModelEcuCert_ext_specialEcu_005/KEYM_E_KEY_CERT_SIZE_MISMATCH, KeyMCertificateElement_Ssa_TrustModelEcuCert_ext_specialEcu_005/KEYM_E_PARAMETER_MISMATCH, KeyMCertificateElement_Ssa_TrustModelEcuCert_ext_specialEcu_005/KEYM_E_KEY_CERT_INVALID, KeyMCertificateElement_Ssa_TrustModelEcuCert_ext_specialEcu_005/KEYM_E_KEY_CERT_EMPTY]  # This operation returns the amount of items available for a certificate element.
        arg count: type=uint16, direction=OUT  # Number of items available for an element.
      5 x error:
        E_NOT_OK: error-code=1  # The service request failed.
        KEYM_E_KEY_CERT_SIZE_MISMATCH: error-code=4  # The service request failed. Parameter size does not match the expected value.
        KEYM_E_PARAMETER_MISMATCH: error-code=5  # The service request failed. Parameter to function does not provide the expected value.
        KEYM_E_KEY_CERT_EMPTY: error-code=10  # The service request failed. The requested key or certificate is not available, slot is empty.
        KEYM_E_KEY_CERT_INVALID: error-code=6  # The service request failed. Key or certificate is invalid and cannot be used for the operation.
    KeyMCertificate_Ssa_TrustModelIntermediateCert  # Service of Certificate sub module
      4 x operation:
        GetCertificate: possible-error=[KeyMCertificate_Ssa_TrustModelIntermediateCert/E_NOT_OK, KeyMCertificate_Ssa_TrustModelIntermediateCert/KEYM_E_KEY_CERT_SIZE_MISMATCH, KeyMCertificate_Ssa_TrustModelIntermediateCert/KEYM_E_PARAMETER_MISMATCH, KeyMCertificate_Ssa_TrustModelIntermediateCert/KEYM_E_KEY_CERT_READ_FAIL, KeyMCertificate_Ssa_TrustModelIntermediateCert/KEYM_E_KEY_CERT_EMPTY]  # Read certificate data from the certificate sub module
          arg Certificate: type=KeyM_CertificateType_Ssa_TrustModelIntermediateCert, direction=OUT  # Holds a pointer to the memory location which will hold the Certificate.
        GetStatus: possible-error=KeyMCertificate_Ssa_TrustModelIntermediateCert/E_NOT_OK  # Provides the status of a certificate.
          arg Status: type=KeyM_CertificateStatusType, direction=OUT  # Holds a pointer to the memory location which will hold the Certificate Status.
        SetCertificate: possible-error=[KeyMCertificate_Ssa_TrustModelIntermediateCert/E_NOT_OK, KeyMCertificate_Ssa_TrustModelIntermediateCert/KEYM_E_KEY_CERT_SIZE_MISMATCH, KeyMCertificate_Ssa_TrustModelIntermediateCert/KEYM_E_PARAMETER_MISMATCH, KeyMCertificate_Ssa_TrustModelIntermediateCert/KEYM_E_KEY_CERT_WRITE_FAIL]  # Provides certificate data to be processed by the certificate sub module.
          arg Certificate: type=KeyM_CertificateType_Ssa_TrustModelIntermediateCert, direction=IN  # Holds a pointer to Certificate.
        VerifyCertificate: possible-error=[KeyMCertificate_Ssa_TrustModelIntermediateCert/E_NOT_OK, KeyMCertificate_Ssa_TrustModelIntermediateCert/KEYM_E_BUSY, KeyMCertificate_Ssa_TrustModelIntermediateCert/KEYM_E_KEY_CERT_SIZE_MISMATCH, KeyMCertificate_Ssa_TrustModelIntermediateCert/KEYM_E_PARAMETER_MISMATCH, KeyMCertificate_Ssa_TrustModelIntermediateCert/KEYM_E_KEY_CERT_EMPTY, KeyMCertificate_Ssa_TrustModelIntermediateCert/KEYM_E_CERT_INVALID_CHAIN_OF_TRUST]  # Verify certificate data from the certificate sub module .
      8 x error:
        E_NOT_OK: error-code=1  # The service request failed.
        KEYM_E_BUSY: error-code=2  # The service request failed. Key management is busy with other operations.
        KEYM_E_KEY_CERT_SIZE_MISMATCH: error-code=4  # The service request failed. Parameter size does not match the expected value.
        KEYM_E_PARAMETER_MISMATCH: error-code=5  # The service request failed. Parameter to function does not provide the expected value.
        KEYM_E_KEY_CERT_WRITE_FAIL: error-code=7  # The service request failed. Certificate or key write operation failed.
        KEYM_E_KEY_CERT_READ_FAIL: error-code=9  # The service request failed. Certificate or key could not be provided due to a read or permission failure.
        KEYM_E_KEY_CERT_EMPTY: error-code=10  # The service request failed. The requested key or certificate is not available, slot is empty.
        KEYM_E_CERT_INVALID_CHAIN_OF_TRUST: error-code=11  # The service request failed. Certificate verification failed - Invalid Chain of Trust.
    KeyMCertificateExtended_Ssa_TrustModelIntermediateCert  # Services of Certificate sub module that extend the standard AUTOSAR services
      operation ServiceCertificate: possible-error=[KeyMCertificateExtended_Ssa_TrustModelIntermediateCert/E_NOT_OK, KeyMCertificateExtended_Ssa_TrustModelIntermediateCert/KEYM_E_BUSY, KeyMCertificateExtended_Ssa_TrustModelIntermediateCert/KEYM_E_KEY_CERT_SIZE_MISMATCH, KeyMCertificateExtended_Ssa_TrustModelIntermediateCert/KEYM_E_PARAMETER_MISMATCH, KeyMCertificateExtended_Ssa_TrustModelIntermediateCert/KEYM_E_KEY_CERT_EMPTY, KeyMCertificateExtended_Ssa_TrustModelIntermediateCert/KEYM_E_CERT_INVALID_CHAIN_OF_TRUST]  # Handle certificate operation request in the certificate sub module.
        5 x arg, all with direction=IN:
          Service: type=KeyM_ServiceCertificateType  # Provides the type of service the key manager has to perform.
          RequestData: type=KeyM_ConstDataPtrType  # Information that comes along with the request.
          RequestDataLength: type=uint32  # Length of data in the RequestData array.
          ResponseData: type=KeyM_DataPtrType  # Pointer to array in which the request response data will be stored upon request completion.
          ResponseDataLength: type=uint32  # Max number of bytes available in ResponseDataPtr.
      operation CsrElementSet: possible-error=[KeyMCertificateExtended_Ssa_TrustModelIntermediateCert/E_NOT_OK, KeyMCertificateExtended_Ssa_TrustModelIntermediateCert/KEYM_E_PARAMETER_MISMATCH]  # To be used before calling GenerateCertificationRequestInfo. Adds an data to the certificate for which a signing request shall be build.
        4 x arg, all with direction=IN:
          CertElementId: type=KeyM_CertElementIdType  # Element ID of the element that shall be added
          EncodingType: type=KeyM_CsrEncodingType  # Encoding type of the CSR element
          ElementData: type=KeyM_ConstDataPtrType  # Data of the element that shall be added
          ElementDataLength: type=uint32  # Length of ElementData data in the ElementData array
      6 x error:
        E_NOT_OK: error-code=1  # The service request failed.
        KEYM_E_BUSY: error-code=2  # The service request failed. Key management is busy with other operations.
        KEYM_E_KEY_CERT_SIZE_MISMATCH: error-code=4  # The service request failed. Parameter size does not match the expected value.
        KEYM_E_PARAMETER_MISMATCH: error-code=5  # The service request failed. Parameter to function does not provide the expected value.
        KEYM_E_KEY_CERT_EMPTY: error-code=10  # The service request failed. The requested key or certificate is not available, slot is empty.
        KEYM_E_CERT_INVALID_CHAIN_OF_TRUST: error-code=11  # The service request failed. Certificate verification failed - Invalid Chain of Trust.
    KeyMCertificateElement_Ssa_TrustModelIntermediateCert_ext_authKeyId_003  # Service of the certificate sub module to access certificate elements.
      operation CertificateElementGet: possible-error=[KeyMCertificateElement_Ssa_TrustModelIntermediateCert_ext_authKeyId_003/E_NOT_OK, KeyMCertificateElement_Ssa_TrustModelIntermediateCert_ext_authKeyId_003/KEYM_E_KEY_CERT_SIZE_MISMATCH, KeyMCertificateElement_Ssa_TrustModelIntermediateCert_ext_authKeyId_003/KEYM_E_PARAMETER_MISMATCH, KeyMCertificateElement_Ssa_TrustModelIntermediateCert_ext_authKeyId_003/KEYM_E_KEY_CERT_INVALID, KeyMCertificateElement_Ssa_TrustModelIntermediateCert_ext_authKeyId_003/KEYM_E_KEY_CERT_EMPTY]  # Provides the content of a specific certificate element. The certificate configuration defines how the certificate submodule can find the element, e.g. by providing the object identifier (OID). This function is used to retrieve this information if only one element is assigned to the respective OID.
        arg CertificateElementData: type=KeyM_CertificateElementType_Ssa_TrustModelIntermediateCert_ext_authKeyId_003, direction=OUT, server-argument-impl-policy=USE-ARRAY-BASE-TYPE  # Holds a pointer to the memory location which will hold the certificate element.
        arg CertificateDataLength: type=uint32, direction=OUT  # Contains the length in bytes of certificate element.
      operation CertificateElementGetByIndex: possible-error=[KeyMCertificateElement_Ssa_TrustModelIntermediateCert_ext_authKeyId_003/E_NOT_OK, KeyMCertificateElement_Ssa_TrustModelIntermediateCert_ext_authKeyId_003/KEYM_E_KEY_CERT_SIZE_MISMATCH, KeyMCertificateElement_Ssa_TrustModelIntermediateCert_ext_authKeyId_003/KEYM_E_PARAMETER_MISMATCH, KeyMCertificateElement_Ssa_TrustModelIntermediateCert_ext_authKeyId_003/KEYM_E_KEY_CERT_INVALID, KeyMCertificateElement_Ssa_TrustModelIntermediateCert_ext_authKeyId_003/KEYM_E_KEY_CERT_EMPTY]  # This operation provides data from a specific certificate element.
        arg Index: type=uint16, direction=IN  # This is the index to dedicated element in the list
        arg CertificateElementData: type=KeyM_CertificateElementType_Ssa_TrustModelIntermediateCert_ext_authKeyId_003, direction=OUT, server-argument-impl-policy=USE-ARRAY-BASE-TYPE  # Holds a pointer to the memory location which will hold the certificate element.
        arg CertificateDataLength: type=uint32, direction=OUT  # Contains the length in bytes of certificate element.
      operation CertificateElementGetCount: possible-error=[KeyMCertificateElement_Ssa_TrustModelIntermediateCert_ext_authKeyId_003/E_NOT_OK, KeyMCertificateElement_Ssa_TrustModelIntermediateCert_ext_authKeyId_003/KEYM_E_KEY_CERT_SIZE_MISMATCH, KeyMCertificateElement_Ssa_TrustModelIntermediateCert_ext_authKeyId_003/KEYM_E_PARAMETER_MISMATCH, KeyMCertificateElement_Ssa_TrustModelIntermediateCert_ext_authKeyId_003/KEYM_E_KEY_CERT_INVALID, KeyMCertificateElement_Ssa_TrustModelIntermediateCert_ext_authKeyId_003/KEYM_E_KEY_CERT_EMPTY]  # This operation returns the amount of items available for a certificate element.
        arg count: type=uint16, direction=OUT  # Number of items available for an element.
      5 x error:
        E_NOT_OK: error-code=1  # The service request failed.
        KEYM_E_KEY_CERT_SIZE_MISMATCH: error-code=4  # The service request failed. Parameter size does not match the expected value.
        KEYM_E_PARAMETER_MISMATCH: error-code=5  # The service request failed. Parameter to function does not provide the expected value.
        KEYM_E_KEY_CERT_EMPTY: error-code=10  # The service request failed. The requested key or certificate is not available, slot is empty.
        KEYM_E_KEY_CERT_INVALID: error-code=6  # The service request failed. Key or certificate is invalid and cannot be used for the operation.
    KeyMCertificateElement_Ssa_TrustModelIntermediateCert_ext_subKeyId_003  # Service of the certificate sub module to access certificate elements.
      operation CertificateElementGet: possible-error=[KeyMCertificateElement_Ssa_TrustModelIntermediateCert_ext_subKeyId_003/E_NOT_OK, KeyMCertificateElement_Ssa_TrustModelIntermediateCert_ext_subKeyId_003/KEYM_E_KEY_CERT_SIZE_MISMATCH, KeyMCertificateElement_Ssa_TrustModelIntermediateCert_ext_subKeyId_003/KEYM_E_PARAMETER_MISMATCH, KeyMCertificateElement_Ssa_TrustModelIntermediateCert_ext_subKeyId_003/KEYM_E_KEY_CERT_INVALID, KeyMCertificateElement_Ssa_TrustModelIntermediateCert_ext_subKeyId_003/KEYM_E_KEY_CERT_EMPTY]  # Provides the content of a specific certificate element. The certificate configuration defines how the certificate submodule can find the element, e.g. by providing the object identifier (OID). This function is used to retrieve this information if only one element is assigned to the respective OID.
        arg CertificateElementData: type=KeyM_CertificateElementType_Ssa_TrustModelIntermediateCert_ext_subKeyId_003, direction=OUT, server-argument-impl-policy=USE-ARRAY-BASE-TYPE  # Holds a pointer to the memory location which will hold the certificate element.
        arg CertificateDataLength: type=uint32, direction=OUT  # Contains the length in bytes of certificate element.
      operation CertificateElementGetByIndex: possible-error=[KeyMCertificateElement_Ssa_TrustModelIntermediateCert_ext_subKeyId_003/E_NOT_OK, KeyMCertificateElement_Ssa_TrustModelIntermediateCert_ext_subKeyId_003/KEYM_E_KEY_CERT_SIZE_MISMATCH, KeyMCertificateElement_Ssa_TrustModelIntermediateCert_ext_subKeyId_003/KEYM_E_PARAMETER_MISMATCH, KeyMCertificateElement_Ssa_TrustModelIntermediateCert_ext_subKeyId_003/KEYM_E_KEY_CERT_INVALID, KeyMCertificateElement_Ssa_TrustModelIntermediateCert_ext_subKeyId_003/KEYM_E_KEY_CERT_EMPTY]  # This operation provides data from a specific certificate element.
        arg Index: type=uint16, direction=IN  # This is the index to dedicated element in the list
        arg CertificateElementData: type=KeyM_CertificateElementType_Ssa_TrustModelIntermediateCert_ext_subKeyId_003, direction=OUT, server-argument-impl-policy=USE-ARRAY-BASE-TYPE  # Holds a pointer to the memory location which will hold the certificate element.
        arg CertificateDataLength: type=uint32, direction=OUT  # Contains the length in bytes of certificate element.
      operation CertificateElementGetCount: possible-error=[KeyMCertificateElement_Ssa_TrustModelIntermediateCert_ext_subKeyId_003/E_NOT_OK, KeyMCertificateElement_Ssa_TrustModelIntermediateCert_ext_subKeyId_003/KEYM_E_KEY_CERT_SIZE_MISMATCH, KeyMCertificateElement_Ssa_TrustModelIntermediateCert_ext_subKeyId_003/KEYM_E_PARAMETER_MISMATCH, KeyMCertificateElement_Ssa_TrustModelIntermediateCert_ext_subKeyId_003/KEYM_E_KEY_CERT_INVALID, KeyMCertificateElement_Ssa_TrustModelIntermediateCert_ext_subKeyId_003/KEYM_E_KEY_CERT_EMPTY]  # This operation returns the amount of items available for a certificate element.
        arg count: type=uint16, direction=OUT  # Number of items available for an element.
      5 x error:
        E_NOT_OK: error-code=1  # The service request failed.
        KEYM_E_KEY_CERT_SIZE_MISMATCH: error-code=4  # The service request failed. Parameter size does not match the expected value.
        KEYM_E_PARAMETER_MISMATCH: error-code=5  # The service request failed. Parameter to function does not provide the expected value.
        KEYM_E_KEY_CERT_EMPTY: error-code=10  # The service request failed. The requested key or certificate is not available, slot is empty.
        KEYM_E_KEY_CERT_INVALID: error-code=6  # The service request failed. Key or certificate is invalid and cannot be used for the operation.
    KeyMCertificateElement_Ssa_TrustModelIntermediateCert_ext_basicConstraints_003  # Service of the certificate sub module to access certificate elements.
      operation CertificateElementGet: possible-error=[KeyMCertificateElement_Ssa_TrustModelIntermediateCert_ext_basicConstraints_003/E_NOT_OK, KeyMCertificateElement_Ssa_TrustModelIntermediateCert_ext_basicConstraints_003/KEYM_E_KEY_CERT_SIZE_MISMATCH, KeyMCertificateElement_Ssa_TrustModelIntermediateCert_ext_basicConstraints_003/KEYM_E_PARAMETER_MISMATCH, KeyMCertificateElement_Ssa_TrustModelIntermediateCert_ext_basicConstraints_003/KEYM_E_KEY_CERT_INVALID, KeyMCertificateElement_Ssa_TrustModelIntermediateCert_ext_basicConstraints_003/KEYM_E_KEY_CERT_EMPTY]  # Provides the content of a specific certificate element. The certificate configuration defines how the certificate submodule can find the element, e.g. by providing the object identifier (OID). This function is used to retrieve this information if only one element is assigned to the respective OID.
        arg CertificateElementData: type=KeyM_CertificateElementType_Ssa_TrustModelIntermediateCert_ext_basicConstraints_003, direction=OUT, server-argument-impl-policy=USE-ARRAY-BASE-TYPE  # Holds a pointer to the memory location which will hold the certificate element.
        arg CertificateDataLength: type=uint32, direction=OUT  # Contains the length in bytes of certificate element.
      operation CertificateElementGetByIndex: possible-error=[KeyMCertificateElement_Ssa_TrustModelIntermediateCert_ext_basicConstraints_003/E_NOT_OK, KeyMCertificateElement_Ssa_TrustModelIntermediateCert_ext_basicConstraints_003/KEYM_E_KEY_CERT_SIZE_MISMATCH, KeyMCertificateElement_Ssa_TrustModelIntermediateCert_ext_basicConstraints_003/KEYM_E_PARAMETER_MISMATCH, KeyMCertificateElement_Ssa_TrustModelIntermediateCert_ext_basicConstraints_003/KEYM_E_KEY_CERT_INVALID, KeyMCertificateElement_Ssa_TrustModelIntermediateCert_ext_basicConstraints_003/KEYM_E_KEY_CERT_EMPTY]  # This operation provides data from a specific certificate element.
        arg Index: type=uint16, direction=IN  # This is the index to dedicated element in the list
        arg CertificateElementData: type=KeyM_CertificateElementType_Ssa_TrustModelIntermediateCert_ext_basicConstraints_003, direction=OUT, server-argument-impl-policy=USE-ARRAY-BASE-TYPE  # Holds a pointer to the memory location which will hold the certificate element.
        arg CertificateDataLength: type=uint32, direction=OUT  # Contains the length in bytes of certificate element.
      operation CertificateElementGetCount: possible-error=[KeyMCertificateElement_Ssa_TrustModelIntermediateCert_ext_basicConstraints_003/E_NOT_OK, KeyMCertificateElement_Ssa_TrustModelIntermediateCert_ext_basicConstraints_003/KEYM_E_KEY_CERT_SIZE_MISMATCH, KeyMCertificateElement_Ssa_TrustModelIntermediateCert_ext_basicConstraints_003/KEYM_E_PARAMETER_MISMATCH, KeyMCertificateElement_Ssa_TrustModelIntermediateCert_ext_basicConstraints_003/KEYM_E_KEY_CERT_INVALID, KeyMCertificateElement_Ssa_TrustModelIntermediateCert_ext_basicConstraints_003/KEYM_E_KEY_CERT_EMPTY]  # This operation returns the amount of items available for a certificate element.
        arg count: type=uint16, direction=OUT  # Number of items available for an element.
      5 x error:
        E_NOT_OK: error-code=1  # The service request failed.
        KEYM_E_KEY_CERT_SIZE_MISMATCH: error-code=4  # The service request failed. Parameter size does not match the expected value.
        KEYM_E_PARAMETER_MISMATCH: error-code=5  # The service request failed. Parameter to function does not provide the expected value.
        KEYM_E_KEY_CERT_EMPTY: error-code=10  # The service request failed. The requested key or certificate is not available, slot is empty.
        KEYM_E_KEY_CERT_INVALID: error-code=6  # The service request failed. Key or certificate is invalid and cannot be used for the operation.
    KeyMCertificateElement_Ssa_TrustModelIntermediateCert_ext_keyUsage_003  # Service of the certificate sub module to access certificate elements.
      operation CertificateElementGet: possible-error=[KeyMCertificateElement_Ssa_TrustModelIntermediateCert_ext_keyUsage_003/E_NOT_OK, KeyMCertificateElement_Ssa_TrustModelIntermediateCert_ext_keyUsage_003/KEYM_E_KEY_CERT_SIZE_MISMATCH, KeyMCertificateElement_Ssa_TrustModelIntermediateCert_ext_keyUsage_003/KEYM_E_PARAMETER_MISMATCH, KeyMCertificateElement_Ssa_TrustModelIntermediateCert_ext_keyUsage_003/KEYM_E_KEY_CERT_INVALID, KeyMCertificateElement_Ssa_TrustModelIntermediateCert_ext_keyUsage_003/KEYM_E_KEY_CERT_EMPTY]  # Provides the content of a specific certificate element. The certificate configuration defines how the certificate submodule can find the element, e.g. by providing the object identifier (OID). This function is used to retrieve this information if only one element is assigned to the respective OID.
        arg CertificateElementData: type=KeyM_CertificateElementType_Ssa_TrustModelIntermediateCert_ext_keyUsage_003, direction=OUT, server-argument-impl-policy=USE-ARRAY-BASE-TYPE  # Holds a pointer to the memory location which will hold the certificate element.
        arg CertificateDataLength: type=uint32, direction=OUT  # Contains the length in bytes of certificate element.
      operation CertificateElementGetByIndex: possible-error=[KeyMCertificateElement_Ssa_TrustModelIntermediateCert_ext_keyUsage_003/E_NOT_OK, KeyMCertificateElement_Ssa_TrustModelIntermediateCert_ext_keyUsage_003/KEYM_E_KEY_CERT_SIZE_MISMATCH, KeyMCertificateElement_Ssa_TrustModelIntermediateCert_ext_keyUsage_003/KEYM_E_PARAMETER_MISMATCH, KeyMCertificateElement_Ssa_TrustModelIntermediateCert_ext_keyUsage_003/KEYM_E_KEY_CERT_INVALID, KeyMCertificateElement_Ssa_TrustModelIntermediateCert_ext_keyUsage_003/KEYM_E_KEY_CERT_EMPTY]  # This operation provides data from a specific certificate element.
        arg Index: type=uint16, direction=IN  # This is the index to dedicated element in the list
        arg CertificateElementData: type=KeyM_CertificateElementType_Ssa_TrustModelIntermediateCert_ext_keyUsage_003, direction=OUT, server-argument-impl-policy=USE-ARRAY-BASE-TYPE  # Holds a pointer to the memory location which will hold the certificate element.
        arg CertificateDataLength: type=uint32, direction=OUT  # Contains the length in bytes of certificate element.
      operation CertificateElementGetCount: possible-error=[KeyMCertificateElement_Ssa_TrustModelIntermediateCert_ext_keyUsage_003/E_NOT_OK, KeyMCertificateElement_Ssa_TrustModelIntermediateCert_ext_keyUsage_003/KEYM_E_KEY_CERT_SIZE_MISMATCH, KeyMCertificateElement_Ssa_TrustModelIntermediateCert_ext_keyUsage_003/KEYM_E_PARAMETER_MISMATCH, KeyMCertificateElement_Ssa_TrustModelIntermediateCert_ext_keyUsage_003/KEYM_E_KEY_CERT_INVALID, KeyMCertificateElement_Ssa_TrustModelIntermediateCert_ext_keyUsage_003/KEYM_E_KEY_CERT_EMPTY]  # This operation returns the amount of items available for a certificate element.
        arg count: type=uint16, direction=OUT  # Number of items available for an element.
      5 x error:
        E_NOT_OK: error-code=1  # The service request failed.
        KEYM_E_KEY_CERT_SIZE_MISMATCH: error-code=4  # The service request failed. Parameter size does not match the expected value.
        KEYM_E_PARAMETER_MISMATCH: error-code=5  # The service request failed. Parameter to function does not provide the expected value.
        KEYM_E_KEY_CERT_EMPTY: error-code=10  # The service request failed. The requested key or certificate is not available, slot is empty.
        KEYM_E_KEY_CERT_INVALID: error-code=6  # The service request failed. Key or certificate is invalid and cannot be used for the operation.
    KeyMCertificateElement_Ssa_TrustModelIntermediateCert_ext_pkiRole_003  # Service of the certificate sub module to access certificate elements.
      operation CertificateElementGet: possible-error=[KeyMCertificateElement_Ssa_TrustModelIntermediateCert_ext_pkiRole_003/E_NOT_OK, KeyMCertificateElement_Ssa_TrustModelIntermediateCert_ext_pkiRole_003/KEYM_E_KEY_CERT_SIZE_MISMATCH, KeyMCertificateElement_Ssa_TrustModelIntermediateCert_ext_pkiRole_003/KEYM_E_PARAMETER_MISMATCH, KeyMCertificateElement_Ssa_TrustModelIntermediateCert_ext_pkiRole_003/KEYM_E_KEY_CERT_INVALID, KeyMCertificateElement_Ssa_TrustModelIntermediateCert_ext_pkiRole_003/KEYM_E_KEY_CERT_EMPTY]  # Provides the content of a specific certificate element. The certificate configuration defines how the certificate submodule can find the element, e.g. by providing the object identifier (OID). This function is used to retrieve this information if only one element is assigned to the respective OID.
        arg CertificateElementData: type=KeyM_CertificateElementType_Ssa_TrustModelIntermediateCert_ext_pkiRole_003, direction=OUT, server-argument-impl-policy=USE-ARRAY-BASE-TYPE  # Holds a pointer to the memory location which will hold the certificate element.
        arg CertificateDataLength: type=uint32, direction=OUT  # Contains the length in bytes of certificate element.
      operation CertificateElementGetByIndex: possible-error=[KeyMCertificateElement_Ssa_TrustModelIntermediateCert_ext_pkiRole_003/E_NOT_OK, KeyMCertificateElement_Ssa_TrustModelIntermediateCert_ext_pkiRole_003/KEYM_E_KEY_CERT_SIZE_MISMATCH, KeyMCertificateElement_Ssa_TrustModelIntermediateCert_ext_pkiRole_003/KEYM_E_PARAMETER_MISMATCH, KeyMCertificateElement_Ssa_TrustModelIntermediateCert_ext_pkiRole_003/KEYM_E_KEY_CERT_INVALID, KeyMCertificateElement_Ssa_TrustModelIntermediateCert_ext_pkiRole_003/KEYM_E_KEY_CERT_EMPTY]  # This operation provides data from a specific certificate element.
        arg Index: type=uint16, direction=IN  # This is the index to dedicated element in the list
        arg CertificateElementData: type=KeyM_CertificateElementType_Ssa_TrustModelIntermediateCert_ext_pkiRole_003, direction=OUT, server-argument-impl-policy=USE-ARRAY-BASE-TYPE  # Holds a pointer to the memory location which will hold the certificate element.
        arg CertificateDataLength: type=uint32, direction=OUT  # Contains the length in bytes of certificate element.
      operation CertificateElementGetCount: possible-error=[KeyMCertificateElement_Ssa_TrustModelIntermediateCert_ext_pkiRole_003/E_NOT_OK, KeyMCertificateElement_Ssa_TrustModelIntermediateCert_ext_pkiRole_003/KEYM_E_KEY_CERT_SIZE_MISMATCH, KeyMCertificateElement_Ssa_TrustModelIntermediateCert_ext_pkiRole_003/KEYM_E_PARAMETER_MISMATCH, KeyMCertificateElement_Ssa_TrustModelIntermediateCert_ext_pkiRole_003/KEYM_E_KEY_CERT_INVALID, KeyMCertificateElement_Ssa_TrustModelIntermediateCert_ext_pkiRole_003/KEYM_E_KEY_CERT_EMPTY]  # This operation returns the amount of items available for a certificate element.
        arg count: type=uint16, direction=OUT  # Number of items available for an element.
      5 x error:
        E_NOT_OK: error-code=1  # The service request failed.
        KEYM_E_KEY_CERT_SIZE_MISMATCH: error-code=4  # The service request failed. Parameter size does not match the expected value.
        KEYM_E_PARAMETER_MISMATCH: error-code=5  # The service request failed. Parameter to function does not provide the expected value.
        KEYM_E_KEY_CERT_EMPTY: error-code=10  # The service request failed. The requested key or certificate is not available, slot is empty.
        KEYM_E_KEY_CERT_INVALID: error-code=6  # The service request failed. Key or certificate is invalid and cannot be used for the operation.
    KeyMCertificateElement_Ssa_TrustModelIntermediateCert_Version_003  # Service of the certificate sub module to access certificate elements.
      operation CertificateElementGet: possible-error=[KeyMCertificateElement_Ssa_TrustModelIntermediateCert_Version_003/E_NOT_OK, KeyMCertificateElement_Ssa_TrustModelIntermediateCert_Version_003/KEYM_E_KEY_CERT_SIZE_MISMATCH, KeyMCertificateElement_Ssa_TrustModelIntermediateCert_Version_003/KEYM_E_PARAMETER_MISMATCH, KeyMCertificateElement_Ssa_TrustModelIntermediateCert_Version_003/KEYM_E_KEY_CERT_INVALID, KeyMCertificateElement_Ssa_TrustModelIntermediateCert_Version_003/KEYM_E_KEY_CERT_EMPTY]  # Provides the content of a specific certificate element. The certificate configuration defines how the certificate submodule can find the element, e.g. by providing the object identifier (OID). This function is used to retrieve this information if only one element is assigned to the respective OID.
        arg CertificateElementData: type=KeyM_CertificateElementType_Ssa_TrustModelIntermediateCert_Version_003, direction=OUT, server-argument-impl-policy=USE-ARRAY-BASE-TYPE  # Holds a pointer to the memory location which will hold the certificate element.
        arg CertificateDataLength: type=uint32, direction=OUT  # Contains the length in bytes of certificate element.
      operation CertificateElementGetByIndex: possible-error=[KeyMCertificateElement_Ssa_TrustModelIntermediateCert_Version_003/E_NOT_OK, KeyMCertificateElement_Ssa_TrustModelIntermediateCert_Version_003/KEYM_E_KEY_CERT_SIZE_MISMATCH, KeyMCertificateElement_Ssa_TrustModelIntermediateCert_Version_003/KEYM_E_PARAMETER_MISMATCH, KeyMCertificateElement_Ssa_TrustModelIntermediateCert_Version_003/KEYM_E_KEY_CERT_INVALID, KeyMCertificateElement_Ssa_TrustModelIntermediateCert_Version_003/KEYM_E_KEY_CERT_EMPTY]  # This operation provides data from a specific certificate element.
        arg Index: type=uint16, direction=IN  # This is the index to dedicated element in the list
        arg CertificateElementData: type=KeyM_CertificateElementType_Ssa_TrustModelIntermediateCert_Version_003, direction=OUT, server-argument-impl-policy=USE-ARRAY-BASE-TYPE  # Holds a pointer to the memory location which will hold the certificate element.
        arg CertificateDataLength: type=uint32, direction=OUT  # Contains the length in bytes of certificate element.
      operation CertificateElementGetCount: possible-error=[KeyMCertificateElement_Ssa_TrustModelIntermediateCert_Version_003/E_NOT_OK, KeyMCertificateElement_Ssa_TrustModelIntermediateCert_Version_003/KEYM_E_KEY_CERT_SIZE_MISMATCH, KeyMCertificateElement_Ssa_TrustModelIntermediateCert_Version_003/KEYM_E_PARAMETER_MISMATCH, KeyMCertificateElement_Ssa_TrustModelIntermediateCert_Version_003/KEYM_E_KEY_CERT_INVALID, KeyMCertificateElement_Ssa_TrustModelIntermediateCert_Version_003/KEYM_E_KEY_CERT_EMPTY]  # This operation returns the amount of items available for a certificate element.
        arg count: type=uint16, direction=OUT  # Number of items available for an element.
      5 x error:
        E_NOT_OK: error-code=1  # The service request failed.
        KEYM_E_KEY_CERT_SIZE_MISMATCH: error-code=4  # The service request failed. Parameter size does not match the expected value.
        KEYM_E_PARAMETER_MISMATCH: error-code=5  # The service request failed. Parameter to function does not provide the expected value.
        KEYM_E_KEY_CERT_EMPTY: error-code=10  # The service request failed. The requested key or certificate is not available, slot is empty.
        KEYM_E_KEY_CERT_INVALID: error-code=6  # The service request failed. Key or certificate is invalid and cannot be used for the operation.
    KeyMCertificateElement_Ssa_TrustModelIntermediateCert_SerialNo_003  # Service of the certificate sub module to access certificate elements.
      operation CertificateElementGet: possible-error=[KeyMCertificateElement_Ssa_TrustModelIntermediateCert_SerialNo_003/E_NOT_OK, KeyMCertificateElement_Ssa_TrustModelIntermediateCert_SerialNo_003/KEYM_E_KEY_CERT_SIZE_MISMATCH, KeyMCertificateElement_Ssa_TrustModelIntermediateCert_SerialNo_003/KEYM_E_PARAMETER_MISMATCH, KeyMCertificateElement_Ssa_TrustModelIntermediateCert_SerialNo_003/KEYM_E_KEY_CERT_INVALID, KeyMCertificateElement_Ssa_TrustModelIntermediateCert_SerialNo_003/KEYM_E_KEY_CERT_EMPTY]  # Provides the content of a specific certificate element. The certificate configuration defines how the certificate submodule can find the element, e.g. by providing the object identifier (OID). This function is used to retrieve this information if only one element is assigned to the respective OID.
        arg CertificateElementData: type=KeyM_CertificateElementType_Ssa_TrustModelIntermediateCert_SerialNo_003, direction=OUT, server-argument-impl-policy=USE-ARRAY-BASE-TYPE  # Holds a pointer to the memory location which will hold the certificate element.
        arg CertificateDataLength: type=uint32, direction=OUT  # Contains the length in bytes of certificate element.
      operation CertificateElementGetByIndex: possible-error=[KeyMCertificateElement_Ssa_TrustModelIntermediateCert_SerialNo_003/E_NOT_OK, KeyMCertificateElement_Ssa_TrustModelIntermediateCert_SerialNo_003/KEYM_E_KEY_CERT_SIZE_MISMATCH, KeyMCertificateElement_Ssa_TrustModelIntermediateCert_SerialNo_003/KEYM_E_PARAMETER_MISMATCH, KeyMCertificateElement_Ssa_TrustModelIntermediateCert_SerialNo_003/KEYM_E_KEY_CERT_INVALID, KeyMCertificateElement_Ssa_TrustModelIntermediateCert_SerialNo_003/KEYM_E_KEY_CERT_EMPTY]  # This operation provides data from a specific certificate element.
        arg Index: type=uint16, direction=IN  # This is the index to dedicated element in the list
        arg CertificateElementData: type=KeyM_CertificateElementType_Ssa_TrustModelIntermediateCert_SerialNo_003, direction=OUT, server-argument-impl-policy=USE-ARRAY-BASE-TYPE  # Holds a pointer to the memory location which will hold the certificate element.
        arg CertificateDataLength: type=uint32, direction=OUT  # Contains the length in bytes of certificate element.
      operation CertificateElementGetCount: possible-error=[KeyMCertificateElement_Ssa_TrustModelIntermediateCert_SerialNo_003/E_NOT_OK, KeyMCertificateElement_Ssa_TrustModelIntermediateCert_SerialNo_003/KEYM_E_KEY_CERT_SIZE_MISMATCH, KeyMCertificateElement_Ssa_TrustModelIntermediateCert_SerialNo_003/KEYM_E_PARAMETER_MISMATCH, KeyMCertificateElement_Ssa_TrustModelIntermediateCert_SerialNo_003/KEYM_E_KEY_CERT_INVALID, KeyMCertificateElement_Ssa_TrustModelIntermediateCert_SerialNo_003/KEYM_E_KEY_CERT_EMPTY]  # This operation returns the amount of items available for a certificate element.
        arg count: type=uint16, direction=OUT  # Number of items available for an element.
      5 x error:
        E_NOT_OK: error-code=1  # The service request failed.
        KEYM_E_KEY_CERT_SIZE_MISMATCH: error-code=4  # The service request failed. Parameter size does not match the expected value.
        KEYM_E_PARAMETER_MISMATCH: error-code=5  # The service request failed. Parameter to function does not provide the expected value.
        KEYM_E_KEY_CERT_EMPTY: error-code=10  # The service request failed. The requested key or certificate is not available, slot is empty.
        KEYM_E_KEY_CERT_INVALID: error-code=6  # The service request failed. Key or certificate is invalid and cannot be used for the operation.
    KeyMCertificateElement_Ssa_TrustModelIntermediateCert_SigAlgoId_003  # Service of the certificate sub module to access certificate elements.
      operation CertificateElementGet: possible-error=[KeyMCertificateElement_Ssa_TrustModelIntermediateCert_SigAlgoId_003/E_NOT_OK, KeyMCertificateElement_Ssa_TrustModelIntermediateCert_SigAlgoId_003/KEYM_E_KEY_CERT_SIZE_MISMATCH, KeyMCertificateElement_Ssa_TrustModelIntermediateCert_SigAlgoId_003/KEYM_E_PARAMETER_MISMATCH, KeyMCertificateElement_Ssa_TrustModelIntermediateCert_SigAlgoId_003/KEYM_E_KEY_CERT_INVALID, KeyMCertificateElement_Ssa_TrustModelIntermediateCert_SigAlgoId_003/KEYM_E_KEY_CERT_EMPTY]  # Provides the content of a specific certificate element. The certificate configuration defines how the certificate submodule can find the element, e.g. by providing the object identifier (OID). This function is used to retrieve this information if only one element is assigned to the respective OID.
        arg CertificateElementData: type=KeyM_CertificateElementType_Ssa_TrustModelIntermediateCert_SigAlgoId_003, direction=OUT, server-argument-impl-policy=USE-ARRAY-BASE-TYPE  # Holds a pointer to the memory location which will hold the certificate element.
        arg CertificateDataLength: type=uint32, direction=OUT  # Contains the length in bytes of certificate element.
      operation CertificateElementGetByIndex: possible-error=[KeyMCertificateElement_Ssa_TrustModelIntermediateCert_SigAlgoId_003/E_NOT_OK, KeyMCertificateElement_Ssa_TrustModelIntermediateCert_SigAlgoId_003/KEYM_E_KEY_CERT_SIZE_MISMATCH, KeyMCertificateElement_Ssa_TrustModelIntermediateCert_SigAlgoId_003/KEYM_E_PARAMETER_MISMATCH, KeyMCertificateElement_Ssa_TrustModelIntermediateCert_SigAlgoId_003/KEYM_E_KEY_CERT_INVALID, KeyMCertificateElement_Ssa_TrustModelIntermediateCert_SigAlgoId_003/KEYM_E_KEY_CERT_EMPTY]  # This operation provides data from a specific certificate element.
        arg Index: type=uint16, direction=IN  # This is the index to dedicated element in the list
        arg CertificateElementData: type=KeyM_CertificateElementType_Ssa_TrustModelIntermediateCert_SigAlgoId_003, direction=OUT, server-argument-impl-policy=USE-ARRAY-BASE-TYPE  # Holds a pointer to the memory location which will hold the certificate element.
        arg CertificateDataLength: type=uint32, direction=OUT  # Contains the length in bytes of certificate element.
      operation CertificateElementGetCount: possible-error=[KeyMCertificateElement_Ssa_TrustModelIntermediateCert_SigAlgoId_003/E_NOT_OK, KeyMCertificateElement_Ssa_TrustModelIntermediateCert_SigAlgoId_003/KEYM_E_KEY_CERT_SIZE_MISMATCH, KeyMCertificateElement_Ssa_TrustModelIntermediateCert_SigAlgoId_003/KEYM_E_PARAMETER_MISMATCH, KeyMCertificateElement_Ssa_TrustModelIntermediateCert_SigAlgoId_003/KEYM_E_KEY_CERT_INVALID, KeyMCertificateElement_Ssa_TrustModelIntermediateCert_SigAlgoId_003/KEYM_E_KEY_CERT_EMPTY]  # This operation returns the amount of items available for a certificate element.
        arg count: type=uint16, direction=OUT  # Number of items available for an element.
      5 x error:
        E_NOT_OK: error-code=1  # The service request failed.
        KEYM_E_KEY_CERT_SIZE_MISMATCH: error-code=4  # The service request failed. Parameter size does not match the expected value.
        KEYM_E_PARAMETER_MISMATCH: error-code=5  # The service request failed. Parameter to function does not provide the expected value.
        KEYM_E_KEY_CERT_EMPTY: error-code=10  # The service request failed. The requested key or certificate is not available, slot is empty.
        KEYM_E_KEY_CERT_INVALID: error-code=6  # The service request failed. Key or certificate is invalid and cannot be used for the operation.
    KeyMCertificateElement_Ssa_TrustModelIntermediateCert_validityNotBefore_003  # Service of the certificate sub module to access certificate elements.
      operation CertificateElementGet: possible-error=[KeyMCertificateElement_Ssa_TrustModelIntermediateCert_validityNotBefore_003/E_NOT_OK, KeyMCertificateElement_Ssa_TrustModelIntermediateCert_validityNotBefore_003/KEYM_E_KEY_CERT_SIZE_MISMATCH, KeyMCertificateElement_Ssa_TrustModelIntermediateCert_validityNotBefore_003/KEYM_E_PARAMETER_MISMATCH, KeyMCertificateElement_Ssa_TrustModelIntermediateCert_validityNotBefore_003/KEYM_E_KEY_CERT_INVALID, KeyMCertificateElement_Ssa_TrustModelIntermediateCert_validityNotBefore_003/KEYM_E_KEY_CERT_EMPTY]  # Provides the content of a specific certificate element. The certificate configuration defines how the certificate submodule can find the element, e.g. by providing the object identifier (OID). This function is used to retrieve this information if only one element is assigned to the respective OID.
        arg CertificateElementData: type=KeyM_CertificateElementType_Ssa_TrustModelIntermediateCert_validityNotBefore_003, direction=OUT, server-argument-impl-policy=USE-ARRAY-BASE-TYPE  # Holds a pointer to the memory location which will hold the certificate element.
        arg CertificateDataLength: type=uint32, direction=OUT  # Contains the length in bytes of certificate element.
      operation CertificateElementGetByIndex: possible-error=[KeyMCertificateElement_Ssa_TrustModelIntermediateCert_validityNotBefore_003/E_NOT_OK, KeyMCertificateElement_Ssa_TrustModelIntermediateCert_validityNotBefore_003/KEYM_E_KEY_CERT_SIZE_MISMATCH, KeyMCertificateElement_Ssa_TrustModelIntermediateCert_validityNotBefore_003/KEYM_E_PARAMETER_MISMATCH, KeyMCertificateElement_Ssa_TrustModelIntermediateCert_validityNotBefore_003/KEYM_E_KEY_CERT_INVALID, KeyMCertificateElement_Ssa_TrustModelIntermediateCert_validityNotBefore_003/KEYM_E_KEY_CERT_EMPTY]  # This operation provides data from a specific certificate element.
        arg Index: type=uint16, direction=IN  # This is the index to dedicated element in the list
        arg CertificateElementData: type=KeyM_CertificateElementType_Ssa_TrustModelIntermediateCert_validityNotBefore_003, direction=OUT, server-argument-impl-policy=USE-ARRAY-BASE-TYPE  # Holds a pointer to the memory location which will hold the certificate element.
        arg CertificateDataLength: type=uint32, direction=OUT  # Contains the length in bytes of certificate element.
      operation CertificateElementGetCount: possible-error=[KeyMCertificateElement_Ssa_TrustModelIntermediateCert_validityNotBefore_003/E_NOT_OK, KeyMCertificateElement_Ssa_TrustModelIntermediateCert_validityNotBefore_003/KEYM_E_KEY_CERT_SIZE_MISMATCH, KeyMCertificateElement_Ssa_TrustModelIntermediateCert_validityNotBefore_003/KEYM_E_PARAMETER_MISMATCH, KeyMCertificateElement_Ssa_TrustModelIntermediateCert_validityNotBefore_003/KEYM_E_KEY_CERT_INVALID, KeyMCertificateElement_Ssa_TrustModelIntermediateCert_validityNotBefore_003/KEYM_E_KEY_CERT_EMPTY]  # This operation returns the amount of items available for a certificate element.
        arg count: type=uint16, direction=OUT  # Number of items available for an element.
      5 x error:
        E_NOT_OK: error-code=1  # The service request failed.
        KEYM_E_KEY_CERT_SIZE_MISMATCH: error-code=4  # The service request failed. Parameter size does not match the expected value.
        KEYM_E_PARAMETER_MISMATCH: error-code=5  # The service request failed. Parameter to function does not provide the expected value.
        KEYM_E_KEY_CERT_EMPTY: error-code=10  # The service request failed. The requested key or certificate is not available, slot is empty.
        KEYM_E_KEY_CERT_INVALID: error-code=6  # The service request failed. Key or certificate is invalid and cannot be used for the operation.
