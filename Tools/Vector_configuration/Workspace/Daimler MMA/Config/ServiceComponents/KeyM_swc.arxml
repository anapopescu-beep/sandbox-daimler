[part 6 of 6: package /MICROSAR/KeyM_swc/ComponentTypes]
AUTOSAR XML (schema 00049)
package /MICROSAR/KeyM_swc/ComponentTypes  (continued)
  service sw component type KeyM: category=SERVICE_COMPONENT  (continued)
    behavior KeyMInternalBehavior: handle-termination-and-restart=NO-SUPPORT, included-data-type-set=data-type=[KeyM_CertElementIdType, KeyM_CertificateIdType, KeyM_const_CryptoKeyDataType, KeyM_CryptoKeyDataType, KeyM_ConstDataPtrType, KeyM_DataPtrType, KeyM_LengthPtrType, KeyM_CertDataPointerType, KeyM_CertDataType, KeyM_CsrEncodingType, KeyM_ServiceCertificateType, KeyM_CertificateStatusType, KeyM_ResultType, KeyM_CertificateDataType_Ssa_TrustModelEcuCert, KeyM_CertificateType_Ssa_TrustModelEcuCert, KeyM_CertificateElementType_Ssa_TrustModelEcuCert_ext_authKeyId_005, KeyM_CertificateElementType_Ssa_TrustModelEcuCert_ext_subKeyId_005, KeyM_CertificateElementType_Ssa_TrustModelEcuCert_ext_keyUsage_005, KeyM_CertificateElementType_Ssa_TrustModelEcuCert_ext_pkiRole_006, KeyM_CertificateElementType_Ssa_TrustModelEcuCert_Version_005, KeyM_CertificateElementType_Ssa_TrustModelEcuCert_SerialNo_005, KeyM_CertificateElementType_Ssa_TrustModelEcuCert_SigAlgoId_005, KeyM_CertificateElementType_Ssa_TrustModelEcuCert_validityNotBefore_005, KeyM_CertificateElementType_Ssa_TrustModelEcuCert_validityNotAfter_005, KeyM_CertificateElementType_Ssa_TrustModelEcuCert_subject_005, KeyM_CertificateElementType_Ssa_TrustModelEcuCert_SubjectPublicKeyInfoAlgo_005, KeyM_CertificateElementType_Ssa_TrustModelEcuCert_SubjectPublicKeyInfoKey_005, KeyM_CertificateElementType_Ssa_TrustModelEcuCert_Issuer_005, KeyM_CertificateElementType_Ssa_TrustModelEcuCert_signatureAlgorithm_005, KeyM_CertificateElementType_Ssa_TrustModelEcuCert_signatureValue_005, KeyM_CertificateElementType_Ssa_TrustModelEcuCert_ext_uniqueECUID_005, KeyM_CertificateElementType_Ssa_TrustModelEcuCert_ext_specialEcu_005, KeyM_CertificateDataType_Ssa_TrustModelIntermediateCert, KeyM_CertificateType_Ssa_TrustModelIntermediateCert, KeyM_CertificateElementType_Ssa_TrustModelIntermediateCert_ext_authKeyId_003, KeyM_CertificateElementType_Ssa_TrustModelIntermediateCert_ext_subKeyId_003, KeyM_CertificateElementType_Ssa_TrustModelIntermediateCert_ext_basicConstraints_003, KeyM_CertificateElementType_Ssa_TrustModelIntermediateCert_ext_keyUsage_003, KeyM_CertificateElementType_Ssa_TrustModelIntermediateCert_ext_pkiRole_003, KeyM_CertificateElementType_Ssa_TrustModelIntermediateCert_Version_003, KeyM_CertificateElementType_Ssa_TrustModelIntermediateCert_SerialNo_003, KeyM_CertificateElementType_Ssa_TrustModelIntermediateCert_SigAlgoId_003, KeyM_CertificateElementType_Ssa_TrustModelIntermediateCert_validityNotBefore_003, KeyM_CertificateElementType_Ssa_TrustModelIntermediateCert_validityNotAfter_003, KeyM_CertificateElementType_Ssa_TrustModelIntermediateCert_subject_003, KeyM_CertificateElementType_Ssa_TrustModelIntermediateCert_SubjectPublicKeyInfoAlgo_003, KeyM_CertificateElementType_Ssa_TrustModelIntermediateCert_SubjectPublicKeyInfoKey_003, KeyM_CertificateElementType_Ssa_TrustModelIntermediateCert_Issuer_003, KeyM_CertificateElementType_Ssa_TrustModelIntermediateCert_signatureAlgorithm_003, KeyM_CertificateElementType_Ssa_TrustModelIntermediateCert_signatureValue_003, KeyM_CertificateDataType_Ssa_TrustModelBackendCert, KeyM_CertificateType_Ssa_TrustModelBackendCert, KeyM_CertificateElementType_Ssa_TrustModelBackendCert_ext_authKeyId_002, KeyM_CertificateElementType_Ssa_TrustModelBackendCert_ext_subKeyId_002, KeyM_CertificateElementType_Ssa_TrustModelBackendCert_ext_basicConstraints_002, KeyM_CertificateElementType_Ssa_TrustModelBackendCert_ext_keyUsage_002, KeyM_CertificateElementType_Ssa_TrustModelBackendCert_ext_pkiRole_002, KeyM_CertificateElementType_Ssa_TrustModelBackendCert_Version_002, KeyM_CertificateElementType_Ssa_TrustModelBackendCert_SerialNo_002, KeyM_CertificateElementType_Ssa_TrustModelBackendCert_SigAlgoId_002, KeyM_CertificateElementType_Ssa_TrustModelBackendCert_validityNotBefore_002, KeyM_CertificateElementType_Ssa_TrustModelBackendCert_validityNotAfter_002, KeyM_CertificateElementType_Ssa_TrustModelBackendCert_subject_002, KeyM_CertificateElementType_Ssa_TrustModelBackendCert_SubjectPublicKeyInfoAlgo_002, KeyM_CertificateElementType_Ssa_TrustModelBackendCert_SubjectPublicKeyInfoKey_002, KeyM_CertificateElementType_Ssa_TrustModelBackendCert_Issuer_002, KeyM_CertificateElementType_Ssa_TrustModelBackendCert_signatureAlgorithm_002, KeyM_CertificateElementType_Ssa_TrustModelBackendCert_signatureValue_002, KeyM_CertificateDataType_Ssa_TrustModelRootCert, KeyM_CertificateType_Ssa_TrustModelRootCert, KeyM_CertificateElementType_Ssa_TrustModelRootCert_ext_authKeyId_009, KeyM_CertificateElementType_Ssa_TrustModelRootCert_Version, KeyM_CertificateElementType_Ssa_TrustModelRootCert_SerialNo, KeyM_CertificateElementType_Ssa_TrustModelRootCert_SigAlgoId, KeyM_CertificateElementType_Ssa_TrustModelRootCert_validityNotBefore, KeyM_CertificateElementType_Ssa_TrustModelRootCert_validityNotAfter, KeyM_CertificateElementType_Ssa_TrustModelRootCert_subject, KeyM_CertificateElementType_Ssa_TrustModelRootCert_SubjectPublicKeyInfoAlgo, KeyM_CertificateElementType_Ssa_TrustModelRootCert_SubjectPublicKeyInfoKey, KeyM_CertificateElementType_Ssa_TrustModelRootCert_Issuer, KeyM_CertificateElementType_Ssa_TrustModelRootCert_signatureAlgorithm, KeyM_CertificateElementType_Ssa_TrustModelRootCert_signatureValue, KeyM_CertificateElementType_Ssa_TrustModelRootCert_ext_subKeyId, KeyM_CertificateElementType_Ssa_TrustModelRootCert_ext_basicConstraints, KeyM_CertificateElementType_Ssa_TrustModelRootCert_ext_keyUsage, KeyM_CertificateElementType_Ssa_TrustModelRootCert_ext_pkiRole, KeyM_CertificateDataType_Ssa_TrustModelEcuPeerCert, KeyM_CertificateType_Ssa_TrustModelEcuPeerCert, KeyM_CertificateElementType_Ssa_TrustModelEcuPeerCert_ext_authKeyId_006, KeyM_CertificateElementType_Ssa_TrustModelEcuPeerCert_ext_subKeyId_006, KeyM_CertificateElementType_Ssa_TrustModelEcuPeerCert_ext_keyUsage_006, KeyM_CertificateElementType_Ssa_TrustModelEcuPeerCert_Version_006, KeyM_CertificateElementType_Ssa_TrustModelEcuPeerCert_SerialNo_006, KeyM_CertificateElementType_Ssa_TrustModelEcuPeerCert_SigAlgoId_006, KeyM_CertificateElementType_Ssa_TrustModelEcuPeerCert_validityNotBefore_006, KeyM_CertificateElementType_Ssa_TrustModelEcuPeerCert_validityNotAfter_006, KeyM_CertificateElementType_Ssa_TrustModelEcuPeerCert_subject_006, KeyM_CertificateElementType_Ssa_TrustModelEcuPeerCert_SubjectPublicKeyInfoAlgo_006, KeyM_CertificateElementType_Ssa_TrustModelEcuPeerCert_SubjectPublicKeyInfoKey_006, KeyM_CertificateElementType_Ssa_TrustModelEcuPeerCert_Issuer_006, KeyM_CertificateElementType_Ssa_TrustModelEcuPeerCert_signatureAlgorithm_006, KeyM_CertificateElementType_Ssa_TrustModelEcuPeerCert_signatureValue_006, KeyM_CertificateElementType_Ssa_TrustModelEcuPeerCert_ext_uniqueECUID_006, KeyM_CertificateElementType_Ssa_TrustModelEcuPeerCert_ext_specialEcu_006, KeyM_CertificateDataType_Ssa_TrustModelBackendPeerCert, KeyM_CertificateType_Ssa_TrustModelBackendPeerCert, KeyM_CertificateElementType_Ssa_TrustModelBackendPeerCert_ext_authKeyId_004, KeyM_CertificateElementType_Ssa_TrustModelBackendPeerCert_ext_subKeyId_004, KeyM_CertificateElementType_Ssa_TrustModelBackendPeerCert_ext_basicConstraints_004, KeyM_CertificateElementType_Ssa_TrustModelBackendPeerCert_ext_keyUsage_004, KeyM_CertificateElementType_Ssa_TrustModelBackendPeerCert_ext_pkiRole_004, KeyM_CertificateElementType_Ssa_TrustModelBackendPeerCert_Version_004, KeyM_CertificateElementType_Ssa_TrustModelBackendPeerCert_SerialNo_004, KeyM_CertificateElementType_Ssa_TrustModelBackendPeerCert_SigAlgoId_004, KeyM_CertificateElementType_Ssa_TrustModelBackendPeerCert_validityNotBefore_004, KeyM_CertificateElementType_Ssa_TrustModelBackendPeerCert_validityNotAfter_004, KeyM_CertificateElementType_Ssa_TrustModelBackendPeerCert_subject_004, KeyM_CertificateElementType_Ssa_TrustModelBackendPeerCert_SubjectPublicKeyInfoAlgo_004, KeyM_CertificateElementType_Ssa_TrustModelBackendPeerCert_SubjectPublicKeyInfoKey_004, KeyM_CertificateElementType_Ssa_TrustModelBackendPeerCert_Issuer_004, KeyM_CertificateElementType_Ssa_TrustModelBackendPeerCert_signatureAlgorithm_004, KeyM_CertificateElementType_Ssa_TrustModelBackendPeerCert_signatureValue_004, KeyM_CertificateDataType_Ssa_TrustModelIntermediatePeerCert, KeyM_CertificateType_Ssa_TrustModelIntermediatePeerCert, KeyM_CertificateElementType_Ssa_TrustModelIntermediatePeerCert_ext_authKeyId_007, KeyM_CertificateElementType_Ssa_TrustModelIntermediatePeerCert_ext_subKeyId_007, KeyM_CertificateElementType_Ssa_TrustModelIntermediatePeerCert_ext_basicConstraints_005, KeyM_CertificateElementType_Ssa_TrustModelIntermediatePeerCert_ext_keyUsage_007, KeyM_CertificateElementType_Ssa_TrustModelIntermediatePeerCert_ext_pkiRole_005, KeyM_CertificateElementType_Ssa_TrustModelIntermediatePeerCert_Version_007, KeyM_CertificateElementType_Ssa_TrustModelIntermediatePeerCert_SerialNo_007, KeyM_CertificateElementType_Ssa_TrustModelIntermediatePeerCert_SigAlgoId_007, KeyM_CertificateElementType_Ssa_TrustModelIntermediatePeerCert_validityNotBefore_007, KeyM_CertificateElementType_Ssa_TrustModelIntermediatePeerCert_validityNotAfter_007, KeyM_CertificateElementType_Ssa_TrustModelIntermediatePeerCert_subject_007, KeyM_CertificateElementType_Ssa_TrustModelIntermediatePeerCert_SubjectPublicKeyInfoAlgo_007, KeyM_CertificateElementType_Ssa_TrustModelIntermediatePeerCert_SubjectPublicKeyInfoKey_007, KeyM_CertificateElementType_Ssa_TrustModelIntermediatePeerCert_Issuer_007, KeyM_CertificateElementType_Ssa_TrustModelIntermediatePeerCert_signatureAlgorithm_007, KeyM_CertificateElementType_Ssa_TrustModelIntermediatePeerCert_signatureValue_007, KeyM_CertificateDataType_Ssa_TrustModelEcuCsr, KeyM_CertificateType_Ssa_TrustModelEcuCsr, KeyM_CertificateElementType_Ssa_TrustModelEcuCsr_ext_authKeyId_008, KeyM_CertificateElementType_Ssa_TrustModelEcuCsr_ext_subKeyId_008, KeyM_CertificateElementType_Ssa_TrustModelEcuCsr_ext_keyUsage_008, KeyM_CertificateElementType_Ssa_TrustModelEcuCsr_ext_pkiRole_008, KeyM_CertificateElementType_Ssa_TrustModelEcuCsr_Version_008, KeyM_CertificateElementType_Ssa_TrustModelEcuCsr_SerialNo_008, KeyM_CertificateElementType_Ssa_TrustModelEcuCsr_SigAlgoId_008, KeyM_CertificateElementType_Ssa_TrustModelEcuCsr_validityNotBefore_008, KeyM_CertificateElementType_Ssa_TrustModelEcuCsr_validityNotAfter_008, KeyM_CertificateElementType_Ssa_TrustModelEcuCsr_subject_008, KeyM_CertificateElementType_Ssa_TrustModelEcuCsr_SubjectPublicKeyInfoAlgo_008, KeyM_CertificateElementType_Ssa_TrustModelEcuCsr_SubjectPublicKeyInfoKey_008, KeyM_CertificateElementType_Ssa_TrustModelEcuCsr_Issuer_008, KeyM_CertificateElementType_Ssa_TrustModelEcuCsr_signatureAlgorithm_008, KeyM_CertificateElementType_Ssa_TrustModelEcuCsr_signatureValue_008, KeyM_CertificateElementType_Ssa_TrustModelEcuCsr_ext_uniqueECUID_007, KeyM_CertificateElementType_Ssa_TrustModelEcuCsr_ext_specialEcu_007, KeyM_CertificateElementType_Ssa_TrustModelEcuCsr_ext_extKeyUsage_007, KeyM_CertificateElementType_Ssa_TrustModelEcuCsr_ext_extKeyUsage_oid1_007, KeyM_CertificateElementType_Ssa_TrustModelEcuCsr_ext_extKeyUsage_oid2_007, KeyM_CertificateElementType_Ssa_TrustModelEcuCsr_ext_extKeyUsage_oid3_007]  (continued)
      port-api-options:
        {enable-take-address=true, indirect-api=false, port-defined-argument-value{value=2, value-type=KeyM_CertificateIdType}, port=KeyMCertificate_Ssa_TrustModelEcuCert}
        {enable-take-address=true, indirect-api=false, port-defined-argument-value{value=2, value-type=KeyM_CertificateIdType}, port=KeyMCertificateExtended_Ssa_TrustModelEcuCert}
        enable-take-address=true, indirect-api=false, port=KeyMServiceCertificate_Ssa_TrustModelEcuCert
        {enable-take-address=true, indirect-api=false, port-defined-argument-value{value=2, value-type=KeyM_CertificateIdType}, port=KeyMServiceCertificateByCertId_Ssa_TrustModelEcuCert}
        enable-take-address=true, indirect-api=false, port=KeyMCertificateNotification_Ssa_TrustModelEcuCert
        {enable-take-address=true, indirect-api=false, port-arg-values=[{value=2, value-type=KeyM_CertificateIdType}, {value=11, value-type=KeyM_CertElementIdType}], port=KeyMCertificateElement_Ssa_TrustModelEcuCert_ext_authKeyId_005}
        {enable-take-address=true, indirect-api=false, port-arg-values=[{value=2, value-type=KeyM_CertificateIdType}, {value=10, value-type=KeyM_CertElementIdType}], port=KeyMCertificateElement_Ssa_TrustModelEcuCert_ext_subKeyId_005}
        {enable-take-address=true, indirect-api=false, port-arg-values=[{value=2, value-type=KeyM_CertificateIdType}, {value=9, value-type=KeyM_CertElementIdType}], port=KeyMCertificateElement_Ssa_TrustModelEcuCert_ext_keyUsage_005}
        {enable-take-address=true, indirect-api=false, port-arg-values=[{value=2, value-type=KeyM_CertificateIdType}, {value=12, value-type=KeyM_CertElementIdType}], port=KeyMCertificateElement_Ssa_TrustModelEcuCert_ext_pkiRole_006}
        {enable-take-address=true, indirect-api=false, port-arg-values=[{value=2, value-type=KeyM_CertificateIdType}, {value=0, value-type=KeyM_CertElementIdType}], port=KeyMCertificateElement_Ssa_TrustModelEcuCert_Version_005}
        {enable-take-address=true, indirect-api=false, port-arg-values=[{value=2, value-type=KeyM_CertificateIdType}, {value=1, value-type=KeyM_CertElementIdType}], port=KeyMCertificateElement_Ssa_TrustModelEcuCert_SerialNo_005}
        {enable-take-address=true, indirect-api=false, port-arg-values=[{value=2, value-type=KeyM_CertificateIdType}, {value=2, value-type=KeyM_CertElementIdType}], port=KeyMCertificateElement_Ssa_TrustModelEcuCert_SigAlgoId_005}
        {enable-take-address=true, indirect-api=false, port-arg-values=[{value=2, value-type=KeyM_CertificateIdType}, {value=4, value-type=KeyM_CertElementIdType}], port=KeyMCertificateElement_Ssa_TrustModelEcuCert_validityNotBefore_005}
        {enable-take-address=true, indirect-api=false, port-arg-values=[{value=2, value-type=KeyM_CertificateIdType}, {value=5, value-type=KeyM_CertElementIdType}], port=KeyMCertificateElement_Ssa_TrustModelEcuCert_validityNotAfter_005}
        {enable-take-address=true, indirect-api=false, port-arg-values=[{value=2, value-type=KeyM_CertificateIdType}, {value=6, value-type=KeyM_CertElementIdType}], port=KeyMCertificateElement_Ssa_TrustModelEcuCert_subject_005}
        {enable-take-address=true, indirect-api=false, port-arg-values=[{value=2, value-type=KeyM_CertificateIdType}, {value=7, value-type=KeyM_CertElementIdType}], port=KeyMCertificateElement_Ssa_TrustModelEcuCert_SubjectPublicKeyInfoAlgo_005}
        {enable-take-address=true, indirect-api=false, port-arg-values=[{value=2, value-type=KeyM_CertificateIdType}, {value=8, value-type=KeyM_CertElementIdType}], port=KeyMCertificateElement_Ssa_TrustModelEcuCert_SubjectPublicKeyInfoKey_005}
        {enable-take-address=true, indirect-api=false, port-arg-values=[{value=2, value-type=KeyM_CertificateIdType}, {value=3, value-type=KeyM_CertElementIdType}], port=KeyMCertificateElement_Ssa_TrustModelEcuCert_Issuer_005}
        {enable-take-address=true, indirect-api=false, port-arg-values=[{value=2, value-type=KeyM_CertificateIdType}, {value=15, value-type=KeyM_CertElementIdType}], port=KeyMCertificateElement_Ssa_TrustModelEcuCert_signatureAlgorithm_005}
        {enable-take-address=true, indirect-api=false, port-arg-values=[{value=2, value-type=KeyM_CertificateIdType}, {value=16, value-type=KeyM_CertElementIdType}], port=KeyMCertificateElement_Ssa_TrustModelEcuCert_signatureValue_005}
        {enable-take-address=true, indirect-api=false, port-arg-values=[{value=2, value-type=KeyM_CertificateIdType}, {value=13, value-type=KeyM_CertElementIdType}], port=KeyMCertificateElement_Ssa_TrustModelEcuCert_ext_uniqueECUID_005}
        {enable-take-address=true, indirect-api=false, port-arg-values=[{value=2, value-type=KeyM_CertificateIdType}, {value=14, value-type=KeyM_CertElementIdType}], port=KeyMCertificateElement_Ssa_TrustModelEcuCert_ext_specialEcu_005}
        {enable-take-address=true, indirect-api=false, port-defined-argument-value{value=5, value-type=KeyM_CertificateIdType}, port=KeyMCertificate_Ssa_TrustModelIntermediateCert}
        {enable-take-address=true, indirect-api=false, port-defined-argument-value{value=5, value-type=KeyM_CertificateIdType}, port=KeyMCertificateExtended_Ssa_TrustModelIntermediateCert}
        enable-take-address=true, indirect-api=false, port=KeyMServiceCertificate_Ssa_TrustModelIntermediateCert
        {enable-take-address=true, indirect-api=false, port-defined-argument-value{value=5, value-type=KeyM_CertificateIdType}, port=KeyMServiceCertificateByCertId_Ssa_TrustModelIntermediateCert}
        enable-take-address=true, indirect-api=false, port=KeyMCertificateNotification_Ssa_TrustModelIntermediateCert
        {enable-take-address=true, indirect-api=false, port-arg-values=[{value=5, value-type=KeyM_CertificateIdType}, {value=10, value-type=KeyM_CertElementIdType}], port=KeyMCertificateElement_Ssa_TrustModelIntermediateCert_ext_authKeyId_003}
        {enable-take-address=true, indirect-api=false, port-arg-values=[{value=5, value-type=KeyM_CertificateIdType}, {value=9, value-type=KeyM_CertElementIdType}], port=KeyMCertificateElement_Ssa_TrustModelIntermediateCert_ext_subKeyId_003}
        {enable-take-address=true, indirect-api=false, port-arg-values=[{value=5, value-type=KeyM_CertificateIdType}, {value=11, value-type=KeyM_CertElementIdType}], port=KeyMCertificateElement_Ssa_TrustModelIntermediateCert_ext_basicConstraints_003}
        {enable-take-address=true, indirect-api=false, port-arg-values=[{value=5, value-type=KeyM_CertificateIdType}, {value=12, value-type=KeyM_CertElementIdType}], port=KeyMCertificateElement_Ssa_TrustModelIntermediateCert_ext_keyUsage_003}
        {enable-take-address=true, indirect-api=false, port-arg-values=[{value=5, value-type=KeyM_CertificateIdType}, {value=13, value-type=KeyM_CertElementIdType}], port=KeyMCertificateElement_Ssa_TrustModelIntermediateCert_ext_pkiRole_003}
        {enable-take-address=true, indirect-api=false, port-arg-values=[{value=5, value-type=KeyM_CertificateIdType}, {value=0, value-type=KeyM_CertElementIdType}], port=KeyMCertificateElement_Ssa_TrustModelIntermediateCert_Version_003}
        {enable-take-address=true, indirect-api=false, port-arg-values=[{value=5, value-type=KeyM_CertificateIdType}, {value=1, value-type=KeyM_CertElementIdType}], port=KeyMCertificateElement_Ssa_TrustModelIntermediateCert_SerialNo_003}
        {enable-take-address=true, indirect-api=false, port-arg-values=[{value=5, value-type=KeyM_CertificateIdType}, {value=2, value-type=KeyM_CertElementIdType}], port=KeyMCertificateElement_Ssa_TrustModelIntermediateCert_SigAlgoId_003}
        {enable-take-address=true, indirect-api=false, port-arg-values=[{value=5, value-type=KeyM_CertificateIdType}, {value=4, value-type=KeyM_CertElementIdType}], port=KeyMCertificateElement_Ssa_TrustModelIntermediateCert_validityNotBefore_003}
        {enable-take-address=true, indirect-api=false, port-arg-values=[{value=5, value-type=KeyM_CertificateIdType}, {value=5, value-type=KeyM_CertElementIdType}], port=KeyMCertificateElement_Ssa_TrustModelIntermediateCert_validityNotAfter_003}
        {enable-take-address=true, indirect-api=false, port-arg-values=[{value=5, value-type=KeyM_CertificateIdType}, {value=6, value-type=KeyM_CertElementIdType}], port=KeyMCertificateElement_Ssa_TrustModelIntermediateCert_subject_003}
        {enable-take-address=true, indirect-api=false, port-arg-values=[{value=5, value-type=KeyM_CertificateIdType}, {value=7, value-type=KeyM_CertElementIdType}], port=KeyMCertificateElement_Ssa_TrustModelIntermediateCert_SubjectPublicKeyInfoAlgo_003}
        {enable-take-address=true, indirect-api=false, port-arg-values=[{value=5, value-type=KeyM_CertificateIdType}, {value=8, value-type=KeyM_CertElementIdType}], port=KeyMCertificateElement_Ssa_TrustModelIntermediateCert_SubjectPublicKeyInfoKey_003}
        {enable-take-address=true, indirect-api=false, port-arg-values=[{value=5, value-type=KeyM_CertificateIdType}, {value=3, value-type=KeyM_CertElementIdType}], port=KeyMCertificateElement_Ssa_TrustModelIntermediateCert_Issuer_003}
        {enable-take-address=true, indirect-api=false, port-arg-values=[{value=5, value-type=KeyM_CertificateIdType}, {value=14, value-type=KeyM_CertElementIdType}], port=KeyMCertificateElement_Ssa_TrustModelIntermediateCert_signatureAlgorithm_003}
        {enable-take-address=true, indirect-api=false, port-arg-values=[{value=5, value-type=KeyM_CertificateIdType}, {value=15, value-type=KeyM_CertElementIdType}], port=KeyMCertificateElement_Ssa_TrustModelIntermediateCert_signatureValue_003}
        {enable-take-address=true, indirect-api=false, port-defined-argument-value{value=0, value-type=KeyM_CertificateIdType}, port=KeyMCertificate_Ssa_TrustModelBackendCert}
        {enable-take-address=true, indirect-api=false, port-defined-argument-value{value=0, value-type=KeyM_CertificateIdType}, port=KeyMCertificateExtended_Ssa_TrustModelBackendCert}
        enable-take-address=true, indirect-api=false, port=KeyMServiceCertificate_Ssa_TrustModelBackendCert
        {enable-take-address=true, indirect-api=false, port-defined-argument-value{value=0, value-type=KeyM_CertificateIdType}, port=KeyMServiceCertificateByCertId_Ssa_TrustModelBackendCert}
        enable-take-address=true, indirect-api=false, port=KeyMCertificateNotification_Ssa_TrustModelBackendCert
        {enable-take-address=true, indirect-api=false, port-arg-values=[{value=0, value-type=KeyM_CertificateIdType}, {value=10, value-type=KeyM_CertElementIdType}], port=KeyMCertificateElement_Ssa_TrustModelBackendCert_ext_authKeyId_002}
        {enable-take-address=true, indirect-api=false, port-arg-values=[{value=0, value-type=KeyM_CertificateIdType}, {value=9, value-type=KeyM_CertElementIdType}], port=KeyMCertificateElement_Ssa_TrustModelBackendCert_ext_subKeyId_002}
        {enable-take-address=true, indirect-api=false, port-arg-values=[{value=0, value-type=KeyM_CertificateIdType}, {value=11, value-type=KeyM_CertElementIdType}], port=KeyMCertificateElement_Ssa_TrustModelBackendCert_ext_basicConstraints_002}
        {enable-take-address=true, indirect-api=false, port-arg-values=[{value=0, value-type=KeyM_CertificateIdType}, {value=12, value-type=KeyM_CertElementIdType}], port=KeyMCertificateElement_Ssa_TrustModelBackendCert_ext_keyUsage_002}
        {enable-take-address=true, indirect-api=false, port-arg-values=[{value=0, value-type=KeyM_CertificateIdType}, {value=13, value-type=KeyM_CertElementIdType}], port=KeyMCertificateElement_Ssa_TrustModelBackendCert_ext_pkiRole_002}
        {enable-take-address=true, indirect-api=false, port-arg-values=[{value=0, value-type=KeyM_CertificateIdType}, {value=0, value-type=KeyM_CertElementIdType}], port=KeyMCertificateElement_Ssa_TrustModelBackendCert_Version_002}
        {enable-take-address=true, indirect-api=false, port-arg-values=[{value=0, value-type=KeyM_CertificateIdType}, {value=1, value-type=KeyM_CertElementIdType}], port=KeyMCertificateElement_Ssa_TrustModelBackendCert_SerialNo_002}
        {enable-take-address=true, indirect-api=false, port-arg-values=[{value=0, value-type=KeyM_CertificateIdType}, {value=2, value-type=KeyM_CertElementIdType}], port=KeyMCertificateElement_Ssa_TrustModelBackendCert_SigAlgoId_002}
        {enable-take-address=true, indirect-api=false, port-arg-values=[{value=0, value-type=KeyM_CertificateIdType}, {value=4, value-type=KeyM_CertElementIdType}], port=KeyMCertificateElement_Ssa_TrustModelBackendCert_validityNotBefore_002}
        {enable-take-address=true, indirect-api=false, port-arg-values=[{value=0, value-type=KeyM_CertificateIdType}, {value=5, value-type=KeyM_CertElementIdType}], port=KeyMCertificateElement_Ssa_TrustModelBackendCert_validityNotAfter_002}
        {enable-take-address=true, indirect-api=false, port-arg-values=[{value=0, value-type=KeyM_CertificateIdType}, {value=6, value-type=KeyM_CertElementIdType}], port=KeyMCertificateElement_Ssa_TrustModelBackendCert_subject_002}
        {enable-take-address=true, indirect-api=false, port-arg-values=[{value=0, value-type=KeyM_CertificateIdType}, {value=7, value-type=KeyM_CertElementIdType}], port=KeyMCertificateElement_Ssa_TrustModelBackendCert_SubjectPublicKeyInfoAlgo_002}
        {enable-take-address=true, indirect-api=false, port-arg-values=[{value=0, value-type=KeyM_CertificateIdType}, {value=8, value-type=KeyM_CertElementIdType}], port=KeyMCertificateElement_Ssa_TrustModelBackendCert_SubjectPublicKeyInfoKey_002}
        {enable-take-address=true, indirect-api=false, port-arg-values=[{value=0, value-type=KeyM_CertificateIdType}, {value=3, value-type=KeyM_CertElementIdType}], port=KeyMCertificateElement_Ssa_TrustModelBackendCert_Issuer_002}
        {enable-take-address=true, indirect-api=false, port-arg-values=[{value=0, value-type=KeyM_CertificateIdType}, {value=14, value-type=KeyM_CertElementIdType}], port=KeyMCertificateElement_Ssa_TrustModelBackendCert_signatureAlgorithm_002}
        {enable-take-address=true, indirect-api=false, port-arg-values=[{value=0, value-type=KeyM_CertificateIdType}, {value=15, value-type=KeyM_CertElementIdType}], port=KeyMCertificateElement_Ssa_TrustModelBackendCert_signatureValue_002}
        {enable-take-address=true, indirect-api=false, port-defined-argument-value{value=7, value-type=KeyM_CertificateIdType}, port=KeyMCertificate_Ssa_TrustModelRootCert}
        {enable-take-address=true, indirect-api=false, port-defined-argument-value{value=7, value-type=KeyM_CertificateIdType}, port=KeyMCertificateExtended_Ssa_TrustModelRootCert}
        enable-take-address=true, indirect-api=false, port=KeyMServiceCertificate_Ssa_TrustModelRootCert
        {enable-take-address=true, indirect-api=false, port-defined-argument-value{value=7, value-type=KeyM_CertificateIdType}, port=KeyMServiceCertificateByCertId_Ssa_TrustModelRootCert}
        enable-take-address=true, indirect-api=false, port=KeyMCertificateNotification_Ssa_TrustModelRootCert
        {enable-take-address=true, indirect-api=false, port-arg-values=[{value=7, value-type=KeyM_CertificateIdType}, {value=12, value-type=KeyM_CertElementIdType}], port=KeyMCertificateElement_Ssa_TrustModelRootCert_ext_authKeyId_009}
        {enable-take-address=true, indirect-api=false, port-arg-values=[{value=7, value-type=KeyM_CertificateIdType}, {value=0, value-type=KeyM_CertElementIdType}], port=KeyMCertificateElement_Ssa_TrustModelRootCert_Version}
        {enable-take-address=true, indirect-api=false, port-arg-values=[{value=7, value-type=KeyM_CertificateIdType}, {value=1, value-type=KeyM_CertElementIdType}], port=KeyMCertificateElement_Ssa_TrustModelRootCert_SerialNo}
        {enable-take-address=true, indirect-api=false, port-arg-values=[{value=7, value-type=KeyM_CertificateIdType}, {value=2, value-type=KeyM_CertElementIdType}], port=KeyMCertificateElement_Ssa_TrustModelRootCert_SigAlgoId}
        {enable-take-address=true, indirect-api=false, port-arg-values=[{value=7, value-type=KeyM_CertificateIdType}, {value=4, value-type=KeyM_CertElementIdType}], port=KeyMCertificateElement_Ssa_TrustModelRootCert_validityNotBefore}
        {enable-take-address=true, indirect-api=false, port-arg-values=[{value=7, value-type=KeyM_CertificateIdType}, {value=5, value-type=KeyM_CertElementIdType}], port=KeyMCertificateElement_Ssa_TrustModelRootCert_validityNotAfter}
        {enable-take-address=true, indirect-api=false, port-arg-values=[{value=7, value-type=KeyM_CertificateIdType}, {value=6, value-type=KeyM_CertElementIdType}], port=KeyMCertificateElement_Ssa_TrustModelRootCert_subject}
        {enable-take-address=true, indirect-api=false, port-arg-values=[{value=7, value-type=KeyM_CertificateIdType}, {value=7, value-type=KeyM_CertElementIdType}], port=KeyMCertificateElement_Ssa_TrustModelRootCert_SubjectPublicKeyInfoAlgo}
        {enable-take-address=true, indirect-api=false, port-arg-values=[{value=7, value-type=KeyM_CertificateIdType}, {value=8, value-type=KeyM_CertElementIdType}], port=KeyMCertificateElement_Ssa_TrustModelRootCert_SubjectPublicKeyInfoKey}
        {enable-take-address=true, indirect-api=false, port-arg-values=[{value=7, value-type=KeyM_CertificateIdType}, {value=3, value-type=KeyM_CertElementIdType}], port=KeyMCertificateElement_Ssa_TrustModelRootCert_Issuer}
        {enable-take-address=true, indirect-api=false, port-arg-values=[{value=7, value-type=KeyM_CertificateIdType}, {value=14, value-type=KeyM_CertElementIdType}], port=KeyMCertificateElement_Ssa_TrustModelRootCert_signatureAlgorithm}
        {enable-take-address=true, indirect-api=false, port-arg-values=[{value=7, value-type=KeyM_CertificateIdType}, {value=15, value-type=KeyM_CertElementIdType}], port=KeyMCertificateElement_Ssa_TrustModelRootCert_signatureValue}
        {enable-take-address=true, indirect-api=false, port-arg-values=[{value=7, value-type=KeyM_CertificateIdType}, {value=9, value-type=KeyM_CertElementIdType}], port=KeyMCertificateElement_Ssa_TrustModelRootCert_ext_subKeyId}
        {enable-take-address=true, indirect-api=false, port-arg-values=[{value=7, value-type=KeyM_CertificateIdType}, {value=10, value-type=KeyM_CertElementIdType}], port=KeyMCertificateElement_Ssa_TrustModelRootCert_ext_basicConstraints}
        {enable-take-address=true, indirect-api=false, port-arg-values=[{value=7, value-type=KeyM_CertificateIdType}, {value=11, value-type=KeyM_CertElementIdType}], port=KeyMCertificateElement_Ssa_TrustModelRootCert_ext_keyUsage}
        {enable-take-address=true, indirect-api=false, port-arg-values=[{value=7, value-type=KeyM_CertificateIdType}, {value=13, value-type=KeyM_CertElementIdType}], port=KeyMCertificateElement_Ssa_TrustModelRootCert_ext_pkiRole}
        {enable-take-address=true, indirect-api=false, port-defined-argument-value{value=4, value-type=KeyM_CertificateIdType}, port=KeyMCertificate_Ssa_TrustModelEcuPeerCert}
        {enable-take-address=true, indirect-api=false, port-defined-argument-value{value=4, value-type=KeyM_CertificateIdType}, port=KeyMCertificateExtended_Ssa_TrustModelEcuPeerCert}
        enable-take-address=true, indirect-api=false, port=KeyMServiceCertificate_Ssa_TrustModelEcuPeerCert
        {enable-take-address=true, indirect-api=false, port-defined-argument-value{value=4, value-type=KeyM_CertificateIdType}, port=KeyMServiceCertificateByCertId_Ssa_TrustModelEcuPeerCert}
        enable-take-address=true, indirect-api=false, port=KeyMCertificateNotification_Ssa_TrustModelEcuPeerCert
        {enable-take-address=true, indirect-api=false, port-arg-values=[{value=4, value-type=KeyM_CertificateIdType}, {value=11, value-type=KeyM_CertElementIdType}], port=KeyMCertificateElement_Ssa_TrustModelEcuPeerCert_ext_authKeyId_006}
        {enable-take-address=true, indirect-api=false, port-arg-values=[{value=4, value-type=KeyM_CertificateIdType}, {value=10, value-type=KeyM_CertElementIdType}], port=KeyMCertificateElement_Ssa_TrustModelEcuPeerCert_ext_subKeyId_006}
        {enable-take-address=true, indirect-api=false, port-arg-values=[{value=4, value-type=KeyM_CertificateIdType}, {value=9, value-type=KeyM_CertElementIdType}], port=KeyMCertificateElement_Ssa_TrustModelEcuPeerCert_ext_keyUsage_006}
        {enable-take-address=true, indirect-api=false, port-arg-values=[{value=4, value-type=KeyM_CertificateIdType}, {value=0, value-type=KeyM_CertElementIdType}], port=KeyMCertificateElement_Ssa_TrustModelEcuPeerCert_Version_006}
        {enable-take-address=true, indirect-api=false, port-arg-values=[{value=4, value-type=KeyM_CertificateIdType}, {value=1, value-type=KeyM_CertElementIdType}], port=KeyMCertificateElement_Ssa_TrustModelEcuPeerCert_SerialNo_006}
        {enable-take-address=true, indirect-api=false, port-arg-values=[{value=4, value-type=KeyM_CertificateIdType}, {value=2, value-type=KeyM_CertElementIdType}], port=KeyMCertificateElement_Ssa_TrustModelEcuPeerCert_SigAlgoId_006}
        {enable-take-address=true, indirect-api=false, port-arg-values=[{value=4, value-type=KeyM_CertificateIdType}, {value=4, value-type=KeyM_CertElementIdType}], port=KeyMCertificateElement_Ssa_TrustModelEcuPeerCert_validityNotBefore_006}
        {enable-take-address=true, indirect-api=false, port-arg-values=[{value=4, value-type=KeyM_CertificateIdType}, {value=5, value-type=KeyM_CertElementIdType}], port=KeyMCertificateElement_Ssa_TrustModelEcuPeerCert_validityNotAfter_006}
        {enable-take-address=true, indirect-api=false, port-arg-values=[{value=4, value-type=KeyM_CertificateIdType}, {value=6, value-type=KeyM_CertElementIdType}], port=KeyMCertificateElement_Ssa_TrustModelEcuPeerCert_subject_006}
        {enable-take-address=true, indirect-api=false, port-arg-values=[{value=4, value-type=KeyM_CertificateIdType}, {value=7, value-type=KeyM_CertElementIdType}], port=KeyMCertificateElement_Ssa_TrustModelEcuPeerCert_SubjectPublicKeyInfoAlgo_006}
        {enable-take-address=true, indirect-api=false, port-arg-values=[{value=4, value-type=KeyM_CertificateIdType}, {value=8, value-type=KeyM_CertElementIdType}], port=KeyMCertificateElement_Ssa_TrustModelEcuPeerCert_SubjectPublicKeyInfoKey_006}
        {enable-take-address=true, indirect-api=false, port-arg-values=[{value=4, value-type=KeyM_CertificateIdType}, {value=3, value-type=KeyM_CertElementIdType}], port=KeyMCertificateElement_Ssa_TrustModelEcuPeerCert_Issuer_006}
        {enable-take-address=true, indirect-api=false, port-arg-values=[{value=4, value-type=KeyM_CertificateIdType}, {value=14, value-type=KeyM_CertElementIdType}], port=KeyMCertificateElement_Ssa_TrustModelEcuPeerCert_signatureAlgorithm_006}
        {enable-take-address=true, indirect-api=false, port-arg-values=[{value=4, value-type=KeyM_CertificateIdType}, {value=15, value-type=KeyM_CertElementIdType}], port=KeyMCertificateElement_Ssa_TrustModelEcuPeerCert_signatureValue_006}
        {enable-take-address=true, indirect-api=false, port-arg-values=[{value=4, value-type=KeyM_CertificateIdType}, {value=13, value-type=KeyM_CertElementIdType}], port=KeyMCertificateElement_Ssa_TrustModelEcuPeerCert_ext_uniqueECUID_006}
        {enable-take-address=true, indirect-api=false, port-arg-values=[{value=4, value-type=KeyM_CertificateIdType}, {value=12, value-type=KeyM_CertElementIdType}], port=KeyMCertificateElement_Ssa_TrustModelEcuPeerCert_ext_specialEcu_006}
        {enable-take-address=true, indirect-api=false, port-defined-argument-value{value=1, value-type=KeyM_CertificateIdType}, port=KeyMCertificate_Ssa_TrustModelBackendPeerCert}
        {enable-take-address=true, indirect-api=false, port-defined-argument-value{value=1, value-type=KeyM_CertificateIdType}, port=KeyMCertificateExtended_Ssa_TrustModelBackendPeerCert}
        enable-take-address=true, indirect-api=false, port=KeyMServiceCertificate_Ssa_TrustModelBackendPeerCert
        {enable-take-address=true, indirect-api=false, port-defined-argument-value{value=1, value-type=KeyM_CertificateIdType}, port=KeyMServiceCertificateByCertId_Ssa_TrustModelBackendPeerCert}
        enable-take-address=true, indirect-api=false, port=KeyMCertificateNotification_Ssa_TrustModelBackendPeerCert
        {enable-take-address=true, indirect-api=false, port-arg-values=[{value=1, value-type=KeyM_CertificateIdType}, {value=10, value-type=KeyM_CertElementIdType}], port=KeyMCertificateElement_Ssa_TrustModelBackendPeerCert_ext_authKeyId_004}
        {enable-take-address=true, indirect-api=false, port-arg-values=[{value=1, value-type=KeyM_CertificateIdType}, {value=9, value-type=KeyM_CertElementIdType}], port=KeyMCertificateElement_Ssa_TrustModelBackendPeerCert_ext_subKeyId_004}
        {enable-take-address=true, indirect-api=false, port-arg-values=[{value=1, value-type=KeyM_CertificateIdType}, {value=11, value-type=KeyM_CertElementIdType}], port=KeyMCertificateElement_Ssa_TrustModelBackendPeerCert_ext_basicConstraints_004}
        {enable-take-address=true, indirect-api=false, port-arg-values=[{value=1, value-type=KeyM_CertificateIdType}, {value=12, value-type=KeyM_CertElementIdType}], port=KeyMCertificateElement_Ssa_TrustModelBackendPeerCert_ext_keyUsage_004}
        {enable-take-address=true, indirect-api=false, port-arg-values=[{value=1, value-type=KeyM_CertificateIdType}, {value=13, value-type=KeyM_CertElementIdType}], port=KeyMCertificateElement_Ssa_TrustModelBackendPeerCert_ext_pkiRole_004}
        {enable-take-address=true, indirect-api=false, port-arg-values=[{value=1, value-type=KeyM_CertificateIdType}, {value=0, value-type=KeyM_CertElementIdType}], port=KeyMCertificateElement_Ssa_TrustModelBackendPeerCert_Version_004}
        {enable-take-address=true, indirect-api=false, port-arg-values=[{value=1, value-type=KeyM_CertificateIdType}, {value=1, value-type=KeyM_CertElementIdType}], port=KeyMCertificateElement_Ssa_TrustModelBackendPeerCert_SerialNo_004}
        {enable-take-address=true, indirect-api=false, port-arg-values=[{value=1, value-type=KeyM_CertificateIdType}, {value=2, value-type=KeyM_CertElementIdType}], port=KeyMCertificateElement_Ssa_TrustModelBackendPeerCert_SigAlgoId_004}
        {enable-take-address=true, indirect-api=false, port-arg-values=[{value=1, value-type=KeyM_CertificateIdType}, {value=4, value-type=KeyM_CertElementIdType}], port=KeyMCertificateElement_Ssa_TrustModelBackendPeerCert_validityNotBefore_004}
        {enable-take-address=true, indirect-api=false, port-arg-values=[{value=1, value-type=KeyM_CertificateIdType}, {value=5, value-type=KeyM_CertElementIdType}], port=KeyMCertificateElement_Ssa_TrustModelBackendPeerCert_validityNotAfter_004}
        {enable-take-address=true, indirect-api=false, port-arg-values=[{value=1, value-type=KeyM_CertificateIdType}, {value=6, value-type=KeyM_CertElementIdType}], port=KeyMCertificateElement_Ssa_TrustModelBackendPeerCert_subject_004}
        {enable-take-address=true, indirect-api=false, port-arg-values=[{value=1, value-type=KeyM_CertificateIdType}, {value=7, value-type=KeyM_CertElementIdType}], port=KeyMCertificateElement_Ssa_TrustModelBackendPeerCert_SubjectPublicKeyInfoAlgo_004}
        {enable-take-address=true, indirect-api=false, port-arg-values=[{value=1, value-type=KeyM_CertificateIdType}, {value=8, value-type=KeyM_CertElementIdType}], port=KeyMCertificateElement_Ssa_TrustModelBackendPeerCert_SubjectPublicKeyInfoKey_004}
        {enable-take-address=true, indirect-api=false, port-arg-values=[{value=1, value-type=KeyM_CertificateIdType}, {value=3, value-type=KeyM_CertElementIdType}], port=KeyMCertificateElement_Ssa_TrustModelBackendPeerCert_Issuer_004}
        {enable-take-address=true, indirect-api=false, port-arg-values=[{value=1, value-type=KeyM_CertificateIdType}, {value=14, value-type=KeyM_CertElementIdType}], port=KeyMCertificateElement_Ssa_TrustModelBackendPeerCert_signatureAlgorithm_004}
        {enable-take-address=true, indirect-api=false, port-arg-values=[{value=1, value-type=KeyM_CertificateIdType}, {value=15, value-type=KeyM_CertElementIdType}], port=KeyMCertificateElement_Ssa_TrustModelBackendPeerCert_signatureValue_004}
        {enable-take-address=true, indirect-api=false, port-defined-argument-value{value=6, value-type=KeyM_CertificateIdType}, port=KeyMCertificate_Ssa_TrustModelIntermediatePeerCert}
        {enable-take-address=true, indirect-api=false, port-defined-argument-value{value=6, value-type=KeyM_CertificateIdType}, port=KeyMCertificateExtended_Ssa_TrustModelIntermediatePeerCert}
        enable-take-address=true, indirect-api=false, port=KeyMServiceCertificate_Ssa_TrustModelIntermediatePeerCert
        {enable-take-address=true, indirect-api=false, port-defined-argument-value{value=6, value-type=KeyM_CertificateIdType}, port=KeyMServiceCertificateByCertId_Ssa_TrustModelIntermediatePeerCert}
        enable-take-address=true, indirect-api=false, port=KeyMCertificateNotification_Ssa_TrustModelIntermediatePeerCert
        {enable-take-address=true, indirect-api=false, port-arg-values=[{value=6, value-type=KeyM_CertificateIdType}, {value=10, value-type=KeyM_CertElementIdType}], port=KeyMCertificateElement_Ssa_TrustModelIntermediatePeerCert_ext_authKeyId_007}
        {enable-take-address=true, indirect-api=false, port-arg-values=[{value=6, value-type=KeyM_CertificateIdType}, {value=9, value-type=KeyM_CertElementIdType}], port=KeyMCertificateElement_Ssa_TrustModelIntermediatePeerCert_ext_subKeyId_007}
        {enable-take-address=true, indirect-api=false, port-arg-values=[{value=6, value-type=KeyM_CertificateIdType}, {value=11, value-type=KeyM_CertElementIdType}], port=KeyMCertificateElement_Ssa_TrustModelIntermediatePeerCert_ext_basicConstraints_005}
        {enable-take-address=true, indirect-api=false, port-arg-values=[{value=6, value-type=KeyM_CertificateIdType}, {value=12, value-type=KeyM_CertElementIdType}], port=KeyMCertificateElement_Ssa_TrustModelIntermediatePeerCert_ext_keyUsage_007}
        {enable-take-address=true, indirect-api=false, port-arg-values=[{value=6, value-type=KeyM_CertificateIdType}, {value=13, value-type=KeyM_CertElementIdType}], port=KeyMCertificateElement_Ssa_TrustModelIntermediatePeerCert_ext_pkiRole_005}
        {enable-take-address=true, indirect-api=false, port-arg-values=[{value=6, value-type=KeyM_CertificateIdType}, {value=0, value-type=KeyM_CertElementIdType}], port=KeyMCertificateElement_Ssa_TrustModelIntermediatePeerCert_Version_007}
        {enable-take-address=true, indirect-api=false, port-arg-values=[{value=6, value-type=KeyM_CertificateIdType}, {value=1, value-type=KeyM_CertElementIdType}], port=KeyMCertificateElement_Ssa_TrustModelIntermediatePeerCert_SerialNo_007}
        {enable-take-address=true, indirect-api=false, port-arg-values=[{value=6, value-type=KeyM_CertificateIdType}, {value=2, value-type=KeyM_CertElementIdType}], port=KeyMCertificateElement_Ssa_TrustModelIntermediatePeerCert_SigAlgoId_007}
        {enable-take-address=true, indirect-api=false, port-arg-values=[{value=6, value-type=KeyM_CertificateIdType}, {value=4, value-type=KeyM_CertElementIdType}], port=KeyMCertificateElement_Ssa_TrustModelIntermediatePeerCert_validityNotBefore_007}
        {enable-take-address=true, indirect-api=false, port-arg-values=[{value=6, value-type=KeyM_CertificateIdType}, {value=5, value-type=KeyM_CertElementIdType}], port=KeyMCertificateElement_Ssa_TrustModelIntermediatePeerCert_validityNotAfter_007}
        {enable-take-address=true, indirect-api=false, port-arg-values=[{value=6, value-type=KeyM_CertificateIdType}, {value=6, value-type=KeyM_CertElementIdType}], port=KeyMCertificateElement_Ssa_TrustModelIntermediatePeerCert_subject_007}
        {enable-take-address=true, indirect-api=false, port-arg-values=[{value=6, value-type=KeyM_CertificateIdType}, {value=7, value-type=KeyM_CertElementIdType}], port=KeyMCertificateElement_Ssa_TrustModelIntermediatePeerCert_SubjectPublicKeyInfoAlgo_007}
        {enable-take-address=true, indirect-api=false, port-arg-values=[{value=6, value-type=KeyM_CertificateIdType}, {value=8, value-type=KeyM_CertElementIdType}], port=KeyMCertificateElement_Ssa_TrustModelIntermediatePeerCert_SubjectPublicKeyInfoKey_007}
        {enable-take-address=true, indirect-api=false, port-arg-values=[{value=6, value-type=KeyM_CertificateIdType}, {value=3, value-type=KeyM_CertElementIdType}], port=KeyMCertificateElement_Ssa_TrustModelIntermediatePeerCert_Issuer_007}
        {enable-take-address=true, indirect-api=false, port-arg-values=[{value=6, value-type=KeyM_CertificateIdType}, {value=14, value-type=KeyM_CertElementIdType}], port=KeyMCertificateElement_Ssa_TrustModelIntermediatePeerCert_signatureAlgorithm_007}
        {enable-take-address=true, indirect-api=false, port-arg-values=[{value=6, value-type=KeyM_CertificateIdType}, {value=15, value-type=KeyM_CertElementIdType}], port=KeyMCertificateElement_Ssa_TrustModelIntermediatePeerCert_signatureValue_007}
        {enable-take-address=true, indirect-api=false, port-defined-argument-value{value=3, value-type=KeyM_CertificateIdType}, port=KeyMCertificate_Ssa_TrustModelEcuCsr}
        {enable-take-address=true, indirect-api=false, port-defined-argument-value{value=3, value-type=KeyM_CertificateIdType}, port=KeyMCertificateExtended_Ssa_TrustModelEcuCsr}
        enable-take-address=true, indirect-api=false, port=KeyMServiceCertificate_Ssa_TrustModelEcuCsr
        {enable-take-address=true, indirect-api=false, port-defined-argument-value{value=3, value-type=KeyM_CertificateIdType}, port=KeyMServiceCertificateByCertId_Ssa_TrustModelEcuCsr}
        enable-take-address=true, indirect-api=false, port=KeyMCertificateNotification_Ssa_TrustModelEcuCsr
        {enable-take-address=true, indirect-api=false, port-arg-values=[{value=3, value-type=KeyM_CertificateIdType}, {value=10, value-type=KeyM_CertElementIdType}], port=KeyMCertificateElement_Ssa_TrustModelEcuCsr_ext_authKeyId_008}
        {enable-take-address=true, indirect-api=false, port-arg-values=[{value=3, value-type=KeyM_CertificateIdType}, {value=9, value-type=KeyM_CertElementIdType}], port=KeyMCertificateElement_Ssa_TrustModelEcuCsr_ext_subKeyId_008}
        {enable-take-address=true, indirect-api=false, port-arg-values=[{value=3, value-type=KeyM_CertificateIdType}, {value=11, value-type=KeyM_CertElementIdType}], port=KeyMCertificateElement_Ssa_TrustModelEcuCsr_ext_keyUsage_008}
        {enable-take-address=true, indirect-api=false, port-arg-values=[{value=3, value-type=KeyM_CertificateIdType}, {value=16, value-type=KeyM_CertElementIdType}], port=KeyMCertificateElement_Ssa_TrustModelEcuCsr_ext_pkiRole_008}
        {enable-take-address=true, indirect-api=false, port-arg-values=[{value=3, value-type=KeyM_CertificateIdType}, {value=0, value-type=KeyM_CertElementIdType}], port=KeyMCertificateElement_Ssa_TrustModelEcuCsr_Version_008}
        {enable-take-address=true, indirect-api=false, port-arg-values=[{value=3, value-type=KeyM_CertificateIdType}, {value=1, value-type=KeyM_CertElementIdType}], port=KeyMCertificateElement_Ssa_TrustModelEcuCsr_SerialNo_008}
        {enable-take-address=true, indirect-api=false, port-arg-values=[{value=3, value-type=KeyM_CertificateIdType}, {value=2, value-type=KeyM_CertElementIdType}], port=KeyMCertificateElement_Ssa_TrustModelEcuCsr_SigAlgoId_008}
        {enable-take-address=true, indirect-api=false, port-arg-values=[{value=3, value-type=KeyM_CertificateIdType}, {value=4, value-type=KeyM_CertElementIdType}], port=KeyMCertificateElement_Ssa_TrustModelEcuCsr_validityNotBefore_008}
        {enable-take-address=true, indirect-api=false, port-arg-values=[{value=3, value-type=KeyM_CertificateIdType}, {value=5, value-type=KeyM_CertElementIdType}], port=KeyMCertificateElement_Ssa_TrustModelEcuCsr_validityNotAfter_008}
        {enable-take-address=true, indirect-api=false, port-arg-values=[{value=3, value-type=KeyM_CertificateIdType}, {value=6, value-type=KeyM_CertElementIdType}], port=KeyMCertificateElement_Ssa_TrustModelEcuCsr_subject_008}
        {enable-take-address=true, indirect-api=false, port-arg-values=[{value=3, value-type=KeyM_CertificateIdType}, {value=7, value-type=KeyM_CertElementIdType}], port=KeyMCertificateElement_Ssa_TrustModelEcuCsr_SubjectPublicKeyInfoAlgo_008}
        {enable-take-address=true, indirect-api=false, port-arg-values=[{value=3, value-type=KeyM_CertificateIdType}, {value=8, value-type=KeyM_CertElementIdType}], port=KeyMCertificateElement_Ssa_TrustModelEcuCsr_SubjectPublicKeyInfoKey_008}
        {enable-take-address=true, indirect-api=false, port-arg-values=[{value=3, value-type=KeyM_CertificateIdType}, {value=3, value-type=KeyM_CertElementIdType}], port=KeyMCertificateElement_Ssa_TrustModelEcuCsr_Issuer_008}
        {enable-take-address=true, indirect-api=false, port-arg-values=[{value=3, value-type=KeyM_CertificateIdType}, {value=19, value-type=KeyM_CertElementIdType}], port=KeyMCertificateElement_Ssa_TrustModelEcuCsr_signatureAlgorithm_008}
        {enable-take-address=true, indirect-api=false, port-arg-values=[{value=3, value-type=KeyM_CertificateIdType}, {value=20, value-type=KeyM_CertElementIdType}], port=KeyMCertificateElement_Ssa_TrustModelEcuCsr_signatureValue_008}
        {enable-take-address=true, indirect-api=false, port-arg-values=[{value=3, value-type=KeyM_CertificateIdType}, {value=17, value-type=KeyM_CertElementIdType}], port=KeyMCertificateElement_Ssa_TrustModelEcuCsr_ext_uniqueECUID_007}
        {enable-take-address=true, indirect-api=false, port-arg-values=[{value=3, value-type=KeyM_CertificateIdType}, {value=18, value-type=KeyM_CertElementIdType}], port=KeyMCertificateElement_Ssa_TrustModelEcuCsr_ext_specialEcu_007}
        {enable-take-address=true, indirect-api=false, port-arg-values=[{value=3, value-type=KeyM_CertificateIdType}, {value=12, value-type=KeyM_CertElementIdType}], port=KeyMCertificateElement_Ssa_TrustModelEcuCsr_ext_extKeyUsage_007}
        {enable-take-address=true, indirect-api=false, port-arg-values=[{value=3, value-type=KeyM_CertificateIdType}, {value=13, value-type=KeyM_CertElementIdType}], port=KeyMCertificateElement_Ssa_TrustModelEcuCsr_ext_extKeyUsage_oid1_007}
        {enable-take-address=true, indirect-api=false, port-arg-values=[{value=3, value-type=KeyM_CertificateIdType}, {value=14, value-type=KeyM_CertElementIdType}], port=KeyMCertificateElement_Ssa_TrustModelEcuCsr_ext_extKeyUsage_oid2_007}
        {enable-take-address=true, indirect-api=false, port-arg-values=[{value=3, value-type=KeyM_CertificateIdType}, {value=15, value-type=KeyM_CertElementIdType}], port=KeyMCertificateElement_Ssa_TrustModelEcuCsr_ext_extKeyUsage_oid3_007}
      292 x runnable:
        KeyM_MainFunction
          16 x sync call, all with timeout=0:
            OpServerCallKeyM_MainFunction_CertificateVerifyCallbackNotification_KeyMCertificateNotification_Ssa_TrustModelEcuCert: operation=KeyMCertificateNotification_Ssa_TrustModelEcuCert.CertificateVerifyCallbackNotification
            OpServerCallKeyM_MainFunction_ServiceCertificateCallbackNotification_KeyMCertificateNotification_Ssa_TrustModelEcuCert: operation=KeyMCertificateNotification_Ssa_TrustModelEcuCert.ServiceCertificateCallbackNotification
            OpServerCallKeyM_MainFunction_CertificateVerifyCallbackNotification_KeyMCertificateNotification_Ssa_TrustModelIntermediateCert: operation=KeyMCertificateNotification_Ssa_TrustModelIntermediateCert.CertificateVerifyCallbackNotification
            OpServerCallKeyM_MainFunction_ServiceCertificateCallbackNotification_KeyMCertificateNotification_Ssa_TrustModelIntermediateCert: operation=KeyMCertificateNotification_Ssa_TrustModelIntermediateCert.ServiceCertificateCallbackNotification
            OpServerCallKeyM_MainFunction_CertificateVerifyCallbackNotification_KeyMCertificateNotification_Ssa_TrustModelBackendCert: operation=KeyMCertificateNotification_Ssa_TrustModelBackendCert.CertificateVerifyCallbackNotification
            OpServerCallKeyM_MainFunction_ServiceCertificateCallbackNotification_KeyMCertificateNotification_Ssa_TrustModelBackendCert: operation=KeyMCertificateNotification_Ssa_TrustModelBackendCert.ServiceCertificateCallbackNotification
            OpServerCallKeyM_MainFunction_CertificateVerifyCallbackNotification_KeyMCertificateNotification_Ssa_TrustModelEcuPeerCert: operation=KeyMCertificateNotification_Ssa_TrustModelEcuPeerCert.CertificateVerifyCallbackNotification
            OpServerCallKeyM_MainFunction_ServiceCertificateCallbackNotification_KeyMCertificateNotification_Ssa_TrustModelEcuPeerCert: operation=KeyMCertificateNotification_Ssa_TrustModelEcuPeerCert.ServiceCertificateCallbackNotification
            OpServerCallKeyM_MainFunction_CertificateVerifyCallbackNotification_KeyMCertificateNotification_Ssa_TrustModelBackendPeerCert: operation=KeyMCertificateNotification_Ssa_TrustModelBackendPeerCert.CertificateVerifyCallbackNotification
            OpServerCallKeyM_MainFunction_ServiceCertificateCallbackNotification_KeyMCertificateNotification_Ssa_TrustModelBackendPeerCert: operation=KeyMCertificateNotification_Ssa_TrustModelBackendPeerCert.ServiceCertificateCallbackNotification
            OpServerCallKeyM_MainFunction_CertificateVerifyCallbackNotification_KeyMCertificateNotification_Ssa_TrustModelIntermedi_c55868d7: operation=KeyMCertificateNotification_Ssa_TrustModelIntermediatePeerCert.CertificateVerifyCallbackNotification
            OpServerCallKeyM_MainFunction_ServiceCertificateCallbackNotification_KeyMCertificateNotification_Ssa_TrustModelIntermed_3b15f3d5: operation=KeyMCertificateNotification_Ssa_TrustModelIntermediatePeerCert.ServiceCertificateCallbackNotification
            OpServerCallKeyM_MainFunction_CertificateVerifyCallbackNotification_KeyMCertificateNotification_Ssa_TrustModelEcuCsr: operation=KeyMCertificateNotification_Ssa_TrustModelEcuCsr.CertificateVerifyCallbackNotification
            OpServerCallKeyM_MainFunction_ServiceCertificateCallbackNotification_KeyMCertificateNotification_Ssa_TrustModelEcuCsr: operation=KeyMCertificateNotification_Ssa_TrustModelEcuCsr.ServiceCertificateCallbackNotification
            OpServerCallKeyM_MainFunction_CertificateVerifyCallbackNotification_KeyMCertificateNotification_Ssa_TrustModelRootCert: operation=KeyMCertificateNotification_Ssa_TrustModelRootCert.CertificateVerifyCallbackNotification
            OpServerCallKeyM_MainFunction_ServiceCertificateCallbackNotification_KeyMCertificateNotification_Ssa_TrustModelRootCert: operation=KeyMCertificateNotification_Ssa_TrustModelRootCert.ServiceCertificateCallbackNotification
        GetCertificate_Ssa_TrustModelBackendCert: can-be-invoked-concurrently=true, symbol=KeyM_GetCertificate_Ssa_TrustModelBackendCert
        CertificateElementGetCount: can-be-invoked-concurrently=true, symbol=KeyM_CertificateElementGetCount
        SetCertificate_Ssa_TrustModelEcuCert: can-be-invoked-concurrently=true, symbol=KeyM_SetCertificate_Ssa_TrustModelEcuCert
        GetCertificate_Ssa_TrustModelEcuCert: can-be-invoked-concurrently=true, symbol=KeyM_GetCertificate_Ssa_TrustModelEcuCert
        CertGetStatus: can-be-invoked-concurrently=true, symbol=KeyM_CertGetStatus
        CsrElementSet: can-be-invoked-concurrently=true, symbol=KeyM_CsrElementSet
        VerifyCertificate: can-be-invoked-concurrently=true, symbol=KeyM_VerifyCertificate
        SetCertificate_Ssa_TrustModelIntermediateCert: can-be-invoked-concurrently=true, symbol=KeyM_SetCertificate_Ssa_TrustModelIntermediateCert
        SetCertificate_Ssa_TrustModelEcuCsr: can-be-invoked-concurrently=true, symbol=KeyM_SetCertificate_Ssa_TrustModelEcuCsr
        ServiceCertificateByIdRteAdpt: can-be-invoked-concurrently=true, symbol=KeyM_ServiceCertificateByIdRteAdpt
        GetCertificate_Ssa_TrustModelEcuCsr: can-be-invoked-concurrently=true, symbol=KeyM_GetCertificate_Ssa_TrustModelEcuCsr
        SetCertificate_Ssa_TrustModelEcuPeerCert: can-be-invoked-concurrently=true, symbol=KeyM_SetCertificate_Ssa_TrustModelEcuPeerCert
        GetCertificate_Ssa_TrustModelIntermediateCert: can-be-invoked-concurrently=true, symbol=KeyM_GetCertificate_Ssa_TrustModelIntermediateCert
        SetCertificate_Ssa_TrustModelBackendPeerCert: can-be-invoked-concurrently=true, symbol=KeyM_SetCertificate_Ssa_TrustModelBackendPeerCert
        GetCertificate_Ssa_TrustModelEcuPeerCert: can-be-invoked-concurrently=true, symbol=KeyM_GetCertificate_Ssa_TrustModelEcuPeerCert
        SetCertificate_Ssa_TrustModelBackendCert: can-be-invoked-concurrently=true, symbol=KeyM_SetCertificate_Ssa_TrustModelBackendCert
        SetCertificate_Ssa_TrustModelIntermediatePeerCert: can-be-invoked-concurrently=true, symbol=KeyM_SetCertificate_Ssa_TrustModelIntermediatePeerCert
        GetCertificate_Ssa_TrustModelBackendPeerCert: can-be-invoked-concurrently=true, symbol=KeyM_GetCertificate_Ssa_TrustModelBackendPeerCert
        GetCertificate_Ssa_TrustModelIntermediatePeerCert: can-be-invoked-concurrently=true, symbol=KeyM_GetCertificate_Ssa_TrustModelIntermediatePeerCert
        GetCertificate_Ssa_TrustModelRootCert: can-be-invoked-concurrently=true, symbol=KeyM_GetCertificate_Ssa_TrustModelRootCert
        SetCertificate_Ssa_TrustModelRootCert: can-be-invoked-concurrently=true, symbol=KeyM_SetCertificate_Ssa_TrustModelRootCert
        CertificateElementGetByIndex_Ssa_TrustModelBackendCert_ext_authKeyId_002: can-be-invoked-concurrently=true, symbol=KeyM_CertificateElementGetByIndex_Ssa_TrustModelBackendCert_ext_authKeyId_002
        CertificateElementGetByIndex_Ssa_TrustModelBackendCert_Issuer_002: can-be-invoked-concurrently=true, symbol=KeyM_CertificateElementGetByIndex_Ssa_TrustModelBackendCert_Issuer_002
        CertElementGet_Ssa_TrustModelBackendCert_ext_subKeyId_002: can-be-invoked-concurrently=true, symbol=KeyM_CertElementGet_Ssa_TrustModelBackendCert_ext_subKeyId_002
        CertificateElementGetByIndex_Ssa_TrustModelEcuPeerCert_ext_authKeyId_006: can-be-invoked-concurrently=true, symbol=KeyM_CertificateElementGetByIndex_Ssa_TrustModelEcuPeerCert_ext_authKeyId_006
        CertificateElementGetByIndex_Ssa_TrustModelIntermediateCert_SubjectPublicKeyInfoAlgo_003: can-be-invoked-concurrently=true, symbol=KeyM_CertificateElementGetByIndex_Ssa_TrustModelIntermediateCert_SubjectPublicKeyInfoAlgo_003
        CertificateElementGetByIndex_Ssa_TrustModelBackendCert_Version_002: can-be-invoked-concurrently=true, symbol=KeyM_CertificateElementGetByIndex_Ssa_TrustModelBackendCert_Version_002
        CertElementGet_Ssa_TrustModelRootCert_ext_pkiRole: can-be-invoked-concurrently=true, symbol=KeyM_CertElementGet_Ssa_TrustModelRootCert_ext_pkiRole
        CertificateElementGetByIndex_Ssa_TrustModelRootCert_Issuer: can-be-invoked-concurrently=true, symbol=KeyM_CertificateElementGetByIndex_Ssa_TrustModelRootCert_Issuer
        CertificateElementGetByIndex_Ssa_TrustModelIntermediatePeerCert_Version_007: can-be-invoked-concurrently=true, symbol=KeyM_CertificateElementGetByIndex_Ssa_TrustModelIntermediatePeerCert_Version_007
        CertElementGet_Ssa_TrustModelBackendCert_ext_authKeyId_002: can-be-invoked-concurrently=true, symbol=KeyM_CertElementGet_Ssa_TrustModelBackendCert_ext_authKeyId_002
        CertElementGet_Ssa_TrustModelEcuPeerCert_validityNotBefore_006: can-be-invoked-concurrently=true, symbol=KeyM_CertElementGet_Ssa_TrustModelEcuPeerCert_validityNotBefore_006
        CertElementGet_Ssa_TrustModelBackendPeerCert_subject_004: can-be-invoked-concurrently=true, symbol=KeyM_CertElementGet_Ssa_TrustModelBackendPeerCert_subject_004
        CertificateElementGetByIndex_Ssa_TrustModelEcuCert_ext_subKeyId_005: can-be-invoked-concurrently=true, symbol=KeyM_CertificateElementGetByIndex_Ssa_TrustModelEcuCert_ext_subKeyId_005
        CertificateElementGetByIndex_Ssa_TrustModelRootCert_ext_keyUsage: can-be-invoked-concurrently=true, symbol=KeyM_CertificateElementGetByIndex_Ssa_TrustModelRootCert_ext_keyUsage
        CertElementGet_Ssa_TrustModelEcuPeerCert_SigAlgoId_006: can-be-invoked-concurrently=true, symbol=KeyM_CertElementGet_Ssa_TrustModelEcuPeerCert_SigAlgoId_006
        CertElementGet_Ssa_TrustModelBackendCert_Issuer_002: can-be-invoked-concurrently=true, symbol=KeyM_CertElementGet_Ssa_TrustModelBackendCert_Issuer_002
        CertificateElementGetByIndex_Ssa_TrustModelBackendPeerCert_ext_pkiRole_004: can-be-invoked-concurrently=true, symbol=KeyM_CertificateElementGetByIndex_Ssa_TrustModelBackendPeerCert_ext_pkiRole_004
        CertificateElementGetByIndex_Ssa_TrustModelIntermediatePeerCert_SigAlgoId_007: can-be-invoked-concurrently=true, symbol=KeyM_CertificateElementGetByIndex_Ssa_TrustModelIntermediatePeerCert_SigAlgoId_007
        CertElementGet_Ssa_TrustModelIntermediateCert_ext_subKeyId_003: can-be-invoked-concurrently=true, symbol=KeyM_CertElementGet_Ssa_TrustModelIntermediateCert_ext_subKeyId_003
        CertificateElementGetByIndex_Ssa_TrustModelBackendCert_SigAlgoId_002: can-be-invoked-concurrently=true, symbol=KeyM_CertificateElementGetByIndex_Ssa_TrustModelBackendCert_SigAlgoId_002
        CertificateElementGetByIndex_Ssa_TrustModelEcuCsr_ext_subKeyId_008: can-be-invoked-concurrently=true, symbol=KeyM_CertificateElementGetByIndex_Ssa_TrustModelEcuCsr_ext_subKeyId_008
        CertElementGet_Ssa_TrustModelEcuCsr_ext_specialEcu_007: can-be-invoked-concurrently=true, symbol=KeyM_CertElementGet_Ssa_TrustModelEcuCsr_ext_specialEcu_007
        CertElementGet_Ssa_TrustModelEcuCsr_ext_extKeyUsage_007: can-be-invoked-concurrently=true, symbol=KeyM_CertElementGet_Ssa_TrustModelEcuCsr_ext_extKeyUsage_007
        CertElementGet_Ssa_TrustModelRootCert_subject: can-be-invoked-concurrently=true, symbol=KeyM_CertElementGet_Ssa_TrustModelRootCert_subject
        CertElementGet_Ssa_TrustModelBackendCert_subject_002: can-be-invoked-concurrently=true, symbol=KeyM_CertElementGet_Ssa_TrustModelBackendCert_subject_002
        CertElementGet_Ssa_TrustModelEcuCsr_validityNotBefore_008: can-be-invoked-concurrently=true, symbol=KeyM_CertElementGet_Ssa_TrustModelEcuCsr_validityNotBefore_008
        CertificateElementGetByIndex_Ssa_TrustModelEcuPeerCert_SigAlgoId_006: can-be-invoked-concurrently=true, symbol=KeyM_CertificateElementGetByIndex_Ssa_TrustModelEcuPeerCert_SigAlgoId_006
        CertElementGet_Ssa_TrustModelBackendCert_ext_pkiRole_002: can-be-invoked-concurrently=true, symbol=KeyM_CertElementGet_Ssa_TrustModelBackendCert_ext_pkiRole_002
        CertElementGet_Ssa_TrustModelRootCert_signatureValue: can-be-invoked-concurrently=true, symbol=KeyM_CertElementGet_Ssa_TrustModelRootCert_signatureValue
        CertificateElementGetByIndex_Ssa_TrustModelBackendPeerCert_SerialNo_004: can-be-invoked-concurrently=true, symbol=KeyM_CertificateElementGetByIndex_Ssa_TrustModelBackendPeerCert_SerialNo_004
        CertificateElementGetByIndex_Ssa_TrustModelBackendPeerCert_ext_basicConstraints_004: can-be-invoked-concurrently=true, symbol=KeyM_CertificateElementGetByIndex_Ssa_TrustModelBackendPeerCert_ext_basicConstraints_004
        CertificateElementGetByIndex_Ssa_TrustModelEcuCsr_SubjectPublicKeyInfoAlgo_008: can-be-invoked-concurrently=true, symbol=KeyM_CertificateElementGetByIndex_Ssa_TrustModelEcuCsr_SubjectPublicKeyInfoAlgo_008
        CertElementGet_Ssa_TrustModelBackendPeerCert_SerialNo_004: can-be-invoked-concurrently=true, symbol=KeyM_CertElementGet_Ssa_TrustModelBackendPeerCert_SerialNo_004
        CertificateElementGetByIndex_Ssa_TrustModelRootCert_validityNotAfter: can-be-invoked-concurrently=true, symbol=KeyM_CertificateElementGetByIndex_Ssa_TrustModelRootCert_validityNotAfter
        CertElementGet_Ssa_TrustModelRootCert_validityNotAfter: can-be-invoked-concurrently=true, symbol=KeyM_CertElementGet_Ssa_TrustModelRootCert_validityNotAfter
        CertElementGet_Ssa_TrustModelEcuCert_SubjectPublicKeyInfoAlgo_005: can-be-invoked-concurrently=true, symbol=KeyM_CertElementGet_Ssa_TrustModelEcuCert_SubjectPublicKeyInfoAlgo_005
        CertificateElementGetByIndex_Ssa_TrustModelEcuPeerCert_ext_keyUsage_006: can-be-invoked-concurrently=true, symbol=KeyM_CertificateElementGetByIndex_Ssa_TrustModelEcuPeerCert_ext_keyUsage_006
        CertElementGet_Ssa_TrustModelIntermediatePeerCert_ext_subKeyId_007: can-be-invoked-concurrently=true, symbol=KeyM_CertElementGet_Ssa_TrustModelIntermediatePeerCert_ext_subKeyId_007
        CertElementGet_Ssa_TrustModelEcuPeerCert_SerialNo_006: can-be-invoked-concurrently=true, symbol=KeyM_CertElementGet_Ssa_TrustModelEcuPeerCert_SerialNo_006
        CertElementGet_Ssa_TrustModelEcuCert_validityNotAfter_005: can-be-invoked-concurrently=true, symbol=KeyM_CertElementGet_Ssa_TrustModelEcuCert_validityNotAfter_005
        CertificateElementGetByIndex_Ssa_TrustModelEcuCsr_Version_008: can-be-invoked-concurrently=true, symbol=KeyM_CertificateElementGetByIndex_Ssa_TrustModelEcuCsr_Version_008
        CertElementGet_Ssa_TrustModelBackendCert_SigAlgoId_002: can-be-invoked-concurrently=true, symbol=KeyM_CertElementGet_Ssa_TrustModelBackendCert_SigAlgoId_002
        CertificateElementGetByIndex_Ssa_TrustModelEcuCsr_ext_specialEcu_007: can-be-invoked-concurrently=true, symbol=KeyM_CertificateElementGetByIndex_Ssa_TrustModelEcuCsr_ext_specialEcu_007
        CertElementGet_Ssa_TrustModelBackendPeerCert_SubjectPublicKeyInfoAlgo_004: can-be-invoked-concurrently=true, symbol=KeyM_CertElementGet_Ssa_TrustModelBackendPeerCert_SubjectPublicKeyInfoAlgo_004
        CertElementGet_Ssa_TrustModelEcuCsr_signatureValue_008: can-be-invoked-concurrently=true, symbol=KeyM_CertElementGet_Ssa_TrustModelEcuCsr_signatureValue_008
        CertificateElementGetByIndex_Ssa_TrustModelEcuCsr_ext_uniqueECUID_007: can-be-invoked-concurrently=true, symbol=KeyM_CertificateElementGetByIndex_Ssa_TrustModelEcuCsr_ext_uniqueECUID_007
        CertificateElementGetByIndex_Ssa_TrustModelIntermediateCert_ext_subKeyId_003: can-be-invoked-concurrently=true, symbol=KeyM_CertificateElementGetByIndex_Ssa_TrustModelIntermediateCert_ext_subKeyId_003
        CertElementGet_Ssa_TrustModelIntermediatePeerCert_SerialNo_007: can-be-invoked-concurrently=true, symbol=KeyM_CertElementGet_Ssa_TrustModelIntermediatePeerCert_SerialNo_007
        CertificateElementGetByIndex_Ssa_TrustModelEcuCsr_SubjectPublicKeyInfoKey_008: can-be-invoked-concurrently=true, symbol=KeyM_CertificateElementGetByIndex_Ssa_TrustModelEcuCsr_SubjectPublicKeyInfoKey_008
        CertificateElementGetByIndex_Ssa_TrustModelEcuCsr_ext_extKeyUsage_oid1_007: can-be-invoked-concurrently=true, symbol=KeyM_CertificateElementGetByIndex_Ssa_TrustModelEcuCsr_ext_extKeyUsage_oid1_007
        CertificateElementGetByIndex_Ssa_TrustModelEcuCert_subject_005: can-be-invoked-concurrently=true, symbol=KeyM_CertificateElementGetByIndex_Ssa_TrustModelEcuCert_subject_005
        CertificateElementGetByIndex_Ssa_TrustModelIntermediatePeerCert_SubjectPublicKeyInfoKey_007: can-be-invoked-concurrently=true, symbol=KeyM_CertificateElementGetByIndex_Ssa_TrustModelIntermediatePeerCert_SubjectPublicKeyInfoKey_007
        CertificateElementGetByIndex_Ssa_TrustModelEcuCsr_SerialNo_008: can-be-invoked-concurrently=true, symbol=KeyM_CertificateElementGetByIndex_Ssa_TrustModelEcuCsr_SerialNo_008
        CertificateElementGetByIndex_Ssa_TrustModelEcuPeerCert_SubjectPublicKeyInfoKey_006: can-be-invoked-concurrently=true, symbol=KeyM_CertificateElementGetByIndex_Ssa_TrustModelEcuPeerCert_SubjectPublicKeyInfoKey_006
        CertificateElementGetByIndex_Ssa_TrustModelBackendPeerCert_Issuer_004: can-be-invoked-concurrently=true, symbol=KeyM_CertificateElementGetByIndex_Ssa_TrustModelBackendPeerCert_Issuer_004
        CertificateElementGetByIndex_Ssa_TrustModelRootCert_signatureAlgorithm: can-be-invoked-concurrently=true, symbol=KeyM_CertificateElementGetByIndex_Ssa_TrustModelRootCert_signatureAlgorithm
        CertificateElementGetByIndex_Ssa_TrustModelIntermediatePeerCert_SubjectPublicKeyInfoAlgo_007: can-be-invoked-concurrently=true, symbol=KeyM_CertificateElementGetByIndex_Ssa_TrustModelIntermediatePeerCert_SubjectPublicKeyInfoAlgo_007
        CertElementGet_Ssa_TrustModelBackendPeerCert_validityNotAfter_004: can-be-invoked-concurrently=true, symbol=KeyM_CertElementGet_Ssa_TrustModelBackendPeerCert_validityNotAfter_004
        CertificateElementGetByIndex_Ssa_TrustModelRootCert_ext_authKeyId_009: can-be-invoked-concurrently=true, symbol=KeyM_CertificateElementGetByIndex_Ssa_TrustModelRootCert_ext_authKeyId_009
        CertElementGet_Ssa_TrustModelIntermediateCert_SerialNo_003: can-be-invoked-concurrently=true, symbol=KeyM_CertElementGet_Ssa_TrustModelIntermediateCert_SerialNo_003
        CertificateElementGetByIndex_Ssa_TrustModelBackendPeerCert_SubjectPublicKeyInfoAlgo_004: can-be-invoked-concurrently=true, symbol=KeyM_CertificateElementGetByIndex_Ssa_TrustModelBackendPeerCert_SubjectPublicKeyInfoAlgo_004
        CertElementGet_Ssa_TrustModelEcuCert_SubjectPublicKeyInfoKey_005: can-be-invoked-concurrently=true, symbol=KeyM_CertElementGet_Ssa_TrustModelEcuCert_SubjectPublicKeyInfoKey_005
        CertificateElementGetByIndex_Ssa_TrustModelIntermediateCert_SubjectPublicKeyInfoKey_003: can-be-invoked-concurrently=true, symbol=KeyM_CertificateElementGetByIndex_Ssa_TrustModelIntermediateCert_SubjectPublicKeyInfoKey_003
        CertElementGet_Ssa_TrustModelEcuCsr_ext_extKeyUsage_oid1_007: can-be-invoked-concurrently=true, symbol=KeyM_CertElementGet_Ssa_TrustModelEcuCsr_ext_extKeyUsage_oid1_007
        CertElementGet_Ssa_TrustModelBackendPeerCert_ext_pkiRole_004: can-be-invoked-concurrently=true, symbol=KeyM_CertElementGet_Ssa_TrustModelBackendPeerCert_ext_pkiRole_004
        CertElementGet_Ssa_TrustModelEcuPeerCert_ext_authKeyId_006: can-be-invoked-concurrently=true, symbol=KeyM_CertElementGet_Ssa_TrustModelEcuPeerCert_ext_authKeyId_006
        CertElementGet_Ssa_TrustModelEcuCsr_Version_008: can-be-invoked-concurrently=true, symbol=KeyM_CertElementGet_Ssa_TrustModelEcuCsr_Version_008
        CertElementGet_Ssa_TrustModelEcuCert_ext_keyUsage_005: can-be-invoked-concurrently=true, symbol=KeyM_CertElementGet_Ssa_TrustModelEcuCert_ext_keyUsage_005
        CertElementGet_Ssa_TrustModelIntermediateCert_validityNotAfter_003: can-be-invoked-concurrently=true, symbol=KeyM_CertElementGet_Ssa_TrustModelIntermediateCert_validityNotAfter_003
        CertElementGet_Ssa_TrustModelIntermediatePeerCert_validityNotBefore_007: can-be-invoked-concurrently=true, symbol=KeyM_CertElementGet_Ssa_TrustModelIntermediatePeerCert_validityNotBefore_007
        CertificateElementGetByIndex_Ssa_TrustModelBackendCert_SerialNo_002: can-be-invoked-concurrently=true, symbol=KeyM_CertificateElementGetByIndex_Ssa_TrustModelBackendCert_SerialNo_002
        CertificateElementGetByIndex_Ssa_TrustModelEcuPeerCert_ext_subKeyId_006: can-be-invoked-concurrently=true, symbol=KeyM_CertificateElementGetByIndex_Ssa_TrustModelEcuPeerCert_ext_subKeyId_006
        CertificateElementGetByIndex_Ssa_TrustModelIntermediateCert_signatureValue_003: can-be-invoked-concurrently=true, symbol=KeyM_CertificateElementGetByIndex_Ssa_TrustModelIntermediateCert_signatureValue_003
        CertificateElementGetByIndex_Ssa_TrustModelEcuCert_ext_pkiRole_006: can-be-invoked-concurrently=true, symbol=KeyM_CertificateElementGetByIndex_Ssa_TrustModelEcuCert_ext_pkiRole_006
        CertElementGet_Ssa_TrustModelBackendCert_signatureAlgorithm_002: can-be-invoked-concurrently=true, symbol=KeyM_CertElementGet_Ssa_TrustModelBackendCert_signatureAlgorithm_002
        CertificateElementGetByIndex_Ssa_TrustModelEcuCert_ext_authKeyId_005: can-be-invoked-concurrently=true, symbol=KeyM_CertificateElementGetByIndex_Ssa_TrustModelEcuCert_ext_authKeyId_005
        CertElementGet_Ssa_TrustModelRootCert_Version: can-be-invoked-concurrently=true, symbol=KeyM_CertElementGet_Ssa_TrustModelRootCert_Version
        CertElementGet_Ssa_TrustModelRootCert_ext_basicConstraints: can-be-invoked-concurrently=true, symbol=KeyM_CertElementGet_Ssa_TrustModelRootCert_ext_basicConstraints
        CertElementGet_Ssa_TrustModelEcuCert_ext_specialEcu_005: can-be-invoked-concurrently=true, symbol=KeyM_CertElementGet_Ssa_TrustModelEcuCert_ext_specialEcu_005
        CertElementGet_Ssa_TrustModelIntermediateCert_ext_authKeyId_003: can-be-invoked-concurrently=true, symbol=KeyM_CertElementGet_Ssa_TrustModelIntermediateCert_ext_authKeyId_003
        CertificateElementGetByIndex_Ssa_TrustModelEcuCsr_validityNotBefore_008: can-be-invoked-concurrently=true, symbol=KeyM_CertificateElementGetByIndex_Ssa_TrustModelEcuCsr_validityNotBefore_008
        CertificateElementGetByIndex_Ssa_TrustModelEcuCsr_signatureAlgorithm_008: can-be-invoked-concurrently=true, symbol=KeyM_CertificateElementGetByIndex_Ssa_TrustModelEcuCsr_signatureAlgorithm_008
        CertElementGet_Ssa_TrustModelIntermediatePeerCert_signatureAlgorithm_007: can-be-invoked-concurrently=true, symbol=KeyM_CertElementGet_Ssa_TrustModelIntermediatePeerCert_signatureAlgorithm_007
        CertElementGet_Ssa_TrustModelEcuPeerCert_Issuer_006: can-be-invoked-concurrently=true, symbol=KeyM_CertElementGet_Ssa_TrustModelEcuPeerCert_Issuer_006
        CertificateElementGetByIndex_Ssa_TrustModelEcuPeerCert_Issuer_006: can-be-invoked-concurrently=true, symbol=KeyM_CertificateElementGetByIndex_Ssa_TrustModelEcuPeerCert_Issuer_006
        CertElementGet_Ssa_TrustModelBackendPeerCert_ext_authKeyId_004: can-be-invoked-concurrently=true, symbol=KeyM_CertElementGet_Ssa_TrustModelBackendPeerCert_ext_authKeyId_004
        CertElementGet_Ssa_TrustModelBackendCert_SubjectPublicKeyInfoKey_002: can-be-invoked-concurrently=true, symbol=KeyM_CertElementGet_Ssa_TrustModelBackendCert_SubjectPublicKeyInfoKey_002
        CertElementGet_Ssa_TrustModelBackendCert_validityNotBefore_002: can-be-invoked-concurrently=true, symbol=KeyM_CertElementGet_Ssa_TrustModelBackendCert_validityNotBefore_002
        CertificateElementGetByIndex_Ssa_TrustModelBackendPeerCert_SubjectPublicKeyInfoKey_004: can-be-invoked-concurrently=true, symbol=KeyM_CertificateElementGetByIndex_Ssa_TrustModelBackendPeerCert_SubjectPublicKeyInfoKey_004
        CertElementGet_Ssa_TrustModelEcuCsr_SubjectPublicKeyInfoAlgo_008: can-be-invoked-concurrently=true, symbol=KeyM_CertElementGet_Ssa_TrustModelEcuCsr_SubjectPublicKeyInfoAlgo_008
        CertificateElementGetByIndex_Ssa_TrustModelIntermediateCert_ext_pkiRole_003: can-be-invoked-concurrently=true, symbol=KeyM_CertificateElementGetByIndex_Ssa_TrustModelIntermediateCert_ext_pkiRole_003
        CertElementGet_Ssa_TrustModelIntermediatePeerCert_Issuer_007: can-be-invoked-concurrently=true, symbol=KeyM_CertElementGet_Ssa_TrustModelIntermediatePeerCert_Issuer_007
        CertElementGet_Ssa_TrustModelIntermediatePeerCert_ext_keyUsage_007: can-be-invoked-concurrently=true, symbol=KeyM_CertElementGet_Ssa_TrustModelIntermediatePeerCert_ext_keyUsage_007
        CertificateElementGetByIndex_Ssa_TrustModelEcuCsr_ext_authKeyId_008: can-be-invoked-concurrently=true, symbol=KeyM_CertificateElementGetByIndex_Ssa_TrustModelEcuCsr_ext_authKeyId_008
        CertificateElementGetByIndex_Ssa_TrustModelBackendCert_signatureAlgorithm_002: can-be-invoked-concurrently=true, symbol=KeyM_CertificateElementGetByIndex_Ssa_TrustModelBackendCert_signatureAlgorithm_002
        CertificateElementGetByIndex_Ssa_TrustModelEcuCsr_SigAlgoId_008: can-be-invoked-concurrently=true, symbol=KeyM_CertificateElementGetByIndex_Ssa_TrustModelEcuCsr_SigAlgoId_008
        CertificateElementGetByIndex_Ssa_TrustModelEcuCsr_validityNotAfter_008: can-be-invoked-concurrently=true, symbol=KeyM_CertificateElementGetByIndex_Ssa_TrustModelEcuCsr_validityNotAfter_008
        CertificateElementGetByIndex_Ssa_TrustModelIntermediateCert_Version_003: can-be-invoked-concurrently=true, symbol=KeyM_CertificateElementGetByIndex_Ssa_TrustModelIntermediateCert_Version_003
        CertElementGet_Ssa_TrustModelBackendCert_ext_keyUsage_002: can-be-invoked-concurrently=true, symbol=KeyM_CertElementGet_Ssa_TrustModelBackendCert_ext_keyUsage_002
        CertificateElementGetByIndex_Ssa_TrustModelBackendPeerCert_validityNotAfter_004: can-be-invoked-concurrently=true, symbol=KeyM_CertificateElementGetByIndex_Ssa_TrustModelBackendPeerCert_validityNotAfter_004
        CertElementGet_Ssa_TrustModelBackendPeerCert_Issuer_004: can-be-invoked-concurrently=true, symbol=KeyM_CertElementGet_Ssa_TrustModelBackendPeerCert_Issuer_004
        CertificateElementGetByIndex_Ssa_TrustModelRootCert_SubjectPublicKeyInfoAlgo: can-be-invoked-concurrently=true, symbol=KeyM_CertificateElementGetByIndex_Ssa_TrustModelRootCert_SubjectPublicKeyInfoAlgo
        CertificateElementGetByIndex_Ssa_TrustModelEcuPeerCert_validityNotAfter_006: can-be-invoked-concurrently=true, symbol=KeyM_CertificateElementGetByIndex_Ssa_TrustModelEcuPeerCert_validityNotAfter_006
        CertElementGet_Ssa_TrustModelEcuCert_validityNotBefore_005: can-be-invoked-concurrently=true, symbol=KeyM_CertElementGet_Ssa_TrustModelEcuCert_validityNotBefore_005
        CertificateElementGetByIndex_Ssa_TrustModelIntermediatePeerCert_SerialNo_007: can-be-invoked-concurrently=true, symbol=KeyM_CertificateElementGetByIndex_Ssa_TrustModelIntermediatePeerCert_SerialNo_007
        CertificateElementGetByIndex_Ssa_TrustModelIntermediatePeerCert_ext_basicConstraints_005: can-be-invoked-concurrently=true, symbol=KeyM_CertificateElementGetByIndex_Ssa_TrustModelIntermediatePeerCert_ext_basicConstraints_005
        CertificateElementGetByIndex_Ssa_TrustModelEcuPeerCert_subject_006: can-be-invoked-concurrently=true, symbol=KeyM_CertificateElementGetByIndex_Ssa_TrustModelEcuPeerCert_subject_006
        CertificateElementGetByIndex_Ssa_TrustModelRootCert_SigAlgoId: can-be-invoked-concurrently=true, symbol=KeyM_CertificateElementGetByIndex_Ssa_TrustModelRootCert_SigAlgoId
        CertificateElementGetByIndex_Ssa_TrustModelEcuCert_ext_uniqueECUID_005: can-be-invoked-concurrently=true, symbol=KeyM_CertificateElementGetByIndex_Ssa_TrustModelEcuCert_ext_uniqueECUID_005
        CertificateElementGetByIndex_Ssa_TrustModelIntermediatePeerCert_ext_pkiRole_005: can-be-invoked-concurrently=true, symbol=KeyM_CertificateElementGetByIndex_Ssa_TrustModelIntermediatePeerCert_ext_pkiRole_005
        CertElementGet_Ssa_TrustModelEcuPeerCert_validityNotAfter_006: can-be-invoked-concurrently=true, symbol=KeyM_CertElementGet_Ssa_TrustModelEcuPeerCert_validityNotAfter_006
        CertElementGet_Ssa_TrustModelRootCert_ext_keyUsage: can-be-invoked-concurrently=true, symbol=KeyM_CertElementGet_Ssa_TrustModelRootCert_ext_keyUsage
        CertificateElementGetByIndex_Ssa_TrustModelIntermediatePeerCert_Issuer_007: can-be-invoked-concurrently=true, symbol=KeyM_CertificateElementGetByIndex_Ssa_TrustModelIntermediatePeerCert_Issuer_007
        CertElementGet_Ssa_TrustModelEcuCsr_ext_extKeyUsage_oid2_007: can-be-invoked-concurrently=true, symbol=KeyM_CertElementGet_Ssa_TrustModelEcuCsr_ext_extKeyUsage_oid2_007
        CertElementGet_Ssa_TrustModelEcuCert_ext_subKeyId_005: can-be-invoked-concurrently=true, symbol=KeyM_CertElementGet_Ssa_TrustModelEcuCert_ext_subKeyId_005
        CertElementGet_Ssa_TrustModelIntermediateCert_validityNotBefore_003: can-be-invoked-concurrently=true, symbol=KeyM_CertElementGet_Ssa_TrustModelIntermediateCert_validityNotBefore_003
        CertElementGet_Ssa_TrustModelIntermediatePeerCert_ext_authKeyId_007: can-be-invoked-concurrently=true, symbol=KeyM_CertElementGet_Ssa_TrustModelIntermediatePeerCert_ext_authKeyId_007
        CertificateElementGetByIndex_Ssa_TrustModelIntermediatePeerCert_validityNotAfter_007: can-be-invoked-concurrently=true, symbol=KeyM_CertificateElementGetByIndex_Ssa_TrustModelIntermediatePeerCert_validityNotAfter_007
        CertElementGet_Ssa_TrustModelEcuCsr_ext_keyUsage_008: can-be-invoked-concurrently=true, symbol=KeyM_CertElementGet_Ssa_TrustModelEcuCsr_ext_keyUsage_008
        CertificateElementGetByIndex_Ssa_TrustModelEcuCsr_subject_008: can-be-invoked-concurrently=true, symbol=KeyM_CertificateElementGetByIndex_Ssa_TrustModelEcuCsr_subject_008
        CertElementGet_Ssa_TrustModelRootCert_Issuer: can-be-invoked-concurrently=true, symbol=KeyM_CertElementGet_Ssa_TrustModelRootCert_Issuer
        CertElementGet_Ssa_TrustModelEcuPeerCert_SubjectPublicKeyInfoAlgo_006: can-be-invoked-concurrently=true, symbol=KeyM_CertElementGet_Ssa_TrustModelEcuPeerCert_SubjectPublicKeyInfoAlgo_006
        CertElementGet_Ssa_TrustModelIntermediatePeerCert_validityNotAfter_007: can-be-invoked-concurrently=true, symbol=KeyM_CertElementGet_Ssa_TrustModelIntermediatePeerCert_validityNotAfter_007
        CertificateElementGetByIndex_Ssa_TrustModelEcuCsr_ext_keyUsage_008: can-be-invoked-concurrently=true, symbol=KeyM_CertificateElementGetByIndex_Ssa_TrustModelEcuCsr_ext_keyUsage_008
        CertElementGet_Ssa_TrustModelIntermediateCert_SubjectPublicKeyInfoAlgo_003: can-be-invoked-concurrently=true, symbol=KeyM_CertElementGet_Ssa_TrustModelIntermediateCert_SubjectPublicKeyInfoAlgo_003
        CertificateElementGetByIndex_Ssa_TrustModelRootCert_ext_subKeyId: can-be-invoked-concurrently=true, symbol=KeyM_CertificateElementGetByIndex_Ssa_TrustModelRootCert_ext_subKeyId
        CertificateElementGetByIndex_Ssa_TrustModelEcuCsr_ext_pkiRole_008: can-be-invoked-concurrently=true, symbol=KeyM_CertificateElementGetByIndex_Ssa_TrustModelEcuCsr_ext_pkiRole_008
        CertElementGet_Ssa_TrustModelEcuPeerCert_Version_006: can-be-invoked-concurrently=true, symbol=KeyM_CertElementGet_Ssa_TrustModelEcuPeerCert_Version_006
        CertificateElementGetByIndex_Ssa_TrustModelBackendPeerCert_signatureAlgorithm_004: can-be-invoked-concurrently=true, symbol=KeyM_CertificateElementGetByIndex_Ssa_TrustModelBackendPeerCert_signatureAlgorithm_004
        CertElementGet_Ssa_TrustModelBackendPeerCert_Version_004: can-be-invoked-concurrently=true, symbol=KeyM_CertElementGet_Ssa_TrustModelBackendPeerCert_Version_004
        CertificateElementGetByIndex_Ssa_TrustModelIntermediateCert_SerialNo_003: can-be-invoked-concurrently=true, symbol=KeyM_CertificateElementGetByIndex_Ssa_TrustModelIntermediateCert_SerialNo_003
        CertElementGet_Ssa_TrustModelIntermediateCert_SubjectPublicKeyInfoKey_003: can-be-invoked-concurrently=true, symbol=KeyM_CertElementGet_Ssa_TrustModelIntermediateCert_SubjectPublicKeyInfoKey_003
        CertElementGet_Ssa_TrustModelRootCert_signatureAlgorithm: can-be-invoked-concurrently=true, symbol=KeyM_CertElementGet_Ssa_TrustModelRootCert_signatureAlgorithm
        CertElementGet_Ssa_TrustModelEcuCert_ext_pkiRole_006: can-be-invoked-concurrently=true, symbol=KeyM_CertElementGet_Ssa_TrustModelEcuCert_ext_pkiRole_006
        CertElementGet_Ssa_TrustModelEcuPeerCert_signatureAlgorithm_006: can-be-invoked-concurrently=true, symbol=KeyM_CertElementGet_Ssa_TrustModelEcuPeerCert_signatureAlgorithm_006
        CertificateElementGetByIndex_Ssa_TrustModelRootCert_signatureValue: can-be-invoked-concurrently=true, symbol=KeyM_CertificateElementGetByIndex_Ssa_TrustModelRootCert_signatureValue
        CertificateElementGetByIndex_Ssa_TrustModelEcuPeerCert_ext_uniqueECUID_006: can-be-invoked-concurrently=true, symbol=KeyM_CertificateElementGetByIndex_Ssa_TrustModelEcuPeerCert_ext_uniqueECUID_006
        CertificateElementGetByIndex_Ssa_TrustModelBackendPeerCert_validityNotBefore_004: can-be-invoked-concurrently=true, symbol=KeyM_CertificateElementGetByIndex_Ssa_TrustModelBackendPeerCert_validityNotBefore_004
        CertElementGet_Ssa_TrustModelBackendCert_SubjectPublicKeyInfoAlgo_002: can-be-invoked-concurrently=true, symbol=KeyM_CertElementGet_Ssa_TrustModelBackendCert_SubjectPublicKeyInfoAlgo_002
        CertElementGet_Ssa_TrustModelEcuCsr_SubjectPublicKeyInfoKey_008: can-be-invoked-concurrently=true, symbol=KeyM_CertElementGet_Ssa_TrustModelEcuCsr_SubjectPublicKeyInfoKey_008
        CertificateElementGetByIndex_Ssa_TrustModelBackendPeerCert_Version_004: can-be-invoked-concurrently=true, symbol=KeyM_CertificateElementGetByIndex_Ssa_TrustModelBackendPeerCert_Version_004
        CertificateElementGetByIndex_Ssa_TrustModelBackendCert_validityNotAfter_002: can-be-invoked-concurrently=true, symbol=KeyM_CertificateElementGetByIndex_Ssa_TrustModelBackendCert_validityNotAfter_002
        CertElementGet_Ssa_TrustModelBackendPeerCert_validityNotBefore_004: can-be-invoked-concurrently=true, symbol=KeyM_CertElementGet_Ssa_TrustModelBackendPeerCert_validityNotBefore_004
        CertElementGet_Ssa_TrustModelIntermediateCert_subject_003: can-be-invoked-concurrently=true, symbol=KeyM_CertElementGet_Ssa_TrustModelIntermediateCert_subject_003
        CertElementGet_Ssa_TrustModelRootCert_ext_subKeyId: can-be-invoked-concurrently=true, symbol=KeyM_CertElementGet_Ssa_TrustModelRootCert_ext_subKeyId
        CertificateElementGetByIndex_Ssa_TrustModelBackendPeerCert_ext_keyUsage_004: can-be-invoked-concurrently=true, symbol=KeyM_CertificateElementGetByIndex_Ssa_TrustModelBackendPeerCert_ext_keyUsage_004
        CertificateElementGetByIndex_Ssa_TrustModelIntermediatePeerCert_signatureAlgorithm_007: can-be-invoked-concurrently=true, symbol=KeyM_CertificateElementGetByIndex_Ssa_TrustModelIntermediatePeerCert_signatureAlgorithm_007
        CertElementGet_Ssa_TrustModelEcuCsr_ext_pkiRole_008: can-be-invoked-concurrently=true, symbol=KeyM_CertElementGet_Ssa_TrustModelEcuCsr_ext_pkiRole_008
        CertElementGet_Ssa_TrustModelBackendCert_ext_basicConstraints_002: can-be-invoked-concurrently=true, symbol=KeyM_CertElementGet_Ssa_TrustModelBackendCert_ext_basicConstraints_002
        CertificateElementGetByIndex_Ssa_TrustModelIntermediateCert_validityNotAfter_003: can-be-invoked-concurrently=true, symbol=KeyM_CertificateElementGetByIndex_Ssa_TrustModelIntermediateCert_validityNotAfter_003
        CertificateElementGetByIndex_Ssa_TrustModelEcuCsr_signatureValue_008: can-be-invoked-concurrently=true, symbol=KeyM_CertificateElementGetByIndex_Ssa_TrustModelEcuCsr_signatureValue_008
        CertificateElementGetByIndex_Ssa_TrustModelEcuPeerCert_validityNotBefore_006: can-be-invoked-concurrently=true, symbol=KeyM_CertificateElementGetByIndex_Ssa_TrustModelEcuPeerCert_validityNotBefore_006
        CertElementGet_Ssa_TrustModelIntermediateCert_ext_pkiRole_003: can-be-invoked-concurrently=true, symbol=KeyM_CertElementGet_Ssa_TrustModelIntermediateCert_ext_pkiRole_003
        CertElementGet_Ssa_TrustModelEcuCsr_subject_008: can-be-invoked-concurrently=true, symbol=KeyM_CertElementGet_Ssa_TrustModelEcuCsr_subject_008
        CertificateElementGetByIndex_Ssa_TrustModelBackendCert_SubjectPublicKeyInfoKey_002: can-be-invoked-concurrently=true, symbol=KeyM_CertificateElementGetByIndex_Ssa_TrustModelBackendCert_SubjectPublicKeyInfoKey_002
        CertElementGet_Ssa_TrustModelBackendPeerCert_ext_subKeyId_004: can-be-invoked-concurrently=true, symbol=KeyM_CertElementGet_Ssa_TrustModelBackendPeerCert_ext_subKeyId_004
        CertificateElementGetByIndex_Ssa_TrustModelIntermediateCert_validityNotBefore_003: can-be-invoked-concurrently=true, symbol=KeyM_CertificateElementGetByIndex_Ssa_TrustModelIntermediateCert_validityNotBefore_003
        CertElementGet_Ssa_TrustModelEcuPeerCert_ext_specialEcu_006: can-be-invoked-concurrently=true, symbol=KeyM_CertElementGet_Ssa_TrustModelEcuPeerCert_ext_specialEcu_006
        CertificateElementGetByIndex_Ssa_TrustModelBackendCert_SubjectPublicKeyInfoAlgo_002: can-be-invoked-concurrently=true, symbol=KeyM_CertificateElementGetByIndex_Ssa_TrustModelBackendCert_SubjectPublicKeyInfoAlgo_002
        CertificateElementGetByIndex_Ssa_TrustModelBackendPeerCert_SigAlgoId_004: can-be-invoked-concurrently=true, symbol=KeyM_CertificateElementGetByIndex_Ssa_TrustModelBackendPeerCert_SigAlgoId_004
        CertElementGet_Ssa_TrustModelBackendPeerCert_signatureAlgorithm_004: can-be-invoked-concurrently=true, symbol=KeyM_CertElementGet_Ssa_TrustModelBackendPeerCert_signatureAlgorithm_004
        CertElementGet_Ssa_TrustModelBackendPeerCert_ext_keyUsage_004: can-be-invoked-concurrently=true, symbol=KeyM_CertElementGet_Ssa_TrustModelBackendPeerCert_ext_keyUsage_004
        CertElementGet_Ssa_TrustModelBackendCert_signatureValue_002: can-be-invoked-concurrently=true, symbol=KeyM_CertElementGet_Ssa_TrustModelBackendCert_signatureValue_002
        CertElementGet_Ssa_TrustModelEcuCert_ext_authKeyId_005: can-be-invoked-concurrently=true, symbol=KeyM_CertElementGet_Ssa_TrustModelEcuCert_ext_authKeyId_005
        CertElementGet_Ssa_TrustModelEcuCert_ext_uniqueECUID_005: can-be-invoked-concurrently=true, symbol=KeyM_CertElementGet_Ssa_TrustModelEcuCert_ext_uniqueECUID_005
        CertificateElementGetByIndex_Ssa_TrustModelEcuCert_SubjectPublicKeyInfoKey_005: can-be-invoked-concurrently=true, symbol=KeyM_CertificateElementGetByIndex_Ssa_TrustModelEcuCert_SubjectPublicKeyInfoKey_005
        CertificateElementGetByIndex_Ssa_TrustModelEcuPeerCert_SerialNo_006: can-be-invoked-concurrently=true, symbol=KeyM_CertificateElementGetByIndex_Ssa_TrustModelEcuPeerCert_SerialNo_006
        CertElementGet_Ssa_TrustModelIntermediatePeerCert_SigAlgoId_007: can-be-invoked-concurrently=true, symbol=KeyM_CertElementGet_Ssa_TrustModelIntermediatePeerCert_SigAlgoId_007
        CertElementGet_Ssa_TrustModelEcuCsr_validityNotAfter_008: can-be-invoked-concurrently=true, symbol=KeyM_CertElementGet_Ssa_TrustModelEcuCsr_validityNotAfter_008
        CertElementGet_Ssa_TrustModelEcuPeerCert_ext_uniqueECUID_006: can-be-invoked-concurrently=true, symbol=KeyM_CertElementGet_Ssa_TrustModelEcuPeerCert_ext_uniqueECUID_006
        CertificateElementGetByIndex_Ssa_TrustModelEcuPeerCert_Version_006: can-be-invoked-concurrently=true, symbol=KeyM_CertificateElementGetByIndex_Ssa_TrustModelEcuPeerCert_Version_006
        CertElementGet_Ssa_TrustModelIntermediateCert_Issuer_003: can-be-invoked-concurrently=true, symbol=KeyM_CertElementGet_Ssa_TrustModelIntermediateCert_Issuer_003
        CertElementGet_Ssa_TrustModelIntermediatePeerCert_Version_007: can-be-invoked-concurrently=true, symbol=KeyM_CertElementGet_Ssa_TrustModelIntermediatePeerCert_Version_007
        CertificateElementGetByIndex_Ssa_TrustModelEcuPeerCert_signatureAlgorithm_006: can-be-invoked-concurrently=true, symbol=KeyM_CertificateElementGetByIndex_Ssa_TrustModelEcuPeerCert_signatureAlgorithm_006
        CertificateElementGetByIndex_Ssa_TrustModelIntermediatePeerCert_ext_authKeyId_007: can-be-invoked-concurrently=true, symbol=KeyM_CertificateElementGetByIndex_Ssa_TrustModelIntermediatePeerCert_ext_authKeyId_007
        CertificateElementGetByIndex_Ssa_TrustModelBackendPeerCert_subject_004: can-be-invoked-concurrently=true, symbol=KeyM_CertificateElementGetByIndex_Ssa_TrustModelBackendPeerCert_subject_004
        CertificateElementGetByIndex_Ssa_TrustModelEcuCert_ext_specialEcu_005: can-be-invoked-concurrently=true, symbol=KeyM_CertificateElementGetByIndex_Ssa_TrustModelEcuCert_ext_specialEcu_005
        CertificateElementGetByIndex_Ssa_TrustModelBackendCert_ext_pkiRole_002: can-be-invoked-concurrently=true, symbol=KeyM_CertificateElementGetByIndex_Ssa_TrustModelBackendCert_ext_pkiRole_002
        CertElementGet_Ssa_TrustModelRootCert_validityNotBefore: can-be-invoked-concurrently=true, symbol=KeyM_CertElementGet_Ssa_TrustModelRootCert_validityNotBefore
        CertificateElementGetByIndex_Ssa_TrustModelBackendPeerCert_ext_subKeyId_004: can-be-invoked-concurrently=true, symbol=KeyM_CertificateElementGetByIndex_Ssa_TrustModelBackendPeerCert_ext_subKeyId_004
        CertElementGet_Ssa_TrustModelEcuCsr_signatureAlgorithm_008: can-be-invoked-concurrently=true, symbol=KeyM_CertElementGet_Ssa_TrustModelEcuCsr_signatureAlgorithm_008
        CertificateElementGetByIndex_Ssa_TrustModelEcuCert_SerialNo_005: can-be-invoked-concurrently=true, symbol=KeyM_CertificateElementGetByIndex_Ssa_TrustModelEcuCert_SerialNo_005
        CertElementGet_Ssa_TrustModelIntermediatePeerCert_SubjectPublicKeyInfoKey_007: can-be-invoked-concurrently=true, symbol=KeyM_CertElementGet_Ssa_TrustModelIntermediatePeerCert_SubjectPublicKeyInfoKey_007
        CertificateElementGetByIndex_Ssa_TrustModelIntermediatePeerCert_signatureValue_007: can-be-invoked-concurrently=true, symbol=KeyM_CertificateElementGetByIndex_Ssa_TrustModelIntermediatePeerCert_signatureValue_007
        CertElementGet_Ssa_TrustModelIntermediatePeerCert_subject_007: can-be-invoked-concurrently=true, symbol=KeyM_CertElementGet_Ssa_TrustModelIntermediatePeerCert_subject_007
        CertElementGet_Ssa_TrustModelEcuPeerCert_ext_keyUsage_006: can-be-invoked-concurrently=true, symbol=KeyM_CertElementGet_Ssa_TrustModelEcuPeerCert_ext_keyUsage_006
        CertificateElementGetByIndex_Ssa_TrustModelIntermediateCert_ext_keyUsage_003: can-be-invoked-concurrently=true, symbol=KeyM_CertificateElementGetByIndex_Ssa_TrustModelIntermediateCert_ext_keyUsage_003
        CertificateElementGetByIndex_Ssa_TrustModelBackendCert_validityNotBefore_002: can-be-invoked-concurrently=true, symbol=KeyM_CertificateElementGetByIndex_Ssa_TrustModelBackendCert_validityNotBefore_002
        CertElementGet_Ssa_TrustModelEcuCert_SigAlgoId_005: can-be-invoked-concurrently=true, symbol=KeyM_CertElementGet_Ssa_TrustModelEcuCert_SigAlgoId_005
        CertElementGet_Ssa_TrustModelEcuCsr_SerialNo_008: can-be-invoked-concurrently=true, symbol=KeyM_CertElementGet_Ssa_TrustModelEcuCsr_SerialNo_008
        CertificateElementGetByIndex_Ssa_TrustModelRootCert_ext_basicConstraints: can-be-invoked-concurrently=true, symbol=KeyM_CertificateElementGetByIndex_Ssa_TrustModelRootCert_ext_basicConstraints
        CertElementGet_Ssa_TrustModelIntermediateCert_Version_003: can-be-invoked-concurrently=true, symbol=KeyM_CertElementGet_Ssa_TrustModelIntermediateCert_Version_003
        CertElementGet_Ssa_TrustModelBackendCert_SerialNo_002: can-be-invoked-concurrently=true, symbol=KeyM_CertElementGet_Ssa_TrustModelBackendCert_SerialNo_002
        CertElementGet_Ssa_TrustModelRootCert_SubjectPublicKeyInfoKey: can-be-invoked-concurrently=true, symbol=KeyM_CertElementGet_Ssa_TrustModelRootCert_SubjectPublicKeyInfoKey
        CertificateElementGetByIndex_Ssa_TrustModelIntermediatePeerCert_ext_subKeyId_007: can-be-invoked-concurrently=true, symbol=KeyM_CertificateElementGetByIndex_Ssa_TrustModelIntermediatePeerCert_ext_subKeyId_007
        CertElementGet_Ssa_TrustModelEcuCsr_ext_subKeyId_008: can-be-invoked-concurrently=true, symbol=KeyM_CertElementGet_Ssa_TrustModelEcuCsr_ext_subKeyId_008
        CertElementGet_Ssa_TrustModelRootCert_SerialNo: can-be-invoked-concurrently=true, symbol=KeyM_CertElementGet_Ssa_TrustModelRootCert_SerialNo
        CertElementGet_Ssa_TrustModelIntermediatePeerCert_signatureValue_007: can-be-invoked-concurrently=true, symbol=KeyM_CertElementGet_Ssa_TrustModelIntermediatePeerCert_signatureValue_007
        CertElementGet_Ssa_TrustModelEcuCsr_ext_uniqueECUID_007: can-be-invoked-concurrently=true, symbol=KeyM_CertElementGet_Ssa_TrustModelEcuCsr_ext_uniqueECUID_007
        CertElementGet_Ssa_TrustModelIntermediateCert_ext_keyUsage_003: can-be-invoked-concurrently=true, symbol=KeyM_CertElementGet_Ssa_TrustModelIntermediateCert_ext_keyUsage_003
        CertElementGet_Ssa_TrustModelBackendPeerCert_SubjectPublicKeyInfoKey_004: can-be-invoked-concurrently=true, symbol=KeyM_CertElementGet_Ssa_TrustModelBackendPeerCert_SubjectPublicKeyInfoKey_004
        CertElementGet_Ssa_TrustModelEcuCsr_ext_authKeyId_008: can-be-invoked-concurrently=true, symbol=KeyM_CertElementGet_Ssa_TrustModelEcuCsr_ext_authKeyId_008
        CertElementGet_Ssa_TrustModelBackendPeerCert_signatureValue_004: can-be-invoked-concurrently=true, symbol=KeyM_CertElementGet_Ssa_TrustModelBackendPeerCert_signatureValue_004
        CertificateElementGetByIndex_Ssa_TrustModelIntermediateCert_signatureAlgorithm_003: can-be-invoked-concurrently=true, symbol=KeyM_CertificateElementGetByIndex_Ssa_TrustModelIntermediateCert_signatureAlgorithm_003
        CertElementGet_Ssa_TrustModelIntermediateCert_signatureValue_003: can-be-invoked-concurrently=true, symbol=KeyM_CertElementGet_Ssa_TrustModelIntermediateCert_signatureValue_003
        CertificateElementGetByIndex_Ssa_TrustModelIntermediateCert_SigAlgoId_003: can-be-invoked-concurrently=true, symbol=KeyM_CertificateElementGetByIndex_Ssa_TrustModelIntermediateCert_SigAlgoId_003
        CertificateElementGetByIndex_Ssa_TrustModelRootCert_validityNotBefore: can-be-invoked-concurrently=true, symbol=KeyM_CertificateElementGetByIndex_Ssa_TrustModelRootCert_validityNotBefore
        CertElementGet_Ssa_TrustModelIntermediatePeerCert_ext_pkiRole_005: can-be-invoked-concurrently=true, symbol=KeyM_CertElementGet_Ssa_TrustModelIntermediatePeerCert_ext_pkiRole_005
        CertElementGet_Ssa_TrustModelEcuCert_Version_005: can-be-invoked-concurrently=true, symbol=KeyM_CertElementGet_Ssa_TrustModelEcuCert_Version_005
        CertificateElementGetByIndex_Ssa_TrustModelRootCert_ext_pkiRole: can-be-invoked-concurrently=true, symbol=KeyM_CertificateElementGetByIndex_Ssa_TrustModelRootCert_ext_pkiRole
        CertificateElementGetByIndex_Ssa_TrustModelEcuCsr_ext_extKeyUsage_oid2_007: can-be-invoked-concurrently=true, symbol=KeyM_CertificateElementGetByIndex_Ssa_TrustModelEcuCsr_ext_extKeyUsage_oid2_007
        CertificateElementGetByIndex_Ssa_TrustModelEcuCert_validityNotBefore_005: can-be-invoked-concurrently=true, symbol=KeyM_CertificateElementGetByIndex_Ssa_TrustModelEcuCert_validityNotBefore_005
        CertificateElementGetByIndex_Ssa_TrustModelIntermediatePeerCert_validityNotBefore_007: can-be-invoked-concurrently=true, symbol=KeyM_CertificateElementGetByIndex_Ssa_TrustModelIntermediatePeerCert_validityNotBefore_007
        CertificateElementGetByIndex_Ssa_TrustModelEcuCert_SubjectPublicKeyInfoAlgo_005: can-be-invoked-concurrently=true, symbol=KeyM_CertificateElementGetByIndex_Ssa_TrustModelEcuCert_SubjectPublicKeyInfoAlgo_005
        CertElementGet_Ssa_TrustModelEcuCert_Issuer_005: can-be-invoked-concurrently=true, symbol=KeyM_CertElementGet_Ssa_TrustModelEcuCert_Issuer_005
        CertificateElementGetByIndex_Ssa_TrustModelEcuPeerCert_signatureValue_006: can-be-invoked-concurrently=true, symbol=KeyM_CertificateElementGetByIndex_Ssa_TrustModelEcuPeerCert_signatureValue_006
        CertElementGet_Ssa_TrustModelEcuCert_signatureValue_005: can-be-invoked-concurrently=true, symbol=KeyM_CertElementGet_Ssa_TrustModelEcuCert_signatureValue_005
        CertificateElementGetByIndex_Ssa_TrustModelEcuPeerCert_SubjectPublicKeyInfoAlgo_006: can-be-invoked-concurrently=true, symbol=KeyM_CertificateElementGetByIndex_Ssa_TrustModelEcuPeerCert_SubjectPublicKeyInfoAlgo_006
        CertElementGet_Ssa_TrustModelEcuCsr_Issuer_008: can-be-invoked-concurrently=true, symbol=KeyM_CertElementGet_Ssa_TrustModelEcuCsr_Issuer_008
        CertificateElementGetByIndex_Ssa_TrustModelIntermediateCert_ext_authKeyId_003: can-be-invoked-concurrently=true, symbol=KeyM_CertificateElementGetByIndex_Ssa_TrustModelIntermediateCert_ext_authKeyId_003
        CertificateElementGetByIndex_Ssa_TrustModelBackendPeerCert_signatureValue_004: can-be-invoked-concurrently=true, symbol=KeyM_CertificateElementGetByIndex_Ssa_TrustModelBackendPeerCert_signatureValue_004
        CertificateElementGetByIndex_Ssa_TrustModelEcuCert_signatureAlgorithm_005: can-be-invoked-concurrently=true, symbol=KeyM_CertificateElementGetByIndex_Ssa_TrustModelEcuCert_signatureAlgorithm_005
        CertificateElementGetByIndex_Ssa_TrustModelBackendCert_ext_basicConstraints_002: can-be-invoked-concurrently=true, symbol=KeyM_CertificateElementGetByIndex_Ssa_TrustModelBackendCert_ext_basicConstraints_002
        CertElementGet_Ssa_TrustModelRootCert_ext_authKeyId_009: can-be-invoked-concurrently=true, symbol=KeyM_CertElementGet_Ssa_TrustModelRootCert_ext_authKeyId_009
        CertElementGet_Ssa_TrustModelEcuCert_signatureAlgorithm_005: can-be-invoked-concurrently=true, symbol=KeyM_CertElementGet_Ssa_TrustModelEcuCert_signatureAlgorithm_005
        CertElementGet_Ssa_TrustModelIntermediateCert_signatureAlgorithm_003: can-be-invoked-concurrently=true, symbol=KeyM_CertElementGet_Ssa_TrustModelIntermediateCert_signatureAlgorithm_003
        CertificateElementGetByIndex_Ssa_TrustModelEcuPeerCert_ext_specialEcu_006: can-be-invoked-concurrently=true, symbol=KeyM_CertificateElementGetByIndex_Ssa_TrustModelEcuPeerCert_ext_specialEcu_006
        CertificateElementGetByIndex_Ssa_TrustModelIntermediatePeerCert_subject_007: can-be-invoked-concurrently=true, symbol=KeyM_CertificateElementGetByIndex_Ssa_TrustModelIntermediatePeerCert_subject_007
        CertificateElementGetByIndex_Ssa_TrustModelIntermediateCert_subject_003: can-be-invoked-concurrently=true, symbol=KeyM_CertificateElementGetByIndex_Ssa_TrustModelIntermediateCert_subject_003
        CertificateElementGetByIndex_Ssa_TrustModelIntermediateCert_Issuer_003: can-be-invoked-concurrently=true, symbol=KeyM_CertificateElementGetByIndex_Ssa_TrustModelIntermediateCert_Issuer_003
        CertificateElementGetByIndex_Ssa_TrustModelBackendCert_subject_002: can-be-invoked-concurrently=true, symbol=KeyM_CertificateElementGetByIndex_Ssa_TrustModelBackendCert_subject_002
        CertificateElementGetByIndex_Ssa_TrustModelBackendCert_signatureValue_002: can-be-invoked-concurrently=true, symbol=KeyM_CertificateElementGetByIndex_Ssa_TrustModelBackendCert_signatureValue_002
        CertificateElementGetByIndex_Ssa_TrustModelEcuCert_Version_005: can-be-invoked-concurrently=true, symbol=KeyM_CertificateElementGetByIndex_Ssa_TrustModelEcuCert_Version_005
        CertElementGet_Ssa_TrustModelRootCert_SigAlgoId: can-be-invoked-concurrently=true, symbol=KeyM_CertElementGet_Ssa_TrustModelRootCert_SigAlgoId
        CertElementGet_Ssa_TrustModelEcuCert_SerialNo_005: can-be-invoked-concurrently=true, symbol=KeyM_CertElementGet_Ssa_TrustModelEcuCert_SerialNo_005
        CertificateElementGetByIndex_Ssa_TrustModelEcuCsr_ext_extKeyUsage_oid3_007: can-be-invoked-concurrently=true, symbol=KeyM_CertificateElementGetByIndex_Ssa_TrustModelEcuCsr_ext_extKeyUsage_oid3_007
        CertificateElementGetByIndex_Ssa_TrustModelEcuCsr_ext_extKeyUsage_007: can-be-invoked-concurrently=true, symbol=KeyM_CertificateElementGetByIndex_Ssa_TrustModelEcuCsr_ext_extKeyUsage_007
        CertificateElementGetByIndex_Ssa_TrustModelEcuCert_Issuer_005: can-be-invoked-concurrently=true, symbol=KeyM_CertificateElementGetByIndex_Ssa_TrustModelEcuCert_Issuer_005
        CertificateElementGetByIndex_Ssa_TrustModelIntermediateCert_ext_basicConstraints_003: can-be-invoked-concurrently=true, symbol=KeyM_CertificateElementGetByIndex_Ssa_TrustModelIntermediateCert_ext_basicConstraints_003
        CertificateElementGetByIndex_Ssa_TrustModelBackendCert_ext_subKeyId_002: can-be-invoked-concurrently=true, symbol=KeyM_CertificateElementGetByIndex_Ssa_TrustModelBackendCert_ext_subKeyId_002
        CertElementGet_Ssa_TrustModelBackendCert_validityNotAfter_002: can-be-invoked-concurrently=true, symbol=KeyM_CertElementGet_Ssa_TrustModelBackendCert_validityNotAfter_002
        CertElementGet_Ssa_TrustModelEcuPeerCert_subject_006: can-be-invoked-concurrently=true, symbol=KeyM_CertElementGet_Ssa_TrustModelEcuPeerCert_subject_006
        CertificateElementGetByIndex_Ssa_TrustModelEcuCsr_Issuer_008: can-be-invoked-concurrently=true, symbol=KeyM_CertificateElementGetByIndex_Ssa_TrustModelEcuCsr_Issuer_008
        CertElementGet_Ssa_TrustModelIntermediatePeerCert_SubjectPublicKeyInfoAlgo_007: can-be-invoked-concurrently=true, symbol=KeyM_CertElementGet_Ssa_TrustModelIntermediatePeerCert_SubjectPublicKeyInfoAlgo_007
        CertificateElementGetByIndex_Ssa_TrustModelEcuCert_ext_keyUsage_005: can-be-invoked-concurrently=true, symbol=KeyM_CertificateElementGetByIndex_Ssa_TrustModelEcuCert_ext_keyUsage_005
        CertificateElementGetByIndex_Ssa_TrustModelRootCert_Version: can-be-invoked-concurrently=true, symbol=KeyM_CertificateElementGetByIndex_Ssa_TrustModelRootCert_Version
        CertElementGet_Ssa_TrustModelEcuPeerCert_signatureValue_006: can-be-invoked-concurrently=true, symbol=KeyM_CertElementGet_Ssa_TrustModelEcuPeerCert_signatureValue_006
        CertificateElementGetByIndex_Ssa_TrustModelEcuCert_SigAlgoId_005: can-be-invoked-concurrently=true, symbol=KeyM_CertificateElementGetByIndex_Ssa_TrustModelEcuCert_SigAlgoId_005
        CertificateElementGetByIndex_Ssa_TrustModelBackendPeerCert_ext_authKeyId_004: can-be-invoked-concurrently=true, symbol=KeyM_CertificateElementGetByIndex_Ssa_TrustModelBackendPeerCert_ext_authKeyId_004
        CertElementGet_Ssa_TrustModelBackendPeerCert_ext_basicConstraints_004: can-be-invoked-concurrently=true, symbol=KeyM_CertElementGet_Ssa_TrustModelBackendPeerCert_ext_basicConstraints_004
        CertElementGet_Ssa_TrustModelIntermediatePeerCert_ext_basicConstraints_005: can-be-invoked-concurrently=true, symbol=KeyM_CertElementGet_Ssa_TrustModelIntermediatePeerCert_ext_basicConstraints_005
        CertElementGet_Ssa_TrustModelEcuCsr_ext_extKeyUsage_oid3_007: can-be-invoked-concurrently=true, symbol=KeyM_CertElementGet_Ssa_TrustModelEcuCsr_ext_extKeyUsage_oid3_007
        CertificateElementGetByIndex_Ssa_TrustModelIntermediatePeerCert_ext_keyUsage_007: can-be-invoked-concurrently=true, symbol=KeyM_CertificateElementGetByIndex_Ssa_TrustModelIntermediatePeerCert_ext_keyUsage_007
        CertElementGet_Ssa_TrustModelIntermediateCert_SigAlgoId_003: can-be-invoked-concurrently=true, symbol=KeyM_CertElementGet_Ssa_TrustModelIntermediateCert_SigAlgoId_003
        CertificateElementGetByIndex_Ssa_TrustModelRootCert_subject: can-be-invoked-concurrently=true, symbol=KeyM_CertificateElementGetByIndex_Ssa_TrustModelRootCert_subject
        CertElementGet_Ssa_TrustModelIntermediateCert_ext_basicConstraints_003: can-be-invoked-concurrently=true, symbol=KeyM_CertElementGet_Ssa_TrustModelIntermediateCert_ext_basicConstraints_003
        CertElementGet_Ssa_TrustModelRootCert_SubjectPublicKeyInfoAlgo: can-be-invoked-concurrently=true, symbol=KeyM_CertElementGet_Ssa_TrustModelRootCert_SubjectPublicKeyInfoAlgo
        CertElementGet_Ssa_TrustModelBackendPeerCert_SigAlgoId_004: can-be-invoked-concurrently=true, symbol=KeyM_CertElementGet_Ssa_TrustModelBackendPeerCert_SigAlgoId_004
        CertificateElementGetByIndex_Ssa_TrustModelRootCert_SerialNo: can-be-invoked-concurrently=true, symbol=KeyM_CertificateElementGetByIndex_Ssa_TrustModelRootCert_SerialNo
        CertificateElementGetByIndex_Ssa_TrustModelRootCert_SubjectPublicKeyInfoKey: can-be-invoked-concurrently=true, symbol=KeyM_CertificateElementGetByIndex_Ssa_TrustModelRootCert_SubjectPublicKeyInfoKey
        CertElementGet_Ssa_TrustModelEcuPeerCert_ext_subKeyId_006: can-be-invoked-concurrently=true, symbol=KeyM_CertElementGet_Ssa_TrustModelEcuPeerCert_ext_subKeyId_006
        CertElementGet_Ssa_TrustModelEcuCert_subject_005: can-be-invoked-concurrently=true, symbol=KeyM_CertElementGet_Ssa_TrustModelEcuCert_subject_005
        CertElementGet_Ssa_TrustModelEcuCsr_SigAlgoId_008: can-be-invoked-concurrently=true, symbol=KeyM_CertElementGet_Ssa_TrustModelEcuCsr_SigAlgoId_008
        CertElementGet_Ssa_TrustModelBackendCert_Version_002: can-be-invoked-concurrently=true, symbol=KeyM_CertElementGet_Ssa_TrustModelBackendCert_Version_002
        CertificateElementGetByIndex_Ssa_TrustModelEcuCert_signatureValue_005: can-be-invoked-concurrently=true, symbol=KeyM_CertificateElementGetByIndex_Ssa_TrustModelEcuCert_signatureValue_005
        CertificateElementGetByIndex_Ssa_TrustModelBackendCert_ext_keyUsage_002: can-be-invoked-concurrently=true, symbol=KeyM_CertificateElementGetByIndex_Ssa_TrustModelBackendCert_ext_keyUsage_002
        CertificateElementGetByIndex_Ssa_TrustModelEcuCert_validityNotAfter_005: can-be-invoked-concurrently=true, symbol=KeyM_CertificateElementGetByIndex_Ssa_TrustModelEcuCert_validityNotAfter_005
        CertElementGet_Ssa_TrustModelEcuPeerCert_SubjectPublicKeyInfoKey_006: can-be-invoked-concurrently=true, symbol=KeyM_CertElementGet_Ssa_TrustModelEcuPeerCert_SubjectPublicKeyInfoKey_006
        ServiceCertificateRteWrapper: can-be-invoked-concurrently=true, symbol=KeyM_ServiceCertificateRteWrapper
        ServiceCertificateByCertIdRteWrapper: can-be-invoked-concurrently=true, symbol=KeyM_ServiceCertificateByCertIdRteWrapper
  swc implementation KeyMImplementation: programming-language=C, behavior=KeyMInternalBehavior
