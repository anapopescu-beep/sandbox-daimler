[part 3 of 6: package /MICROSAR/KeyM_swc/Interfaces]
AUTOSAR XML (schema 00049)
package /MICROSAR/KeyM_swc/Interfaces  (continued)
  153 x client server interface, all with is-service=true, service-kind=VENDOR-SPECIFIC:  (continued)
    KeyMCertificate_Ssa_TrustModelBackendPeerCert  # Service of Certificate sub module
      4 x operation:
        GetCertificate: possible-error=[KeyMCertificate_Ssa_TrustModelBackendPeerCert/E_NOT_OK, KeyMCertificate_Ssa_TrustModelBackendPeerCert/KEYM_E_KEY_CERT_SIZE_MISMATCH, KeyMCertificate_Ssa_TrustModelBackendPeerCert/KEYM_E_PARAMETER_MISMATCH, KeyMCertificate_Ssa_TrustModelBackendPeerCert/KEYM_E_KEY_CERT_READ_FAIL, KeyMCertificate_Ssa_TrustModelBackendPeerCert/KEYM_E_KEY_CERT_EMPTY]  # Read certificate data from the certificate sub module
          arg Certificate: type=KeyM_CertificateType_Ssa_TrustModelBackendPeerCert, direction=OUT  # Holds a pointer to the memory location which will hold the Certificate.
        GetStatus: possible-error=KeyMCertificate_Ssa_TrustModelBackendPeerCert/E_NOT_OK  # Provides the status of a certificate.
          arg Status: type=KeyM_CertificateStatusType, direction=OUT  # Holds a pointer to the memory location which will hold the Certificate Status.
        SetCertificate: possible-error=[KeyMCertificate_Ssa_TrustModelBackendPeerCert/E_NOT_OK, KeyMCertificate_Ssa_TrustModelBackendPeerCert/KEYM_E_KEY_CERT_SIZE_MISMATCH, KeyMCertificate_Ssa_TrustModelBackendPeerCert/KEYM_E_PARAMETER_MISMATCH, KeyMCertificate_Ssa_TrustModelBackendPeerCert/KEYM_E_KEY_CERT_WRITE_FAIL]  # Provides certificate data to be processed by the certificate sub module.
          arg Certificate: type=KeyM_CertificateType_Ssa_TrustModelBackendPeerCert, direction=IN  # Holds a pointer to Certificate.
        VerifyCertificate: possible-error=[KeyMCertificate_Ssa_TrustModelBackendPeerCert/E_NOT_OK, KeyMCertificate_Ssa_TrustModelBackendPeerCert/KEYM_E_BUSY, KeyMCertificate_Ssa_TrustModelBackendPeerCert/KEYM_E_KEY_CERT_SIZE_MISMATCH, KeyMCertificate_Ssa_TrustModelBackendPeerCert/KEYM_E_PARAMETER_MISMATCH, KeyMCertificate_Ssa_TrustModelBackendPeerCert/KEYM_E_KEY_CERT_EMPTY, KeyMCertificate_Ssa_TrustModelBackendPeerCert/KEYM_E_CERT_INVALID_CHAIN_OF_TRUST]  # Verify certificate data from the certificate sub module .
      8 x error:
        E_NOT_OK: error-code=1  # The service request failed.
        KEYM_E_BUSY: error-code=2  # The service request failed. Key management is busy with other operations.
        KEYM_E_KEY_CERT_SIZE_MISMATCH: error-code=4  # The service request failed. Parameter size does not match the expected value.
        KEYM_E_PARAMETER_MISMATCH: error-code=5  # The service request failed. Parameter to function does not provide the expected value.
        KEYM_E_KEY_CERT_WRITE_FAIL: error-code=7  # The service request failed. Certificate or key write operation failed.
        KEYM_E_KEY_CERT_READ_FAIL: error-code=9  # The service request failed. Certificate or key could not be provided due to a read or permission failure.
        KEYM_E_KEY_CERT_EMPTY: error-code=10  # The service request failed. The requested key or certificate is not available, slot is empty.
        KEYM_E_CERT_INVALID_CHAIN_OF_TRUST: error-code=11  # The service request failed. Certificate verification failed - Invalid Chain of Trust.
    KeyMCertificateExtended_Ssa_TrustModelBackendPeerCert  # Services of Certificate sub module that extend the standard AUTOSAR services
      operation ServiceCertificate: possible-error=[KeyMCertificateExtended_Ssa_TrustModelBackendPeerCert/E_NOT_OK, KeyMCertificateExtended_Ssa_TrustModelBackendPeerCert/KEYM_E_BUSY, KeyMCertificateExtended_Ssa_TrustModelBackendPeerCert/KEYM_E_KEY_CERT_SIZE_MISMATCH, KeyMCertificateExtended_Ssa_TrustModelBackendPeerCert/KEYM_E_PARAMETER_MISMATCH, KeyMCertificateExtended_Ssa_TrustModelBackendPeerCert/KEYM_E_KEY_CERT_EMPTY, KeyMCertificateExtended_Ssa_TrustModelBackendPeerCert/KEYM_E_CERT_INVALID_CHAIN_OF_TRUST]  # Handle certificate operation request in the certificate sub module.
        5 x arg, all with direction=IN:
          Service: type=KeyM_ServiceCertificateType  # Provides the type of service the key manager has to perform.
          RequestData: type=KeyM_ConstDataPtrType  # Information that comes along with the request.
          RequestDataLength: type=uint32  # Length of data in the RequestData array.
          ResponseData: type=KeyM_DataPtrType  # Pointer to array in which the request response data will be stored upon request completion.
          ResponseDataLength: type=uint32  # Max number of bytes available in ResponseDataPtr.
      operation CsrElementSet: possible-error=[KeyMCertificateExtended_Ssa_TrustModelBackendPeerCert/E_NOT_OK, KeyMCertificateExtended_Ssa_TrustModelBackendPeerCert/KEYM_E_PARAMETER_MISMATCH]  # To be used before calling GenerateCertificationRequestInfo. Adds an data to the certificate for which a signing request shall be build.
        4 x arg, all with direction=IN:
          CertElementId: type=KeyM_CertElementIdType  # Element ID of the element that shall be added
          EncodingType: type=KeyM_CsrEncodingType  # Encoding type of the CSR element
          ElementData: type=KeyM_ConstDataPtrType  # Data of the element that shall be added
          ElementDataLength: type=uint32  # Length of ElementData data in the ElementData array
      6 x error:
        E_NOT_OK: error-code=1  # The service request failed.
        KEYM_E_BUSY: error-code=2  # The service request failed. Key management is busy with other operations.
        KEYM_E_KEY_CERT_SIZE_MISMATCH: error-code=4  # The service request failed. Parameter size does not match the expected value.
        KEYM_E_PARAMETER_MISMATCH: error-code=5  # The service request failed. Parameter to function does not provide the expected value.
        KEYM_E_KEY_CERT_EMPTY: error-code=10  # The service request failed. The requested key or certificate is not available, slot is empty.
        KEYM_E_CERT_INVALID_CHAIN_OF_TRUST: error-code=11  # The service request failed. Certificate verification failed - Invalid Chain of Trust.
    KeyMCertificateElement_Ssa_TrustModelBackendPeerCert_ext_authKeyId_004  # Service of the certificate sub module to access certificate elements.
      operation CertificateElementGet: possible-error=[KeyMCertificateElement_Ssa_TrustModelBackendPeerCert_ext_authKeyId_004/E_NOT_OK, KeyMCertificateElement_Ssa_TrustModelBackendPeerCert_ext_authKeyId_004/KEYM_E_KEY_CERT_SIZE_MISMATCH, KeyMCertificateElement_Ssa_TrustModelBackendPeerCert_ext_authKeyId_004/KEYM_E_PARAMETER_MISMATCH, KeyMCertificateElement_Ssa_TrustModelBackendPeerCert_ext_authKeyId_004/KEYM_E_KEY_CERT_INVALID, KeyMCertificateElement_Ssa_TrustModelBackendPeerCert_ext_authKeyId_004/KEYM_E_KEY_CERT_EMPTY]  # Provides the content of a specific certificate element. The certificate configuration defines how the certificate submodule can find the element, e.g. by providing the object identifier (OID). This function is used to retrieve this information if only one element is assigned to the respective OID.
        arg CertificateElementData: type=KeyM_CertificateElementType_Ssa_TrustModelBackendPeerCert_ext_authKeyId_004, direction=OUT, server-argument-impl-policy=USE-ARRAY-BASE-TYPE  # Holds a pointer to the memory location which will hold the certificate element.
        arg CertificateDataLength: type=uint32, direction=OUT  # Contains the length in bytes of certificate element.
      operation CertificateElementGetByIndex: possible-error=[KeyMCertificateElement_Ssa_TrustModelBackendPeerCert_ext_authKeyId_004/E_NOT_OK, KeyMCertificateElement_Ssa_TrustModelBackendPeerCert_ext_authKeyId_004/KEYM_E_KEY_CERT_SIZE_MISMATCH, KeyMCertificateElement_Ssa_TrustModelBackendPeerCert_ext_authKeyId_004/KEYM_E_PARAMETER_MISMATCH, KeyMCertificateElement_Ssa_TrustModelBackendPeerCert_ext_authKeyId_004/KEYM_E_KEY_CERT_INVALID, KeyMCertificateElement_Ssa_TrustModelBackendPeerCert_ext_authKeyId_004/KEYM_E_KEY_CERT_EMPTY]  # This operation provides data from a specific certificate element.
        arg Index: type=uint16, direction=IN  # This is the index to dedicated element in the list
        arg CertificateElementData: type=KeyM_CertificateElementType_Ssa_TrustModelBackendPeerCert_ext_authKeyId_004, direction=OUT, server-argument-impl-policy=USE-ARRAY-BASE-TYPE  # Holds a pointer to the memory location which will hold the certificate element.
        arg CertificateDataLength: type=uint32, direction=OUT  # Contains the length in bytes of certificate element.
      operation CertificateElementGetCount: possible-error=[KeyMCertificateElement_Ssa_TrustModelBackendPeerCert_ext_authKeyId_004/E_NOT_OK, KeyMCertificateElement_Ssa_TrustModelBackendPeerCert_ext_authKeyId_004/KEYM_E_KEY_CERT_SIZE_MISMATCH, KeyMCertificateElement_Ssa_TrustModelBackendPeerCert_ext_authKeyId_004/KEYM_E_PARAMETER_MISMATCH, KeyMCertificateElement_Ssa_TrustModelBackendPeerCert_ext_authKeyId_004/KEYM_E_KEY_CERT_INVALID, KeyMCertificateElement_Ssa_TrustModelBackendPeerCert_ext_authKeyId_004/KEYM_E_KEY_CERT_EMPTY]  # This operation returns the amount of items available for a certificate element.
        arg count: type=uint16, direction=OUT  # Number of items available for an element.
      5 x error:
        E_NOT_OK: error-code=1  # The service request failed.
        KEYM_E_KEY_CERT_SIZE_MISMATCH: error-code=4  # The service request failed. Parameter size does not match the expected value.
        KEYM_E_PARAMETER_MISMATCH: error-code=5  # The service request failed. Parameter to function does not provide the expected value.
        KEYM_E_KEY_CERT_EMPTY: error-code=10  # The service request failed. The requested key or certificate is not available, slot is empty.
        KEYM_E_KEY_CERT_INVALID: error-code=6  # The service request failed. Key or certificate is invalid and cannot be used for the operation.
    KeyMCertificateElement_Ssa_TrustModelBackendPeerCert_ext_subKeyId_004  # Service of the certificate sub module to access certificate elements.
      operation CertificateElementGet: possible-error=[KeyMCertificateElement_Ssa_TrustModelBackendPeerCert_ext_subKeyId_004/E_NOT_OK, KeyMCertificateElement_Ssa_TrustModelBackendPeerCert_ext_subKeyId_004/KEYM_E_KEY_CERT_SIZE_MISMATCH, KeyMCertificateElement_Ssa_TrustModelBackendPeerCert_ext_subKeyId_004/KEYM_E_PARAMETER_MISMATCH, KeyMCertificateElement_Ssa_TrustModelBackendPeerCert_ext_subKeyId_004/KEYM_E_KEY_CERT_INVALID, KeyMCertificateElement_Ssa_TrustModelBackendPeerCert_ext_subKeyId_004/KEYM_E_KEY_CERT_EMPTY]  # Provides the content of a specific certificate element. The certificate configuration defines how the certificate submodule can find the element, e.g. by providing the object identifier (OID). This function is used to retrieve this information if only one element is assigned to the respective OID.
        arg CertificateElementData: type=KeyM_CertificateElementType_Ssa_TrustModelBackendPeerCert_ext_subKeyId_004, direction=OUT, server-argument-impl-policy=USE-ARRAY-BASE-TYPE  # Holds a pointer to the memory location which will hold the certificate element.
        arg CertificateDataLength: type=uint32, direction=OUT  # Contains the length in bytes of certificate element.
      operation CertificateElementGetByIndex: possible-error=[KeyMCertificateElement_Ssa_TrustModelBackendPeerCert_ext_subKeyId_004/E_NOT_OK, KeyMCertificateElement_Ssa_TrustModelBackendPeerCert_ext_subKeyId_004/KEYM_E_KEY_CERT_SIZE_MISMATCH, KeyMCertificateElement_Ssa_TrustModelBackendPeerCert_ext_subKeyId_004/KEYM_E_PARAMETER_MISMATCH, KeyMCertificateElement_Ssa_TrustModelBackendPeerCert_ext_subKeyId_004/KEYM_E_KEY_CERT_INVALID, KeyMCertificateElement_Ssa_TrustModelBackendPeerCert_ext_subKeyId_004/KEYM_E_KEY_CERT_EMPTY]  # This operation provides data from a specific certificate element.
        arg Index: type=uint16, direction=IN  # This is the index to dedicated element in the list
        arg CertificateElementData: type=KeyM_CertificateElementType_Ssa_TrustModelBackendPeerCert_ext_subKeyId_004, direction=OUT, server-argument-impl-policy=USE-ARRAY-BASE-TYPE  # Holds a pointer to the memory location which will hold the certificate element.
        arg CertificateDataLength: type=uint32, direction=OUT  # Contains the length in bytes of certificate element.
      operation CertificateElementGetCount: possible-error=[KeyMCertificateElement_Ssa_TrustModelBackendPeerCert_ext_subKeyId_004/E_NOT_OK, KeyMCertificateElement_Ssa_TrustModelBackendPeerCert_ext_subKeyId_004/KEYM_E_KEY_CERT_SIZE_MISMATCH, KeyMCertificateElement_Ssa_TrustModelBackendPeerCert_ext_subKeyId_004/KEYM_E_PARAMETER_MISMATCH, KeyMCertificateElement_Ssa_TrustModelBackendPeerCert_ext_subKeyId_004/KEYM_E_KEY_CERT_INVALID, KeyMCertificateElement_Ssa_TrustModelBackendPeerCert_ext_subKeyId_004/KEYM_E_KEY_CERT_EMPTY]  # This operation returns the amount of items available for a certificate element.
        arg count: type=uint16, direction=OUT  # Number of items available for an element.
      5 x error:
        E_NOT_OK: error-code=1  # The service request failed.
        KEYM_E_KEY_CERT_SIZE_MISMATCH: error-code=4  # The service request failed. Parameter size does not match the expected value.
        KEYM_E_PARAMETER_MISMATCH: error-code=5  # The service request failed. Parameter to function does not provide the expected value.
        KEYM_E_KEY_CERT_EMPTY: error-code=10  # The service request failed. The requested key or certificate is not available, slot is empty.
        KEYM_E_KEY_CERT_INVALID: error-code=6  # The service request failed. Key or certificate is invalid and cannot be used for the operation.
    KeyMCertificateElement_Ssa_TrustModelBackendPeerCert_ext_basicConstraints_004  # Service of the certificate sub module to access certificate elements.
      operation CertificateElementGet: possible-error=[KeyMCertificateElement_Ssa_TrustModelBackendPeerCert_ext_basicConstraints_004/E_NOT_OK, KeyMCertificateElement_Ssa_TrustModelBackendPeerCert_ext_basicConstraints_004/KEYM_E_KEY_CERT_SIZE_MISMATCH, KeyMCertificateElement_Ssa_TrustModelBackendPeerCert_ext_basicConstraints_004/KEYM_E_PARAMETER_MISMATCH, KeyMCertificateElement_Ssa_TrustModelBackendPeerCert_ext_basicConstraints_004/KEYM_E_KEY_CERT_INVALID, KeyMCertificateElement_Ssa_TrustModelBackendPeerCert_ext_basicConstraints_004/KEYM_E_KEY_CERT_EMPTY]  # Provides the content of a specific certificate element. The certificate configuration defines how the certificate submodule can find the element, e.g. by providing the object identifier (OID). This function is used to retrieve this information if only one element is assigned to the respective OID.
        arg CertificateElementData: type=KeyM_CertificateElementType_Ssa_TrustModelBackendPeerCert_ext_basicConstraints_004, direction=OUT, server-argument-impl-policy=USE-ARRAY-BASE-TYPE  # Holds a pointer to the memory location which will hold the certificate element.
        arg CertificateDataLength: type=uint32, direction=OUT  # Contains the length in bytes of certificate element.
      operation CertificateElementGetByIndex: possible-error=[KeyMCertificateElement_Ssa_TrustModelBackendPeerCert_ext_basicConstraints_004/E_NOT_OK, KeyMCertificateElement_Ssa_TrustModelBackendPeerCert_ext_basicConstraints_004/KEYM_E_KEY_CERT_SIZE_MISMATCH, KeyMCertificateElement_Ssa_TrustModelBackendPeerCert_ext_basicConstraints_004/KEYM_E_PARAMETER_MISMATCH, KeyMCertificateElement_Ssa_TrustModelBackendPeerCert_ext_basicConstraints_004/KEYM_E_KEY_CERT_INVALID, KeyMCertificateElement_Ssa_TrustModelBackendPeerCert_ext_basicConstraints_004/KEYM_E_KEY_CERT_EMPTY]  # This operation provides data from a specific certificate element.
        arg Index: type=uint16, direction=IN  # This is the index to dedicated element in the list
        arg CertificateElementData: type=KeyM_CertificateElementType_Ssa_TrustModelBackendPeerCert_ext_basicConstraints_004, direction=OUT, server-argument-impl-policy=USE-ARRAY-BASE-TYPE  # Holds a pointer to the memory location which will hold the certificate element.
        arg CertificateDataLength: type=uint32, direction=OUT  # Contains the length in bytes of certificate element.
      operation CertificateElementGetCount: possible-error=[KeyMCertificateElement_Ssa_TrustModelBackendPeerCert_ext_basicConstraints_004/E_NOT_OK, KeyMCertificateElement_Ssa_TrustModelBackendPeerCert_ext_basicConstraints_004/KEYM_E_KEY_CERT_SIZE_MISMATCH, KeyMCertificateElement_Ssa_TrustModelBackendPeerCert_ext_basicConstraints_004/KEYM_E_PARAMETER_MISMATCH, KeyMCertificateElement_Ssa_TrustModelBackendPeerCert_ext_basicConstraints_004/KEYM_E_KEY_CERT_INVALID, KeyMCertificateElement_Ssa_TrustModelBackendPeerCert_ext_basicConstraints_004/KEYM_E_KEY_CERT_EMPTY]  # This operation returns the amount of items available for a certificate element.
        arg count: type=uint16, direction=OUT  # Number of items available for an element.
      5 x error:
        E_NOT_OK: error-code=1  # The service request failed.
        KEYM_E_KEY_CERT_SIZE_MISMATCH: error-code=4  # The service request failed. Parameter size does not match the expected value.
        KEYM_E_PARAMETER_MISMATCH: error-code=5  # The service request failed. Parameter to function does not provide the expected value.
        KEYM_E_KEY_CERT_EMPTY: error-code=10  # The service request failed. The requested key or certificate is not available, slot is empty.
        KEYM_E_KEY_CERT_INVALID: error-code=6  # The service request failed. Key or certificate is invalid and cannot be used for the operation.
    KeyMCertificateElement_Ssa_TrustModelBackendPeerCert_ext_keyUsage_004  # Service of the certificate sub module to access certificate elements.
      operation CertificateElementGet: possible-error=[KeyMCertificateElement_Ssa_TrustModelBackendPeerCert_ext_keyUsage_004/E_NOT_OK, KeyMCertificateElement_Ssa_TrustModelBackendPeerCert_ext_keyUsage_004/KEYM_E_KEY_CERT_SIZE_MISMATCH, KeyMCertificateElement_Ssa_TrustModelBackendPeerCert_ext_keyUsage_004/KEYM_E_PARAMETER_MISMATCH, KeyMCertificateElement_Ssa_TrustModelBackendPeerCert_ext_keyUsage_004/KEYM_E_KEY_CERT_INVALID, KeyMCertificateElement_Ssa_TrustModelBackendPeerCert_ext_keyUsage_004/KEYM_E_KEY_CERT_EMPTY]  # Provides the content of a specific certificate element. The certificate configuration defines how the certificate submodule can find the element, e.g. by providing the object identifier (OID). This function is used to retrieve this information if only one element is assigned to the respective OID.
        arg CertificateElementData: type=KeyM_CertificateElementType_Ssa_TrustModelBackendPeerCert_ext_keyUsage_004, direction=OUT, server-argument-impl-policy=USE-ARRAY-BASE-TYPE  # Holds a pointer to the memory location which will hold the certificate element.
        arg CertificateDataLength: type=uint32, direction=OUT  # Contains the length in bytes of certificate element.
      operation CertificateElementGetByIndex: possible-error=[KeyMCertificateElement_Ssa_TrustModelBackendPeerCert_ext_keyUsage_004/E_NOT_OK, KeyMCertificateElement_Ssa_TrustModelBackendPeerCert_ext_keyUsage_004/KEYM_E_KEY_CERT_SIZE_MISMATCH, KeyMCertificateElement_Ssa_TrustModelBackendPeerCert_ext_keyUsage_004/KEYM_E_PARAMETER_MISMATCH, KeyMCertificateElement_Ssa_TrustModelBackendPeerCert_ext_keyUsage_004/KEYM_E_KEY_CERT_INVALID, KeyMCertificateElement_Ssa_TrustModelBackendPeerCert_ext_keyUsage_004/KEYM_E_KEY_CERT_EMPTY]  # This operation provides data from a specific certificate element.
        arg Index: type=uint16, direction=IN  # This is the index to dedicated element in the list
        arg CertificateElementData: type=KeyM_CertificateElementType_Ssa_TrustModelBackendPeerCert_ext_keyUsage_004, direction=OUT, server-argument-impl-policy=USE-ARRAY-BASE-TYPE  # Holds a pointer to the memory location which will hold the certificate element.
        arg CertificateDataLength: type=uint32, direction=OUT  # Contains the length in bytes of certificate element.
      operation CertificateElementGetCount: possible-error=[KeyMCertificateElement_Ssa_TrustModelBackendPeerCert_ext_keyUsage_004/E_NOT_OK, KeyMCertificateElement_Ssa_TrustModelBackendPeerCert_ext_keyUsage_004/KEYM_E_KEY_CERT_SIZE_MISMATCH, KeyMCertificateElement_Ssa_TrustModelBackendPeerCert_ext_keyUsage_004/KEYM_E_PARAMETER_MISMATCH, KeyMCertificateElement_Ssa_TrustModelBackendPeerCert_ext_keyUsage_004/KEYM_E_KEY_CERT_INVALID, KeyMCertificateElement_Ssa_TrustModelBackendPeerCert_ext_keyUsage_004/KEYM_E_KEY_CERT_EMPTY]  # This operation returns the amount of items available for a certificate element.
        arg count: type=uint16, direction=OUT  # Number of items available for an element.
      5 x error:
        E_NOT_OK: error-code=1  # The service request failed.
        KEYM_E_KEY_CERT_SIZE_MISMATCH: error-code=4  # The service request failed. Parameter size does not match the expected value.
        KEYM_E_PARAMETER_MISMATCH: error-code=5  # The service request failed. Parameter to function does not provide the expected value.
        KEYM_E_KEY_CERT_EMPTY: error-code=10  # The service request failed. The requested key or certificate is not available, slot is empty.
        KEYM_E_KEY_CERT_INVALID: error-code=6  # The service request failed. Key or certificate is invalid and cannot be used for the operation.
    KeyMCertificateElement_Ssa_TrustModelBackendPeerCert_ext_pkiRole_004  # Service of the certificate sub module to access certificate elements.
      operation CertificateElementGet: possible-error=[KeyMCertificateElement_Ssa_TrustModelBackendPeerCert_ext_pkiRole_004/E_NOT_OK, KeyMCertificateElement_Ssa_TrustModelBackendPeerCert_ext_pkiRole_004/KEYM_E_KEY_CERT_SIZE_MISMATCH, KeyMCertificateElement_Ssa_TrustModelBackendPeerCert_ext_pkiRole_004/KEYM_E_PARAMETER_MISMATCH, KeyMCertificateElement_Ssa_TrustModelBackendPeerCert_ext_pkiRole_004/KEYM_E_KEY_CERT_INVALID, KeyMCertificateElement_Ssa_TrustModelBackendPeerCert_ext_pkiRole_004/KEYM_E_KEY_CERT_EMPTY]  # Provides the content of a specific certificate element. The certificate configuration defines how the certificate submodule can find the element, e.g. by providing the object identifier (OID). This function is used to retrieve this information if only one element is assigned to the respective OID.
        arg CertificateElementData: type=KeyM_CertificateElementType_Ssa_TrustModelBackendPeerCert_ext_pkiRole_004, direction=OUT, server-argument-impl-policy=USE-ARRAY-BASE-TYPE  # Holds a pointer to the memory location which will hold the certificate element.
        arg CertificateDataLength: type=uint32, direction=OUT  # Contains the length in bytes of certificate element.
      operation CertificateElementGetByIndex: possible-error=[KeyMCertificateElement_Ssa_TrustModelBackendPeerCert_ext_pkiRole_004/E_NOT_OK, KeyMCertificateElement_Ssa_TrustModelBackendPeerCert_ext_pkiRole_004/KEYM_E_KEY_CERT_SIZE_MISMATCH, KeyMCertificateElement_Ssa_TrustModelBackendPeerCert_ext_pkiRole_004/KEYM_E_PARAMETER_MISMATCH, KeyMCertificateElement_Ssa_TrustModelBackendPeerCert_ext_pkiRole_004/KEYM_E_KEY_CERT_INVALID, KeyMCertificateElement_Ssa_TrustModelBackendPeerCert_ext_pkiRole_004/KEYM_E_KEY_CERT_EMPTY]  # This operation provides data from a specific certificate element.
        arg Index: type=uint16, direction=IN  # This is the index to dedicated element in the list
        arg CertificateElementData: type=KeyM_CertificateElementType_Ssa_TrustModelBackendPeerCert_ext_pkiRole_004, direction=OUT, server-argument-impl-policy=USE-ARRAY-BASE-TYPE  # Holds a pointer to the memory location which will hold the certificate element.
        arg CertificateDataLength: type=uint32, direction=OUT  # Contains the length in bytes of certificate element.
      operation CertificateElementGetCount: possible-error=[KeyMCertificateElement_Ssa_TrustModelBackendPeerCert_ext_pkiRole_004/E_NOT_OK, KeyMCertificateElement_Ssa_TrustModelBackendPeerCert_ext_pkiRole_004/KEYM_E_KEY_CERT_SIZE_MISMATCH, KeyMCertificateElement_Ssa_TrustModelBackendPeerCert_ext_pkiRole_004/KEYM_E_PARAMETER_MISMATCH, KeyMCertificateElement_Ssa_TrustModelBackendPeerCert_ext_pkiRole_004/KEYM_E_KEY_CERT_INVALID, KeyMCertificateElement_Ssa_TrustModelBackendPeerCert_ext_pkiRole_004/KEYM_E_KEY_CERT_EMPTY]  # This operation returns the amount of items available for a certificate element.
        arg count: type=uint16, direction=OUT  # Number of items available for an element.
      5 x error:
        E_NOT_OK: error-code=1  # The service request failed.
        KEYM_E_KEY_CERT_SIZE_MISMATCH: error-code=4  # The service request failed. Parameter size does not match the expected value.
        KEYM_E_PARAMETER_MISMATCH: error-code=5  # The service request failed. Parameter to function does not provide the expected value.
        KEYM_E_KEY_CERT_EMPTY: error-code=10  # The service request failed. The requested key or certificate is not available, slot is empty.
        KEYM_E_KEY_CERT_INVALID: error-code=6  # The service request failed. Key or certificate is invalid and cannot be used for the operation.
    KeyMCertificateElement_Ssa_TrustModelBackendPeerCert_Version_004  # Service of the certificate sub module to access certificate elements.
      operation CertificateElementGet: possible-error=[KeyMCertificateElement_Ssa_TrustModelBackendPeerCert_Version_004/E_NOT_OK, KeyMCertificateElement_Ssa_TrustModelBackendPeerCert_Version_004/KEYM_E_KEY_CERT_SIZE_MISMATCH, KeyMCertificateElement_Ssa_TrustModelBackendPeerCert_Version_004/KEYM_E_PARAMETER_MISMATCH, KeyMCertificateElement_Ssa_TrustModelBackendPeerCert_Version_004/KEYM_E_KEY_CERT_INVALID, KeyMCertificateElement_Ssa_TrustModelBackendPeerCert_Version_004/KEYM_E_KEY_CERT_EMPTY]  # Provides the content of a specific certificate element. The certificate configuration defines how the certificate submodule can find the element, e.g. by providing the object identifier (OID). This function is used to retrieve this information if only one element is assigned to the respective OID.
        arg CertificateElementData: type=KeyM_CertificateElementType_Ssa_TrustModelBackendPeerCert_Version_004, direction=OUT, server-argument-impl-policy=USE-ARRAY-BASE-TYPE  # Holds a pointer to the memory location which will hold the certificate element.
        arg CertificateDataLength: type=uint32, direction=OUT  # Contains the length in bytes of certificate element.
      operation CertificateElementGetByIndex: possible-error=[KeyMCertificateElement_Ssa_TrustModelBackendPeerCert_Version_004/E_NOT_OK, KeyMCertificateElement_Ssa_TrustModelBackendPeerCert_Version_004/KEYM_E_KEY_CERT_SIZE_MISMATCH, KeyMCertificateElement_Ssa_TrustModelBackendPeerCert_Version_004/KEYM_E_PARAMETER_MISMATCH, KeyMCertificateElement_Ssa_TrustModelBackendPeerCert_Version_004/KEYM_E_KEY_CERT_INVALID, KeyMCertificateElement_Ssa_TrustModelBackendPeerCert_Version_004/KEYM_E_KEY_CERT_EMPTY]  # This operation provides data from a specific certificate element.
        arg Index: type=uint16, direction=IN  # This is the index to dedicated element in the list
        arg CertificateElementData: type=KeyM_CertificateElementType_Ssa_TrustModelBackendPeerCert_Version_004, direction=OUT, server-argument-impl-policy=USE-ARRAY-BASE-TYPE  # Holds a pointer to the memory location which will hold the certificate element.
        arg CertificateDataLength: type=uint32, direction=OUT  # Contains the length in bytes of certificate element.
      operation CertificateElementGetCount: possible-error=[KeyMCertificateElement_Ssa_TrustModelBackendPeerCert_Version_004/E_NOT_OK, KeyMCertificateElement_Ssa_TrustModelBackendPeerCert_Version_004/KEYM_E_KEY_CERT_SIZE_MISMATCH, KeyMCertificateElement_Ssa_TrustModelBackendPeerCert_Version_004/KEYM_E_PARAMETER_MISMATCH, KeyMCertificateElement_Ssa_TrustModelBackendPeerCert_Version_004/KEYM_E_KEY_CERT_INVALID, KeyMCertificateElement_Ssa_TrustModelBackendPeerCert_Version_004/KEYM_E_KEY_CERT_EMPTY]  # This operation returns the amount of items available for a certificate element.
        arg count: type=uint16, direction=OUT  # Number of items available for an element.
      5 x error:
        E_NOT_OK: error-code=1  # The service request failed.
        KEYM_E_KEY_CERT_SIZE_MISMATCH: error-code=4  # The service request failed. Parameter size does not match the expected value.
        KEYM_E_PARAMETER_MISMATCH: error-code=5  # The service request failed. Parameter to function does not provide the expected value.
        KEYM_E_KEY_CERT_EMPTY: error-code=10  # The service request failed. The requested key or certificate is not available, slot is empty.
        KEYM_E_KEY_CERT_INVALID: error-code=6  # The service request failed. Key or certificate is invalid and cannot be used for the operation.
    KeyMCertificateElement_Ssa_TrustModelBackendPeerCert_SerialNo_004  # Service of the certificate sub module to access certificate elements.
      operation CertificateElementGet: possible-error=[KeyMCertificateElement_Ssa_TrustModelBackendPeerCert_SerialNo_004/E_NOT_OK, KeyMCertificateElement_Ssa_TrustModelBackendPeerCert_SerialNo_004/KEYM_E_KEY_CERT_SIZE_MISMATCH, KeyMCertificateElement_Ssa_TrustModelBackendPeerCert_SerialNo_004/KEYM_E_PARAMETER_MISMATCH, KeyMCertificateElement_Ssa_TrustModelBackendPeerCert_SerialNo_004/KEYM_E_KEY_CERT_INVALID, KeyMCertificateElement_Ssa_TrustModelBackendPeerCert_SerialNo_004/KEYM_E_KEY_CERT_EMPTY]  # Provides the content of a specific certificate element. The certificate configuration defines how the certificate submodule can find the element, e.g. by providing the object identifier (OID). This function is used to retrieve this information if only one element is assigned to the respective OID.
        arg CertificateElementData: type=KeyM_CertificateElementType_Ssa_TrustModelBackendPeerCert_SerialNo_004, direction=OUT, server-argument-impl-policy=USE-ARRAY-BASE-TYPE  # Holds a pointer to the memory location which will hold the certificate element.
        arg CertificateDataLength: type=uint32, direction=OUT  # Contains the length in bytes of certificate element.
      operation CertificateElementGetByIndex: possible-error=[KeyMCertificateElement_Ssa_TrustModelBackendPeerCert_SerialNo_004/E_NOT_OK, KeyMCertificateElement_Ssa_TrustModelBackendPeerCert_SerialNo_004/KEYM_E_KEY_CERT_SIZE_MISMATCH, KeyMCertificateElement_Ssa_TrustModelBackendPeerCert_SerialNo_004/KEYM_E_PARAMETER_MISMATCH, KeyMCertificateElement_Ssa_TrustModelBackendPeerCert_SerialNo_004/KEYM_E_KEY_CERT_INVALID, KeyMCertificateElement_Ssa_TrustModelBackendPeerCert_SerialNo_004/KEYM_E_KEY_CERT_EMPTY]  # This operation provides data from a specific certificate element.
        arg Index: type=uint16, direction=IN  # This is the index to dedicated element in the list
        arg CertificateElementData: type=KeyM_CertificateElementType_Ssa_TrustModelBackendPeerCert_SerialNo_004, direction=OUT, server-argument-impl-policy=USE-ARRAY-BASE-TYPE  # Holds a pointer to the memory location which will hold the certificate element.
        arg CertificateDataLength: type=uint32, direction=OUT  # Contains the length in bytes of certificate element.
      operation CertificateElementGetCount: possible-error=[KeyMCertificateElement_Ssa_TrustModelBackendPeerCert_SerialNo_004/E_NOT_OK, KeyMCertificateElement_Ssa_TrustModelBackendPeerCert_SerialNo_004/KEYM_E_KEY_CERT_SIZE_MISMATCH, KeyMCertificateElement_Ssa_TrustModelBackendPeerCert_SerialNo_004/KEYM_E_PARAMETER_MISMATCH, KeyMCertificateElement_Ssa_TrustModelBackendPeerCert_SerialNo_004/KEYM_E_KEY_CERT_INVALID, KeyMCertificateElement_Ssa_TrustModelBackendPeerCert_SerialNo_004/KEYM_E_KEY_CERT_EMPTY]  # This operation returns the amount of items available for a certificate element.
        arg count: type=uint16, direction=OUT  # Number of items available for an element.
      5 x error:
        E_NOT_OK: error-code=1  # The service request failed.
        KEYM_E_KEY_CERT_SIZE_MISMATCH: error-code=4  # The service request failed. Parameter size does not match the expected value.
        KEYM_E_PARAMETER_MISMATCH: error-code=5  # The service request failed. Parameter to function does not provide the expected value.
        KEYM_E_KEY_CERT_EMPTY: error-code=10  # The service request failed. The requested key or certificate is not available, slot is empty.
        KEYM_E_KEY_CERT_INVALID: error-code=6  # The service request failed. Key or certificate is invalid and cannot be used for the operation.
    KeyMCertificateElement_Ssa_TrustModelBackendPeerCert_SigAlgoId_004  # Service of the certificate sub module to access certificate elements.
      operation CertificateElementGet: possible-error=[KeyMCertificateElement_Ssa_TrustModelBackendPeerCert_SigAlgoId_004/E_NOT_OK, KeyMCertificateElement_Ssa_TrustModelBackendPeerCert_SigAlgoId_004/KEYM_E_KEY_CERT_SIZE_MISMATCH, KeyMCertificateElement_Ssa_TrustModelBackendPeerCert_SigAlgoId_004/KEYM_E_PARAMETER_MISMATCH, KeyMCertificateElement_Ssa_TrustModelBackendPeerCert_SigAlgoId_004/KEYM_E_KEY_CERT_INVALID, KeyMCertificateElement_Ssa_TrustModelBackendPeerCert_SigAlgoId_004/KEYM_E_KEY_CERT_EMPTY]  # Provides the content of a specific certificate element. The certificate configuration defines how the certificate submodule can find the element, e.g. by providing the object identifier (OID). This function is used to retrieve this information if only one element is assigned to the respective OID.
        arg CertificateElementData: type=KeyM_CertificateElementType_Ssa_TrustModelBackendPeerCert_SigAlgoId_004, direction=OUT, server-argument-impl-policy=USE-ARRAY-BASE-TYPE  # Holds a pointer to the memory location which will hold the certificate element.
        arg CertificateDataLength: type=uint32, direction=OUT  # Contains the length in bytes of certificate element.
      operation CertificateElementGetByIndex: possible-error=[KeyMCertificateElement_Ssa_TrustModelBackendPeerCert_SigAlgoId_004/E_NOT_OK, KeyMCertificateElement_Ssa_TrustModelBackendPeerCert_SigAlgoId_004/KEYM_E_KEY_CERT_SIZE_MISMATCH, KeyMCertificateElement_Ssa_TrustModelBackendPeerCert_SigAlgoId_004/KEYM_E_PARAMETER_MISMATCH, KeyMCertificateElement_Ssa_TrustModelBackendPeerCert_SigAlgoId_004/KEYM_E_KEY_CERT_INVALID, KeyMCertificateElement_Ssa_TrustModelBackendPeerCert_SigAlgoId_004/KEYM_E_KEY_CERT_EMPTY]  # This operation provides data from a specific certificate element.
        arg Index: type=uint16, direction=IN  # This is the index to dedicated element in the list
        arg CertificateElementData: type=KeyM_CertificateElementType_Ssa_TrustModelBackendPeerCert_SigAlgoId_004, direction=OUT, server-argument-impl-policy=USE-ARRAY-BASE-TYPE  # Holds a pointer to the memory location which will hold the certificate element.
        arg CertificateDataLength: type=uint32, direction=OUT  # Contains the length in bytes of certificate element.
      operation CertificateElementGetCount: possible-error=[KeyMCertificateElement_Ssa_TrustModelBackendPeerCert_SigAlgoId_004/E_NOT_OK, KeyMCertificateElement_Ssa_TrustModelBackendPeerCert_SigAlgoId_004/KEYM_E_KEY_CERT_SIZE_MISMATCH, KeyMCertificateElement_Ssa_TrustModelBackendPeerCert_SigAlgoId_004/KEYM_E_PARAMETER_MISMATCH, KeyMCertificateElement_Ssa_TrustModelBackendPeerCert_SigAlgoId_004/KEYM_E_KEY_CERT_INVALID, KeyMCertificateElement_Ssa_TrustModelBackendPeerCert_SigAlgoId_004/KEYM_E_KEY_CERT_EMPTY]  # This operation returns the amount of items available for a certificate element.
        arg count: type=uint16, direction=OUT  # Number of items available for an element.
      5 x error:
        E_NOT_OK: error-code=1  # The service request failed.
        KEYM_E_KEY_CERT_SIZE_MISMATCH: error-code=4  # The service request failed. Parameter size does not match the expected value.
        KEYM_E_PARAMETER_MISMATCH: error-code=5  # The service request failed. Parameter to function does not provide the expected value.
        KEYM_E_KEY_CERT_EMPTY: error-code=10  # The service request failed. The requested key or certificate is not available, slot is empty.
        KEYM_E_KEY_CERT_INVALID: error-code=6  # The service request failed. Key or certificate is invalid and cannot be used for the operation.
    KeyMCertificateElement_Ssa_TrustModelBackendPeerCert_validityNotBefore_004  # Service of the certificate sub module to access certificate elements.
      operation CertificateElementGet: possible-error=[KeyMCertificateElement_Ssa_TrustModelBackendPeerCert_validityNotBefore_004/E_NOT_OK, KeyMCertificateElement_Ssa_TrustModelBackendPeerCert_validityNotBefore_004/KEYM_E_KEY_CERT_SIZE_MISMATCH, KeyMCertificateElement_Ssa_TrustModelBackendPeerCert_validityNotBefore_004/KEYM_E_PARAMETER_MISMATCH, KeyMCertificateElement_Ssa_TrustModelBackendPeerCert_validityNotBefore_004/KEYM_E_KEY_CERT_INVALID, KeyMCertificateElement_Ssa_TrustModelBackendPeerCert_validityNotBefore_004/KEYM_E_KEY_CERT_EMPTY]  # Provides the content of a specific certificate element. The certificate configuration defines how the certificate submodule can find the element, e.g. by providing the object identifier (OID). This function is used to retrieve this information if only one element is assigned to the respective OID.
        arg CertificateElementData: type=KeyM_CertificateElementType_Ssa_TrustModelBackendPeerCert_validityNotBefore_004, direction=OUT, server-argument-impl-policy=USE-ARRAY-BASE-TYPE  # Holds a pointer to the memory location which will hold the certificate element.
        arg CertificateDataLength: type=uint32, direction=OUT  # Contains the length in bytes of certificate element.
      operation CertificateElementGetByIndex: possible-error=[KeyMCertificateElement_Ssa_TrustModelBackendPeerCert_validityNotBefore_004/E_NOT_OK, KeyMCertificateElement_Ssa_TrustModelBackendPeerCert_validityNotBefore_004/KEYM_E_KEY_CERT_SIZE_MISMATCH, KeyMCertificateElement_Ssa_TrustModelBackendPeerCert_validityNotBefore_004/KEYM_E_PARAMETER_MISMATCH, KeyMCertificateElement_Ssa_TrustModelBackendPeerCert_validityNotBefore_004/KEYM_E_KEY_CERT_INVALID, KeyMCertificateElement_Ssa_TrustModelBackendPeerCert_validityNotBefore_004/KEYM_E_KEY_CERT_EMPTY]  # This operation provides data from a specific certificate element.
        arg Index: type=uint16, direction=IN  # This is the index to dedicated element in the list
        arg CertificateElementData: type=KeyM_CertificateElementType_Ssa_TrustModelBackendPeerCert_validityNotBefore_004, direction=OUT, server-argument-impl-policy=USE-ARRAY-BASE-TYPE  # Holds a pointer to the memory location which will hold the certificate element.
        arg CertificateDataLength: type=uint32, direction=OUT  # Contains the length in bytes of certificate element.
      operation CertificateElementGetCount: possible-error=[KeyMCertificateElement_Ssa_TrustModelBackendPeerCert_validityNotBefore_004/E_NOT_OK, KeyMCertificateElement_Ssa_TrustModelBackendPeerCert_validityNotBefore_004/KEYM_E_KEY_CERT_SIZE_MISMATCH, KeyMCertificateElement_Ssa_TrustModelBackendPeerCert_validityNotBefore_004/KEYM_E_PARAMETER_MISMATCH, KeyMCertificateElement_Ssa_TrustModelBackendPeerCert_validityNotBefore_004/KEYM_E_KEY_CERT_INVALID, KeyMCertificateElement_Ssa_TrustModelBackendPeerCert_validityNotBefore_004/KEYM_E_KEY_CERT_EMPTY]  # This operation returns the amount of items available for a certificate element.
        arg count: type=uint16, direction=OUT  # Number of items available for an element.
      5 x error:
        E_NOT_OK: error-code=1  # The service request failed.
        KEYM_E_KEY_CERT_SIZE_MISMATCH: error-code=4  # The service request failed. Parameter size does not match the expected value.
        KEYM_E_PARAMETER_MISMATCH: error-code=5  # The service request failed. Parameter to function does not provide the expected value.
        KEYM_E_KEY_CERT_EMPTY: error-code=10  # The service request failed. The requested key or certificate is not available, slot is empty.
        KEYM_E_KEY_CERT_INVALID: error-code=6  # The service request failed. Key or certificate is invalid and cannot be used for the operation.
    KeyMCertificateElement_Ssa_TrustModelBackendPeerCert_validityNotAfter_004  # Service of the certificate sub module to access certificate elements.
      operation CertificateElementGet: possible-error=[KeyMCertificateElement_Ssa_TrustModelBackendPeerCert_validityNotAfter_004/E_NOT_OK, KeyMCertificateElement_Ssa_TrustModelBackendPeerCert_validityNotAfter_004/KEYM_E_KEY_CERT_SIZE_MISMATCH, KeyMCertificateElement_Ssa_TrustModelBackendPeerCert_validityNotAfter_004/KEYM_E_PARAMETER_MISMATCH, KeyMCertificateElement_Ssa_TrustModelBackendPeerCert_validityNotAfter_004/KEYM_E_KEY_CERT_INVALID, KeyMCertificateElement_Ssa_TrustModelBackendPeerCert_validityNotAfter_004/KEYM_E_KEY_CERT_EMPTY]  # Provides the content of a specific certificate element. The certificate configuration defines how the certificate submodule can find the element, e.g. by providing the object identifier (OID). This function is used to retrieve this information if only one element is assigned to the respective OID.
        arg CertificateElementData: type=KeyM_CertificateElementType_Ssa_TrustModelBackendPeerCert_validityNotAfter_004, direction=OUT, server-argument-impl-policy=USE-ARRAY-BASE-TYPE  # Holds a pointer to the memory location which will hold the certificate element.
        arg CertificateDataLength: type=uint32, direction=OUT  # Contains the length in bytes of certificate element.
      operation CertificateElementGetByIndex: possible-error=[KeyMCertificateElement_Ssa_TrustModelBackendPeerCert_validityNotAfter_004/E_NOT_OK, KeyMCertificateElement_Ssa_TrustModelBackendPeerCert_validityNotAfter_004/KEYM_E_KEY_CERT_SIZE_MISMATCH, KeyMCertificateElement_Ssa_TrustModelBackendPeerCert_validityNotAfter_004/KEYM_E_PARAMETER_MISMATCH, KeyMCertificateElement_Ssa_TrustModelBackendPeerCert_validityNotAfter_004/KEYM_E_KEY_CERT_INVALID, KeyMCertificateElement_Ssa_TrustModelBackendPeerCert_validityNotAfter_004/KEYM_E_KEY_CERT_EMPTY]  # This operation provides data from a specific certificate element.
        arg Index: type=uint16, direction=IN  # This is the index to dedicated element in the list
        arg CertificateElementData: type=KeyM_CertificateElementType_Ssa_TrustModelBackendPeerCert_validityNotAfter_004, direction=OUT, server-argument-impl-policy=USE-ARRAY-BASE-TYPE  # Holds a pointer to the memory location which will hold the certificate element.
        arg CertificateDataLength: type=uint32, direction=OUT  # Contains the length in bytes of certificate element.
      operation CertificateElementGetCount: possible-error=[KeyMCertificateElement_Ssa_TrustModelBackendPeerCert_validityNotAfter_004/E_NOT_OK, KeyMCertificateElement_Ssa_TrustModelBackendPeerCert_validityNotAfter_004/KEYM_E_KEY_CERT_SIZE_MISMATCH, KeyMCertificateElement_Ssa_TrustModelBackendPeerCert_validityNotAfter_004/KEYM_E_PARAMETER_MISMATCH, KeyMCertificateElement_Ssa_TrustModelBackendPeerCert_validityNotAfter_004/KEYM_E_KEY_CERT_INVALID, KeyMCertificateElement_Ssa_TrustModelBackendPeerCert_validityNotAfter_004/KEYM_E_KEY_CERT_EMPTY]  # This operation returns the amount of items available for a certificate element.
        arg count: type=uint16, direction=OUT  # Number of items available for an element.
      5 x error:
        E_NOT_OK: error-code=1  # The service request failed.
        KEYM_E_KEY_CERT_SIZE_MISMATCH: error-code=4  # The service request failed. Parameter size does not match the expected value.
        KEYM_E_PARAMETER_MISMATCH: error-code=5  # The service request failed. Parameter to function does not provide the expected value.
        KEYM_E_KEY_CERT_EMPTY: error-code=10  # The service request failed. The requested key or certificate is not available, slot is empty.
        KEYM_E_KEY_CERT_INVALID: error-code=6  # The service request failed. Key or certificate is invalid and cannot be used for the operation.
    KeyMCertificateElement_Ssa_TrustModelBackendPeerCert_subject_004  # Service of the certificate sub module to access certificate elements.
      operation CertificateElementGet: possible-error=[KeyMCertificateElement_Ssa_TrustModelBackendPeerCert_subject_004/E_NOT_OK, KeyMCertificateElement_Ssa_TrustModelBackendPeerCert_subject_004/KEYM_E_KEY_CERT_SIZE_MISMATCH, KeyMCertificateElement_Ssa_TrustModelBackendPeerCert_subject_004/KEYM_E_PARAMETER_MISMATCH, KeyMCertificateElement_Ssa_TrustModelBackendPeerCert_subject_004/KEYM_E_KEY_CERT_INVALID, KeyMCertificateElement_Ssa_TrustModelBackendPeerCert_subject_004/KEYM_E_KEY_CERT_EMPTY]  # Provides the content of a specific certificate element. The certificate configuration defines how the certificate submodule can find the element, e.g. by providing the object identifier (OID). This function is used to retrieve this information if only one element is assigned to the respective OID.
        arg CertificateElementData: type=KeyM_CertificateElementType_Ssa_TrustModelBackendPeerCert_subject_004, direction=OUT, server-argument-impl-policy=USE-ARRAY-BASE-TYPE  # Holds a pointer to the memory location which will hold the certificate element.
        arg CertificateDataLength: type=uint32, direction=OUT  # Contains the length in bytes of certificate element.
      operation CertificateElementGetByIndex: possible-error=[KeyMCertificateElement_Ssa_TrustModelBackendPeerCert_subject_004/E_NOT_OK, KeyMCertificateElement_Ssa_TrustModelBackendPeerCert_subject_004/KEYM_E_KEY_CERT_SIZE_MISMATCH, KeyMCertificateElement_Ssa_TrustModelBackendPeerCert_subject_004/KEYM_E_PARAMETER_MISMATCH, KeyMCertificateElement_Ssa_TrustModelBackendPeerCert_subject_004/KEYM_E_KEY_CERT_INVALID, KeyMCertificateElement_Ssa_TrustModelBackendPeerCert_subject_004/KEYM_E_KEY_CERT_EMPTY]  # This operation provides data from a specific certificate element.
        arg Index: type=uint16, direction=IN  # This is the index to dedicated element in the list
        arg CertificateElementData: type=KeyM_CertificateElementType_Ssa_TrustModelBackendPeerCert_subject_004, direction=OUT, server-argument-impl-policy=USE-ARRAY-BASE-TYPE  # Holds a pointer to the memory location which will hold the certificate element.
        arg CertificateDataLength: type=uint32, direction=OUT  # Contains the length in bytes of certificate element.
      operation CertificateElementGetCount: possible-error=[KeyMCertificateElement_Ssa_TrustModelBackendPeerCert_subject_004/E_NOT_OK, KeyMCertificateElement_Ssa_TrustModelBackendPeerCert_subject_004/KEYM_E_KEY_CERT_SIZE_MISMATCH, KeyMCertificateElement_Ssa_TrustModelBackendPeerCert_subject_004/KEYM_E_PARAMETER_MISMATCH, KeyMCertificateElement_Ssa_TrustModelBackendPeerCert_subject_004/KEYM_E_KEY_CERT_INVALID, KeyMCertificateElement_Ssa_TrustModelBackendPeerCert_subject_004/KEYM_E_KEY_CERT_EMPTY]  # This operation returns the amount of items available for a certificate element.
        arg count: type=uint16, direction=OUT  # Number of items available for an element.
      5 x error:
        E_NOT_OK: error-code=1  # The service request failed.
        KEYM_E_KEY_CERT_SIZE_MISMATCH: error-code=4  # The service request failed. Parameter size does not match the expected value.
        KEYM_E_PARAMETER_MISMATCH: error-code=5  # The service request failed. Parameter to function does not provide the expected value.
        KEYM_E_KEY_CERT_EMPTY: error-code=10  # The service request failed. The requested key or certificate is not available, slot is empty.
        KEYM_E_KEY_CERT_INVALID: error-code=6  # The service request failed. Key or certificate is invalid and cannot be used for the operation.
    KeyMCertificateElement_Ssa_TrustModelBackendPeerCert_SubjectPublicKeyInfoAlgo_004  # Service of the certificate sub module to access certificate elements.
      operation CertificateElementGet: possible-error=[KeyMCertificateElement_Ssa_TrustModelBackendPeerCert_SubjectPublicKeyInfoAlgo_004/E_NOT_OK, KeyMCertificateElement_Ssa_TrustModelBackendPeerCert_SubjectPublicKeyInfoAlgo_004/KEYM_E_KEY_CERT_SIZE_MISMATCH, KeyMCertificateElement_Ssa_TrustModelBackendPeerCert_SubjectPublicKeyInfoAlgo_004/KEYM_E_PARAMETER_MISMATCH, KeyMCertificateElement_Ssa_TrustModelBackendPeerCert_SubjectPublicKeyInfoAlgo_004/KEYM_E_KEY_CERT_INVALID, KeyMCertificateElement_Ssa_TrustModelBackendPeerCert_SubjectPublicKeyInfoAlgo_004/KEYM_E_KEY_CERT_EMPTY]  # Provides the content of a specific certificate element. The certificate configuration defines how the certificate submodule can find the element, e.g. by providing the object identifier (OID). This function is used to retrieve this information if only one element is assigned to the respective OID.
        arg CertificateElementData: type=KeyM_CertificateElementType_Ssa_TrustModelBackendPeerCert_SubjectPublicKeyInfoAlgo_004, direction=OUT, server-argument-impl-policy=USE-ARRAY-BASE-TYPE  # Holds a pointer to the memory location which will hold the certificate element.
        arg CertificateDataLength: type=uint32, direction=OUT  # Contains the length in bytes of certificate element.
      operation CertificateElementGetByIndex: possible-error=[KeyMCertificateElement_Ssa_TrustModelBackendPeerCert_SubjectPublicKeyInfoAlgo_004/E_NOT_OK, KeyMCertificateElement_Ssa_TrustModelBackendPeerCert_SubjectPublicKeyInfoAlgo_004/KEYM_E_KEY_CERT_SIZE_MISMATCH, KeyMCertificateElement_Ssa_TrustModelBackendPeerCert_SubjectPublicKeyInfoAlgo_004/KEYM_E_PARAMETER_MISMATCH, KeyMCertificateElement_Ssa_TrustModelBackendPeerCert_SubjectPublicKeyInfoAlgo_004/KEYM_E_KEY_CERT_INVALID, KeyMCertificateElement_Ssa_TrustModelBackendPeerCert_SubjectPublicKeyInfoAlgo_004/KEYM_E_KEY_CERT_EMPTY]  # This operation provides data from a specific certificate element.
        arg Index: type=uint16, direction=IN  # This is the index to dedicated element in the list
        arg CertificateElementData: type=KeyM_CertificateElementType_Ssa_TrustModelBackendPeerCert_SubjectPublicKeyInfoAlgo_004, direction=OUT, server-argument-impl-policy=USE-ARRAY-BASE-TYPE  # Holds a pointer to the memory location which will hold the certificate element.
        arg CertificateDataLength: type=uint32, direction=OUT  # Contains the length in bytes of certificate element.
      operation CertificateElementGetCount: possible-error=[KeyMCertificateElement_Ssa_TrustModelBackendPeerCert_SubjectPublicKeyInfoAlgo_004/E_NOT_OK, KeyMCertificateElement_Ssa_TrustModelBackendPeerCert_SubjectPublicKeyInfoAlgo_004/KEYM_E_KEY_CERT_SIZE_MISMATCH, KeyMCertificateElement_Ssa_TrustModelBackendPeerCert_SubjectPublicKeyInfoAlgo_004/KEYM_E_PARAMETER_MISMATCH, KeyMCertificateElement_Ssa_TrustModelBackendPeerCert_SubjectPublicKeyInfoAlgo_004/KEYM_E_KEY_CERT_INVALID, KeyMCertificateElement_Ssa_TrustModelBackendPeerCert_SubjectPublicKeyInfoAlgo_004/KEYM_E_KEY_CERT_EMPTY]  # This operation returns the amount of items available for a certificate element.
        arg count: type=uint16, direction=OUT  # Number of items available for an element.
      5 x error:
        E_NOT_OK: error-code=1  # The service request failed.
        KEYM_E_KEY_CERT_SIZE_MISMATCH: error-code=4  # The service request failed. Parameter size does not match the expected value.
        KEYM_E_PARAMETER_MISMATCH: error-code=5  # The service request failed. Parameter to function does not provide the expected value.
        KEYM_E_KEY_CERT_EMPTY: error-code=10  # The service request failed. The requested key or certificate is not available, slot is empty.
        KEYM_E_KEY_CERT_INVALID: error-code=6  # The service request failed. Key or certificate is invalid and cannot be used for the operation.
    KeyMCertificateElement_Ssa_TrustModelBackendPeerCert_SubjectPublicKeyInfoKey_004  # Service of the certificate sub module to access certificate elements.
      operation CertificateElementGet: possible-error=[KeyMCertificateElement_Ssa_TrustModelBackendPeerCert_SubjectPublicKeyInfoKey_004/E_NOT_OK, KeyMCertificateElement_Ssa_TrustModelBackendPeerCert_SubjectPublicKeyInfoKey_004/KEYM_E_KEY_CERT_SIZE_MISMATCH, KeyMCertificateElement_Ssa_TrustModelBackendPeerCert_SubjectPublicKeyInfoKey_004/KEYM_E_PARAMETER_MISMATCH, KeyMCertificateElement_Ssa_TrustModelBackendPeerCert_SubjectPublicKeyInfoKey_004/KEYM_E_KEY_CERT_INVALID, KeyMCertificateElement_Ssa_TrustModelBackendPeerCert_SubjectPublicKeyInfoKey_004/KEYM_E_KEY_CERT_EMPTY]  # Provides the content of a specific certificate element. The certificate configuration defines how the certificate submodule can find the element, e.g. by providing the object identifier (OID). This function is used to retrieve this information if only one element is assigned to the respective OID.
        arg CertificateElementData: type=KeyM_CertificateElementType_Ssa_TrustModelBackendPeerCert_SubjectPublicKeyInfoKey_004, direction=OUT, server-argument-impl-policy=USE-ARRAY-BASE-TYPE  # Holds a pointer to the memory location which will hold the certificate element.
        arg CertificateDataLength: type=uint32, direction=OUT  # Contains the length in bytes of certificate element.
      operation CertificateElementGetByIndex: possible-error=[KeyMCertificateElement_Ssa_TrustModelBackendPeerCert_SubjectPublicKeyInfoKey_004/E_NOT_OK, KeyMCertificateElement_Ssa_TrustModelBackendPeerCert_SubjectPublicKeyInfoKey_004/KEYM_E_KEY_CERT_SIZE_MISMATCH, KeyMCertificateElement_Ssa_TrustModelBackendPeerCert_SubjectPublicKeyInfoKey_004/KEYM_E_PARAMETER_MISMATCH, KeyMCertificateElement_Ssa_TrustModelBackendPeerCert_SubjectPublicKeyInfoKey_004/KEYM_E_KEY_CERT_INVALID, KeyMCertificateElement_Ssa_TrustModelBackendPeerCert_SubjectPublicKeyInfoKey_004/KEYM_E_KEY_CERT_EMPTY]  # This operation provides data from a specific certificate element.
        arg Index: type=uint16, direction=IN  # This is the index to dedicated element in the list
        arg CertificateElementData: type=KeyM_CertificateElementType_Ssa_TrustModelBackendPeerCert_SubjectPublicKeyInfoKey_004, direction=OUT, server-argument-impl-policy=USE-ARRAY-BASE-TYPE  # Holds a pointer to the memory location which will hold the certificate element.
        arg CertificateDataLength: type=uint32, direction=OUT  # Contains the length in bytes of certificate element.
      operation CertificateElementGetCount: possible-error=[KeyMCertificateElement_Ssa_TrustModelBackendPeerCert_SubjectPublicKeyInfoKey_004/E_NOT_OK, KeyMCertificateElement_Ssa_TrustModelBackendPeerCert_SubjectPublicKeyInfoKey_004/KEYM_E_KEY_CERT_SIZE_MISMATCH, KeyMCertificateElement_Ssa_TrustModelBackendPeerCert_SubjectPublicKeyInfoKey_004/KEYM_E_PARAMETER_MISMATCH, KeyMCertificateElement_Ssa_TrustModelBackendPeerCert_SubjectPublicKeyInfoKey_004/KEYM_E_KEY_CERT_INVALID, KeyMCertificateElement_Ssa_TrustModelBackendPeerCert_SubjectPublicKeyInfoKey_004/KEYM_E_KEY_CERT_EMPTY]  # This operation returns the amount of items available for a certificate element.
        arg count: type=uint16, direction=OUT  # Number of items available for an element.
      5 x error:
        E_NOT_OK: error-code=1  # The service request failed.
        KEYM_E_KEY_CERT_SIZE_MISMATCH: error-code=4  # The service request failed. Parameter size does not match the expected value.
        KEYM_E_PARAMETER_MISMATCH: error-code=5  # The service request failed. Parameter to function does not provide the expected value.
        KEYM_E_KEY_CERT_EMPTY: error-code=10  # The service request failed. The requested key or certificate is not available, slot is empty.
        KEYM_E_KEY_CERT_INVALID: error-code=6  # The service request failed. Key or certificate is invalid and cannot be used for the operation.
    KeyMCertificateElement_Ssa_TrustModelBackendPeerCert_Issuer_004  # Service of the certificate sub module to access certificate elements.
      operation CertificateElementGet: possible-error=[KeyMCertificateElement_Ssa_TrustModelBackendPeerCert_Issuer_004/E_NOT_OK, KeyMCertificateElement_Ssa_TrustModelBackendPeerCert_Issuer_004/KEYM_E_KEY_CERT_SIZE_MISMATCH, KeyMCertificateElement_Ssa_TrustModelBackendPeerCert_Issuer_004/KEYM_E_PARAMETER_MISMATCH, KeyMCertificateElement_Ssa_TrustModelBackendPeerCert_Issuer_004/KEYM_E_KEY_CERT_INVALID, KeyMCertificateElement_Ssa_TrustModelBackendPeerCert_Issuer_004/KEYM_E_KEY_CERT_EMPTY]  # Provides the content of a specific certificate element. The certificate configuration defines how the certificate submodule can find the element, e.g. by providing the object identifier (OID). This function is used to retrieve this information if only one element is assigned to the respective OID.
        arg CertificateElementData: type=KeyM_CertificateElementType_Ssa_TrustModelBackendPeerCert_Issuer_004, direction=OUT, server-argument-impl-policy=USE-ARRAY-BASE-TYPE  # Holds a pointer to the memory location which will hold the certificate element.
        arg CertificateDataLength: type=uint32, direction=OUT  # Contains the length in bytes of certificate element.
      operation CertificateElementGetByIndex: possible-error=[KeyMCertificateElement_Ssa_TrustModelBackendPeerCert_Issuer_004/E_NOT_OK, KeyMCertificateElement_Ssa_TrustModelBackendPeerCert_Issuer_004/KEYM_E_KEY_CERT_SIZE_MISMATCH, KeyMCertificateElement_Ssa_TrustModelBackendPeerCert_Issuer_004/KEYM_E_PARAMETER_MISMATCH, KeyMCertificateElement_Ssa_TrustModelBackendPeerCert_Issuer_004/KEYM_E_KEY_CERT_INVALID, KeyMCertificateElement_Ssa_TrustModelBackendPeerCert_Issuer_004/KEYM_E_KEY_CERT_EMPTY]  # This operation provides data from a specific certificate element.
        arg Index: type=uint16, direction=IN  # This is the index to dedicated element in the list
        arg CertificateElementData: type=KeyM_CertificateElementType_Ssa_TrustModelBackendPeerCert_Issuer_004, direction=OUT, server-argument-impl-policy=USE-ARRAY-BASE-TYPE  # Holds a pointer to the memory location which will hold the certificate element.
        arg CertificateDataLength: type=uint32, direction=OUT  # Contains the length in bytes of certificate element.
      operation CertificateElementGetCount: possible-error=[KeyMCertificateElement_Ssa_TrustModelBackendPeerCert_Issuer_004/E_NOT_OK, KeyMCertificateElement_Ssa_TrustModelBackendPeerCert_Issuer_004/KEYM_E_KEY_CERT_SIZE_MISMATCH, KeyMCertificateElement_Ssa_TrustModelBackendPeerCert_Issuer_004/KEYM_E_PARAMETER_MISMATCH, KeyMCertificateElement_Ssa_TrustModelBackendPeerCert_Issuer_004/KEYM_E_KEY_CERT_INVALID, KeyMCertificateElement_Ssa_TrustModelBackendPeerCert_Issuer_004/KEYM_E_KEY_CERT_EMPTY]  # This operation returns the amount of items available for a certificate element.
        arg count: type=uint16, direction=OUT  # Number of items available for an element.
      5 x error:
        E_NOT_OK: error-code=1  # The service request failed.
        KEYM_E_KEY_CERT_SIZE_MISMATCH: error-code=4  # The service request failed. Parameter size does not match the expected value.
        KEYM_E_PARAMETER_MISMATCH: error-code=5  # The service request failed. Parameter to function does not provide the expected value.
        KEYM_E_KEY_CERT_EMPTY: error-code=10  # The service request failed. The requested key or certificate is not available, slot is empty.
        KEYM_E_KEY_CERT_INVALID: error-code=6  # The service request failed. Key or certificate is invalid and cannot be used for the operation.
    KeyMCertificateElement_Ssa_TrustModelBackendPeerCert_signatureAlgorithm_004  # Service of the certificate sub module to access certificate elements.
      operation CertificateElementGet: possible-error=[KeyMCertificateElement_Ssa_TrustModelBackendPeerCert_signatureAlgorithm_004/E_NOT_OK, KeyMCertificateElement_Ssa_TrustModelBackendPeerCert_signatureAlgorithm_004/KEYM_E_KEY_CERT_SIZE_MISMATCH, KeyMCertificateElement_Ssa_TrustModelBackendPeerCert_signatureAlgorithm_004/KEYM_E_PARAMETER_MISMATCH, KeyMCertificateElement_Ssa_TrustModelBackendPeerCert_signatureAlgorithm_004/KEYM_E_KEY_CERT_INVALID, KeyMCertificateElement_Ssa_TrustModelBackendPeerCert_signatureAlgorithm_004/KEYM_E_KEY_CERT_EMPTY]  # Provides the content of a specific certificate element. The certificate configuration defines how the certificate submodule can find the element, e.g. by providing the object identifier (OID). This function is used to retrieve this information if only one element is assigned to the respective OID.
        arg CertificateElementData: type=KeyM_CertificateElementType_Ssa_TrustModelBackendPeerCert_signatureAlgorithm_004, direction=OUT, server-argument-impl-policy=USE-ARRAY-BASE-TYPE  # Holds a pointer to the memory location which will hold the certificate element.
        arg CertificateDataLength: type=uint32, direction=OUT  # Contains the length in bytes of certificate element.
      operation CertificateElementGetByIndex: possible-error=[KeyMCertificateElement_Ssa_TrustModelBackendPeerCert_signatureAlgorithm_004/E_NOT_OK, KeyMCertificateElement_Ssa_TrustModelBackendPeerCert_signatureAlgorithm_004/KEYM_E_KEY_CERT_SIZE_MISMATCH, KeyMCertificateElement_Ssa_TrustModelBackendPeerCert_signatureAlgorithm_004/KEYM_E_PARAMETER_MISMATCH, KeyMCertificateElement_Ssa_TrustModelBackendPeerCert_signatureAlgorithm_004/KEYM_E_KEY_CERT_INVALID, KeyMCertificateElement_Ssa_TrustModelBackendPeerCert_signatureAlgorithm_004/KEYM_E_KEY_CERT_EMPTY]  # This operation provides data from a specific certificate element.
        arg Index: type=uint16, direction=IN  # This is the index to dedicated element in the list
        arg CertificateElementData: type=KeyM_CertificateElementType_Ssa_TrustModelBackendPeerCert_signatureAlgorithm_004, direction=OUT, server-argument-impl-policy=USE-ARRAY-BASE-TYPE  # Holds a pointer to the memory location which will hold the certificate element.
        arg CertificateDataLength: type=uint32, direction=OUT  # Contains the length in bytes of certificate element.
      operation CertificateElementGetCount: possible-error=[KeyMCertificateElement_Ssa_TrustModelBackendPeerCert_signatureAlgorithm_004/E_NOT_OK, KeyMCertificateElement_Ssa_TrustModelBackendPeerCert_signatureAlgorithm_004/KEYM_E_KEY_CERT_SIZE_MISMATCH, KeyMCertificateElement_Ssa_TrustModelBackendPeerCert_signatureAlgorithm_004/KEYM_E_PARAMETER_MISMATCH, KeyMCertificateElement_Ssa_TrustModelBackendPeerCert_signatureAlgorithm_004/KEYM_E_KEY_CERT_INVALID, KeyMCertificateElement_Ssa_TrustModelBackendPeerCert_signatureAlgorithm_004/KEYM_E_KEY_CERT_EMPTY]  # This operation returns the amount of items available for a certificate element.
        arg count: type=uint16, direction=OUT  # Number of items available for an element.
      5 x error:
        E_NOT_OK: error-code=1  # The service request failed.
        KEYM_E_KEY_CERT_SIZE_MISMATCH: error-code=4  # The service request failed. Parameter size does not match the expected value.
        KEYM_E_PARAMETER_MISMATCH: error-code=5  # The service request failed. Parameter to function does not provide the expected value.
        KEYM_E_KEY_CERT_EMPTY: error-code=10  # The service request failed. The requested key or certificate is not available, slot is empty.
        KEYM_E_KEY_CERT_INVALID: error-code=6  # The service request failed. Key or certificate is invalid and cannot be used for the operation.
    KeyMCertificateElement_Ssa_TrustModelBackendPeerCert_signatureValue_004  # Service of the certificate sub module to access certificate elements.
      operation CertificateElementGet: possible-error=[KeyMCertificateElement_Ssa_TrustModelBackendPeerCert_signatureValue_004/E_NOT_OK, KeyMCertificateElement_Ssa_TrustModelBackendPeerCert_signatureValue_004/KEYM_E_KEY_CERT_SIZE_MISMATCH, KeyMCertificateElement_Ssa_TrustModelBackendPeerCert_signatureValue_004/KEYM_E_PARAMETER_MISMATCH, KeyMCertificateElement_Ssa_TrustModelBackendPeerCert_signatureValue_004/KEYM_E_KEY_CERT_INVALID, KeyMCertificateElement_Ssa_TrustModelBackendPeerCert_signatureValue_004/KEYM_E_KEY_CERT_EMPTY]  # Provides the content of a specific certificate element. The certificate configuration defines how the certificate submodule can find the element, e.g. by providing the object identifier (OID). This function is used to retrieve this information if only one element is assigned to the respective OID.
        arg CertificateElementData: type=KeyM_CertificateElementType_Ssa_TrustModelBackendPeerCert_signatureValue_004, direction=OUT, server-argument-impl-policy=USE-ARRAY-BASE-TYPE  # Holds a pointer to the memory location which will hold the certificate element.
        arg CertificateDataLength: type=uint32, direction=OUT  # Contains the length in bytes of certificate element.
      operation CertificateElementGetByIndex: possible-error=[KeyMCertificateElement_Ssa_TrustModelBackendPeerCert_signatureValue_004/E_NOT_OK, KeyMCertificateElement_Ssa_TrustModelBackendPeerCert_signatureValue_004/KEYM_E_KEY_CERT_SIZE_MISMATCH, KeyMCertificateElement_Ssa_TrustModelBackendPeerCert_signatureValue_004/KEYM_E_PARAMETER_MISMATCH, KeyMCertificateElement_Ssa_TrustModelBackendPeerCert_signatureValue_004/KEYM_E_KEY_CERT_INVALID, KeyMCertificateElement_Ssa_TrustModelBackendPeerCert_signatureValue_004/KEYM_E_KEY_CERT_EMPTY]  # This operation provides data from a specific certificate element.
        arg Index: type=uint16, direction=IN  # This is the index to dedicated element in the list
        arg CertificateElementData: type=KeyM_CertificateElementType_Ssa_TrustModelBackendPeerCert_signatureValue_004, direction=OUT, server-argument-impl-policy=USE-ARRAY-BASE-TYPE  # Holds a pointer to the memory location which will hold the certificate element.
        arg CertificateDataLength: type=uint32, direction=OUT  # Contains the length in bytes of certificate element.
      operation CertificateElementGetCount: possible-error=[KeyMCertificateElement_Ssa_TrustModelBackendPeerCert_signatureValue_004/E_NOT_OK, KeyMCertificateElement_Ssa_TrustModelBackendPeerCert_signatureValue_004/KEYM_E_KEY_CERT_SIZE_MISMATCH, KeyMCertificateElement_Ssa_TrustModelBackendPeerCert_signatureValue_004/KEYM_E_PARAMETER_MISMATCH, KeyMCertificateElement_Ssa_TrustModelBackendPeerCert_signatureValue_004/KEYM_E_KEY_CERT_INVALID, KeyMCertificateElement_Ssa_TrustModelBackendPeerCert_signatureValue_004/KEYM_E_KEY_CERT_EMPTY]  # This operation returns the amount of items available for a certificate element.
        arg count: type=uint16, direction=OUT  # Number of items available for an element.
      5 x error:
        E_NOT_OK: error-code=1  # The service request failed.
        KEYM_E_KEY_CERT_SIZE_MISMATCH: error-code=4  # The service request failed. Parameter size does not match the expected value.
        KEYM_E_PARAMETER_MISMATCH: error-code=5  # The service request failed. Parameter to function does not provide the expected value.
        KEYM_E_KEY_CERT_EMPTY: error-code=10  # The service request failed. The requested key or certificate is not available, slot is empty.
        KEYM_E_KEY_CERT_INVALID: error-code=6  # The service request failed. Key or certificate is invalid and cannot be used for the operation.
    KeyMCertificate_Ssa_TrustModelIntermediatePeerCert  # Service of Certificate sub module
      4 x operation:
        GetCertificate: possible-error=[KeyMCertificate_Ssa_TrustModelIntermediatePeerCert/E_NOT_OK, KeyMCertificate_Ssa_TrustModelIntermediatePeerCert/KEYM_E_KEY_CERT_SIZE_MISMATCH, KeyMCertificate_Ssa_TrustModelIntermediatePeerCert/KEYM_E_PARAMETER_MISMATCH, KeyMCertificate_Ssa_TrustModelIntermediatePeerCert/KEYM_E_KEY_CERT_READ_FAIL, KeyMCertificate_Ssa_TrustModelIntermediatePeerCert/KEYM_E_KEY_CERT_EMPTY]  # Read certificate data from the certificate sub module
          arg Certificate: type=KeyM_CertificateType_Ssa_TrustModelIntermediatePeerCert, direction=OUT  # Holds a pointer to the memory location which will hold the Certificate.
        GetStatus: possible-error=KeyMCertificate_Ssa_TrustModelIntermediatePeerCert/E_NOT_OK  # Provides the status of a certificate.
          arg Status: type=KeyM_CertificateStatusType, direction=OUT  # Holds a pointer to the memory location which will hold the Certificate Status.
        SetCertificate: possible-error=[KeyMCertificate_Ssa_TrustModelIntermediatePeerCert/E_NOT_OK, KeyMCertificate_Ssa_TrustModelIntermediatePeerCert/KEYM_E_KEY_CERT_SIZE_MISMATCH, KeyMCertificate_Ssa_TrustModelIntermediatePeerCert/KEYM_E_PARAMETER_MISMATCH, KeyMCertificate_Ssa_TrustModelIntermediatePeerCert/KEYM_E_KEY_CERT_WRITE_FAIL]  # Provides certificate data to be processed by the certificate sub module.
          arg Certificate: type=KeyM_CertificateType_Ssa_TrustModelIntermediatePeerCert, direction=IN  # Holds a pointer to Certificate.
        VerifyCertificate: possible-error=[KeyMCertificate_Ssa_TrustModelIntermediatePeerCert/E_NOT_OK, KeyMCertificate_Ssa_TrustModelIntermediatePeerCert/KEYM_E_BUSY, KeyMCertificate_Ssa_TrustModelIntermediatePeerCert/KEYM_E_KEY_CERT_SIZE_MISMATCH, KeyMCertificate_Ssa_TrustModelIntermediatePeerCert/KEYM_E_PARAMETER_MISMATCH, KeyMCertificate_Ssa_TrustModelIntermediatePeerCert/KEYM_E_KEY_CERT_EMPTY, KeyMCertificate_Ssa_TrustModelIntermediatePeerCert/KEYM_E_CERT_INVALID_CHAIN_OF_TRUST]  # Verify certificate data from the certificate sub module .
      8 x error:
        E_NOT_OK: error-code=1  # The service request failed.
        KEYM_E_BUSY: error-code=2  # The service request failed. Key management is busy with other operations.
        KEYM_E_KEY_CERT_SIZE_MISMATCH: error-code=4  # The service request failed. Parameter size does not match the expected value.
        KEYM_E_PARAMETER_MISMATCH: error-code=5  # The service request failed. Parameter to function does not provide the expected value.
        KEYM_E_KEY_CERT_WRITE_FAIL: error-code=7  # The service request failed. Certificate or key write operation failed.
        KEYM_E_KEY_CERT_READ_FAIL: error-code=9  # The service request failed. Certificate or key could not be provided due to a read or permission failure.
        KEYM_E_KEY_CERT_EMPTY: error-code=10  # The service request failed. The requested key or certificate is not available, slot is empty.
        KEYM_E_CERT_INVALID_CHAIN_OF_TRUST: error-code=11  # The service request failed. Certificate verification failed - Invalid Chain of Trust.
    KeyMCertificateExtended_Ssa_TrustModelIntermediatePeerCert  # Services of Certificate sub module that extend the standard AUTOSAR services
      operation ServiceCertificate: possible-error=[KeyMCertificateExtended_Ssa_TrustModelIntermediatePeerCert/E_NOT_OK, KeyMCertificateExtended_Ssa_TrustModelIntermediatePeerCert/KEYM_E_BUSY, KeyMCertificateExtended_Ssa_TrustModelIntermediatePeerCert/KEYM_E_KEY_CERT_SIZE_MISMATCH, KeyMCertificateExtended_Ssa_TrustModelIntermediatePeerCert/KEYM_E_PARAMETER_MISMATCH, KeyMCertificateExtended_Ssa_TrustModelIntermediatePeerCert/KEYM_E_KEY_CERT_EMPTY, KeyMCertificateExtended_Ssa_TrustModelIntermediatePeerCert/KEYM_E_CERT_INVALID_CHAIN_OF_TRUST]  # Handle certificate operation request in the certificate sub module.
        5 x arg, all with direction=IN:
          Service: type=KeyM_ServiceCertificateType  # Provides the type of service the key manager has to perform.
          RequestData: type=KeyM_ConstDataPtrType  # Information that comes along with the request.
          RequestDataLength: type=uint32  # Length of data in the RequestData array.
          ResponseData: type=KeyM_DataPtrType  # Pointer to array in which the request response data will be stored upon request completion.
          ResponseDataLength: type=uint32  # Max number of bytes available in ResponseDataPtr.
      operation CsrElementSet: possible-error=[KeyMCertificateExtended_Ssa_TrustModelIntermediatePeerCert/E_NOT_OK, KeyMCertificateExtended_Ssa_TrustModelIntermediatePeerCert/KEYM_E_PARAMETER_MISMATCH]  # To be used before calling GenerateCertificationRequestInfo. Adds an data to the certificate for which a signing request shall be build.
        4 x arg, all with direction=IN:
          CertElementId: type=KeyM_CertElementIdType  # Element ID of the element that shall be added
          EncodingType: type=KeyM_CsrEncodingType  # Encoding type of the CSR element
          ElementData: type=KeyM_ConstDataPtrType  # Data of the element that shall be added
          ElementDataLength: type=uint32  # Length of ElementData data in the ElementData array
      6 x error:
        E_NOT_OK: error-code=1  # The service request failed.
        KEYM_E_BUSY: error-code=2  # The service request failed. Key management is busy with other operations.
        KEYM_E_KEY_CERT_SIZE_MISMATCH: error-code=4  # The service request failed. Parameter size does not match the expected value.
        KEYM_E_PARAMETER_MISMATCH: error-code=5  # The service request failed. Parameter to function does not provide the expected value.
        KEYM_E_KEY_CERT_EMPTY: error-code=10  # The service request failed. The requested key or certificate is not available, slot is empty.
        KEYM_E_CERT_INVALID_CHAIN_OF_TRUST: error-code=11  # The service request failed. Certificate verification failed - Invalid Chain of Trust.
    KeyMCertificateElement_Ssa_TrustModelIntermediatePeerCert_ext_authKeyId_007  # Service of the certificate sub module to access certificate elements.
      operation CertificateElementGet: possible-error=[KeyMCertificateElement_Ssa_TrustModelIntermediatePeerCert_ext_authKeyId_007/E_NOT_OK, KeyMCertificateElement_Ssa_TrustModelIntermediatePeerCert_ext_authKeyId_007/KEYM_E_KEY_CERT_SIZE_MISMATCH, KeyMCertificateElement_Ssa_TrustModelIntermediatePeerCert_ext_authKeyId_007/KEYM_E_PARAMETER_MISMATCH, KeyMCertificateElement_Ssa_TrustModelIntermediatePeerCert_ext_authKeyId_007/KEYM_E_KEY_CERT_INVALID, KeyMCertificateElement_Ssa_TrustModelIntermediatePeerCert_ext_authKeyId_007/KEYM_E_KEY_CERT_EMPTY]  # Provides the content of a specific certificate element. The certificate configuration defines how the certificate submodule can find the element, e.g. by providing the object identifier (OID). This function is used to retrieve this information if only one element is assigned to the respective OID.
        arg CertificateElementData: type=KeyM_CertificateElementType_Ssa_TrustModelIntermediatePeerCert_ext_authKeyId_007, direction=OUT, server-argument-impl-policy=USE-ARRAY-BASE-TYPE  # Holds a pointer to the memory location which will hold the certificate element.
        arg CertificateDataLength: type=uint32, direction=OUT  # Contains the length in bytes of certificate element.
      operation CertificateElementGetByIndex: possible-error=[KeyMCertificateElement_Ssa_TrustModelIntermediatePeerCert_ext_authKeyId_007/E_NOT_OK, KeyMCertificateElement_Ssa_TrustModelIntermediatePeerCert_ext_authKeyId_007/KEYM_E_KEY_CERT_SIZE_MISMATCH, KeyMCertificateElement_Ssa_TrustModelIntermediatePeerCert_ext_authKeyId_007/KEYM_E_PARAMETER_MISMATCH, KeyMCertificateElement_Ssa_TrustModelIntermediatePeerCert_ext_authKeyId_007/KEYM_E_KEY_CERT_INVALID, KeyMCertificateElement_Ssa_TrustModelIntermediatePeerCert_ext_authKeyId_007/KEYM_E_KEY_CERT_EMPTY]  # This operation provides data from a specific certificate element.
        arg Index: type=uint16, direction=IN  # This is the index to dedicated element in the list
        arg CertificateElementData: type=KeyM_CertificateElementType_Ssa_TrustModelIntermediatePeerCert_ext_authKeyId_007, direction=OUT, server-argument-impl-policy=USE-ARRAY-BASE-TYPE  # Holds a pointer to the memory location which will hold the certificate element.
        arg CertificateDataLength: type=uint32, direction=OUT  # Contains the length in bytes of certificate element.
      operation CertificateElementGetCount: possible-error=[KeyMCertificateElement_Ssa_TrustModelIntermediatePeerCert_ext_authKeyId_007/E_NOT_OK, KeyMCertificateElement_Ssa_TrustModelIntermediatePeerCert_ext_authKeyId_007/KEYM_E_KEY_CERT_SIZE_MISMATCH, KeyMCertificateElement_Ssa_TrustModelIntermediatePeerCert_ext_authKeyId_007/KEYM_E_PARAMETER_MISMATCH, KeyMCertificateElement_Ssa_TrustModelIntermediatePeerCert_ext_authKeyId_007/KEYM_E_KEY_CERT_INVALID, KeyMCertificateElement_Ssa_TrustModelIntermediatePeerCert_ext_authKeyId_007/KEYM_E_KEY_CERT_EMPTY]  # This operation returns the amount of items available for a certificate element.
        arg count: type=uint16, direction=OUT  # Number of items available for an element.
      5 x error:
        E_NOT_OK: error-code=1  # The service request failed.
        KEYM_E_KEY_CERT_SIZE_MISMATCH: error-code=4  # The service request failed. Parameter size does not match the expected value.
        KEYM_E_PARAMETER_MISMATCH: error-code=5  # The service request failed. Parameter to function does not provide the expected value.
        KEYM_E_KEY_CERT_EMPTY: error-code=10  # The service request failed. The requested key or certificate is not available, slot is empty.
        KEYM_E_KEY_CERT_INVALID: error-code=6  # The service request failed. Key or certificate is invalid and cannot be used for the operation.
    KeyMCertificateElement_Ssa_TrustModelIntermediatePeerCert_ext_subKeyId_007  # Service of the certificate sub module to access certificate elements.
      operation CertificateElementGet: possible-error=[KeyMCertificateElement_Ssa_TrustModelIntermediatePeerCert_ext_subKeyId_007/E_NOT_OK, KeyMCertificateElement_Ssa_TrustModelIntermediatePeerCert_ext_subKeyId_007/KEYM_E_KEY_CERT_SIZE_MISMATCH, KeyMCertificateElement_Ssa_TrustModelIntermediatePeerCert_ext_subKeyId_007/KEYM_E_PARAMETER_MISMATCH, KeyMCertificateElement_Ssa_TrustModelIntermediatePeerCert_ext_subKeyId_007/KEYM_E_KEY_CERT_INVALID, KeyMCertificateElement_Ssa_TrustModelIntermediatePeerCert_ext_subKeyId_007/KEYM_E_KEY_CERT_EMPTY]  # Provides the content of a specific certificate element. The certificate configuration defines how the certificate submodule can find the element, e.g. by providing the object identifier (OID). This function is used to retrieve this information if only one element is assigned to the respective OID.
        arg CertificateElementData: type=KeyM_CertificateElementType_Ssa_TrustModelIntermediatePeerCert_ext_subKeyId_007, direction=OUT, server-argument-impl-policy=USE-ARRAY-BASE-TYPE  # Holds a pointer to the memory location which will hold the certificate element.
        arg CertificateDataLength: type=uint32, direction=OUT  # Contains the length in bytes of certificate element.
      operation CertificateElementGetByIndex: possible-error=[KeyMCertificateElement_Ssa_TrustModelIntermediatePeerCert_ext_subKeyId_007/E_NOT_OK, KeyMCertificateElement_Ssa_TrustModelIntermediatePeerCert_ext_subKeyId_007/KEYM_E_KEY_CERT_SIZE_MISMATCH, KeyMCertificateElement_Ssa_TrustModelIntermediatePeerCert_ext_subKeyId_007/KEYM_E_PARAMETER_MISMATCH, KeyMCertificateElement_Ssa_TrustModelIntermediatePeerCert_ext_subKeyId_007/KEYM_E_KEY_CERT_INVALID, KeyMCertificateElement_Ssa_TrustModelIntermediatePeerCert_ext_subKeyId_007/KEYM_E_KEY_CERT_EMPTY]  # This operation provides data from a specific certificate element.
        arg Index: type=uint16, direction=IN  # This is the index to dedicated element in the list
        arg CertificateElementData: type=KeyM_CertificateElementType_Ssa_TrustModelIntermediatePeerCert_ext_subKeyId_007, direction=OUT, server-argument-impl-policy=USE-ARRAY-BASE-TYPE  # Holds a pointer to the memory location which will hold the certificate element.
        arg CertificateDataLength: type=uint32, direction=OUT  # Contains the length in bytes of certificate element.
      operation CertificateElementGetCount: possible-error=[KeyMCertificateElement_Ssa_TrustModelIntermediatePeerCert_ext_subKeyId_007/E_NOT_OK, KeyMCertificateElement_Ssa_TrustModelIntermediatePeerCert_ext_subKeyId_007/KEYM_E_KEY_CERT_SIZE_MISMATCH, KeyMCertificateElement_Ssa_TrustModelIntermediatePeerCert_ext_subKeyId_007/KEYM_E_PARAMETER_MISMATCH, KeyMCertificateElement_Ssa_TrustModelIntermediatePeerCert_ext_subKeyId_007/KEYM_E_KEY_CERT_INVALID, KeyMCertificateElement_Ssa_TrustModelIntermediatePeerCert_ext_subKeyId_007/KEYM_E_KEY_CERT_EMPTY]  # This operation returns the amount of items available for a certificate element.
        arg count: type=uint16, direction=OUT  # Number of items available for an element.
      5 x error:
        E_NOT_OK: error-code=1  # The service request failed.
        KEYM_E_KEY_CERT_SIZE_MISMATCH: error-code=4  # The service request failed. Parameter size does not match the expected value.
        KEYM_E_PARAMETER_MISMATCH: error-code=5  # The service request failed. Parameter to function does not provide the expected value.
        KEYM_E_KEY_CERT_EMPTY: error-code=10  # The service request failed. The requested key or certificate is not available, slot is empty.
        KEYM_E_KEY_CERT_INVALID: error-code=6  # The service request failed. Key or certificate is invalid and cannot be used for the operation.
    KeyMCertificateElement_Ssa_TrustModelIntermediatePeerCert_ext_basicConstraints_005  # Service of the certificate sub module to access certificate elements.
      operation CertificateElementGet: possible-error=[KeyMCertificateElement_Ssa_TrustModelIntermediatePeerCert_ext_basicConstraints_005/E_NOT_OK, KeyMCertificateElement_Ssa_TrustModelIntermediatePeerCert_ext_basicConstraints_005/KEYM_E_KEY_CERT_SIZE_MISMATCH, KeyMCertificateElement_Ssa_TrustModelIntermediatePeerCert_ext_basicConstraints_005/KEYM_E_PARAMETER_MISMATCH, KeyMCertificateElement_Ssa_TrustModelIntermediatePeerCert_ext_basicConstraints_005/KEYM_E_KEY_CERT_INVALID, KeyMCertificateElement_Ssa_TrustModelIntermediatePeerCert_ext_basicConstraints_005/KEYM_E_KEY_CERT_EMPTY]  # Provides the content of a specific certificate element. The certificate configuration defines how the certificate submodule can find the element, e.g. by providing the object identifier (OID). This function is used to retrieve this information if only one element is assigned to the respective OID.
        arg CertificateElementData: type=KeyM_CertificateElementType_Ssa_TrustModelIntermediatePeerCert_ext_basicConstraints_005, direction=OUT, server-argument-impl-policy=USE-ARRAY-BASE-TYPE  # Holds a pointer to the memory location which will hold the certificate element.
        arg CertificateDataLength: type=uint32, direction=OUT  # Contains the length in bytes of certificate element.
      operation CertificateElementGetByIndex: possible-error=[KeyMCertificateElement_Ssa_TrustModelIntermediatePeerCert_ext_basicConstraints_005/E_NOT_OK, KeyMCertificateElement_Ssa_TrustModelIntermediatePeerCert_ext_basicConstraints_005/KEYM_E_KEY_CERT_SIZE_MISMATCH, KeyMCertificateElement_Ssa_TrustModelIntermediatePeerCert_ext_basicConstraints_005/KEYM_E_PARAMETER_MISMATCH, KeyMCertificateElement_Ssa_TrustModelIntermediatePeerCert_ext_basicConstraints_005/KEYM_E_KEY_CERT_INVALID, KeyMCertificateElement_Ssa_TrustModelIntermediatePeerCert_ext_basicConstraints_005/KEYM_E_KEY_CERT_EMPTY]  # This operation provides data from a specific certificate element.
        arg Index: type=uint16, direction=IN  # This is the index to dedicated element in the list
        arg CertificateElementData: type=KeyM_CertificateElementType_Ssa_TrustModelIntermediatePeerCert_ext_basicConstraints_005, direction=OUT, server-argument-impl-policy=USE-ARRAY-BASE-TYPE  # Holds a pointer to the memory location which will hold the certificate element.
        arg CertificateDataLength: type=uint32, direction=OUT  # Contains the length in bytes of certificate element.
      operation CertificateElementGetCount: possible-error=[KeyMCertificateElement_Ssa_TrustModelIntermediatePeerCert_ext_basicConstraints_005/E_NOT_OK, KeyMCertificateElement_Ssa_TrustModelIntermediatePeerCert_ext_basicConstraints_005/KEYM_E_KEY_CERT_SIZE_MISMATCH, KeyMCertificateElement_Ssa_TrustModelIntermediatePeerCert_ext_basicConstraints_005/KEYM_E_PARAMETER_MISMATCH, KeyMCertificateElement_Ssa_TrustModelIntermediatePeerCert_ext_basicConstraints_005/KEYM_E_KEY_CERT_INVALID, KeyMCertificateElement_Ssa_TrustModelIntermediatePeerCert_ext_basicConstraints_005/KEYM_E_KEY_CERT_EMPTY]  # This operation returns the amount of items available for a certificate element.
        arg count: type=uint16, direction=OUT  # Number of items available for an element.
      5 x error:
        E_NOT_OK: error-code=1  # The service request failed.
        KEYM_E_KEY_CERT_SIZE_MISMATCH: error-code=4  # The service request failed. Parameter size does not match the expected value.
        KEYM_E_PARAMETER_MISMATCH: error-code=5  # The service request failed. Parameter to function does not provide the expected value.
        KEYM_E_KEY_CERT_EMPTY: error-code=10  # The service request failed. The requested key or certificate is not available, slot is empty.
        KEYM_E_KEY_CERT_INVALID: error-code=6  # The service request failed. Key or certificate is invalid and cannot be used for the operation.
    KeyMCertificateElement_Ssa_TrustModelIntermediatePeerCert_ext_keyUsage_007  # Service of the certificate sub module to access certificate elements.
      operation CertificateElementGet: possible-error=[KeyMCertificateElement_Ssa_TrustModelIntermediatePeerCert_ext_keyUsage_007/E_NOT_OK, KeyMCertificateElement_Ssa_TrustModelIntermediatePeerCert_ext_keyUsage_007/KEYM_E_KEY_CERT_SIZE_MISMATCH, KeyMCertificateElement_Ssa_TrustModelIntermediatePeerCert_ext_keyUsage_007/KEYM_E_PARAMETER_MISMATCH, KeyMCertificateElement_Ssa_TrustModelIntermediatePeerCert_ext_keyUsage_007/KEYM_E_KEY_CERT_INVALID, KeyMCertificateElement_Ssa_TrustModelIntermediatePeerCert_ext_keyUsage_007/KEYM_E_KEY_CERT_EMPTY]  # Provides the content of a specific certificate element. The certificate configuration defines how the certificate submodule can find the element, e.g. by providing the object identifier (OID). This function is used to retrieve this information if only one element is assigned to the respective OID.
        arg CertificateElementData: type=KeyM_CertificateElementType_Ssa_TrustModelIntermediatePeerCert_ext_keyUsage_007, direction=OUT, server-argument-impl-policy=USE-ARRAY-BASE-TYPE  # Holds a pointer to the memory location which will hold the certificate element.
        arg CertificateDataLength: type=uint32, direction=OUT  # Contains the length in bytes of certificate element.
      operation CertificateElementGetByIndex: possible-error=[KeyMCertificateElement_Ssa_TrustModelIntermediatePeerCert_ext_keyUsage_007/E_NOT_OK, KeyMCertificateElement_Ssa_TrustModelIntermediatePeerCert_ext_keyUsage_007/KEYM_E_KEY_CERT_SIZE_MISMATCH, KeyMCertificateElement_Ssa_TrustModelIntermediatePeerCert_ext_keyUsage_007/KEYM_E_PARAMETER_MISMATCH, KeyMCertificateElement_Ssa_TrustModelIntermediatePeerCert_ext_keyUsage_007/KEYM_E_KEY_CERT_INVALID, KeyMCertificateElement_Ssa_TrustModelIntermediatePeerCert_ext_keyUsage_007/KEYM_E_KEY_CERT_EMPTY]  # This operation provides data from a specific certificate element.
        arg Index: type=uint16, direction=IN  # This is the index to dedicated element in the list
        arg CertificateElementData: type=KeyM_CertificateElementType_Ssa_TrustModelIntermediatePeerCert_ext_keyUsage_007, direction=OUT, server-argument-impl-policy=USE-ARRAY-BASE-TYPE  # Holds a pointer to the memory location which will hold the certificate element.
        arg CertificateDataLength: type=uint32, direction=OUT  # Contains the length in bytes of certificate element.
      operation CertificateElementGetCount: possible-error=[KeyMCertificateElement_Ssa_TrustModelIntermediatePeerCert_ext_keyUsage_007/E_NOT_OK, KeyMCertificateElement_Ssa_TrustModelIntermediatePeerCert_ext_keyUsage_007/KEYM_E_KEY_CERT_SIZE_MISMATCH, KeyMCertificateElement_Ssa_TrustModelIntermediatePeerCert_ext_keyUsage_007/KEYM_E_PARAMETER_MISMATCH, KeyMCertificateElement_Ssa_TrustModelIntermediatePeerCert_ext_keyUsage_007/KEYM_E_KEY_CERT_INVALID, KeyMCertificateElement_Ssa_TrustModelIntermediatePeerCert_ext_keyUsage_007/KEYM_E_KEY_CERT_EMPTY]  # This operation returns the amount of items available for a certificate element.
        arg count: type=uint16, direction=OUT  # Number of items available for an element.
      5 x error:
        E_NOT_OK: error-code=1  # The service request failed.
        KEYM_E_KEY_CERT_SIZE_MISMATCH: error-code=4  # The service request failed. Parameter size does not match the expected value.
        KEYM_E_PARAMETER_MISMATCH: error-code=5  # The service request failed. Parameter to function does not provide the expected value.
        KEYM_E_KEY_CERT_EMPTY: error-code=10  # The service request failed. The requested key or certificate is not available, slot is empty.
        KEYM_E_KEY_CERT_INVALID: error-code=6  # The service request failed. Key or certificate is invalid and cannot be used for the operation.
    KeyMCertificateElement_Ssa_TrustModelIntermediatePeerCert_Version_007  # Service of the certificate sub module to access certificate elements.
      operation CertificateElementGet: possible-error=[KeyMCertificateElement_Ssa_TrustModelIntermediatePeerCert_Version_007/E_NOT_OK, KeyMCertificateElement_Ssa_TrustModelIntermediatePeerCert_Version_007/KEYM_E_KEY_CERT_SIZE_MISMATCH, KeyMCertificateElement_Ssa_TrustModelIntermediatePeerCert_Version_007/KEYM_E_PARAMETER_MISMATCH, KeyMCertificateElement_Ssa_TrustModelIntermediatePeerCert_Version_007/KEYM_E_KEY_CERT_INVALID, KeyMCertificateElement_Ssa_TrustModelIntermediatePeerCert_Version_007/KEYM_E_KEY_CERT_EMPTY]  # Provides the content of a specific certificate element. The certificate configuration defines how the certificate submodule can find the element, e.g. by providing the object identifier (OID). This function is used to retrieve this information if only one element is assigned to the respective OID.
        arg CertificateElementData: type=KeyM_CertificateElementType_Ssa_TrustModelIntermediatePeerCert_Version_007, direction=OUT, server-argument-impl-policy=USE-ARRAY-BASE-TYPE  # Holds a pointer to the memory location which will hold the certificate element.
        arg CertificateDataLength: type=uint32, direction=OUT  # Contains the length in bytes of certificate element.
      operation CertificateElementGetByIndex: possible-error=[KeyMCertificateElement_Ssa_TrustModelIntermediatePeerCert_Version_007/E_NOT_OK, KeyMCertificateElement_Ssa_TrustModelIntermediatePeerCert_Version_007/KEYM_E_KEY_CERT_SIZE_MISMATCH, KeyMCertificateElement_Ssa_TrustModelIntermediatePeerCert_Version_007/KEYM_E_PARAMETER_MISMATCH, KeyMCertificateElement_Ssa_TrustModelIntermediatePeerCert_Version_007/KEYM_E_KEY_CERT_INVALID, KeyMCertificateElement_Ssa_TrustModelIntermediatePeerCert_Version_007/KEYM_E_KEY_CERT_EMPTY]  # This operation provides data from a specific certificate element.
        arg Index: type=uint16, direction=IN  # This is the index to dedicated element in the list
        arg CertificateElementData: type=KeyM_CertificateElementType_Ssa_TrustModelIntermediatePeerCert_Version_007, direction=OUT, server-argument-impl-policy=USE-ARRAY-BASE-TYPE  # Holds a pointer to the memory location which will hold the certificate element.
        arg CertificateDataLength: type=uint32, direction=OUT  # Contains the length in bytes of certificate element.
      operation CertificateElementGetCount: possible-error=[KeyMCertificateElement_Ssa_TrustModelIntermediatePeerCert_Version_007/E_NOT_OK, KeyMCertificateElement_Ssa_TrustModelIntermediatePeerCert_Version_007/KEYM_E_KEY_CERT_SIZE_MISMATCH, KeyMCertificateElement_Ssa_TrustModelIntermediatePeerCert_Version_007/KEYM_E_PARAMETER_MISMATCH, KeyMCertificateElement_Ssa_TrustModelIntermediatePeerCert_Version_007/KEYM_E_KEY_CERT_INVALID, KeyMCertificateElement_Ssa_TrustModelIntermediatePeerCert_Version_007/KEYM_E_KEY_CERT_EMPTY]  # This operation returns the amount of items available for a certificate element.
        arg count: type=uint16, direction=OUT  # Number of items available for an element.
      5 x error:
        E_NOT_OK: error-code=1  # The service request failed.
        KEYM_E_KEY_CERT_SIZE_MISMATCH: error-code=4  # The service request failed. Parameter size does not match the expected value.
        KEYM_E_PARAMETER_MISMATCH: error-code=5  # The service request failed. Parameter to function does not provide the expected value.
        KEYM_E_KEY_CERT_EMPTY: error-code=10  # The service request failed. The requested key or certificate is not available, slot is empty.
        KEYM_E_KEY_CERT_INVALID: error-code=6  # The service request failed. Key or certificate is invalid and cannot be used for the operation.
    KeyMCertificateElement_Ssa_TrustModelIntermediatePeerCert_SerialNo_007  # Service of the certificate sub module to access certificate elements.
      operation CertificateElementGet: possible-error=[KeyMCertificateElement_Ssa_TrustModelIntermediatePeerCert_SerialNo_007/E_NOT_OK, KeyMCertificateElement_Ssa_TrustModelIntermediatePeerCert_SerialNo_007/KEYM_E_KEY_CERT_SIZE_MISMATCH, KeyMCertificateElement_Ssa_TrustModelIntermediatePeerCert_SerialNo_007/KEYM_E_PARAMETER_MISMATCH, KeyMCertificateElement_Ssa_TrustModelIntermediatePeerCert_SerialNo_007/KEYM_E_KEY_CERT_INVALID, KeyMCertificateElement_Ssa_TrustModelIntermediatePeerCert_SerialNo_007/KEYM_E_KEY_CERT_EMPTY]  # Provides the content of a specific certificate element. The certificate configuration defines how the certificate submodule can find the element, e.g. by providing the object identifier (OID). This function is used to retrieve this information if only one element is assigned to the respective OID.
        arg CertificateElementData: type=KeyM_CertificateElementType_Ssa_TrustModelIntermediatePeerCert_SerialNo_007, direction=OUT, server-argument-impl-policy=USE-ARRAY-BASE-TYPE  # Holds a pointer to the memory location which will hold the certificate element.
        arg CertificateDataLength: type=uint32, direction=OUT  # Contains the length in bytes of certificate element.
      operation CertificateElementGetByIndex: possible-error=[KeyMCertificateElement_Ssa_TrustModelIntermediatePeerCert_SerialNo_007/E_NOT_OK, KeyMCertificateElement_Ssa_TrustModelIntermediatePeerCert_SerialNo_007/KEYM_E_KEY_CERT_SIZE_MISMATCH, KeyMCertificateElement_Ssa_TrustModelIntermediatePeerCert_SerialNo_007/KEYM_E_PARAMETER_MISMATCH, KeyMCertificateElement_Ssa_TrustModelIntermediatePeerCert_SerialNo_007/KEYM_E_KEY_CERT_INVALID, KeyMCertificateElement_Ssa_TrustModelIntermediatePeerCert_SerialNo_007/KEYM_E_KEY_CERT_EMPTY]  # This operation provides data from a specific certificate element.
        arg Index: type=uint16, direction=IN  # This is the index to dedicated element in the list
        arg CertificateElementData: type=KeyM_CertificateElementType_Ssa_TrustModelIntermediatePeerCert_SerialNo_007, direction=OUT, server-argument-impl-policy=USE-ARRAY-BASE-TYPE  # Holds a pointer to the memory location which will hold the certificate element.
        arg CertificateDataLength: type=uint32, direction=OUT  # Contains the length in bytes of certificate element.
      operation CertificateElementGetCount: possible-error=[KeyMCertificateElement_Ssa_TrustModelIntermediatePeerCert_SerialNo_007/E_NOT_OK, KeyMCertificateElement_Ssa_TrustModelIntermediatePeerCert_SerialNo_007/KEYM_E_KEY_CERT_SIZE_MISMATCH, KeyMCertificateElement_Ssa_TrustModelIntermediatePeerCert_SerialNo_007/KEYM_E_PARAMETER_MISMATCH, KeyMCertificateElement_Ssa_TrustModelIntermediatePeerCert_SerialNo_007/KEYM_E_KEY_CERT_INVALID, KeyMCertificateElement_Ssa_TrustModelIntermediatePeerCert_SerialNo_007/KEYM_E_KEY_CERT_EMPTY]  # This operation returns the amount of items available for a certificate element.
        arg count: type=uint16, direction=OUT  # Number of items available for an element.
      5 x error:
        E_NOT_OK: error-code=1  # The service request failed.
        KEYM_E_KEY_CERT_SIZE_MISMATCH: error-code=4  # The service request failed. Parameter size does not match the expected value.
        KEYM_E_PARAMETER_MISMATCH: error-code=5  # The service request failed. Parameter to function does not provide the expected value.
        KEYM_E_KEY_CERT_EMPTY: error-code=10  # The service request failed. The requested key or certificate is not available, slot is empty.
        KEYM_E_KEY_CERT_INVALID: error-code=6  # The service request failed. Key or certificate is invalid and cannot be used for the operation.
    KeyMCertificateElement_Ssa_TrustModelIntermediatePeerCert_SigAlgoId_007  # Service of the certificate sub module to access certificate elements.
      operation CertificateElementGet: possible-error=[KeyMCertificateElement_Ssa_TrustModelIntermediatePeerCert_SigAlgoId_007/E_NOT_OK, KeyMCertificateElement_Ssa_TrustModelIntermediatePeerCert_SigAlgoId_007/KEYM_E_KEY_CERT_SIZE_MISMATCH, KeyMCertificateElement_Ssa_TrustModelIntermediatePeerCert_SigAlgoId_007/KEYM_E_PARAMETER_MISMATCH, KeyMCertificateElement_Ssa_TrustModelIntermediatePeerCert_SigAlgoId_007/KEYM_E_KEY_CERT_INVALID, KeyMCertificateElement_Ssa_TrustModelIntermediatePeerCert_SigAlgoId_007/KEYM_E_KEY_CERT_EMPTY]  # Provides the content of a specific certificate element. The certificate configuration defines how the certificate submodule can find the element, e.g. by providing the object identifier (OID). This function is used to retrieve this information if only one element is assigned to the respective OID.
        arg CertificateElementData: type=KeyM_CertificateElementType_Ssa_TrustModelIntermediatePeerCert_SigAlgoId_007, direction=OUT, server-argument-impl-policy=USE-ARRAY-BASE-TYPE  # Holds a pointer to the memory location which will hold the certificate element.
        arg CertificateDataLength: type=uint32, direction=OUT  # Contains the length in bytes of certificate element.
      operation CertificateElementGetByIndex: possible-error=[KeyMCertificateElement_Ssa_TrustModelIntermediatePeerCert_SigAlgoId_007/E_NOT_OK, KeyMCertificateElement_Ssa_TrustModelIntermediatePeerCert_SigAlgoId_007/KEYM_E_KEY_CERT_SIZE_MISMATCH, KeyMCertificateElement_Ssa_TrustModelIntermediatePeerCert_SigAlgoId_007/KEYM_E_PARAMETER_MISMATCH, KeyMCertificateElement_Ssa_TrustModelIntermediatePeerCert_SigAlgoId_007/KEYM_E_KEY_CERT_INVALID, KeyMCertificateElement_Ssa_TrustModelIntermediatePeerCert_SigAlgoId_007/KEYM_E_KEY_CERT_EMPTY]  # This operation provides data from a specific certificate element.
        arg Index: type=uint16, direction=IN  # This is the index to dedicated element in the list
        arg CertificateElementData: type=KeyM_CertificateElementType_Ssa_TrustModelIntermediatePeerCert_SigAlgoId_007, direction=OUT, server-argument-impl-policy=USE-ARRAY-BASE-TYPE  # Holds a pointer to the memory location which will hold the certificate element.
        arg CertificateDataLength: type=uint32, direction=OUT  # Contains the length in bytes of certificate element.
      operation CertificateElementGetCount: possible-error=[KeyMCertificateElement_Ssa_TrustModelIntermediatePeerCert_SigAlgoId_007/E_NOT_OK, KeyMCertificateElement_Ssa_TrustModelIntermediatePeerCert_SigAlgoId_007/KEYM_E_KEY_CERT_SIZE_MISMATCH, KeyMCertificateElement_Ssa_TrustModelIntermediatePeerCert_SigAlgoId_007/KEYM_E_PARAMETER_MISMATCH, KeyMCertificateElement_Ssa_TrustModelIntermediatePeerCert_SigAlgoId_007/KEYM_E_KEY_CERT_INVALID, KeyMCertificateElement_Ssa_TrustModelIntermediatePeerCert_SigAlgoId_007/KEYM_E_KEY_CERT_EMPTY]  # This operation returns the amount of items available for a certificate element.
        arg count: type=uint16, direction=OUT  # Number of items available for an element.
      5 x error:
        E_NOT_OK: error-code=1  # The service request failed.
        KEYM_E_KEY_CERT_SIZE_MISMATCH: error-code=4  # The service request failed. Parameter size does not match the expected value.
        KEYM_E_PARAMETER_MISMATCH: error-code=5  # The service request failed. Parameter to function does not provide the expected value.
        KEYM_E_KEY_CERT_EMPTY: error-code=10  # The service request failed. The requested key or certificate is not available, slot is empty.
        KEYM_E_KEY_CERT_INVALID: error-code=6  # The service request failed. Key or certificate is invalid and cannot be used for the operation.
    KeyMCertificateElement_Ssa_TrustModelIntermediatePeerCert_validityNotBefore_007  # Service of the certificate sub module to access certificate elements.
      operation CertificateElementGet: possible-error=[KeyMCertificateElement_Ssa_TrustModelIntermediatePeerCert_validityNotBefore_007/E_NOT_OK, KeyMCertificateElement_Ssa_TrustModelIntermediatePeerCert_validityNotBefore_007/KEYM_E_KEY_CERT_SIZE_MISMATCH, KeyMCertificateElement_Ssa_TrustModelIntermediatePeerCert_validityNotBefore_007/KEYM_E_PARAMETER_MISMATCH, KeyMCertificateElement_Ssa_TrustModelIntermediatePeerCert_validityNotBefore_007/KEYM_E_KEY_CERT_INVALID, KeyMCertificateElement_Ssa_TrustModelIntermediatePeerCert_validityNotBefore_007/KEYM_E_KEY_CERT_EMPTY]  # Provides the content of a specific certificate element. The certificate configuration defines how the certificate submodule can find the element, e.g. by providing the object identifier (OID). This function is used to retrieve this information if only one element is assigned to the respective OID.
        arg CertificateElementData: type=KeyM_CertificateElementType_Ssa_TrustModelIntermediatePeerCert_validityNotBefore_007, direction=OUT, server-argument-impl-policy=USE-ARRAY-BASE-TYPE  # Holds a pointer to the memory location which will hold the certificate element.
        arg CertificateDataLength: type=uint32, direction=OUT  # Contains the length in bytes of certificate element.
      operation CertificateElementGetByIndex: possible-error=[KeyMCertificateElement_Ssa_TrustModelIntermediatePeerCert_validityNotBefore_007/E_NOT_OK, KeyMCertificateElement_Ssa_TrustModelIntermediatePeerCert_validityNotBefore_007/KEYM_E_KEY_CERT_SIZE_MISMATCH, KeyMCertificateElement_Ssa_TrustModelIntermediatePeerCert_validityNotBefore_007/KEYM_E_PARAMETER_MISMATCH, KeyMCertificateElement_Ssa_TrustModelIntermediatePeerCert_validityNotBefore_007/KEYM_E_KEY_CERT_INVALID, KeyMCertificateElement_Ssa_TrustModelIntermediatePeerCert_validityNotBefore_007/KEYM_E_KEY_CERT_EMPTY]  # This operation provides data from a specific certificate element.
        arg Index: type=uint16, direction=IN  # This is the index to dedicated element in the list
        arg CertificateElementData: type=KeyM_CertificateElementType_Ssa_TrustModelIntermediatePeerCert_validityNotBefore_007, direction=OUT, server-argument-impl-policy=USE-ARRAY-BASE-TYPE  # Holds a pointer to the memory location which will hold the certificate element.
        arg CertificateDataLength: type=uint32, direction=OUT  # Contains the length in bytes of certificate element.
      operation CertificateElementGetCount: possible-error=[KeyMCertificateElement_Ssa_TrustModelIntermediatePeerCert_validityNotBefore_007/E_NOT_OK, KeyMCertificateElement_Ssa_TrustModelIntermediatePeerCert_validityNotBefore_007/KEYM_E_KEY_CERT_SIZE_MISMATCH, KeyMCertificateElement_Ssa_TrustModelIntermediatePeerCert_validityNotBefore_007/KEYM_E_PARAMETER_MISMATCH, KeyMCertificateElement_Ssa_TrustModelIntermediatePeerCert_validityNotBefore_007/KEYM_E_KEY_CERT_INVALID, KeyMCertificateElement_Ssa_TrustModelIntermediatePeerCert_validityNotBefore_007/KEYM_E_KEY_CERT_EMPTY]  # This operation returns the amount of items available for a certificate element.
        arg count: type=uint16, direction=OUT  # Number of items available for an element.
      5 x error:
        E_NOT_OK: error-code=1  # The service request failed.
        KEYM_E_KEY_CERT_SIZE_MISMATCH: error-code=4  # The service request failed. Parameter size does not match the expected value.
        KEYM_E_PARAMETER_MISMATCH: error-code=5  # The service request failed. Parameter to function does not provide the expected value.
        KEYM_E_KEY_CERT_EMPTY: error-code=10  # The service request failed. The requested key or certificate is not available, slot is empty.
        KEYM_E_KEY_CERT_INVALID: error-code=6  # The service request failed. Key or certificate is invalid and cannot be used for the operation.
    KeyMCertificateElement_Ssa_TrustModelIntermediatePeerCert_validityNotAfter_007  # Service of the certificate sub module to access certificate elements.
      operation CertificateElementGet: possible-error=[KeyMCertificateElement_Ssa_TrustModelIntermediatePeerCert_validityNotAfter_007/E_NOT_OK, KeyMCertificateElement_Ssa_TrustModelIntermediatePeerCert_validityNotAfter_007/KEYM_E_KEY_CERT_SIZE_MISMATCH, KeyMCertificateElement_Ssa_TrustModelIntermediatePeerCert_validityNotAfter_007/KEYM_E_PARAMETER_MISMATCH, KeyMCertificateElement_Ssa_TrustModelIntermediatePeerCert_validityNotAfter_007/KEYM_E_KEY_CERT_INVALID, KeyMCertificateElement_Ssa_TrustModelIntermediatePeerCert_validityNotAfter_007/KEYM_E_KEY_CERT_EMPTY]  # Provides the content of a specific certificate element. The certificate configuration defines how the certificate submodule can find the element, e.g. by providing the object identifier (OID). This function is used to retrieve this information if only one element is assigned to the respective OID.
        arg CertificateElementData: type=KeyM_CertificateElementType_Ssa_TrustModelIntermediatePeerCert_validityNotAfter_007, direction=OUT, server-argument-impl-policy=USE-ARRAY-BASE-TYPE  # Holds a pointer to the memory location which will hold the certificate element.
        arg CertificateDataLength: type=uint32, direction=OUT  # Contains the length in bytes of certificate element.
      operation CertificateElementGetByIndex: possible-error=[KeyMCertificateElement_Ssa_TrustModelIntermediatePeerCert_validityNotAfter_007/E_NOT_OK, KeyMCertificateElement_Ssa_TrustModelIntermediatePeerCert_validityNotAfter_007/KEYM_E_KEY_CERT_SIZE_MISMATCH, KeyMCertificateElement_Ssa_TrustModelIntermediatePeerCert_validityNotAfter_007/KEYM_E_PARAMETER_MISMATCH, KeyMCertificateElement_Ssa_TrustModelIntermediatePeerCert_validityNotAfter_007/KEYM_E_KEY_CERT_INVALID, KeyMCertificateElement_Ssa_TrustModelIntermediatePeerCert_validityNotAfter_007/KEYM_E_KEY_CERT_EMPTY]  # This operation provides data from a specific certificate element.
        arg Index: type=uint16, direction=IN  # This is the index to dedicated element in the list
        arg CertificateElementData: type=KeyM_CertificateElementType_Ssa_TrustModelIntermediatePeerCert_validityNotAfter_007, direction=OUT, server-argument-impl-policy=USE-ARRAY-BASE-TYPE  # Holds a pointer to the memory location which will hold the certificate element.
        arg CertificateDataLength: type=uint32, direction=OUT  # Contains the length in bytes of certificate element.
      operation CertificateElementGetCount: possible-error=[KeyMCertificateElement_Ssa_TrustModelIntermediatePeerCert_validityNotAfter_007/E_NOT_OK, KeyMCertificateElement_Ssa_TrustModelIntermediatePeerCert_validityNotAfter_007/KEYM_E_KEY_CERT_SIZE_MISMATCH, KeyMCertificateElement_Ssa_TrustModelIntermediatePeerCert_validityNotAfter_007/KEYM_E_PARAMETER_MISMATCH, KeyMCertificateElement_Ssa_TrustModelIntermediatePeerCert_validityNotAfter_007/KEYM_E_KEY_CERT_INVALID, KeyMCertificateElement_Ssa_TrustModelIntermediatePeerCert_validityNotAfter_007/KEYM_E_KEY_CERT_EMPTY]  # This operation returns the amount of items available for a certificate element.
        arg count: type=uint16, direction=OUT  # Number of items available for an element.
      5 x error:
        E_NOT_OK: error-code=1  # The service request failed.
        KEYM_E_KEY_CERT_SIZE_MISMATCH: error-code=4  # The service request failed. Parameter size does not match the expected value.
        KEYM_E_PARAMETER_MISMATCH: error-code=5  # The service request failed. Parameter to function does not provide the expected value.
        KEYM_E_KEY_CERT_EMPTY: error-code=10  # The service request failed. The requested key or certificate is not available, slot is empty.
        KEYM_E_KEY_CERT_INVALID: error-code=6  # The service request failed. Key or certificate is invalid and cannot be used for the operation.
    KeyMCertificateElement_Ssa_TrustModelIntermediatePeerCert_subject_007  # Service of the certificate sub module to access certificate elements.
      operation CertificateElementGet: possible-error=[KeyMCertificateElement_Ssa_TrustModelIntermediatePeerCert_subject_007/E_NOT_OK, KeyMCertificateElement_Ssa_TrustModelIntermediatePeerCert_subject_007/KEYM_E_KEY_CERT_SIZE_MISMATCH, KeyMCertificateElement_Ssa_TrustModelIntermediatePeerCert_subject_007/KEYM_E_PARAMETER_MISMATCH, KeyMCertificateElement_Ssa_TrustModelIntermediatePeerCert_subject_007/KEYM_E_KEY_CERT_INVALID, KeyMCertificateElement_Ssa_TrustModelIntermediatePeerCert_subject_007/KEYM_E_KEY_CERT_EMPTY]  # Provides the content of a specific certificate element. The certificate configuration defines how the certificate submodule can find the element, e.g. by providing the object identifier (OID). This function is used to retrieve this information if only one element is assigned to the respective OID.
        arg CertificateElementData: type=KeyM_CertificateElementType_Ssa_TrustModelIntermediatePeerCert_subject_007, direction=OUT, server-argument-impl-policy=USE-ARRAY-BASE-TYPE  # Holds a pointer to the memory location which will hold the certificate element.
        arg CertificateDataLength: type=uint32, direction=OUT  # Contains the length in bytes of certificate element.
      operation CertificateElementGetByIndex: possible-error=[KeyMCertificateElement_Ssa_TrustModelIntermediatePeerCert_subject_007/E_NOT_OK, KeyMCertificateElement_Ssa_TrustModelIntermediatePeerCert_subject_007/KEYM_E_KEY_CERT_SIZE_MISMATCH, KeyMCertificateElement_Ssa_TrustModelIntermediatePeerCert_subject_007/KEYM_E_PARAMETER_MISMATCH, KeyMCertificateElement_Ssa_TrustModelIntermediatePeerCert_subject_007/KEYM_E_KEY_CERT_INVALID, KeyMCertificateElement_Ssa_TrustModelIntermediatePeerCert_subject_007/KEYM_E_KEY_CERT_EMPTY]  # This operation provides data from a specific certificate element.
        arg Index: type=uint16, direction=IN  # This is the index to dedicated element in the list
        arg CertificateElementData: type=KeyM_CertificateElementType_Ssa_TrustModelIntermediatePeerCert_subject_007, direction=OUT, server-argument-impl-policy=USE-ARRAY-BASE-TYPE  # Holds a pointer to the memory location which will hold the certificate element.
        arg CertificateDataLength: type=uint32, direction=OUT  # Contains the length in bytes of certificate element.
      operation CertificateElementGetCount: possible-error=[KeyMCertificateElement_Ssa_TrustModelIntermediatePeerCert_subject_007/E_NOT_OK, KeyMCertificateElement_Ssa_TrustModelIntermediatePeerCert_subject_007/KEYM_E_KEY_CERT_SIZE_MISMATCH, KeyMCertificateElement_Ssa_TrustModelIntermediatePeerCert_subject_007/KEYM_E_PARAMETER_MISMATCH, KeyMCertificateElement_Ssa_TrustModelIntermediatePeerCert_subject_007/KEYM_E_KEY_CERT_INVALID, KeyMCertificateElement_Ssa_TrustModelIntermediatePeerCert_subject_007/KEYM_E_KEY_CERT_EMPTY]  # This operation returns the amount of items available for a certificate element.
        arg count: type=uint16, direction=OUT  # Number of items available for an element.
      5 x error:
        E_NOT_OK: error-code=1  # The service request failed.
        KEYM_E_KEY_CERT_SIZE_MISMATCH: error-code=4  # The service request failed. Parameter size does not match the expected value.
        KEYM_E_PARAMETER_MISMATCH: error-code=5  # The service request failed. Parameter to function does not provide the expected value.
        KEYM_E_KEY_CERT_EMPTY: error-code=10  # The service request failed. The requested key or certificate is not available, slot is empty.
        KEYM_E_KEY_CERT_INVALID: error-code=6  # The service request failed. Key or certificate is invalid and cannot be used for the operation.
    KeyMCertificateElement_Ssa_TrustModelIntermediatePeerCert_SubjectPublicKeyInfoAlgo_007  # Service of the certificate sub module to access certificate elements.
      operation CertificateElementGet: possible-error=[KeyMCertificateElement_Ssa_TrustModelIntermediatePeerCert_SubjectPublicKeyInfoAlgo_007/E_NOT_OK, KeyMCertificateElement_Ssa_TrustModelIntermediatePeerCert_SubjectPublicKeyInfoAlgo_007/KEYM_E_KEY_CERT_SIZE_MISMATCH, KeyMCertificateElement_Ssa_TrustModelIntermediatePeerCert_SubjectPublicKeyInfoAlgo_007/KEYM_E_PARAMETER_MISMATCH, KeyMCertificateElement_Ssa_TrustModelIntermediatePeerCert_SubjectPublicKeyInfoAlgo_007/KEYM_E_KEY_CERT_INVALID, KeyMCertificateElement_Ssa_TrustModelIntermediatePeerCert_SubjectPublicKeyInfoAlgo_007/KEYM_E_KEY_CERT_EMPTY]  # Provides the content of a specific certificate element. The certificate configuration defines how the certificate submodule can find the element, e.g. by providing the object identifier (OID). This function is used to retrieve this information if only one element is assigned to the respective OID.
        arg CertificateElementData: type=KeyM_CertificateElementType_Ssa_TrustModelIntermediatePeerCert_SubjectPublicKeyInfoAlgo_007, direction=OUT, server-argument-impl-policy=USE-ARRAY-BASE-TYPE  # Holds a pointer to the memory location which will hold the certificate element.
        arg CertificateDataLength: type=uint32, direction=OUT  # Contains the length in bytes of certificate element.
      operation CertificateElementGetByIndex: possible-error=[KeyMCertificateElement_Ssa_TrustModelIntermediatePeerCert_SubjectPublicKeyInfoAlgo_007/E_NOT_OK, KeyMCertificateElement_Ssa_TrustModelIntermediatePeerCert_SubjectPublicKeyInfoAlgo_007/KEYM_E_KEY_CERT_SIZE_MISMATCH, KeyMCertificateElement_Ssa_TrustModelIntermediatePeerCert_SubjectPublicKeyInfoAlgo_007/KEYM_E_PARAMETER_MISMATCH, KeyMCertificateElement_Ssa_TrustModelIntermediatePeerCert_SubjectPublicKeyInfoAlgo_007/KEYM_E_KEY_CERT_INVALID, KeyMCertificateElement_Ssa_TrustModelIntermediatePeerCert_SubjectPublicKeyInfoAlgo_007/KEYM_E_KEY_CERT_EMPTY]  # This operation provides data from a specific certificate element.
        arg Index: type=uint16, direction=IN  # This is the index to dedicated element in the list
        arg CertificateElementData: type=KeyM_CertificateElementType_Ssa_TrustModelIntermediatePeerCert_SubjectPublicKeyInfoAlgo_007, direction=OUT, server-argument-impl-policy=USE-ARRAY-BASE-TYPE  # Holds a pointer to the memory location which will hold the certificate element.
        arg CertificateDataLength: type=uint32, direction=OUT  # Contains the length in bytes of certificate element.
      operation CertificateElementGetCount: possible-error=[KeyMCertificateElement_Ssa_TrustModelIntermediatePeerCert_SubjectPublicKeyInfoAlgo_007/E_NOT_OK, KeyMCertificateElement_Ssa_TrustModelIntermediatePeerCert_SubjectPublicKeyInfoAlgo_007/KEYM_E_KEY_CERT_SIZE_MISMATCH, KeyMCertificateElement_Ssa_TrustModelIntermediatePeerCert_SubjectPublicKeyInfoAlgo_007/KEYM_E_PARAMETER_MISMATCH, KeyMCertificateElement_Ssa_TrustModelIntermediatePeerCert_SubjectPublicKeyInfoAlgo_007/KEYM_E_KEY_CERT_INVALID, KeyMCertificateElement_Ssa_TrustModelIntermediatePeerCert_SubjectPublicKeyInfoAlgo_007/KEYM_E_KEY_CERT_EMPTY]  # This operation returns the amount of items available for a certificate element.
        arg count: type=uint16, direction=OUT  # Number of items available for an element.
      5 x error:
        E_NOT_OK: error-code=1  # The service request failed.
        KEYM_E_KEY_CERT_SIZE_MISMATCH: error-code=4  # The service request failed. Parameter size does not match the expected value.
        KEYM_E_PARAMETER_MISMATCH: error-code=5  # The service request failed. Parameter to function does not provide the expected value.
        KEYM_E_KEY_CERT_EMPTY: error-code=10  # The service request failed. The requested key or certificate is not available, slot is empty.
        KEYM_E_KEY_CERT_INVALID: error-code=6  # The service request failed. Key or certificate is invalid and cannot be used for the operation.
    KeyMCertificateElement_Ssa_TrustModelIntermediatePeerCert_SubjectPublicKeyInfoKey_007  # Service of the certificate sub module to access certificate elements.
      operation CertificateElementGet: possible-error=[KeyMCertificateElement_Ssa_TrustModelIntermediatePeerCert_SubjectPublicKeyInfoKey_007/E_NOT_OK, KeyMCertificateElement_Ssa_TrustModelIntermediatePeerCert_SubjectPublicKeyInfoKey_007/KEYM_E_KEY_CERT_SIZE_MISMATCH, KeyMCertificateElement_Ssa_TrustModelIntermediatePeerCert_SubjectPublicKeyInfoKey_007/KEYM_E_PARAMETER_MISMATCH, KeyMCertificateElement_Ssa_TrustModelIntermediatePeerCert_SubjectPublicKeyInfoKey_007/KEYM_E_KEY_CERT_INVALID, KeyMCertificateElement_Ssa_TrustModelIntermediatePeerCert_SubjectPublicKeyInfoKey_007/KEYM_E_KEY_CERT_EMPTY]  # Provides the content of a specific certificate element. The certificate configuration defines how the certificate submodule can find the element, e.g. by providing the object identifier (OID). This function is used to retrieve this information if only one element is assigned to the respective OID.
        arg CertificateElementData: type=KeyM_CertificateElementType_Ssa_TrustModelIntermediatePeerCert_SubjectPublicKeyInfoKey_007, direction=OUT, server-argument-impl-policy=USE-ARRAY-BASE-TYPE  # Holds a pointer to the memory location which will hold the certificate element.
        arg CertificateDataLength: type=uint32, direction=OUT  # Contains the length in bytes of certificate element.
      operation CertificateElementGetByIndex: possible-error=[KeyMCertificateElement_Ssa_TrustModelIntermediatePeerCert_SubjectPublicKeyInfoKey_007/E_NOT_OK, KeyMCertificateElement_Ssa_TrustModelIntermediatePeerCert_SubjectPublicKeyInfoKey_007/KEYM_E_KEY_CERT_SIZE_MISMATCH, KeyMCertificateElement_Ssa_TrustModelIntermediatePeerCert_SubjectPublicKeyInfoKey_007/KEYM_E_PARAMETER_MISMATCH, KeyMCertificateElement_Ssa_TrustModelIntermediatePeerCert_SubjectPublicKeyInfoKey_007/KEYM_E_KEY_CERT_INVALID, KeyMCertificateElement_Ssa_TrustModelIntermediatePeerCert_SubjectPublicKeyInfoKey_007/KEYM_E_KEY_CERT_EMPTY]  # This operation provides data from a specific certificate element.
        arg Index: type=uint16, direction=IN  # This is the index to dedicated element in the list
        arg CertificateElementData: type=KeyM_CertificateElementType_Ssa_TrustModelIntermediatePeerCert_SubjectPublicKeyInfoKey_007, direction=OUT, server-argument-impl-policy=USE-ARRAY-BASE-TYPE  # Holds a pointer to the memory location which will hold the certificate element.
        arg CertificateDataLength: type=uint32, direction=OUT  # Contains the length in bytes of certificate element.
      operation CertificateElementGetCount: possible-error=[KeyMCertificateElement_Ssa_TrustModelIntermediatePeerCert_SubjectPublicKeyInfoKey_007/E_NOT_OK, KeyMCertificateElement_Ssa_TrustModelIntermediatePeerCert_SubjectPublicKeyInfoKey_007/KEYM_E_KEY_CERT_SIZE_MISMATCH, KeyMCertificateElement_Ssa_TrustModelIntermediatePeerCert_SubjectPublicKeyInfoKey_007/KEYM_E_PARAMETER_MISMATCH, KeyMCertificateElement_Ssa_TrustModelIntermediatePeerCert_SubjectPublicKeyInfoKey_007/KEYM_E_KEY_CERT_INVALID, KeyMCertificateElement_Ssa_TrustModelIntermediatePeerCert_SubjectPublicKeyInfoKey_007/KEYM_E_KEY_CERT_EMPTY]  # This operation returns the amount of items available for a certificate element.
        arg count: type=uint16, direction=OUT  # Number of items available for an element.
      5 x error:
        E_NOT_OK: error-code=1  # The service request failed.
        KEYM_E_KEY_CERT_SIZE_MISMATCH: error-code=4  # The service request failed. Parameter size does not match the expected value.
        KEYM_E_PARAMETER_MISMATCH: error-code=5  # The service request failed. Parameter to function does not provide the expected value.
        KEYM_E_KEY_CERT_EMPTY: error-code=10  # The service request failed. The requested key or certificate is not available, slot is empty.
        KEYM_E_KEY_CERT_INVALID: error-code=6  # The service request failed. Key or certificate is invalid and cannot be used for the operation.
    KeyMCertificateElement_Ssa_TrustModelIntermediatePeerCert_Issuer_007  # Service of the certificate sub module to access certificate elements.
      operation CertificateElementGet: possible-error=[KeyMCertificateElement_Ssa_TrustModelIntermediatePeerCert_Issuer_007/E_NOT_OK, KeyMCertificateElement_Ssa_TrustModelIntermediatePeerCert_Issuer_007/KEYM_E_KEY_CERT_SIZE_MISMATCH, KeyMCertificateElement_Ssa_TrustModelIntermediatePeerCert_Issuer_007/KEYM_E_PARAMETER_MISMATCH, KeyMCertificateElement_Ssa_TrustModelIntermediatePeerCert_Issuer_007/KEYM_E_KEY_CERT_INVALID, KeyMCertificateElement_Ssa_TrustModelIntermediatePeerCert_Issuer_007/KEYM_E_KEY_CERT_EMPTY]  # Provides the content of a specific certificate element. The certificate configuration defines how the certificate submodule can find the element, e.g. by providing the object identifier (OID). This function is used to retrieve this information if only one element is assigned to the respective OID.
        arg CertificateElementData: type=KeyM_CertificateElementType_Ssa_TrustModelIntermediatePeerCert_Issuer_007, direction=OUT, server-argument-impl-policy=USE-ARRAY-BASE-TYPE  # Holds a pointer to the memory location which will hold the certificate element.
        arg CertificateDataLength: type=uint32, direction=OUT  # Contains the length in bytes of certificate element.
      operation CertificateElementGetByIndex: possible-error=[KeyMCertificateElement_Ssa_TrustModelIntermediatePeerCert_Issuer_007/E_NOT_OK, KeyMCertificateElement_Ssa_TrustModelIntermediatePeerCert_Issuer_007/KEYM_E_KEY_CERT_SIZE_MISMATCH, KeyMCertificateElement_Ssa_TrustModelIntermediatePeerCert_Issuer_007/KEYM_E_PARAMETER_MISMATCH, KeyMCertificateElement_Ssa_TrustModelIntermediatePeerCert_Issuer_007/KEYM_E_KEY_CERT_INVALID, KeyMCertificateElement_Ssa_TrustModelIntermediatePeerCert_Issuer_007/KEYM_E_KEY_CERT_EMPTY]  # This operation provides data from a specific certificate element.
        arg Index: type=uint16, direction=IN  # This is the index to dedicated element in the list
        arg CertificateElementData: type=KeyM_CertificateElementType_Ssa_TrustModelIntermediatePeerCert_Issuer_007, direction=OUT, server-argument-impl-policy=USE-ARRAY-BASE-TYPE  # Holds a pointer to the memory location which will hold the certificate element.
        arg CertificateDataLength: type=uint32, direction=OUT  # Contains the length in bytes of certificate element.
      operation CertificateElementGetCount: possible-error=[KeyMCertificateElement_Ssa_TrustModelIntermediatePeerCert_Issuer_007/E_NOT_OK, KeyMCertificateElement_Ssa_TrustModelIntermediatePeerCert_Issuer_007/KEYM_E_KEY_CERT_SIZE_MISMATCH, KeyMCertificateElement_Ssa_TrustModelIntermediatePeerCert_Issuer_007/KEYM_E_PARAMETER_MISMATCH, KeyMCertificateElement_Ssa_TrustModelIntermediatePeerCert_Issuer_007/KEYM_E_KEY_CERT_INVALID, KeyMCertificateElement_Ssa_TrustModelIntermediatePeerCert_Issuer_007/KEYM_E_KEY_CERT_EMPTY]  # This operation returns the amount of items available for a certificate element.
        arg count: type=uint16, direction=OUT  # Number of items available for an element.
      5 x error:
        E_NOT_OK: error-code=1  # The service request failed.
        KEYM_E_KEY_CERT_SIZE_MISMATCH: error-code=4  # The service request failed. Parameter size does not match the expected value.
        KEYM_E_PARAMETER_MISMATCH: error-code=5  # The service request failed. Parameter to function does not provide the expected value.
        KEYM_E_KEY_CERT_EMPTY: error-code=10  # The service request failed. The requested key or certificate is not available, slot is empty.
        KEYM_E_KEY_CERT_INVALID: error-code=6  # The service request failed. Key or certificate is invalid and cannot be used for the operation.
    KeyMCertificateElement_Ssa_TrustModelIntermediatePeerCert_signatureAlgorithm_007  # Service of the certificate sub module to access certificate elements.
      operation CertificateElementGet: possible-error=[KeyMCertificateElement_Ssa_TrustModelIntermediatePeerCert_signatureAlgorithm_007/E_NOT_OK, KeyMCertificateElement_Ssa_TrustModelIntermediatePeerCert_signatureAlgorithm_007/KEYM_E_KEY_CERT_SIZE_MISMATCH, KeyMCertificateElement_Ssa_TrustModelIntermediatePeerCert_signatureAlgorithm_007/KEYM_E_PARAMETER_MISMATCH, KeyMCertificateElement_Ssa_TrustModelIntermediatePeerCert_signatureAlgorithm_007/KEYM_E_KEY_CERT_INVALID, KeyMCertificateElement_Ssa_TrustModelIntermediatePeerCert_signatureAlgorithm_007/KEYM_E_KEY_CERT_EMPTY]  # Provides the content of a specific certificate element. The certificate configuration defines how the certificate submodule can find the element, e.g. by providing the object identifier (OID). This function is used to retrieve this information if only one element is assigned to the respective OID.
        arg CertificateElementData: type=KeyM_CertificateElementType_Ssa_TrustModelIntermediatePeerCert_signatureAlgorithm_007, direction=OUT, server-argument-impl-policy=USE-ARRAY-BASE-TYPE  # Holds a pointer to the memory location which will hold the certificate element.
        arg CertificateDataLength: type=uint32, direction=OUT  # Contains the length in bytes of certificate element.
      operation CertificateElementGetByIndex: possible-error=[KeyMCertificateElement_Ssa_TrustModelIntermediatePeerCert_signatureAlgorithm_007/E_NOT_OK, KeyMCertificateElement_Ssa_TrustModelIntermediatePeerCert_signatureAlgorithm_007/KEYM_E_KEY_CERT_SIZE_MISMATCH, KeyMCertificateElement_Ssa_TrustModelIntermediatePeerCert_signatureAlgorithm_007/KEYM_E_PARAMETER_MISMATCH, KeyMCertificateElement_Ssa_TrustModelIntermediatePeerCert_signatureAlgorithm_007/KEYM_E_KEY_CERT_INVALID, KeyMCertificateElement_Ssa_TrustModelIntermediatePeerCert_signatureAlgorithm_007/KEYM_E_KEY_CERT_EMPTY]  # This operation provides data from a specific certificate element.
        arg Index: type=uint16, direction=IN  # This is the index to dedicated element in the list
        arg CertificateElementData: type=KeyM_CertificateElementType_Ssa_TrustModelIntermediatePeerCert_signatureAlgorithm_007, direction=OUT, server-argument-impl-policy=USE-ARRAY-BASE-TYPE  # Holds a pointer to the memory location which will hold the certificate element.
        arg CertificateDataLength: type=uint32, direction=OUT  # Contains the length in bytes of certificate element.
      operation CertificateElementGetCount: possible-error=[KeyMCertificateElement_Ssa_TrustModelIntermediatePeerCert_signatureAlgorithm_007/E_NOT_OK, KeyMCertificateElement_Ssa_TrustModelIntermediatePeerCert_signatureAlgorithm_007/KEYM_E_KEY_CERT_SIZE_MISMATCH, KeyMCertificateElement_Ssa_TrustModelIntermediatePeerCert_signatureAlgorithm_007/KEYM_E_PARAMETER_MISMATCH, KeyMCertificateElement_Ssa_TrustModelIntermediatePeerCert_signatureAlgorithm_007/KEYM_E_KEY_CERT_INVALID, KeyMCertificateElement_Ssa_TrustModelIntermediatePeerCert_signatureAlgorithm_007/KEYM_E_KEY_CERT_EMPTY]  # This operation returns the amount of items available for a certificate element.
        arg count: type=uint16, direction=OUT  # Number of items available for an element.
      5 x error:
        E_NOT_OK: error-code=1  # The service request failed.
        KEYM_E_KEY_CERT_SIZE_MISMATCH: error-code=4  # The service request failed. Parameter size does not match the expected value.
        KEYM_E_PARAMETER_MISMATCH: error-code=5  # The service request failed. Parameter to function does not provide the expected value.
        KEYM_E_KEY_CERT_EMPTY: error-code=10  # The service request failed. The requested key or certificate is not available, slot is empty.
        KEYM_E_KEY_CERT_INVALID: error-code=6  # The service request failed. Key or certificate is invalid and cannot be used for the operation.
    KeyMCertificateElement_Ssa_TrustModelIntermediatePeerCert_signatureValue_007  # Service of the certificate sub module to access certificate elements.
      operation CertificateElementGet: possible-error=[KeyMCertificateElement_Ssa_TrustModelIntermediatePeerCert_signatureValue_007/E_NOT_OK, KeyMCertificateElement_Ssa_TrustModelIntermediatePeerCert_signatureValue_007/KEYM_E_KEY_CERT_SIZE_MISMATCH, KeyMCertificateElement_Ssa_TrustModelIntermediatePeerCert_signatureValue_007/KEYM_E_PARAMETER_MISMATCH, KeyMCertificateElement_Ssa_TrustModelIntermediatePeerCert_signatureValue_007/KEYM_E_KEY_CERT_INVALID, KeyMCertificateElement_Ssa_TrustModelIntermediatePeerCert_signatureValue_007/KEYM_E_KEY_CERT_EMPTY]  # Provides the content of a specific certificate element. The certificate configuration defines how the certificate submodule can find the element, e.g. by providing the object identifier (OID). This function is used to retrieve this information if only one element is assigned to the respective OID.
        arg CertificateElementData: type=KeyM_CertificateElementType_Ssa_TrustModelIntermediatePeerCert_signatureValue_007, direction=OUT, server-argument-impl-policy=USE-ARRAY-BASE-TYPE  # Holds a pointer to the memory location which will hold the certificate element.
        arg CertificateDataLength: type=uint32, direction=OUT  # Contains the length in bytes of certificate element.
      operation CertificateElementGetByIndex: possible-error=[KeyMCertificateElement_Ssa_TrustModelIntermediatePeerCert_signatureValue_007/E_NOT_OK, KeyMCertificateElement_Ssa_TrustModelIntermediatePeerCert_signatureValue_007/KEYM_E_KEY_CERT_SIZE_MISMATCH, KeyMCertificateElement_Ssa_TrustModelIntermediatePeerCert_signatureValue_007/KEYM_E_PARAMETER_MISMATCH, KeyMCertificateElement_Ssa_TrustModelIntermediatePeerCert_signatureValue_007/KEYM_E_KEY_CERT_INVALID, KeyMCertificateElement_Ssa_TrustModelIntermediatePeerCert_signatureValue_007/KEYM_E_KEY_CERT_EMPTY]  # This operation provides data from a specific certificate element.
        arg Index: type=uint16, direction=IN  # This is the index to dedicated element in the list
        arg CertificateElementData: type=KeyM_CertificateElementType_Ssa_TrustModelIntermediatePeerCert_signatureValue_007, direction=OUT, server-argument-impl-policy=USE-ARRAY-BASE-TYPE  # Holds a pointer to the memory location which will hold the certificate element.
        arg CertificateDataLength: type=uint32, direction=OUT  # Contains the length in bytes of certificate element.
      operation CertificateElementGetCount: possible-error=[KeyMCertificateElement_Ssa_TrustModelIntermediatePeerCert_signatureValue_007/E_NOT_OK, KeyMCertificateElement_Ssa_TrustModelIntermediatePeerCert_signatureValue_007/KEYM_E_KEY_CERT_SIZE_MISMATCH, KeyMCertificateElement_Ssa_TrustModelIntermediatePeerCert_signatureValue_007/KEYM_E_PARAMETER_MISMATCH, KeyMCertificateElement_Ssa_TrustModelIntermediatePeerCert_signatureValue_007/KEYM_E_KEY_CERT_INVALID, KeyMCertificateElement_Ssa_TrustModelIntermediatePeerCert_signatureValue_007/KEYM_E_KEY_CERT_EMPTY]  # This operation returns the amount of items available for a certificate element.
        arg count: type=uint16, direction=OUT  # Number of items available for an element.
      5 x error:
        E_NOT_OK: error-code=1  # The service request failed.
        KEYM_E_KEY_CERT_SIZE_MISMATCH: error-code=4  # The service request failed. Parameter size does not match the expected value.
        KEYM_E_PARAMETER_MISMATCH: error-code=5  # The service request failed. Parameter to function does not provide the expected value.
        KEYM_E_KEY_CERT_EMPTY: error-code=10  # The service request failed. The requested key or certificate is not available, slot is empty.
        KEYM_E_KEY_CERT_INVALID: error-code=6  # The service request failed. Key or certificate is invalid and cannot be used for the operation.
    KeyMCertificate_Ssa_TrustModelEcuCsr  # Service of Certificate sub module
      4 x operation:
        GetCertificate: possible-error=[KeyMCertificate_Ssa_TrustModelEcuCsr/E_NOT_OK, KeyMCertificate_Ssa_TrustModelEcuCsr/KEYM_E_KEY_CERT_SIZE_MISMATCH, KeyMCertificate_Ssa_TrustModelEcuCsr/KEYM_E_PARAMETER_MISMATCH, KeyMCertificate_Ssa_TrustModelEcuCsr/KEYM_E_KEY_CERT_READ_FAIL, KeyMCertificate_Ssa_TrustModelEcuCsr/KEYM_E_KEY_CERT_EMPTY]  # Read certificate data from the certificate sub module
          arg Certificate: type=KeyM_CertificateType_Ssa_TrustModelEcuCsr, direction=OUT  # Holds a pointer to the memory location which will hold the Certificate.
        GetStatus: possible-error=KeyMCertificate_Ssa_TrustModelEcuCsr/E_NOT_OK  # Provides the status of a certificate.
          arg Status: type=KeyM_CertificateStatusType, direction=OUT  # Holds a pointer to the memory location which will hold the Certificate Status.
        SetCertificate: possible-error=[KeyMCertificate_Ssa_TrustModelEcuCsr/E_NOT_OK, KeyMCertificate_Ssa_TrustModelEcuCsr/KEYM_E_KEY_CERT_SIZE_MISMATCH, KeyMCertificate_Ssa_TrustModelEcuCsr/KEYM_E_PARAMETER_MISMATCH, KeyMCertificate_Ssa_TrustModelEcuCsr/KEYM_E_KEY_CERT_WRITE_FAIL]  # Provides certificate data to be processed by the certificate sub module.
          arg Certificate: type=KeyM_CertificateType_Ssa_TrustModelEcuCsr, direction=IN  # Holds a pointer to Certificate.
        VerifyCertificate: possible-error=[KeyMCertificate_Ssa_TrustModelEcuCsr/E_NOT_OK, KeyMCertificate_Ssa_TrustModelEcuCsr/KEYM_E_BUSY, KeyMCertificate_Ssa_TrustModelEcuCsr/KEYM_E_KEY_CERT_SIZE_MISMATCH, KeyMCertificate_Ssa_TrustModelEcuCsr/KEYM_E_PARAMETER_MISMATCH, KeyMCertificate_Ssa_TrustModelEcuCsr/KEYM_E_KEY_CERT_EMPTY, KeyMCertificate_Ssa_TrustModelEcuCsr/KEYM_E_CERT_INVALID_CHAIN_OF_TRUST]  # Verify certificate data from the certificate sub module .
      8 x error:
        E_NOT_OK: error-code=1  # The service request failed.
        KEYM_E_BUSY: error-code=2  # The service request failed. Key management is busy with other operations.
        KEYM_E_KEY_CERT_SIZE_MISMATCH: error-code=4  # The service request failed. Parameter size does not match the expected value.
        KEYM_E_PARAMETER_MISMATCH: error-code=5  # The service request failed. Parameter to function does not provide the expected value.
        KEYM_E_KEY_CERT_WRITE_FAIL: error-code=7  # The service request failed. Certificate or key write operation failed.
        KEYM_E_KEY_CERT_READ_FAIL: error-code=9  # The service request failed. Certificate or key could not be provided due to a read or permission failure.
        KEYM_E_KEY_CERT_EMPTY: error-code=10  # The service request failed. The requested key or certificate is not available, slot is empty.
        KEYM_E_CERT_INVALID_CHAIN_OF_TRUST: error-code=11  # The service request failed. Certificate verification failed - Invalid Chain of Trust.
    KeyMCertificateExtended_Ssa_TrustModelEcuCsr  # Services of Certificate sub module that extend the standard AUTOSAR services
      operation ServiceCertificate: possible-error=[KeyMCertificateExtended_Ssa_TrustModelEcuCsr/E_NOT_OK, KeyMCertificateExtended_Ssa_TrustModelEcuCsr/KEYM_E_BUSY, KeyMCertificateExtended_Ssa_TrustModelEcuCsr/KEYM_E_KEY_CERT_SIZE_MISMATCH, KeyMCertificateExtended_Ssa_TrustModelEcuCsr/KEYM_E_PARAMETER_MISMATCH, KeyMCertificateExtended_Ssa_TrustModelEcuCsr/KEYM_E_KEY_CERT_EMPTY, KeyMCertificateExtended_Ssa_TrustModelEcuCsr/KEYM_E_CERT_INVALID_CHAIN_OF_TRUST]  # Handle certificate operation request in the certificate sub module.
        5 x arg, all with direction=IN:
          Service: type=KeyM_ServiceCertificateType  # Provides the type of service the key manager has to perform.
          RequestData: type=KeyM_ConstDataPtrType  # Information that comes along with the request.
          RequestDataLength: type=uint32  # Length of data in the RequestData array.
          ResponseData: type=KeyM_DataPtrType  # Pointer to array in which the request response data will be stored upon request completion.
          ResponseDataLength: type=uint32  # Max number of bytes available in ResponseDataPtr.
      operation CsrElementSet: possible-error=[KeyMCertificateExtended_Ssa_TrustModelEcuCsr/E_NOT_OK, KeyMCertificateExtended_Ssa_TrustModelEcuCsr/KEYM_E_PARAMETER_MISMATCH]  # To be used before calling GenerateCertificationRequestInfo. Adds an data to the certificate for which a signing request shall be build.
        4 x arg, all with direction=IN:
          CertElementId: type=KeyM_CertElementIdType  # Element ID of the element that shall be added
          EncodingType: type=KeyM_CsrEncodingType  # Encoding type of the CSR element
          ElementData: type=KeyM_ConstDataPtrType  # Data of the element that shall be added
          ElementDataLength: type=uint32  # Length of ElementData data in the ElementData array
      6 x error:
        E_NOT_OK: error-code=1  # The service request failed.
        KEYM_E_BUSY: error-code=2  # The service request failed. Key management is busy with other operations.
        KEYM_E_KEY_CERT_SIZE_MISMATCH: error-code=4  # The service request failed. Parameter size does not match the expected value.
        KEYM_E_PARAMETER_MISMATCH: error-code=5  # The service request failed. Parameter to function does not provide the expected value.
        KEYM_E_KEY_CERT_EMPTY: error-code=10  # The service request failed. The requested key or certificate is not available, slot is empty.
        KEYM_E_CERT_INVALID_CHAIN_OF_TRUST: error-code=11  # The service request failed. Certificate verification failed - Invalid Chain of Trust.
    KeyMCertificateElement_Ssa_TrustModelEcuCsr_ext_authKeyId_008  # Service of the certificate sub module to access certificate elements.
      operation CertificateElementGet: possible-error=[KeyMCertificateElement_Ssa_TrustModelEcuCsr_ext_authKeyId_008/E_NOT_OK, KeyMCertificateElement_Ssa_TrustModelEcuCsr_ext_authKeyId_008/KEYM_E_KEY_CERT_SIZE_MISMATCH, KeyMCertificateElement_Ssa_TrustModelEcuCsr_ext_authKeyId_008/KEYM_E_PARAMETER_MISMATCH, KeyMCertificateElement_Ssa_TrustModelEcuCsr_ext_authKeyId_008/KEYM_E_KEY_CERT_INVALID, KeyMCertificateElement_Ssa_TrustModelEcuCsr_ext_authKeyId_008/KEYM_E_KEY_CERT_EMPTY]  # Provides the content of a specific certificate element. The certificate configuration defines how the certificate submodule can find the element, e.g. by providing the object identifier (OID). This function is used to retrieve this information if only one element is assigned to the respective OID.
        arg CertificateElementData: type=KeyM_CertificateElementType_Ssa_TrustModelEcuCsr_ext_authKeyId_008, direction=OUT, server-argument-impl-policy=USE-ARRAY-BASE-TYPE  # Holds a pointer to the memory location which will hold the certificate element.
        arg CertificateDataLength: type=uint32, direction=OUT  # Contains the length in bytes of certificate element.
      operation CertificateElementGetByIndex: possible-error=[KeyMCertificateElement_Ssa_TrustModelEcuCsr_ext_authKeyId_008/E_NOT_OK, KeyMCertificateElement_Ssa_TrustModelEcuCsr_ext_authKeyId_008/KEYM_E_KEY_CERT_SIZE_MISMATCH, KeyMCertificateElement_Ssa_TrustModelEcuCsr_ext_authKeyId_008/KEYM_E_PARAMETER_MISMATCH, KeyMCertificateElement_Ssa_TrustModelEcuCsr_ext_authKeyId_008/KEYM_E_KEY_CERT_INVALID, KeyMCertificateElement_Ssa_TrustModelEcuCsr_ext_authKeyId_008/KEYM_E_KEY_CERT_EMPTY]  # This operation provides data from a specific certificate element.
        arg Index: type=uint16, direction=IN  # This is the index to dedicated element in the list
        arg CertificateElementData: type=KeyM_CertificateElementType_Ssa_TrustModelEcuCsr_ext_authKeyId_008, direction=OUT, server-argument-impl-policy=USE-ARRAY-BASE-TYPE  # Holds a pointer to the memory location which will hold the certificate element.
        arg CertificateDataLength: type=uint32, direction=OUT  # Contains the length in bytes of certificate element.
      operation CertificateElementGetCount: possible-error=[KeyMCertificateElement_Ssa_TrustModelEcuCsr_ext_authKeyId_008/E_NOT_OK, KeyMCertificateElement_Ssa_TrustModelEcuCsr_ext_authKeyId_008/KEYM_E_KEY_CERT_SIZE_MISMATCH, KeyMCertificateElement_Ssa_TrustModelEcuCsr_ext_authKeyId_008/KEYM_E_PARAMETER_MISMATCH, KeyMCertificateElement_Ssa_TrustModelEcuCsr_ext_authKeyId_008/KEYM_E_KEY_CERT_INVALID, KeyMCertificateElement_Ssa_TrustModelEcuCsr_ext_authKeyId_008/KEYM_E_KEY_CERT_EMPTY]  # This operation returns the amount of items available for a certificate element.
        arg count: type=uint16, direction=OUT  # Number of items available for an element.
      5 x error:
        E_NOT_OK: error-code=1  # The service request failed.
        KEYM_E_KEY_CERT_SIZE_MISMATCH: error-code=4  # The service request failed. Parameter size does not match the expected value.
        KEYM_E_PARAMETER_MISMATCH: error-code=5  # The service request failed. Parameter to function does not provide the expected value.
        KEYM_E_KEY_CERT_EMPTY: error-code=10  # The service request failed. The requested key or certificate is not available, slot is empty.
        KEYM_E_KEY_CERT_INVALID: error-code=6  # The service request failed. Key or certificate is invalid and cannot be used for the operation.
    KeyMCertificateElement_Ssa_TrustModelEcuCsr_ext_subKeyId_008  # Service of the certificate sub module to access certificate elements.
      operation CertificateElementGet: possible-error=[KeyMCertificateElement_Ssa_TrustModelEcuCsr_ext_subKeyId_008/E_NOT_OK, KeyMCertificateElement_Ssa_TrustModelEcuCsr_ext_subKeyId_008/KEYM_E_KEY_CERT_SIZE_MISMATCH, KeyMCertificateElement_Ssa_TrustModelEcuCsr_ext_subKeyId_008/KEYM_E_PARAMETER_MISMATCH, KeyMCertificateElement_Ssa_TrustModelEcuCsr_ext_subKeyId_008/KEYM_E_KEY_CERT_INVALID, KeyMCertificateElement_Ssa_TrustModelEcuCsr_ext_subKeyId_008/KEYM_E_KEY_CERT_EMPTY]  # Provides the content of a specific certificate element. The certificate configuration defines how the certificate submodule can find the element, e.g. by providing the object identifier (OID). This function is used to retrieve this information if only one element is assigned to the respective OID.
        arg CertificateElementData: type=KeyM_CertificateElementType_Ssa_TrustModelEcuCsr_ext_subKeyId_008, direction=OUT, server-argument-impl-policy=USE-ARRAY-BASE-TYPE  # Holds a pointer to the memory location which will hold the certificate element.
        arg CertificateDataLength: type=uint32, direction=OUT  # Contains the length in bytes of certificate element.
      operation CertificateElementGetByIndex: possible-error=[KeyMCertificateElement_Ssa_TrustModelEcuCsr_ext_subKeyId_008/E_NOT_OK, KeyMCertificateElement_Ssa_TrustModelEcuCsr_ext_subKeyId_008/KEYM_E_KEY_CERT_SIZE_MISMATCH, KeyMCertificateElement_Ssa_TrustModelEcuCsr_ext_subKeyId_008/KEYM_E_PARAMETER_MISMATCH, KeyMCertificateElement_Ssa_TrustModelEcuCsr_ext_subKeyId_008/KEYM_E_KEY_CERT_INVALID, KeyMCertificateElement_Ssa_TrustModelEcuCsr_ext_subKeyId_008/KEYM_E_KEY_CERT_EMPTY]  # This operation provides data from a specific certificate element.
        arg Index: type=uint16, direction=IN  # This is the index to dedicated element in the list
        arg CertificateElementData: type=KeyM_CertificateElementType_Ssa_TrustModelEcuCsr_ext_subKeyId_008, direction=OUT, server-argument-impl-policy=USE-ARRAY-BASE-TYPE  # Holds a pointer to the memory location which will hold the certificate element.
        arg CertificateDataLength: type=uint32, direction=OUT  # Contains the length in bytes of certificate element.
      operation CertificateElementGetCount: possible-error=[KeyMCertificateElement_Ssa_TrustModelEcuCsr_ext_subKeyId_008/E_NOT_OK, KeyMCertificateElement_Ssa_TrustModelEcuCsr_ext_subKeyId_008/KEYM_E_KEY_CERT_SIZE_MISMATCH, KeyMCertificateElement_Ssa_TrustModelEcuCsr_ext_subKeyId_008/KEYM_E_PARAMETER_MISMATCH, KeyMCertificateElement_Ssa_TrustModelEcuCsr_ext_subKeyId_008/KEYM_E_KEY_CERT_INVALID, KeyMCertificateElement_Ssa_TrustModelEcuCsr_ext_subKeyId_008/KEYM_E_KEY_CERT_EMPTY]  # This operation returns the amount of items available for a certificate element.
        arg count: type=uint16, direction=OUT  # Number of items available for an element.
      5 x error:
        E_NOT_OK: error-code=1  # The service request failed.
        KEYM_E_KEY_CERT_SIZE_MISMATCH: error-code=4  # The service request failed. Parameter size does not match the expected value.
        KEYM_E_PARAMETER_MISMATCH: error-code=5  # The service request failed. Parameter to function does not provide the expected value.
        KEYM_E_KEY_CERT_EMPTY: error-code=10  # The service request failed. The requested key or certificate is not available, slot is empty.
        KEYM_E_KEY_CERT_INVALID: error-code=6  # The service request failed. Key or certificate is invalid and cannot be used for the operation.
    KeyMCertificateElement_Ssa_TrustModelEcuCsr_ext_keyUsage_008  # Service of the certificate sub module to access certificate elements.
      operation CertificateElementGet: possible-error=[KeyMCertificateElement_Ssa_TrustModelEcuCsr_ext_keyUsage_008/E_NOT_OK, KeyMCertificateElement_Ssa_TrustModelEcuCsr_ext_keyUsage_008/KEYM_E_KEY_CERT_SIZE_MISMATCH, KeyMCertificateElement_Ssa_TrustModelEcuCsr_ext_keyUsage_008/KEYM_E_PARAMETER_MISMATCH, KeyMCertificateElement_Ssa_TrustModelEcuCsr_ext_keyUsage_008/KEYM_E_KEY_CERT_INVALID, KeyMCertificateElement_Ssa_TrustModelEcuCsr_ext_keyUsage_008/KEYM_E_KEY_CERT_EMPTY]  # Provides the content of a specific certificate element. The certificate configuration defines how the certificate submodule can find the element, e.g. by providing the object identifier (OID). This function is used to retrieve this information if only one element is assigned to the respective OID.
        arg CertificateElementData: type=KeyM_CertificateElementType_Ssa_TrustModelEcuCsr_ext_keyUsage_008, direction=OUT, server-argument-impl-policy=USE-ARRAY-BASE-TYPE  # Holds a pointer to the memory location which will hold the certificate element.
        arg CertificateDataLength: type=uint32, direction=OUT  # Contains the length in bytes of certificate element.
      operation CertificateElementGetByIndex: possible-error=[KeyMCertificateElement_Ssa_TrustModelEcuCsr_ext_keyUsage_008/E_NOT_OK, KeyMCertificateElement_Ssa_TrustModelEcuCsr_ext_keyUsage_008/KEYM_E_KEY_CERT_SIZE_MISMATCH, KeyMCertificateElement_Ssa_TrustModelEcuCsr_ext_keyUsage_008/KEYM_E_PARAMETER_MISMATCH, KeyMCertificateElement_Ssa_TrustModelEcuCsr_ext_keyUsage_008/KEYM_E_KEY_CERT_INVALID, KeyMCertificateElement_Ssa_TrustModelEcuCsr_ext_keyUsage_008/KEYM_E_KEY_CERT_EMPTY]  # This operation provides data from a specific certificate element.
        arg Index: type=uint16, direction=IN  # This is the index to dedicated element in the list
        arg CertificateElementData: type=KeyM_CertificateElementType_Ssa_TrustModelEcuCsr_ext_keyUsage_008, direction=OUT, server-argument-impl-policy=USE-ARRAY-BASE-TYPE  # Holds a pointer to the memory location which will hold the certificate element.
        arg CertificateDataLength: type=uint32, direction=OUT  # Contains the length in bytes of certificate element.
      operation CertificateElementGetCount: possible-error=[KeyMCertificateElement_Ssa_TrustModelEcuCsr_ext_keyUsage_008/E_NOT_OK, KeyMCertificateElement_Ssa_TrustModelEcuCsr_ext_keyUsage_008/KEYM_E_KEY_CERT_SIZE_MISMATCH, KeyMCertificateElement_Ssa_TrustModelEcuCsr_ext_keyUsage_008/KEYM_E_PARAMETER_MISMATCH, KeyMCertificateElement_Ssa_TrustModelEcuCsr_ext_keyUsage_008/KEYM_E_KEY_CERT_INVALID, KeyMCertificateElement_Ssa_TrustModelEcuCsr_ext_keyUsage_008/KEYM_E_KEY_CERT_EMPTY]  # This operation returns the amount of items available for a certificate element.
        arg count: type=uint16, direction=OUT  # Number of items available for an element.
      5 x error:
        E_NOT_OK: error-code=1  # The service request failed.
        KEYM_E_KEY_CERT_SIZE_MISMATCH: error-code=4  # The service request failed. Parameter size does not match the expected value.
        KEYM_E_PARAMETER_MISMATCH: error-code=5  # The service request failed. Parameter to function does not provide the expected value.
        KEYM_E_KEY_CERT_EMPTY: error-code=10  # The service request failed. The requested key or certificate is not available, slot is empty.
        KEYM_E_KEY_CERT_INVALID: error-code=6  # The service request failed. Key or certificate is invalid and cannot be used for the operation.
    KeyMCertificateElement_Ssa_TrustModelEcuCsr_ext_pkiRole_008  # Service of the certificate sub module to access certificate elements.
      operation CertificateElementGet: possible-error=[KeyMCertificateElement_Ssa_TrustModelEcuCsr_ext_pkiRole_008/E_NOT_OK, KeyMCertificateElement_Ssa_TrustModelEcuCsr_ext_pkiRole_008/KEYM_E_KEY_CERT_SIZE_MISMATCH, KeyMCertificateElement_Ssa_TrustModelEcuCsr_ext_pkiRole_008/KEYM_E_PARAMETER_MISMATCH, KeyMCertificateElement_Ssa_TrustModelEcuCsr_ext_pkiRole_008/KEYM_E_KEY_CERT_INVALID, KeyMCertificateElement_Ssa_TrustModelEcuCsr_ext_pkiRole_008/KEYM_E_KEY_CERT_EMPTY]  # Provides the content of a specific certificate element. The certificate configuration defines how the certificate submodule can find the element, e.g. by providing the object identifier (OID). This function is used to retrieve this information if only one element is assigned to the respective OID.
        arg CertificateElementData: type=KeyM_CertificateElementType_Ssa_TrustModelEcuCsr_ext_pkiRole_008, direction=OUT, server-argument-impl-policy=USE-ARRAY-BASE-TYPE  # Holds a pointer to the memory location which will hold the certificate element.
        arg CertificateDataLength: type=uint32, direction=OUT  # Contains the length in bytes of certificate element.
      operation CertificateElementGetByIndex: possible-error=[KeyMCertificateElement_Ssa_TrustModelEcuCsr_ext_pkiRole_008/E_NOT_OK, KeyMCertificateElement_Ssa_TrustModelEcuCsr_ext_pkiRole_008/KEYM_E_KEY_CERT_SIZE_MISMATCH, KeyMCertificateElement_Ssa_TrustModelEcuCsr_ext_pkiRole_008/KEYM_E_PARAMETER_MISMATCH, KeyMCertificateElement_Ssa_TrustModelEcuCsr_ext_pkiRole_008/KEYM_E_KEY_CERT_INVALID, KeyMCertificateElement_Ssa_TrustModelEcuCsr_ext_pkiRole_008/KEYM_E_KEY_CERT_EMPTY]  # This operation provides data from a specific certificate element.
        arg Index: type=uint16, direction=IN  # This is the index to dedicated element in the list
        arg CertificateElementData: type=KeyM_CertificateElementType_Ssa_TrustModelEcuCsr_ext_pkiRole_008, direction=OUT, server-argument-impl-policy=USE-ARRAY-BASE-TYPE  # Holds a pointer to the memory location which will hold the certificate element.
        arg CertificateDataLength: type=uint32, direction=OUT  # Contains the length in bytes of certificate element.
      operation CertificateElementGetCount: possible-error=[KeyMCertificateElement_Ssa_TrustModelEcuCsr_ext_pkiRole_008/E_NOT_OK, KeyMCertificateElement_Ssa_TrustModelEcuCsr_ext_pkiRole_008/KEYM_E_KEY_CERT_SIZE_MISMATCH, KeyMCertificateElement_Ssa_TrustModelEcuCsr_ext_pkiRole_008/KEYM_E_PARAMETER_MISMATCH, KeyMCertificateElement_Ssa_TrustModelEcuCsr_ext_pkiRole_008/KEYM_E_KEY_CERT_INVALID, KeyMCertificateElement_Ssa_TrustModelEcuCsr_ext_pkiRole_008/KEYM_E_KEY_CERT_EMPTY]  # This operation returns the amount of items available for a certificate element.
        arg count: type=uint16, direction=OUT  # Number of items available for an element.
      5 x error:
        E_NOT_OK: error-code=1  # The service request failed.
        KEYM_E_KEY_CERT_SIZE_MISMATCH: error-code=4  # The service request failed. Parameter size does not match the expected value.
        KEYM_E_PARAMETER_MISMATCH: error-code=5  # The service request failed. Parameter to function does not provide the expected value.
        KEYM_E_KEY_CERT_EMPTY: error-code=10  # The service request failed. The requested key or certificate is not available, slot is empty.
        KEYM_E_KEY_CERT_INVALID: error-code=6  # The service request failed. Key or certificate is invalid and cannot be used for the operation.
    KeyMCertificateElement_Ssa_TrustModelEcuCsr_Version_008  # Service of the certificate sub module to access certificate elements.
      operation CertificateElementGet: possible-error=[KeyMCertificateElement_Ssa_TrustModelEcuCsr_Version_008/E_NOT_OK, KeyMCertificateElement_Ssa_TrustModelEcuCsr_Version_008/KEYM_E_KEY_CERT_SIZE_MISMATCH, KeyMCertificateElement_Ssa_TrustModelEcuCsr_Version_008/KEYM_E_PARAMETER_MISMATCH, KeyMCertificateElement_Ssa_TrustModelEcuCsr_Version_008/KEYM_E_KEY_CERT_INVALID, KeyMCertificateElement_Ssa_TrustModelEcuCsr_Version_008/KEYM_E_KEY_CERT_EMPTY]  # Provides the content of a specific certificate element. The certificate configuration defines how the certificate submodule can find the element, e.g. by providing the object identifier (OID). This function is used to retrieve this information if only one element is assigned to the respective OID.
        arg CertificateElementData: type=KeyM_CertificateElementType_Ssa_TrustModelEcuCsr_Version_008, direction=OUT, server-argument-impl-policy=USE-ARRAY-BASE-TYPE  # Holds a pointer to the memory location which will hold the certificate element.
        arg CertificateDataLength: type=uint32, direction=OUT  # Contains the length in bytes of certificate element.
      operation CertificateElementGetByIndex: possible-error=[KeyMCertificateElement_Ssa_TrustModelEcuCsr_Version_008/E_NOT_OK, KeyMCertificateElement_Ssa_TrustModelEcuCsr_Version_008/KEYM_E_KEY_CERT_SIZE_MISMATCH, KeyMCertificateElement_Ssa_TrustModelEcuCsr_Version_008/KEYM_E_PARAMETER_MISMATCH, KeyMCertificateElement_Ssa_TrustModelEcuCsr_Version_008/KEYM_E_KEY_CERT_INVALID, KeyMCertificateElement_Ssa_TrustModelEcuCsr_Version_008/KEYM_E_KEY_CERT_EMPTY]  # This operation provides data from a specific certificate element.
        arg Index: type=uint16, direction=IN  # This is the index to dedicated element in the list
        arg CertificateElementData: type=KeyM_CertificateElementType_Ssa_TrustModelEcuCsr_Version_008, direction=OUT, server-argument-impl-policy=USE-ARRAY-BASE-TYPE  # Holds a pointer to the memory location which will hold the certificate element.
        arg CertificateDataLength: type=uint32, direction=OUT  # Contains the length in bytes of certificate element.
      operation CertificateElementGetCount: possible-error=[KeyMCertificateElement_Ssa_TrustModelEcuCsr_Version_008/E_NOT_OK, KeyMCertificateElement_Ssa_TrustModelEcuCsr_Version_008/KEYM_E_KEY_CERT_SIZE_MISMATCH, KeyMCertificateElement_Ssa_TrustModelEcuCsr_Version_008/KEYM_E_PARAMETER_MISMATCH, KeyMCertificateElement_Ssa_TrustModelEcuCsr_Version_008/KEYM_E_KEY_CERT_INVALID, KeyMCertificateElement_Ssa_TrustModelEcuCsr_Version_008/KEYM_E_KEY_CERT_EMPTY]  # This operation returns the amount of items available for a certificate element.
        arg count: type=uint16, direction=OUT  # Number of items available for an element.
      5 x error:
        E_NOT_OK: error-code=1  # The service request failed.
        KEYM_E_KEY_CERT_SIZE_MISMATCH: error-code=4  # The service request failed. Parameter size does not match the expected value.
        KEYM_E_PARAMETER_MISMATCH: error-code=5  # The service request failed. Parameter to function does not provide the expected value.
        KEYM_E_KEY_CERT_EMPTY: error-code=10  # The service request failed. The requested key or certificate is not available, slot is empty.
        KEYM_E_KEY_CERT_INVALID: error-code=6  # The service request failed. Key or certificate is invalid and cannot be used for the operation.
    KeyMCertificateElement_Ssa_TrustModelEcuCsr_SerialNo_008  # Service of the certificate sub module to access certificate elements.
      operation CertificateElementGet: possible-error=[KeyMCertificateElement_Ssa_TrustModelEcuCsr_SerialNo_008/E_NOT_OK, KeyMCertificateElement_Ssa_TrustModelEcuCsr_SerialNo_008/KEYM_E_KEY_CERT_SIZE_MISMATCH, KeyMCertificateElement_Ssa_TrustModelEcuCsr_SerialNo_008/KEYM_E_PARAMETER_MISMATCH, KeyMCertificateElement_Ssa_TrustModelEcuCsr_SerialNo_008/KEYM_E_KEY_CERT_INVALID, KeyMCertificateElement_Ssa_TrustModelEcuCsr_SerialNo_008/KEYM_E_KEY_CERT_EMPTY]  # Provides the content of a specific certificate element. The certificate configuration defines how the certificate submodule can find the element, e.g. by providing the object identifier (OID). This function is used to retrieve this information if only one element is assigned to the respective OID.
        arg CertificateElementData: type=KeyM_CertificateElementType_Ssa_TrustModelEcuCsr_SerialNo_008, direction=OUT, server-argument-impl-policy=USE-ARRAY-BASE-TYPE  # Holds a pointer to the memory location which will hold the certificate element.
        arg CertificateDataLength: type=uint32, direction=OUT  # Contains the length in bytes of certificate element.
      operation CertificateElementGetByIndex: possible-error=[KeyMCertificateElement_Ssa_TrustModelEcuCsr_SerialNo_008/E_NOT_OK, KeyMCertificateElement_Ssa_TrustModelEcuCsr_SerialNo_008/KEYM_E_KEY_CERT_SIZE_MISMATCH, KeyMCertificateElement_Ssa_TrustModelEcuCsr_SerialNo_008/KEYM_E_PARAMETER_MISMATCH, KeyMCertificateElement_Ssa_TrustModelEcuCsr_SerialNo_008/KEYM_E_KEY_CERT_INVALID, KeyMCertificateElement_Ssa_TrustModelEcuCsr_SerialNo_008/KEYM_E_KEY_CERT_EMPTY]  # This operation provides data from a specific certificate element.
        arg Index: type=uint16, direction=IN  # This is the index to dedicated element in the list
        arg CertificateElementData: type=KeyM_CertificateElementType_Ssa_TrustModelEcuCsr_SerialNo_008, direction=OUT, server-argument-impl-policy=USE-ARRAY-BASE-TYPE  # Holds a pointer to the memory location which will hold the certificate element.
        arg CertificateDataLength: type=uint32, direction=OUT  # Contains the length in bytes of certificate element.
      operation CertificateElementGetCount: possible-error=[KeyMCertificateElement_Ssa_TrustModelEcuCsr_SerialNo_008/E_NOT_OK, KeyMCertificateElement_Ssa_TrustModelEcuCsr_SerialNo_008/KEYM_E_KEY_CERT_SIZE_MISMATCH, KeyMCertificateElement_Ssa_TrustModelEcuCsr_SerialNo_008/KEYM_E_PARAMETER_MISMATCH, KeyMCertificateElement_Ssa_TrustModelEcuCsr_SerialNo_008/KEYM_E_KEY_CERT_INVALID, KeyMCertificateElement_Ssa_TrustModelEcuCsr_SerialNo_008/KEYM_E_KEY_CERT_EMPTY]  # This operation returns the amount of items available for a certificate element.
        arg count: type=uint16, direction=OUT  # Number of items available for an element.
      5 x error:
        E_NOT_OK: error-code=1  # The service request failed.
        KEYM_E_KEY_CERT_SIZE_MISMATCH: error-code=4  # The service request failed. Parameter size does not match the expected value.
        KEYM_E_PARAMETER_MISMATCH: error-code=5  # The service request failed. Parameter to function does not provide the expected value.
        KEYM_E_KEY_CERT_EMPTY: error-code=10  # The service request failed. The requested key or certificate is not available, slot is empty.
        KEYM_E_KEY_CERT_INVALID: error-code=6  # The service request failed. Key or certificate is invalid and cannot be used for the operation.
