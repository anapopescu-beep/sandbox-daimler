[part 2 of 3: package /MICROSAR/Dcm_swc/Interfaces]
AUTOSAR XML (schema 00049)
package /MICROSAR/Dcm_swc/Interfaces  (continued)
  69 x client server interface, all with is-service=true, service-kind=DIAGNOSTIC-COMMUNICATION-MANAGER:
    RoutineServices_Routine_Status_of_Post_Production_Flag_Start
      operation Start: possible-error=[RoutineServices_Routine_Status_of_Post_Production_Flag_Start/E_NOT_OK, RoutineServices_Routine_Status_of_Post_Production_Flag_Start/DCM_E_PENDING, RoutineServices_Routine_Status_of_Post_Production_Flag_Start/DCM_E_FORCE_RCRRP]
        5 x arg:
          In_Post_Production_Flag: type=Dcm_StartDataIn_Routine_Status_of_Post_Production_Flag_Start_In_Post_Production_FlagType, direction=IN
          OpStatus: type=Dcm_OpStatusType, direction=IN
          routineInfo: type=Dcm_StartDataOut_Routine_Status_of_Post_Production_Flag_Start_routineInfoType, direction=OUT
          Out_Post_Production_Flag: type=Dcm_StartDataOut_Routine_Status_of_Post_Production_Flag_Start_Out_Post_Production_FlagType, direction=OUT
          ErrorCode: type=Dcm_NegativeResponseCodeType, direction=OUT
      operation Stop: possible-error=[RoutineServices_Routine_Status_of_Post_Production_Flag_Start/E_NOT_OK, RoutineServices_Routine_Status_of_Post_Production_Flag_Start/DCM_E_PENDING, RoutineServices_Routine_Status_of_Post_Production_Flag_Start/DCM_E_FORCE_RCRRP]
        5 x arg:
          In_Post_Production_Flag: type=Dcm_StopDataIn_Routine_Status_of_Post_Production_Flag_Start_In_Post_Production_FlagType, direction=IN
          OpStatus: type=Dcm_OpStatusType, direction=IN
          routineInfo: type=Dcm_StopDataOut_Routine_Status_of_Post_Production_Flag_Start_routineInfoType, direction=OUT
          Out_Post_Production_Flag: type=Dcm_StopDataOut_Routine_Status_of_Post_Production_Flag_Start_Out_Post_Production_FlagType, direction=OUT
          ErrorCode: type=Dcm_NegativeResponseCodeType, direction=OUT
      operation RequestResults: possible-error=[RoutineServices_Routine_Status_of_Post_Production_Flag_Start/E_NOT_OK, RoutineServices_Routine_Status_of_Post_Production_Flag_Start/DCM_E_PENDING, RoutineServices_Routine_Status_of_Post_Production_Flag_Start/DCM_E_FORCE_RCRRP]
        4 x arg:
          OpStatus: type=Dcm_OpStatusType, direction=IN
          routineInfo: type=Dcm_RequestDataOut_Routine_Status_of_Post_Production_Flag_Start_routineInfoType, direction=OUT
          Post_Production_Flag: type=Dcm_RequestDataOut_Routine_Status_of_Post_Production_Flag_Start_Post_Production_FlagType, direction=OUT
          ErrorCode: type=Dcm_NegativeResponseCodeType, direction=OUT
      error E_NOT_OK: error-code=1
      error DCM_E_PENDING: error-code=10
      error DCM_E_FORCE_RCRRP: error-code=12
    RoutineServices_Routine_Trigger_Presafe_Display_Request_Start
      operation Start: possible-error=[RoutineServices_Routine_Trigger_Presafe_Display_Request_Start/E_NOT_OK, RoutineServices_Routine_Trigger_Presafe_Display_Request_Start/DCM_E_PENDING, RoutineServices_Routine_Trigger_Presafe_Display_Request_Start/DCM_E_FORCE_RCRRP]
        4 x arg:
          OpStatus: type=Dcm_OpStatusType, direction=IN
          routineInfo: type=Dcm_StartDataOut_Routine_Trigger_Presafe_Display_Request_Start_routineInfoType, direction=OUT
          Result: type=Dcm_StartDataOut_Routine_Trigger_Presafe_Display_Request_Start_ResultType, direction=OUT
          ErrorCode: type=Dcm_NegativeResponseCodeType, direction=OUT
      operation Stop: possible-error=[RoutineServices_Routine_Trigger_Presafe_Display_Request_Start/E_NOT_OK, RoutineServices_Routine_Trigger_Presafe_Display_Request_Start/DCM_E_PENDING, RoutineServices_Routine_Trigger_Presafe_Display_Request_Start/DCM_E_FORCE_RCRRP]
        arg OpStatus: type=Dcm_OpStatusType, direction=IN
        arg routineInfo: type=Dcm_StopDataOut_Routine_Trigger_Presafe_Display_Request_Start_routineInfoType, direction=OUT
        arg ErrorCode: type=Dcm_NegativeResponseCodeType, direction=OUT
      operation RequestResults: possible-error=[RoutineServices_Routine_Trigger_Presafe_Display_Request_Start/E_NOT_OK, RoutineServices_Routine_Trigger_Presafe_Display_Request_Start/DCM_E_PENDING, RoutineServices_Routine_Trigger_Presafe_Display_Request_Start/DCM_E_FORCE_RCRRP]
        4 x arg:
          OpStatus: type=Dcm_OpStatusType, direction=IN
          routineInfo: type=Dcm_RequestDataOut_Routine_Trigger_Presafe_Display_Request_Start_routineInfoType, direction=OUT
          Result: type=Dcm_RequestDataOut_Routine_Trigger_Presafe_Display_Request_Start_ResultType, direction=OUT
          ErrorCode: type=Dcm_NegativeResponseCodeType, direction=OUT
      error E_NOT_OK: error-code=1
      error DCM_E_PENDING: error-code=10
      error DCM_E_FORCE_RCRRP: error-code=12
    RoutineServices_Routine_Trigger_BSR_Start
      operation Start: possible-error=[RoutineServices_Routine_Trigger_BSR_Start/E_NOT_OK, RoutineServices_Routine_Trigger_BSR_Start/DCM_E_PENDING, RoutineServices_Routine_Trigger_BSR_Start/DCM_E_FORCE_RCRRP]
        4 x arg:
          OpStatus: type=Dcm_OpStatusType, direction=IN
          routineInfo: type=Dcm_StartDataOut_Routine_Trigger_BSR_Start_routineInfoType, direction=OUT
          Result: type=Dcm_StartDataOut_Routine_Trigger_BSR_Start_ResultType, direction=OUT
          ErrorCode: type=Dcm_NegativeResponseCodeType, direction=OUT
      operation Stop: possible-error=[RoutineServices_Routine_Trigger_BSR_Start/E_NOT_OK, RoutineServices_Routine_Trigger_BSR_Start/DCM_E_PENDING, RoutineServices_Routine_Trigger_BSR_Start/DCM_E_FORCE_RCRRP]
        arg OpStatus: type=Dcm_OpStatusType, direction=IN
        arg routineInfo: type=Dcm_StopDataOut_Routine_Trigger_BSR_Start_routineInfoType, direction=OUT
        arg ErrorCode: type=Dcm_NegativeResponseCodeType, direction=OUT
      operation RequestResults: possible-error=[RoutineServices_Routine_Trigger_BSR_Start/E_NOT_OK, RoutineServices_Routine_Trigger_BSR_Start/DCM_E_PENDING, RoutineServices_Routine_Trigger_BSR_Start/DCM_E_FORCE_RCRRP]
        4 x arg:
          OpStatus: type=Dcm_OpStatusType, direction=IN
          routineInfo: type=Dcm_RequestDataOut_Routine_Trigger_BSR_Start_routineInfoType, direction=OUT
          Result: type=Dcm_RequestDataOut_Routine_Trigger_BSR_Start_ResultType, direction=OUT
          ErrorCode: type=Dcm_NegativeResponseCodeType, direction=OUT
      error E_NOT_OK: error-code=1
      error DCM_E_PENDING: error-code=10
      error DCM_E_FORCE_RCRRP: error-code=12
    RoutineServices_Routine_Trigger_Tensioning_Cycle_Start
      operation Start: possible-error=[RoutineServices_Routine_Trigger_Tensioning_Cycle_Start/E_NOT_OK, RoutineServices_Routine_Trigger_Tensioning_Cycle_Start/DCM_E_PENDING, RoutineServices_Routine_Trigger_Tensioning_Cycle_Start/DCM_E_FORCE_RCRRP]
        6 x arg:
          Type_of_tensioning_cycle: type=Dcm_StartDataIn_Routine_Trigger_Tensioning_Cycle_Start_Type_of_tensioning_cycleType, direction=IN
          PreSafe_Duration: type=Dcm_StartDataIn_Routine_Trigger_Tensioning_Cycle_Start_PreSafe_DurationType, direction=IN
          OpStatus: type=Dcm_OpStatusType, direction=IN
          routineInfo: type=Dcm_StartDataOut_Routine_Trigger_Tensioning_Cycle_Start_routineInfoType, direction=OUT
          Result: type=Dcm_StartDataOut_Routine_Trigger_Tensioning_Cycle_Start_ResultType, direction=OUT
          ErrorCode: type=Dcm_NegativeResponseCodeType, direction=OUT
      operation Stop: possible-error=[RoutineServices_Routine_Trigger_Tensioning_Cycle_Start/E_NOT_OK, RoutineServices_Routine_Trigger_Tensioning_Cycle_Start/DCM_E_PENDING, RoutineServices_Routine_Trigger_Tensioning_Cycle_Start/DCM_E_FORCE_RCRRP]
        arg OpStatus: type=Dcm_OpStatusType, direction=IN
        arg routineInfo: type=Dcm_StopDataOut_Routine_Trigger_Tensioning_Cycle_Start_routineInfoType, direction=OUT
        arg ErrorCode: type=Dcm_NegativeResponseCodeType, direction=OUT
      operation RequestResults: possible-error=[RoutineServices_Routine_Trigger_Tensioning_Cycle_Start/E_NOT_OK, RoutineServices_Routine_Trigger_Tensioning_Cycle_Start/DCM_E_PENDING, RoutineServices_Routine_Trigger_Tensioning_Cycle_Start/DCM_E_FORCE_RCRRP]
        4 x arg:
          OpStatus: type=Dcm_OpStatusType, direction=IN
          routineInfo: type=Dcm_RequestDataOut_Routine_Trigger_Tensioning_Cycle_Start_routineInfoType, direction=OUT
          Result: type=Dcm_RequestDataOut_Routine_Trigger_Tensioning_Cycle_Start_ResultType, direction=OUT
          ErrorCode: type=Dcm_NegativeResponseCodeType, direction=OUT
      error E_NOT_OK: error-code=1
      error DCM_E_PENDING: error-code=10
      error DCM_E_FORCE_RCRRP: error-code=12
    DataServices_Obsolescence_Data_Read_Obsolescence_Data_haptic_Warning_Threshold_Yellow_to_Red
      operation ReadData: possible-error=[DataServices_Obsolescence_Data_Read_Obsolescence_Data_haptic_Warning_Threshold_Yellow_to_Red/E_NOT_OK, DataServices_Obsolescence_Data_Read_Obsolescence_Data_haptic_Warning_Threshold_Yellow_to_Red/DCM_E_PENDING]
        arg OpStatus: type=Dcm_OpStatusType, direction=IN
        arg Data: type=Dcm_Data2ByteType, direction=OUT
      operation ConditionCheckRead: possible-error=[DataServices_Obsolescence_Data_Read_Obsolescence_Data_haptic_Warning_Threshold_Yellow_to_Red/E_NOT_OK, DataServices_Obsolescence_Data_Read_Obsolescence_Data_haptic_Warning_Threshold_Yellow_to_Red/DCM_E_PENDING]
        arg OpStatus: type=Dcm_OpStatusType, direction=IN
        arg ErrorCode: type=Dcm_NegativeResponseCodeType, direction=OUT
      error E_NOT_OK: error-code=1
      error DCM_E_PENDING: error-code=10
    DataServices_Obsolescence_Data_Read_Obsolescence_Data_PRE_SAFE_Lvl_4_5_Threshold_Green_to_Yellow
      operation ReadData: possible-error=[DataServices_Obsolescence_Data_Read_Obsolescence_Data_PRE_SAFE_Lvl_4_5_Threshold_Green_to_Yellow/E_NOT_OK, DataServices_Obsolescence_Data_Read_Obsolescence_Data_PRE_SAFE_Lvl_4_5_Threshold_Green_to_Yellow/DCM_E_PENDING]
        arg OpStatus: type=Dcm_OpStatusType, direction=IN
        arg Data: type=Dcm_Data2ByteType, direction=OUT
      operation ConditionCheckRead: possible-error=[DataServices_Obsolescence_Data_Read_Obsolescence_Data_PRE_SAFE_Lvl_4_5_Threshold_Green_to_Yellow/E_NOT_OK, DataServices_Obsolescence_Data_Read_Obsolescence_Data_PRE_SAFE_Lvl_4_5_Threshold_Green_to_Yellow/DCM_E_PENDING]
        arg OpStatus: type=Dcm_OpStatusType, direction=IN
        arg ErrorCode: type=Dcm_NegativeResponseCodeType, direction=OUT
      error E_NOT_OK: error-code=1
      error DCM_E_PENDING: error-code=10
    DataServices_Obsolescence_Data_Read_Obsolescence_Data_BSR_Threshold_Yellow_to_Red
      operation ReadData: possible-error=[DataServices_Obsolescence_Data_Read_Obsolescence_Data_BSR_Threshold_Yellow_to_Red/E_NOT_OK, DataServices_Obsolescence_Data_Read_Obsolescence_Data_BSR_Threshold_Yellow_to_Red/DCM_E_PENDING]
        arg OpStatus: type=Dcm_OpStatusType, direction=IN
        arg Data: type=Dcm_Data2ByteType, direction=OUT
      operation ConditionCheckRead: possible-error=[DataServices_Obsolescence_Data_Read_Obsolescence_Data_BSR_Threshold_Yellow_to_Red/E_NOT_OK, DataServices_Obsolescence_Data_Read_Obsolescence_Data_BSR_Threshold_Yellow_to_Red/DCM_E_PENDING]
        arg OpStatus: type=Dcm_OpStatusType, direction=IN
        arg ErrorCode: type=Dcm_NegativeResponseCodeType, direction=OUT
      error E_NOT_OK: error-code=1
      error DCM_E_PENDING: error-code=10
    DataServices_Obsolescence_Data_Read_Obsolescence_Data_haptic_Warning_Threshold_Green_to_Yellow
      operation ReadData: possible-error=[DataServices_Obsolescence_Data_Read_Obsolescence_Data_haptic_Warning_Threshold_Green_to_Yellow/E_NOT_OK, DataServices_Obsolescence_Data_Read_Obsolescence_Data_haptic_Warning_Threshold_Green_to_Yellow/DCM_E_PENDING]
        arg OpStatus: type=Dcm_OpStatusType, direction=IN
        arg Data: type=Dcm_Data2ByteType, direction=OUT
      operation ConditionCheckRead: possible-error=[DataServices_Obsolescence_Data_Read_Obsolescence_Data_haptic_Warning_Threshold_Green_to_Yellow/E_NOT_OK, DataServices_Obsolescence_Data_Read_Obsolescence_Data_haptic_Warning_Threshold_Green_to_Yellow/DCM_E_PENDING]
        arg OpStatus: type=Dcm_OpStatusType, direction=IN
        arg ErrorCode: type=Dcm_NegativeResponseCodeType, direction=OUT
      error E_NOT_OK: error-code=1
      error DCM_E_PENDING: error-code=10
    DataServices_Obsolescence_Data_Read_Obsolescence_Data_BSR_Current_Value
      operation ReadData: possible-error=[DataServices_Obsolescence_Data_Read_Obsolescence_Data_BSR_Current_Value/E_NOT_OK, DataServices_Obsolescence_Data_Read_Obsolescence_Data_BSR_Current_Value/DCM_E_PENDING]
        arg OpStatus: type=Dcm_OpStatusType, direction=IN
        arg Data: type=Dcm_Data2ByteType, direction=OUT
      operation ConditionCheckRead: possible-error=[DataServices_Obsolescence_Data_Read_Obsolescence_Data_BSR_Current_Value/E_NOT_OK, DataServices_Obsolescence_Data_Read_Obsolescence_Data_BSR_Current_Value/DCM_E_PENDING]
        arg OpStatus: type=Dcm_OpStatusType, direction=IN
        arg ErrorCode: type=Dcm_NegativeResponseCodeType, direction=OUT
      error E_NOT_OK: error-code=1
      error DCM_E_PENDING: error-code=10
    DataServices_Obsolescence_Data_Read_Obsolescence_Data_PRE_CRASH_Threshold_Yellow_to_Red
      operation ReadData: possible-error=[DataServices_Obsolescence_Data_Read_Obsolescence_Data_PRE_CRASH_Threshold_Yellow_to_Red/E_NOT_OK, DataServices_Obsolescence_Data_Read_Obsolescence_Data_PRE_CRASH_Threshold_Yellow_to_Red/DCM_E_PENDING]
        arg OpStatus: type=Dcm_OpStatusType, direction=IN
        arg Data: type=Dcm_Data2ByteType, direction=OUT
      operation ConditionCheckRead: possible-error=[DataServices_Obsolescence_Data_Read_Obsolescence_Data_PRE_CRASH_Threshold_Yellow_to_Red/E_NOT_OK, DataServices_Obsolescence_Data_Read_Obsolescence_Data_PRE_CRASH_Threshold_Yellow_to_Red/DCM_E_PENDING]
        arg OpStatus: type=Dcm_OpStatusType, direction=IN
        arg ErrorCode: type=Dcm_NegativeResponseCodeType, direction=OUT
      error E_NOT_OK: error-code=1
      error DCM_E_PENDING: error-code=10
    DataServices_Obsolescence_Data_Read_Obsolescence_Data_PRE_SAFE_Lvl_4_5_Threshold_Yellow_to_Red
      operation ReadData: possible-error=[DataServices_Obsolescence_Data_Read_Obsolescence_Data_PRE_SAFE_Lvl_4_5_Threshold_Yellow_to_Red/E_NOT_OK, DataServices_Obsolescence_Data_Read_Obsolescence_Data_PRE_SAFE_Lvl_4_5_Threshold_Yellow_to_Red/DCM_E_PENDING]
        arg OpStatus: type=Dcm_OpStatusType, direction=IN
        arg Data: type=Dcm_Data2ByteType, direction=OUT
      operation ConditionCheckRead: possible-error=[DataServices_Obsolescence_Data_Read_Obsolescence_Data_PRE_SAFE_Lvl_4_5_Threshold_Yellow_to_Red/E_NOT_OK, DataServices_Obsolescence_Data_Read_Obsolescence_Data_PRE_SAFE_Lvl_4_5_Threshold_Yellow_to_Red/DCM_E_PENDING]
        arg OpStatus: type=Dcm_OpStatusType, direction=IN
        arg ErrorCode: type=Dcm_NegativeResponseCodeType, direction=OUT
      error E_NOT_OK: error-code=1
      error DCM_E_PENDING: error-code=10
    DataServices_Obsolescence_Data_Read_Obsolescence_Data_PRE_CRASH_Threshold_Green_to_Yellow
      operation ReadData: possible-error=[DataServices_Obsolescence_Data_Read_Obsolescence_Data_PRE_CRASH_Threshold_Green_to_Yellow/E_NOT_OK, DataServices_Obsolescence_Data_Read_Obsolescence_Data_PRE_CRASH_Threshold_Green_to_Yellow/DCM_E_PENDING]
        arg OpStatus: type=Dcm_OpStatusType, direction=IN
        arg Data: type=Dcm_Data2ByteType, direction=OUT
      operation ConditionCheckRead: possible-error=[DataServices_Obsolescence_Data_Read_Obsolescence_Data_PRE_CRASH_Threshold_Green_to_Yellow/E_NOT_OK, DataServices_Obsolescence_Data_Read_Obsolescence_Data_PRE_CRASH_Threshold_Green_to_Yellow/DCM_E_PENDING]
        arg OpStatus: type=Dcm_OpStatusType, direction=IN
        arg ErrorCode: type=Dcm_NegativeResponseCodeType, direction=OUT
      error E_NOT_OK: error-code=1
      error DCM_E_PENDING: error-code=10
    DataServices_Obsolescence_Data_Read_Obsolescence_Data_PRE_SAFE_Lvl_4_5_Current_Value
      operation ReadData: possible-error=[DataServices_Obsolescence_Data_Read_Obsolescence_Data_PRE_SAFE_Lvl_4_5_Current_Value/E_NOT_OK, DataServices_Obsolescence_Data_Read_Obsolescence_Data_PRE_SAFE_Lvl_4_5_Current_Value/DCM_E_PENDING]
        arg OpStatus: type=Dcm_OpStatusType, direction=IN
        arg Data: type=Dcm_Data2ByteType, direction=OUT
      operation ConditionCheckRead: possible-error=[DataServices_Obsolescence_Data_Read_Obsolescence_Data_PRE_SAFE_Lvl_4_5_Current_Value/E_NOT_OK, DataServices_Obsolescence_Data_Read_Obsolescence_Data_PRE_SAFE_Lvl_4_5_Current_Value/DCM_E_PENDING]
        arg OpStatus: type=Dcm_OpStatusType, direction=IN
        arg ErrorCode: type=Dcm_NegativeResponseCodeType, direction=OUT
      error E_NOT_OK: error-code=1
      error DCM_E_PENDING: error-code=10
    DataServices_Obsolescence_Data_Read_Obsolescence_Data_haptic_Warning_Current_Value
      operation ReadData: possible-error=[DataServices_Obsolescence_Data_Read_Obsolescence_Data_haptic_Warning_Current_Value/E_NOT_OK, DataServices_Obsolescence_Data_Read_Obsolescence_Data_haptic_Warning_Current_Value/DCM_E_PENDING]
        arg OpStatus: type=Dcm_OpStatusType, direction=IN
        arg Data: type=Dcm_Data2ByteType, direction=OUT
      operation ConditionCheckRead: possible-error=[DataServices_Obsolescence_Data_Read_Obsolescence_Data_haptic_Warning_Current_Value/E_NOT_OK, DataServices_Obsolescence_Data_Read_Obsolescence_Data_haptic_Warning_Current_Value/DCM_E_PENDING]
        arg OpStatus: type=Dcm_OpStatusType, direction=IN
        arg ErrorCode: type=Dcm_NegativeResponseCodeType, direction=OUT
      error E_NOT_OK: error-code=1
      error DCM_E_PENDING: error-code=10
    DataServices_Obsolescence_Data_Read_Obsolescence_Data_BSR_Threshold_Green_to_Yellow
      operation ReadData: possible-error=[DataServices_Obsolescence_Data_Read_Obsolescence_Data_BSR_Threshold_Green_to_Yellow/E_NOT_OK, DataServices_Obsolescence_Data_Read_Obsolescence_Data_BSR_Threshold_Green_to_Yellow/DCM_E_PENDING]
        arg OpStatus: type=Dcm_OpStatusType, direction=IN
        arg Data: type=Dcm_Data2ByteType, direction=OUT
      operation ConditionCheckRead: possible-error=[DataServices_Obsolescence_Data_Read_Obsolescence_Data_BSR_Threshold_Green_to_Yellow/E_NOT_OK, DataServices_Obsolescence_Data_Read_Obsolescence_Data_BSR_Threshold_Green_to_Yellow/DCM_E_PENDING]
        arg OpStatus: type=Dcm_OpStatusType, direction=IN
        arg ErrorCode: type=Dcm_NegativeResponseCodeType, direction=OUT
      error E_NOT_OK: error-code=1
      error DCM_E_PENDING: error-code=10
    DataServices_Obsolescence_Data_Read_Obsolescence_Data_PRE_CRASH_Current_Value
      operation ReadData: possible-error=[DataServices_Obsolescence_Data_Read_Obsolescence_Data_PRE_CRASH_Current_Value/E_NOT_OK, DataServices_Obsolescence_Data_Read_Obsolescence_Data_PRE_CRASH_Current_Value/DCM_E_PENDING]
        arg OpStatus: type=Dcm_OpStatusType, direction=IN
        arg Data: type=Dcm_Data2ByteType, direction=OUT
      operation ConditionCheckRead: possible-error=[DataServices_Obsolescence_Data_Read_Obsolescence_Data_PRE_CRASH_Current_Value/E_NOT_OK, DataServices_Obsolescence_Data_Read_Obsolescence_Data_PRE_CRASH_Current_Value/DCM_E_PENDING]
        arg OpStatus: type=Dcm_OpStatusType, direction=IN
        arg ErrorCode: type=Dcm_NegativeResponseCodeType, direction=OUT
      error E_NOT_OK: error-code=1
      error DCM_E_PENDING: error-code=10
    DataServices_Availability_Data_Read_Availability_Data_PRE_SAFE_haptic_warning
      operation ReadData: possible-error=[DataServices_Availability_Data_Read_Availability_Data_PRE_SAFE_haptic_warning/E_NOT_OK, DataServices_Availability_Data_Read_Availability_Data_PRE_SAFE_haptic_warning/DCM_E_PENDING]
        arg OpStatus: type=Dcm_OpStatusType, direction=IN
        arg Data: type=Dcm_Data1ByteType, direction=OUT
      operation ConditionCheckRead: possible-error=[DataServices_Availability_Data_Read_Availability_Data_PRE_SAFE_haptic_warning/E_NOT_OK, DataServices_Availability_Data_Read_Availability_Data_PRE_SAFE_haptic_warning/DCM_E_PENDING]
        arg OpStatus: type=Dcm_OpStatusType, direction=IN
        arg ErrorCode: type=Dcm_NegativeResponseCodeType, direction=OUT
      error E_NOT_OK: error-code=1
      error DCM_E_PENDING: error-code=10
    DataServices_Standard_Application_SW_Package_Information_Read_AUTOSAR_Platform
      operation ReadData: possible-error=[DataServices_Standard_Application_SW_Package_Information_Read_AUTOSAR_Platform/E_NOT_OK, DataServices_Standard_Application_SW_Package_Information_Read_AUTOSAR_Platform/DCM_E_PENDING]
        arg OpStatus: type=Dcm_OpStatusType, direction=IN
        arg Data: type=Dcm_Data1ByteType, direction=OUT
      operation ConditionCheckRead: possible-error=[DataServices_Standard_Application_SW_Package_Information_Read_AUTOSAR_Platform/E_NOT_OK, DataServices_Standard_Application_SW_Package_Information_Read_AUTOSAR_Platform/DCM_E_PENDING]
        arg OpStatus: type=Dcm_OpStatusType, direction=IN
        arg ErrorCode: type=Dcm_NegativeResponseCodeType, direction=OUT
      error E_NOT_OK: error-code=1
      error DCM_E_PENDING: error-code=10
    DataServices_CAN_output_Read_PS_Curve_XX_Stat_ST3
      operation ReadData: possible-error=[DataServices_CAN_output_Read_PS_Curve_XX_Stat_ST3/E_NOT_OK, DataServices_CAN_output_Read_PS_Curve_XX_Stat_ST3/DCM_E_PENDING]
        arg OpStatus: type=Dcm_OpStatusType, direction=IN
        arg Data: type=Dcm_Data1ByteType, direction=OUT
      operation ConditionCheckRead: possible-error=[DataServices_CAN_output_Read_PS_Curve_XX_Stat_ST3/E_NOT_OK, DataServices_CAN_output_Read_PS_Curve_XX_Stat_ST3/DCM_E_PENDING]
        arg OpStatus: type=Dcm_OpStatusType, direction=IN
        arg ErrorCode: type=Dcm_NegativeResponseCodeType, direction=OUT
      error E_NOT_OK: error-code=1
      error DCM_E_PENDING: error-code=10
    DataServices_CAN_output_Read_RBTMxx_Actv_Lvl_ST35
      operation ReadData: possible-error=[DataServices_CAN_output_Read_RBTMxx_Actv_Lvl_ST35/E_NOT_OK, DataServices_CAN_output_Read_RBTMxx_Actv_Lvl_ST35/DCM_E_PENDING]
        arg OpStatus: type=Dcm_OpStatusType, direction=IN
        arg Data: type=Dcm_Data1ByteType, direction=OUT
      operation ConditionCheckRead: possible-error=[DataServices_CAN_output_Read_RBTMxx_Actv_Lvl_ST35/E_NOT_OK, DataServices_CAN_output_Read_RBTMxx_Actv_Lvl_ST35/DCM_E_PENDING]
        arg OpStatus: type=Dcm_OpStatusType, direction=IN
        arg ErrorCode: type=Dcm_NegativeResponseCodeType, direction=OUT
      error E_NOT_OK: error-code=1
      error DCM_E_PENDING: error-code=10
    DataServices_CAN_output_Read_RBTMxx_SP_ActvClient_ST35
      operation ReadData: possible-error=[DataServices_CAN_output_Read_RBTMxx_SP_ActvClient_ST35/E_NOT_OK, DataServices_CAN_output_Read_RBTMxx_SP_ActvClient_ST35/DCM_E_PENDING]
        arg OpStatus: type=Dcm_OpStatusType, direction=IN
        arg Data: type=Dcm_Data1ByteType, direction=OUT
      operation ConditionCheckRead: possible-error=[DataServices_CAN_output_Read_RBTMxx_SP_ActvClient_ST35/E_NOT_OK, DataServices_CAN_output_Read_RBTMxx_SP_ActvClient_ST35/DCM_E_PENDING]
        arg OpStatus: type=Dcm_OpStatusType, direction=IN
        arg ErrorCode: type=Dcm_NegativeResponseCodeType, direction=OUT
      error E_NOT_OK: error-code=1
      error DCM_E_PENDING: error-code=10
    DataServices_CAN_output_Read_RBTMxx_SP_FctPrecond_Stat_ST35
      operation ReadData: possible-error=[DataServices_CAN_output_Read_RBTMxx_SP_FctPrecond_Stat_ST35/E_NOT_OK, DataServices_CAN_output_Read_RBTMxx_SP_FctPrecond_Stat_ST35/DCM_E_PENDING]
        arg OpStatus: type=Dcm_OpStatusType, direction=IN
        arg Data: type=Dcm_Data2ByteType, direction=OUT
      operation ConditionCheckRead: possible-error=[DataServices_CAN_output_Read_RBTMxx_SP_FctPrecond_Stat_ST35/E_NOT_OK, DataServices_CAN_output_Read_RBTMxx_SP_FctPrecond_Stat_ST35/DCM_E_PENDING]
        arg OpStatus: type=Dcm_OpStatusType, direction=IN
        arg ErrorCode: type=Dcm_NegativeResponseCodeType, direction=OUT
      error E_NOT_OK: error-code=1
      error DCM_E_PENDING: error-code=10
    DataServices_Trust_Model_Root_Replacement_Key_Read_Root_Replacement_Key
      operation ReadData: possible-error=[DataServices_Trust_Model_Root_Replacement_Key_Read_Root_Replacement_Key/E_NOT_OK, DataServices_Trust_Model_Root_Replacement_Key_Read_Root_Replacement_Key/DCM_E_PENDING]
        arg OpStatus: type=Dcm_OpStatusType, direction=IN
        arg Data: type=Dcm_Data32ByteType, direction=OUT
      operation ConditionCheckRead: possible-error=[DataServices_Trust_Model_Root_Replacement_Key_Read_Root_Replacement_Key/E_NOT_OK, DataServices_Trust_Model_Root_Replacement_Key_Read_Root_Replacement_Key/DCM_E_PENDING]
        arg OpStatus: type=Dcm_OpStatusType, direction=IN
        arg ErrorCode: type=Dcm_NegativeResponseCodeType, direction=OUT
      error E_NOT_OK: error-code=1
      error DCM_E_PENDING: error-code=10
    DataServices_Last_Warm_Reset_Parameters_Read_Reset_Cause_Counter
      operation ReadData: possible-error=[DataServices_Last_Warm_Reset_Parameters_Read_Reset_Cause_Counter/E_NOT_OK, DataServices_Last_Warm_Reset_Parameters_Read_Reset_Cause_Counter/DCM_E_PENDING]
        arg OpStatus: type=Dcm_OpStatusType, direction=IN
        arg Data: type=Dcm_Data4ByteType, direction=OUT
      operation ConditionCheckRead: possible-error=[DataServices_Last_Warm_Reset_Parameters_Read_Reset_Cause_Counter/E_NOT_OK, DataServices_Last_Warm_Reset_Parameters_Read_Reset_Cause_Counter/DCM_E_PENDING]
        arg OpStatus: type=Dcm_OpStatusType, direction=IN
        arg ErrorCode: type=Dcm_NegativeResponseCodeType, direction=OUT
      error E_NOT_OK: error-code=1
      error DCM_E_PENDING: error-code=10
    DataServices_Last_Warm_Reset_Parameters_Read_Last_Detected_Warm_Reset_Cause
      operation ReadData: possible-error=[DataServices_Last_Warm_Reset_Parameters_Read_Last_Detected_Warm_Reset_Cause/E_NOT_OK, DataServices_Last_Warm_Reset_Parameters_Read_Last_Detected_Warm_Reset_Cause/DCM_E_PENDING]
        arg OpStatus: type=Dcm_OpStatusType, direction=IN
        arg Data: type=Dcm_Data4ByteType, direction=OUT
      operation ConditionCheckRead: possible-error=[DataServices_Last_Warm_Reset_Parameters_Read_Last_Detected_Warm_Reset_Cause/E_NOT_OK, DataServices_Last_Warm_Reset_Parameters_Read_Last_Detected_Warm_Reset_Cause/DCM_E_PENDING]
        arg OpStatus: type=Dcm_OpStatusType, direction=IN
        arg ErrorCode: type=Dcm_NegativeResponseCodeType, direction=OUT
      error E_NOT_OK: error-code=1
      error DCM_E_PENDING: error-code=10
    RoutineServices_Routine_Cycle_Execution_Start
      operation Start: possible-error=[RoutineServices_Routine_Cycle_Execution_Start/E_NOT_OK, RoutineServices_Routine_Cycle_Execution_Start/DCM_E_PENDING, RoutineServices_Routine_Cycle_Execution_Start/DCM_E_FORCE_RCRRP]
        4 x arg:
          Cycle: type=Dcm_StartDataIn_Routine_Cycle_Execution_Start_CycleType, direction=IN
          OpStatus: type=Dcm_OpStatusType, direction=IN
          routineInfo: type=Dcm_StartDataOut_Routine_Cycle_Execution_Start_routineInfoType, direction=OUT
          ErrorCode: type=Dcm_NegativeResponseCodeType, direction=OUT
      operation Stop: possible-error=[RoutineServices_Routine_Cycle_Execution_Start/E_NOT_OK, RoutineServices_Routine_Cycle_Execution_Start/DCM_E_PENDING, RoutineServices_Routine_Cycle_Execution_Start/DCM_E_FORCE_RCRRP]
        arg OpStatus: type=Dcm_OpStatusType, direction=IN
        arg routineInfo: type=Dcm_StopDataOut_Routine_Cycle_Execution_Start_routineInfoType, direction=OUT
        arg ErrorCode: type=Dcm_NegativeResponseCodeType, direction=OUT
      operation RequestResults: possible-error=[RoutineServices_Routine_Cycle_Execution_Start/E_NOT_OK, RoutineServices_Routine_Cycle_Execution_Start/DCM_E_PENDING, RoutineServices_Routine_Cycle_Execution_Start/DCM_E_FORCE_RCRRP]
        4 x arg:
          OpStatus: type=Dcm_OpStatusType, direction=IN
          routineInfo: type=Dcm_RequestDataOut_Routine_Cycle_Execution_Start_routineInfoType, direction=OUT
          Executed_Cycle: type=Dcm_RequestDataOut_Routine_Cycle_Execution_Start_Executed_CycleType, direction=OUT
          ErrorCode: type=Dcm_NegativeResponseCodeType, direction=OUT
      error E_NOT_OK: error-code=1
      error DCM_E_PENDING: error-code=10
      error DCM_E_FORCE_RCRRP: error-code=12
    DataServices_Measurement_Frames_Configuration_Read_CombinedSignal
      operation ReadData: possible-error=[DataServices_Measurement_Frames_Configuration_Read_CombinedSignal/E_NOT_OK, DataServices_Measurement_Frames_Configuration_Read_CombinedSignal/DCM_E_PENDING]
        arg OpStatus: type=Dcm_OpStatusType, direction=IN
        arg Data: type=Dcm_Data4ByteType, direction=OUT
      operation ConditionCheckRead: possible-error=[DataServices_Measurement_Frames_Configuration_Read_CombinedSignal/E_NOT_OK, DataServices_Measurement_Frames_Configuration_Read_CombinedSignal/DCM_E_PENDING]
        arg OpStatus: type=Dcm_OpStatusType, direction=IN
        arg ErrorCode: type=Dcm_NegativeResponseCodeType, direction=OUT
      operation WriteData: possible-error=[DataServices_Measurement_Frames_Configuration_Read_CombinedSignal/E_NOT_OK, DataServices_Measurement_Frames_Configuration_Read_CombinedSignal/DCM_E_PENDING]
        arg Data: type=Dcm_Data4ByteType, direction=IN
        arg OpStatus: type=Dcm_OpStatusType, direction=IN
        arg ErrorCode: type=Dcm_NegativeResponseCodeType, direction=OUT
      error E_NOT_OK: error-code=1
      error DCM_E_PENDING: error-code=10
    DataServices_Measurement_Frame_Block_12_Config_Read_CombinedSignal
      operation ReadData: possible-error=[DataServices_Measurement_Frame_Block_12_Config_Read_CombinedSignal/E_NOT_OK, DataServices_Measurement_Frame_Block_12_Config_Read_CombinedSignal/DCM_E_PENDING]
        arg OpStatus: type=Dcm_OpStatusType, direction=IN
        arg Data: type=Dcm_Data5ByteType, direction=OUT
      operation ConditionCheckRead: possible-error=[DataServices_Measurement_Frame_Block_12_Config_Read_CombinedSignal/E_NOT_OK, DataServices_Measurement_Frame_Block_12_Config_Read_CombinedSignal/DCM_E_PENDING]
        arg OpStatus: type=Dcm_OpStatusType, direction=IN
        arg ErrorCode: type=Dcm_NegativeResponseCodeType, direction=OUT
      operation WriteData: possible-error=[DataServices_Measurement_Frame_Block_12_Config_Read_CombinedSignal/E_NOT_OK, DataServices_Measurement_Frame_Block_12_Config_Read_CombinedSignal/DCM_E_PENDING]
        arg Data: type=Dcm_Data5ByteType, direction=IN
        arg OpStatus: type=Dcm_OpStatusType, direction=IN
        arg ErrorCode: type=Dcm_NegativeResponseCodeType, direction=OUT
      error E_NOT_OK: error-code=1
      error DCM_E_PENDING: error-code=10
    DataServices_HB_Calibration_Read_CombinedSignal
      operation ReadData: possible-error=[DataServices_HB_Calibration_Read_CombinedSignal/E_NOT_OK, DataServices_HB_Calibration_Read_CombinedSignal/DCM_E_PENDING]
        arg OpStatus: type=Dcm_OpStatusType, direction=IN
        arg Data: type=Dcm_Data40ByteType, direction=OUT
      operation ConditionCheckRead: possible-error=[DataServices_HB_Calibration_Read_CombinedSignal/E_NOT_OK, DataServices_HB_Calibration_Read_CombinedSignal/DCM_E_PENDING]
        arg OpStatus: type=Dcm_OpStatusType, direction=IN
        arg ErrorCode: type=Dcm_NegativeResponseCodeType, direction=OUT
      operation WriteData: possible-error=[DataServices_HB_Calibration_Read_CombinedSignal/E_NOT_OK, DataServices_HB_Calibration_Read_CombinedSignal/DCM_E_PENDING]
        arg Data: type=Dcm_Data40ByteType, direction=IN
        arg OpStatus: type=Dcm_OpStatusType, direction=IN
        arg ErrorCode: type=Dcm_NegativeResponseCodeType, direction=OUT
      error E_NOT_OK: error-code=1
      error DCM_E_PENDING: error-code=10
    DataServices_AEC_Status_Read_AEC_Status
      operation ReadData: possible-error=[DataServices_AEC_Status_Read_AEC_Status/E_NOT_OK, DataServices_AEC_Status_Read_AEC_Status/DCM_E_PENDING]
        arg OpStatus: type=Dcm_OpStatusType, direction=IN
        arg Data: type=Dcm_Data240ByteType, direction=OUT
      operation ReadDataLength: possible-error=[DataServices_AEC_Status_Read_AEC_Status/E_NOT_OK, DataServices_AEC_Status_Read_AEC_Status/DCM_E_PENDING]
        arg OpStatus: type=Dcm_OpStatusType, direction=IN
        arg DataLength: type=uint16, direction=OUT
      operation ConditionCheckRead: possible-error=[DataServices_AEC_Status_Read_AEC_Status/E_NOT_OK, DataServices_AEC_Status_Read_AEC_Status/DCM_E_PENDING]
        arg OpStatus: type=Dcm_OpStatusType, direction=IN
        arg ErrorCode: type=Dcm_NegativeResponseCodeType, direction=OUT
      error E_NOT_OK: error-code=1
      error DCM_E_PENDING: error-code=10
    DataServices_Reset_Cause_Management_Read_Reset_Cause
      operation ReadData: possible-error=[DataServices_Reset_Cause_Management_Read_Reset_Cause/E_NOT_OK, DataServices_Reset_Cause_Management_Read_Reset_Cause/DCM_E_PENDING]
        arg OpStatus: type=Dcm_OpStatusType, direction=IN
        arg Data: type=Dcm_Data1ByteType, direction=OUT
      operation ConditionCheckRead: possible-error=[DataServices_Reset_Cause_Management_Read_Reset_Cause/E_NOT_OK, DataServices_Reset_Cause_Management_Read_Reset_Cause/DCM_E_PENDING]
        arg OpStatus: type=Dcm_OpStatusType, direction=IN
        arg ErrorCode: type=Dcm_NegativeResponseCodeType, direction=OUT
      error E_NOT_OK: error-code=1
      error DCM_E_PENDING: error-code=10
    RoutineServices_Routine_Clear_Resource_Consumption_Data_Start
      operation Start: possible-error=[RoutineServices_Routine_Clear_Resource_Consumption_Data_Start/E_NOT_OK, RoutineServices_Routine_Clear_Resource_Consumption_Data_Start/DCM_E_PENDING, RoutineServices_Routine_Clear_Resource_Consumption_Data_Start/DCM_E_FORCE_RCRRP]
        arg OpStatus: type=Dcm_OpStatusType, direction=IN
        arg routineInfo: type=Dcm_StartDataOut_Routine_Clear_Resource_Consumption_Data_Start_routineInfoType, direction=OUT
        arg ErrorCode: type=Dcm_NegativeResponseCodeType, direction=OUT
      error E_NOT_OK: error-code=1
      error DCM_E_PENDING: error-code=10
      error DCM_E_FORCE_RCRRP: error-code=12
    DataServices_Task_Response_Time_Read_Task_histograms
      operation ReadData: possible-error=[DataServices_Task_Response_Time_Read_Task_histograms/E_NOT_OK, DataServices_Task_Response_Time_Read_Task_histograms/DCM_E_PENDING]
        arg OpStatus: type=Dcm_OpStatusType, direction=IN
        arg Data: type=Dcm_Data4080ByteType, direction=OUT
      operation ReadDataLength: possible-error=[DataServices_Task_Response_Time_Read_Task_histograms/E_NOT_OK, DataServices_Task_Response_Time_Read_Task_histograms/DCM_E_PENDING]
        arg OpStatus: type=Dcm_OpStatusType, direction=IN
        arg DataLength: type=uint16, direction=OUT
      operation ConditionCheckRead: possible-error=[DataServices_Task_Response_Time_Read_Task_histograms/E_NOT_OK, DataServices_Task_Response_Time_Read_Task_histograms/DCM_E_PENDING]
        arg OpStatus: type=Dcm_OpStatusType, direction=IN
        arg ErrorCode: type=Dcm_NegativeResponseCodeType, direction=OUT
      error E_NOT_OK: error-code=1
      error DCM_E_PENDING: error-code=10
    DataServices_Stack_Load_Read_Maximum
      operation ReadData: possible-error=[DataServices_Stack_Load_Read_Maximum/E_NOT_OK, DataServices_Stack_Load_Read_Maximum/DCM_E_PENDING]
        arg OpStatus: type=Dcm_OpStatusType, direction=IN
        arg Data: type=Dcm_Data510ByteType, direction=OUT
      operation ReadDataLength: possible-error=[DataServices_Stack_Load_Read_Maximum/E_NOT_OK, DataServices_Stack_Load_Read_Maximum/DCM_E_PENDING]
        arg OpStatus: type=Dcm_OpStatusType, direction=IN
        arg DataLength: type=uint16, direction=OUT
      operation ConditionCheckRead: possible-error=[DataServices_Stack_Load_Read_Maximum/E_NOT_OK, DataServices_Stack_Load_Read_Maximum/DCM_E_PENDING]
        arg OpStatus: type=Dcm_OpStatusType, direction=IN
        arg ErrorCode: type=Dcm_NegativeResponseCodeType, direction=OUT
      error E_NOT_OK: error-code=1
      error DCM_E_PENDING: error-code=10
    DataServices_CPU_Load_Read_CPU_load_histograms
      operation ReadData: possible-error=[DataServices_CPU_Load_Read_CPU_load_histograms/E_NOT_OK, DataServices_CPU_Load_Read_CPU_load_histograms/DCM_E_PENDING]
        arg OpStatus: type=Dcm_OpStatusType, direction=IN
        arg Data: type=Dcm_Data3060ByteType, direction=OUT
      operation ReadDataLength: possible-error=[DataServices_CPU_Load_Read_CPU_load_histograms/E_NOT_OK, DataServices_CPU_Load_Read_CPU_load_histograms/DCM_E_PENDING]
        arg OpStatus: type=Dcm_OpStatusType, direction=IN
        arg DataLength: type=uint16, direction=OUT
      operation ConditionCheckRead: possible-error=[DataServices_CPU_Load_Read_CPU_load_histograms/E_NOT_OK, DataServices_CPU_Load_Read_CPU_load_histograms/DCM_E_PENDING]
        arg OpStatus: type=Dcm_OpStatusType, direction=IN
        arg ErrorCode: type=Dcm_NegativeResponseCodeType, direction=OUT
      error E_NOT_OK: error-code=1
      error DCM_E_PENDING: error-code=10
    DataServices_Vehicle_Equipment_Read_Equipment_6
      operation ReadData: possible-error=[DataServices_Vehicle_Equipment_Read_Equipment_6/E_NOT_OK, DataServices_Vehicle_Equipment_Read_Equipment_6/DCM_E_PENDING]
        arg OpStatus: type=Dcm_OpStatusType, direction=IN
        arg Data: type=Dcm_Data1ByteType, direction=OUT
      operation ConditionCheckRead: possible-error=[DataServices_Vehicle_Equipment_Read_Equipment_6/E_NOT_OK, DataServices_Vehicle_Equipment_Read_Equipment_6/DCM_E_PENDING]
        arg OpStatus: type=Dcm_OpStatusType, direction=IN
        arg ErrorCode: type=Dcm_NegativeResponseCodeType, direction=OUT
      operation WriteData: possible-error=[DataServices_Vehicle_Equipment_Read_Equipment_6/E_NOT_OK, DataServices_Vehicle_Equipment_Read_Equipment_6/DCM_E_PENDING]
        arg Data: type=Dcm_Data1ByteType, direction=IN
        arg OpStatus: type=Dcm_OpStatusType, direction=IN
        arg ErrorCode: type=Dcm_NegativeResponseCodeType, direction=OUT
      error E_NOT_OK: error-code=1
      error DCM_E_PENDING: error-code=10
    DataServices_Vehicle_Equipment_Read_Equipment_5
      operation ReadData: possible-error=[DataServices_Vehicle_Equipment_Read_Equipment_5/E_NOT_OK, DataServices_Vehicle_Equipment_Read_Equipment_5/DCM_E_PENDING]
        arg OpStatus: type=Dcm_OpStatusType, direction=IN
        arg Data: type=Dcm_Data1ByteType, direction=OUT
      operation ConditionCheckRead: possible-error=[DataServices_Vehicle_Equipment_Read_Equipment_5/E_NOT_OK, DataServices_Vehicle_Equipment_Read_Equipment_5/DCM_E_PENDING]
        arg OpStatus: type=Dcm_OpStatusType, direction=IN
        arg ErrorCode: type=Dcm_NegativeResponseCodeType, direction=OUT
      operation WriteData: possible-error=[DataServices_Vehicle_Equipment_Read_Equipment_5/E_NOT_OK, DataServices_Vehicle_Equipment_Read_Equipment_5/DCM_E_PENDING]
        arg Data: type=Dcm_Data1ByteType, direction=IN
        arg OpStatus: type=Dcm_OpStatusType, direction=IN
        arg ErrorCode: type=Dcm_NegativeResponseCodeType, direction=OUT
      error E_NOT_OK: error-code=1
      error DCM_E_PENDING: error-code=10
    DataServices_Vehicle_Equipment_Read_Equipment_4
      operation ReadData: possible-error=[DataServices_Vehicle_Equipment_Read_Equipment_4/E_NOT_OK, DataServices_Vehicle_Equipment_Read_Equipment_4/DCM_E_PENDING]
        arg OpStatus: type=Dcm_OpStatusType, direction=IN
        arg Data: type=Dcm_Data1ByteType, direction=OUT
      operation ConditionCheckRead: possible-error=[DataServices_Vehicle_Equipment_Read_Equipment_4/E_NOT_OK, DataServices_Vehicle_Equipment_Read_Equipment_4/DCM_E_PENDING]
        arg OpStatus: type=Dcm_OpStatusType, direction=IN
        arg ErrorCode: type=Dcm_NegativeResponseCodeType, direction=OUT
      operation WriteData: possible-error=[DataServices_Vehicle_Equipment_Read_Equipment_4/E_NOT_OK, DataServices_Vehicle_Equipment_Read_Equipment_4/DCM_E_PENDING]
        arg Data: type=Dcm_Data1ByteType, direction=IN
        arg OpStatus: type=Dcm_OpStatusType, direction=IN
        arg ErrorCode: type=Dcm_NegativeResponseCodeType, direction=OUT
      error E_NOT_OK: error-code=1
      error DCM_E_PENDING: error-code=10
    DataServices_Tensioning_Cycle_BSR_Read_CombinedSignal
      operation ReadData: possible-error=[DataServices_Tensioning_Cycle_BSR_Read_CombinedSignal/E_NOT_OK, DataServices_Tensioning_Cycle_BSR_Read_CombinedSignal/DCM_E_PENDING]
        arg OpStatus: type=Dcm_OpStatusType, direction=IN
        arg Data: type=Dcm_Data233ByteType, direction=OUT
      operation ConditionCheckRead: possible-error=[DataServices_Tensioning_Cycle_BSR_Read_CombinedSignal/E_NOT_OK, DataServices_Tensioning_Cycle_BSR_Read_CombinedSignal/DCM_E_PENDING]
        arg OpStatus: type=Dcm_OpStatusType, direction=IN
        arg ErrorCode: type=Dcm_NegativeResponseCodeType, direction=OUT
      operation WriteData: possible-error=[DataServices_Tensioning_Cycle_BSR_Read_CombinedSignal/E_NOT_OK, DataServices_Tensioning_Cycle_BSR_Read_CombinedSignal/DCM_E_PENDING]
        arg Data: type=Dcm_Data233ByteType, direction=IN
        arg OpStatus: type=Dcm_OpStatusType, direction=IN
        arg ErrorCode: type=Dcm_NegativeResponseCodeType, direction=OUT
      error E_NOT_OK: error-code=1
      error DCM_E_PENDING: error-code=10
    DataServices_Release_Cycles_BSR_and_PreSafe_Read_CombinedSignal
      operation ReadData: possible-error=[DataServices_Release_Cycles_BSR_and_PreSafe_Read_CombinedSignal/E_NOT_OK, DataServices_Release_Cycles_BSR_and_PreSafe_Read_CombinedSignal/DCM_E_PENDING]
        arg OpStatus: type=Dcm_OpStatusType, direction=IN
        arg Data: type=Dcm_Data144ByteType, direction=OUT
      operation ConditionCheckRead: possible-error=[DataServices_Release_Cycles_BSR_and_PreSafe_Read_CombinedSignal/E_NOT_OK, DataServices_Release_Cycles_BSR_and_PreSafe_Read_CombinedSignal/DCM_E_PENDING]
        arg OpStatus: type=Dcm_OpStatusType, direction=IN
        arg ErrorCode: type=Dcm_NegativeResponseCodeType, direction=OUT
      operation WriteData: possible-error=[DataServices_Release_Cycles_BSR_and_PreSafe_Read_CombinedSignal/E_NOT_OK, DataServices_Release_Cycles_BSR_and_PreSafe_Read_CombinedSignal/DCM_E_PENDING]
        arg Data: type=Dcm_Data144ByteType, direction=IN
        arg OpStatus: type=Dcm_OpStatusType, direction=IN
        arg ErrorCode: type=Dcm_NegativeResponseCodeType, direction=OUT
      error E_NOT_OK: error-code=1
      error DCM_E_PENDING: error-code=10
    DataServices_PreSafe_Cycles_Level_1_8_Read_CombinedSignal
      operation ReadData: possible-error=[DataServices_PreSafe_Cycles_Level_1_8_Read_CombinedSignal/E_NOT_OK, DataServices_PreSafe_Cycles_Level_1_8_Read_CombinedSignal/DCM_E_PENDING]
        arg OpStatus: type=Dcm_OpStatusType, direction=IN
        arg Data: type=Dcm_Data1073ByteType, direction=OUT
      operation ConditionCheckRead: possible-error=[DataServices_PreSafe_Cycles_Level_1_8_Read_CombinedSignal/E_NOT_OK, DataServices_PreSafe_Cycles_Level_1_8_Read_CombinedSignal/DCM_E_PENDING]
        arg OpStatus: type=Dcm_OpStatusType, direction=IN
        arg ErrorCode: type=Dcm_NegativeResponseCodeType, direction=OUT
      operation WriteData: possible-error=[DataServices_PreSafe_Cycles_Level_1_8_Read_CombinedSignal/E_NOT_OK, DataServices_PreSafe_Cycles_Level_1_8_Read_CombinedSignal/DCM_E_PENDING]
        arg Data: type=Dcm_Data1073ByteType, direction=IN
        arg OpStatus: type=Dcm_OpStatusType, direction=IN
        arg ErrorCode: type=Dcm_NegativeResponseCodeType, direction=OUT
      error E_NOT_OK: error-code=1
      error DCM_E_PENDING: error-code=10
    DataServices_Global_Time_Sync_Measured_Values_Read_GTSM
      operation ReadData: possible-error=[DataServices_Global_Time_Sync_Measured_Values_Read_GTSM/E_NOT_OK, DataServices_Global_Time_Sync_Measured_Values_Read_GTSM/DCM_E_PENDING]
        arg OpStatus: type=Dcm_OpStatusType, direction=IN
        arg Data: type=Dcm_Data2613ByteType, direction=OUT
      operation ReadDataLength: possible-error=[DataServices_Global_Time_Sync_Measured_Values_Read_GTSM/E_NOT_OK, DataServices_Global_Time_Sync_Measured_Values_Read_GTSM/DCM_E_PENDING]
        arg OpStatus: type=Dcm_OpStatusType, direction=IN
        arg DataLength: type=uint16, direction=OUT
      operation ConditionCheckRead: possible-error=[DataServices_Global_Time_Sync_Measured_Values_Read_GTSM/E_NOT_OK, DataServices_Global_Time_Sync_Measured_Values_Read_GTSM/DCM_E_PENDING]
        arg OpStatus: type=Dcm_OpStatusType, direction=IN
        arg ErrorCode: type=Dcm_NegativeResponseCodeType, direction=OUT
      error E_NOT_OK: error-code=1
      error DCM_E_PENDING: error-code=10
    DataServices_Memory_Usage_Cycles_Read_Memory_Usage_Cycles
      operation ReadData: possible-error=[DataServices_Memory_Usage_Cycles_Read_Memory_Usage_Cycles/E_NOT_OK, DataServices_Memory_Usage_Cycles_Read_Memory_Usage_Cycles/DCM_E_PENDING]
        arg OpStatus: type=Dcm_OpStatusType, direction=IN
        arg Data: type=Dcm_Data1275ByteType, direction=OUT
      operation ReadDataLength: possible-error=[DataServices_Memory_Usage_Cycles_Read_Memory_Usage_Cycles/E_NOT_OK, DataServices_Memory_Usage_Cycles_Read_Memory_Usage_Cycles/DCM_E_PENDING]
        arg OpStatus: type=Dcm_OpStatusType, direction=IN
        arg DataLength: type=uint16, direction=OUT
      operation ConditionCheckRead: possible-error=[DataServices_Memory_Usage_Cycles_Read_Memory_Usage_Cycles/E_NOT_OK, DataServices_Memory_Usage_Cycles_Read_Memory_Usage_Cycles/DCM_E_PENDING]
        arg OpStatus: type=Dcm_OpStatusType, direction=IN
        arg ErrorCode: type=Dcm_NegativeResponseCodeType, direction=OUT
      error E_NOT_OK: error-code=1
      error DCM_E_PENDING: error-code=10
    DataServices_CAN_input_Read_Neues_Bitfeld_8
      operation ReadData: possible-error=[DataServices_CAN_input_Read_Neues_Bitfeld_8/E_NOT_OK, DataServices_CAN_input_Read_Neues_Bitfeld_8/DCM_E_PENDING]
        arg OpStatus: type=Dcm_OpStatusType, direction=IN
        arg Data: type=Dcm_Data1ByteType, direction=OUT
      operation ConditionCheckRead: possible-error=[DataServices_CAN_input_Read_Neues_Bitfeld_8/E_NOT_OK, DataServices_CAN_input_Read_Neues_Bitfeld_8/DCM_E_PENDING]
        arg OpStatus: type=Dcm_OpStatusType, direction=IN
        arg ErrorCode: type=Dcm_NegativeResponseCodeType, direction=OUT
      error E_NOT_OK: error-code=1
      error DCM_E_PENDING: error-code=10
    DataServices_CAN_input_Read_Neues_Bitfeld_7
      operation ReadData: possible-error=[DataServices_CAN_input_Read_Neues_Bitfeld_7/E_NOT_OK, DataServices_CAN_input_Read_Neues_Bitfeld_7/DCM_E_PENDING]
        arg OpStatus: type=Dcm_OpStatusType, direction=IN
        arg Data: type=Dcm_Data1ByteType, direction=OUT
      operation ConditionCheckRead: possible-error=[DataServices_CAN_input_Read_Neues_Bitfeld_7/E_NOT_OK, DataServices_CAN_input_Read_Neues_Bitfeld_7/DCM_E_PENDING]
        arg OpStatus: type=Dcm_OpStatusType, direction=IN
        arg ErrorCode: type=Dcm_NegativeResponseCodeType, direction=OUT
      error E_NOT_OK: error-code=1
      error DCM_E_PENDING: error-code=10
    DataServices_HSM_Identification_Read_HSM_MB_Version_HW_patch_level
      operation ReadData: possible-error=[DataServices_HSM_Identification_Read_HSM_MB_Version_HW_patch_level/E_NOT_OK, DataServices_HSM_Identification_Read_HSM_MB_Version_HW_patch_level/DCM_E_PENDING]
        arg OpStatus: type=Dcm_OpStatusType, direction=IN
        arg Data: type=Dcm_Data1ByteType, direction=OUT
      operation ConditionCheckRead: possible-error=[DataServices_HSM_Identification_Read_HSM_MB_Version_HW_patch_level/E_NOT_OK, DataServices_HSM_Identification_Read_HSM_MB_Version_HW_patch_level/DCM_E_PENDING]
        arg OpStatus: type=Dcm_OpStatusType, direction=IN
        arg ErrorCode: type=Dcm_NegativeResponseCodeType, direction=OUT
      operation WriteData: possible-error=[DataServices_HSM_Identification_Read_HSM_MB_Version_HW_patch_level/E_NOT_OK, DataServices_HSM_Identification_Read_HSM_MB_Version_HW_patch_level/DCM_E_PENDING]
        arg Data: type=Dcm_Data1ByteType, direction=IN
        arg OpStatus: type=Dcm_OpStatusType, direction=IN
        arg ErrorCode: type=Dcm_NegativeResponseCodeType, direction=OUT
      error E_NOT_OK: error-code=1
      error DCM_E_PENDING: error-code=10
    DataServices_HSM_Identification_Read_HSM_MB_Supplier_Version_HW_week
      operation ReadData: possible-error=[DataServices_HSM_Identification_Read_HSM_MB_Supplier_Version_HW_week/E_NOT_OK, DataServices_HSM_Identification_Read_HSM_MB_Supplier_Version_HW_week/DCM_E_PENDING]
        arg OpStatus: type=Dcm_OpStatusType, direction=IN
        arg Data: type=Dcm_Data1ByteType, direction=OUT
      operation ConditionCheckRead: possible-error=[DataServices_HSM_Identification_Read_HSM_MB_Supplier_Version_HW_week/E_NOT_OK, DataServices_HSM_Identification_Read_HSM_MB_Supplier_Version_HW_week/DCM_E_PENDING]
        arg OpStatus: type=Dcm_OpStatusType, direction=IN
        arg ErrorCode: type=Dcm_NegativeResponseCodeType, direction=OUT
      operation WriteData: possible-error=[DataServices_HSM_Identification_Read_HSM_MB_Supplier_Version_HW_week/E_NOT_OK, DataServices_HSM_Identification_Read_HSM_MB_Supplier_Version_HW_week/DCM_E_PENDING]
        arg Data: type=Dcm_Data1ByteType, direction=IN
        arg OpStatus: type=Dcm_OpStatusType, direction=IN
        arg ErrorCode: type=Dcm_NegativeResponseCodeType, direction=OUT
      error E_NOT_OK: error-code=1
      error DCM_E_PENDING: error-code=10
    DataServices_HSM_Identification_Read_HSM_MB_Supplier_Version_HW_patch_level
      operation ReadData: possible-error=[DataServices_HSM_Identification_Read_HSM_MB_Supplier_Version_HW_patch_level/E_NOT_OK, DataServices_HSM_Identification_Read_HSM_MB_Supplier_Version_HW_patch_level/DCM_E_PENDING]
        arg OpStatus: type=Dcm_OpStatusType, direction=IN
        arg Data: type=Dcm_Data1ByteType, direction=OUT
      operation ConditionCheckRead: possible-error=[DataServices_HSM_Identification_Read_HSM_MB_Supplier_Version_HW_patch_level/E_NOT_OK, DataServices_HSM_Identification_Read_HSM_MB_Supplier_Version_HW_patch_level/DCM_E_PENDING]
        arg OpStatus: type=Dcm_OpStatusType, direction=IN
        arg ErrorCode: type=Dcm_NegativeResponseCodeType, direction=OUT
      operation WriteData: possible-error=[DataServices_HSM_Identification_Read_HSM_MB_Supplier_Version_HW_patch_level/E_NOT_OK, DataServices_HSM_Identification_Read_HSM_MB_Supplier_Version_HW_patch_level/DCM_E_PENDING]
        arg Data: type=Dcm_Data1ByteType, direction=IN
        arg OpStatus: type=Dcm_OpStatusType, direction=IN
        arg ErrorCode: type=Dcm_NegativeResponseCodeType, direction=OUT
      error E_NOT_OK: error-code=1
      error DCM_E_PENDING: error-code=10
    DataServices_HSM_Identification_Read_HSM_MB_Version_HW_year
      operation ReadData: possible-error=[DataServices_HSM_Identification_Read_HSM_MB_Version_HW_year/E_NOT_OK, DataServices_HSM_Identification_Read_HSM_MB_Version_HW_year/DCM_E_PENDING]
        arg OpStatus: type=Dcm_OpStatusType, direction=IN
        arg Data: type=Dcm_Data1ByteType, direction=OUT
      operation ConditionCheckRead: possible-error=[DataServices_HSM_Identification_Read_HSM_MB_Version_HW_year/E_NOT_OK, DataServices_HSM_Identification_Read_HSM_MB_Version_HW_year/DCM_E_PENDING]
        arg OpStatus: type=Dcm_OpStatusType, direction=IN
        arg ErrorCode: type=Dcm_NegativeResponseCodeType, direction=OUT
      operation WriteData: possible-error=[DataServices_HSM_Identification_Read_HSM_MB_Version_HW_year/E_NOT_OK, DataServices_HSM_Identification_Read_HSM_MB_Version_HW_year/DCM_E_PENDING]
        arg Data: type=Dcm_Data1ByteType, direction=IN
        arg OpStatus: type=Dcm_OpStatusType, direction=IN
        arg ErrorCode: type=Dcm_NegativeResponseCodeType, direction=OUT
      error E_NOT_OK: error-code=1
      error DCM_E_PENDING: error-code=10
    DataServices_HSM_Identification_Read_HSM_MB_Partnumber
      operation ReadData: possible-error=[DataServices_HSM_Identification_Read_HSM_MB_Partnumber/E_NOT_OK, DataServices_HSM_Identification_Read_HSM_MB_Partnumber/DCM_E_PENDING]
        arg OpStatus: type=Dcm_OpStatusType, direction=IN
        arg Data: type=Dcm_Data10ByteType, direction=OUT
      operation ConditionCheckRead: possible-error=[DataServices_HSM_Identification_Read_HSM_MB_Partnumber/E_NOT_OK, DataServices_HSM_Identification_Read_HSM_MB_Partnumber/DCM_E_PENDING]
        arg OpStatus: type=Dcm_OpStatusType, direction=IN
        arg ErrorCode: type=Dcm_NegativeResponseCodeType, direction=OUT
      operation WriteData: possible-error=[DataServices_HSM_Identification_Read_HSM_MB_Partnumber/E_NOT_OK, DataServices_HSM_Identification_Read_HSM_MB_Partnumber/DCM_E_PENDING]
        arg Data: type=Dcm_Data10ByteType, direction=IN
        arg OpStatus: type=Dcm_OpStatusType, direction=IN
        arg ErrorCode: type=Dcm_NegativeResponseCodeType, direction=OUT
      error E_NOT_OK: error-code=1
      error DCM_E_PENDING: error-code=10
    DataServices_HSM_Identification_Read_HSM_MB_Supplier_Version_HW_year
      operation ReadData: possible-error=[DataServices_HSM_Identification_Read_HSM_MB_Supplier_Version_HW_year/E_NOT_OK, DataServices_HSM_Identification_Read_HSM_MB_Supplier_Version_HW_year/DCM_E_PENDING]
        arg OpStatus: type=Dcm_OpStatusType, direction=IN
        arg Data: type=Dcm_Data1ByteType, direction=OUT
      operation ConditionCheckRead: possible-error=[DataServices_HSM_Identification_Read_HSM_MB_Supplier_Version_HW_year/E_NOT_OK, DataServices_HSM_Identification_Read_HSM_MB_Supplier_Version_HW_year/DCM_E_PENDING]
        arg OpStatus: type=Dcm_OpStatusType, direction=IN
        arg ErrorCode: type=Dcm_NegativeResponseCodeType, direction=OUT
      operation WriteData: possible-error=[DataServices_HSM_Identification_Read_HSM_MB_Supplier_Version_HW_year/E_NOT_OK, DataServices_HSM_Identification_Read_HSM_MB_Supplier_Version_HW_year/DCM_E_PENDING]
        arg Data: type=Dcm_Data1ByteType, direction=IN
        arg OpStatus: type=Dcm_OpStatusType, direction=IN
        arg ErrorCode: type=Dcm_NegativeResponseCodeType, direction=OUT
      error E_NOT_OK: error-code=1
      error DCM_E_PENDING: error-code=10
    DataServices_HSM_Identification_Read_HSM_MB_Version_HW_week
      operation ReadData: possible-error=[DataServices_HSM_Identification_Read_HSM_MB_Version_HW_week/E_NOT_OK, DataServices_HSM_Identification_Read_HSM_MB_Version_HW_week/DCM_E_PENDING]
        arg OpStatus: type=Dcm_OpStatusType, direction=IN
        arg Data: type=Dcm_Data1ByteType, direction=OUT
      operation ConditionCheckRead: possible-error=[DataServices_HSM_Identification_Read_HSM_MB_Version_HW_week/E_NOT_OK, DataServices_HSM_Identification_Read_HSM_MB_Version_HW_week/DCM_E_PENDING]
        arg OpStatus: type=Dcm_OpStatusType, direction=IN
        arg ErrorCode: type=Dcm_NegativeResponseCodeType, direction=OUT
      operation WriteData: possible-error=[DataServices_HSM_Identification_Read_HSM_MB_Version_HW_week/E_NOT_OK, DataServices_HSM_Identification_Read_HSM_MB_Version_HW_week/DCM_E_PENDING]
        arg Data: type=Dcm_Data1ByteType, direction=IN
        arg OpStatus: type=Dcm_OpStatusType, direction=IN
        arg ErrorCode: type=Dcm_NegativeResponseCodeType, direction=OUT
      error E_NOT_OK: error-code=1
      error DCM_E_PENDING: error-code=10
    DataServices_SW_Version_Read_SW_Version
      operation ReadData: possible-error=[DataServices_SW_Version_Read_SW_Version/E_NOT_OK, DataServices_SW_Version_Read_SW_Version/DCM_E_PENDING]
        arg OpStatus: type=Dcm_OpStatusType, direction=IN
        arg Data: type=Dcm_Data12ByteType, direction=OUT
      operation ConditionCheckRead: possible-error=[DataServices_SW_Version_Read_SW_Version/E_NOT_OK, DataServices_SW_Version_Read_SW_Version/DCM_E_PENDING]
        arg OpStatus: type=Dcm_OpStatusType, direction=IN
        arg ErrorCode: type=Dcm_NegativeResponseCodeType, direction=OUT
      error E_NOT_OK: error-code=1
      error DCM_E_PENDING: error-code=10
    DataServices_Hardware_Version_Information_Write_HW_year
      operation WriteData: possible-error=[DataServices_Hardware_Version_Information_Write_HW_year/E_NOT_OK, DataServices_Hardware_Version_Information_Write_HW_year/DCM_E_PENDING]
        arg Data: type=Dcm_Data1ByteType, direction=IN
        arg OpStatus: type=Dcm_OpStatusType, direction=IN
        arg ErrorCode: type=Dcm_NegativeResponseCodeType, direction=OUT
      error E_NOT_OK: error-code=1
      error DCM_E_PENDING: error-code=10
    DataServices_Hardware_Version_Information_Write_HW_week
      operation WriteData: possible-error=[DataServices_Hardware_Version_Information_Write_HW_week/E_NOT_OK, DataServices_Hardware_Version_Information_Write_HW_week/DCM_E_PENDING]
        arg Data: type=Dcm_Data1ByteType, direction=IN
        arg OpStatus: type=Dcm_OpStatusType, direction=IN
        arg ErrorCode: type=Dcm_NegativeResponseCodeType, direction=OUT
      error E_NOT_OK: error-code=1
      error DCM_E_PENDING: error-code=10
    DataServices_Hardware_Version_Information_Write_HW_patch_level
      operation WriteData: possible-error=[DataServices_Hardware_Version_Information_Write_HW_patch_level/E_NOT_OK, DataServices_Hardware_Version_Information_Write_HW_patch_level/DCM_E_PENDING]
        arg Data: type=Dcm_Data1ByteType, direction=IN
        arg OpStatus: type=Dcm_OpStatusType, direction=IN
        arg ErrorCode: type=Dcm_NegativeResponseCodeType, direction=OUT
      error E_NOT_OK: error-code=1
      error DCM_E_PENDING: error-code=10
    DataServices_Standard_Application_SW_Package_Information_Read_C_P_Identification
      operation ReadData: possible-error=[DataServices_Standard_Application_SW_Package_Information_Read_C_P_Identification/E_NOT_OK, DataServices_Standard_Application_SW_Package_Information_Read_C_P_Identification/DCM_E_PENDING]
        arg OpStatus: type=Dcm_OpStatusType, direction=IN
        arg Data: type=Dcm_Data20ByteType, direction=OUT
      operation ConditionCheckRead: possible-error=[DataServices_Standard_Application_SW_Package_Information_Read_C_P_Identification/E_NOT_OK, DataServices_Standard_Application_SW_Package_Information_Read_C_P_Identification/DCM_E_PENDING]
        arg OpStatus: type=Dcm_OpStatusType, direction=IN
        arg ErrorCode: type=Dcm_NegativeResponseCodeType, direction=OUT
      error E_NOT_OK: error-code=1
      error DCM_E_PENDING: error-code=10
    DataServices_Calibration_Identifications_CAL_ID_Read_Calibration_Identification
      operation ReadData: possible-error=[DataServices_Calibration_Identifications_CAL_ID_Read_Calibration_Identification/E_NOT_OK, DataServices_Calibration_Identifications_CAL_ID_Read_Calibration_Identification/DCM_E_PENDING]
        arg OpStatus: type=Dcm_OpStatusType, direction=IN
        arg Data: type=Dcm_Data320ByteType, direction=OUT
      operation ReadDataLength: possible-error=[DataServices_Calibration_Identifications_CAL_ID_Read_Calibration_Identification/E_NOT_OK, DataServices_Calibration_Identifications_CAL_ID_Read_Calibration_Identification/DCM_E_PENDING]
        arg OpStatus: type=Dcm_OpStatusType, direction=IN
        arg DataLength: type=uint16, direction=OUT
      operation ConditionCheckRead: possible-error=[DataServices_Calibration_Identifications_CAL_ID_Read_Calibration_Identification/E_NOT_OK, DataServices_Calibration_Identifications_CAL_ID_Read_Calibration_Identification/DCM_E_PENDING]
        arg OpStatus: type=Dcm_OpStatusType, direction=IN
        arg ErrorCode: type=Dcm_NegativeResponseCodeType, direction=OUT
      error E_NOT_OK: error-code=1
      error DCM_E_PENDING: error-code=10
    DataServices_Calibration_Identifications_CAL_ID_Write_Calibration_Identification
      operation WriteData: possible-error=[DataServices_Calibration_Identifications_CAL_ID_Write_Calibration_Identification/E_NOT_OK, DataServices_Calibration_Identifications_CAL_ID_Write_Calibration_Identification/DCM_E_PENDING]
        4 x arg:
          Data: type=Dcm_Data320ByteType, direction=IN
          DataLength: type=uint16, direction=IN
          OpStatus: type=Dcm_OpStatusType, direction=IN
          ErrorCode: type=Dcm_NegativeResponseCodeType, direction=OUT
      error E_NOT_OK: error-code=1
      error DCM_E_PENDING: error-code=10
    DataServices_Calibration_Identifications_CAL_ID_Write_Number_of_data_items
      operation WriteData: possible-error=[DataServices_Calibration_Identifications_CAL_ID_Write_Number_of_data_items/E_NOT_OK, DataServices_Calibration_Identifications_CAL_ID_Write_Number_of_data_items/DCM_E_PENDING]
        arg Data: type=Dcm_Data1ByteType, direction=IN
        arg OpStatus: type=Dcm_OpStatusType, direction=IN
        arg ErrorCode: type=Dcm_NegativeResponseCodeType, direction=OUT
      error E_NOT_OK: error-code=1
      error DCM_E_PENDING: error-code=10
    DataServices_ECU_serial_number_Read_PCBA_Programmed_Part_number
      operation ReadData: possible-error=[DataServices_ECU_serial_number_Read_PCBA_Programmed_Part_number/E_NOT_OK, DataServices_ECU_serial_number_Read_PCBA_Programmed_Part_number/DCM_E_PENDING]
        arg OpStatus: type=Dcm_OpStatusType, direction=IN
        arg Data: type=Dcm_Data10ByteType, direction=OUT
      operation ConditionCheckRead: possible-error=[DataServices_ECU_serial_number_Read_PCBA_Programmed_Part_number/E_NOT_OK, DataServices_ECU_serial_number_Read_PCBA_Programmed_Part_number/DCM_E_PENDING]
        arg OpStatus: type=Dcm_OpStatusType, direction=IN
        arg ErrorCode: type=Dcm_NegativeResponseCodeType, direction=OUT
      operation WriteData: possible-error=[DataServices_ECU_serial_number_Read_PCBA_Programmed_Part_number/E_NOT_OK, DataServices_ECU_serial_number_Read_PCBA_Programmed_Part_number/DCM_E_PENDING]
        arg Data: type=Dcm_Data10ByteType, direction=IN
        arg OpStatus: type=Dcm_OpStatusType, direction=IN
        arg ErrorCode: type=Dcm_NegativeResponseCodeType, direction=OUT
      error E_NOT_OK: error-code=1
      error DCM_E_PENDING: error-code=10
    DataServices_ECU_serial_number_Read_ECU_traceability_number
      operation ReadData: possible-error=[DataServices_ECU_serial_number_Read_ECU_traceability_number/E_NOT_OK, DataServices_ECU_serial_number_Read_ECU_traceability_number/DCM_E_PENDING]
        arg OpStatus: type=Dcm_OpStatusType, direction=IN
        arg Data: type=Dcm_Data12ByteType, direction=OUT
      operation ConditionCheckRead: possible-error=[DataServices_ECU_serial_number_Read_ECU_traceability_number/E_NOT_OK, DataServices_ECU_serial_number_Read_ECU_traceability_number/DCM_E_PENDING]
        arg OpStatus: type=Dcm_OpStatusType, direction=IN
        arg ErrorCode: type=Dcm_NegativeResponseCodeType, direction=OUT
      operation WriteData: possible-error=[DataServices_ECU_serial_number_Read_ECU_traceability_number/E_NOT_OK, DataServices_ECU_serial_number_Read_ECU_traceability_number/DCM_E_PENDING]
        arg Data: type=Dcm_Data12ByteType, direction=IN
        arg OpStatus: type=Dcm_OpStatusType, direction=IN
        arg ErrorCode: type=Dcm_NegativeResponseCodeType, direction=OUT
      error E_NOT_OK: error-code=1
      error DCM_E_PENDING: error-code=10
    RoutineServices_Routine_Erase_All_Start
      operation Start: possible-error=[RoutineServices_Routine_Erase_All_Start/E_NOT_OK, RoutineServices_Routine_Erase_All_Start/DCM_E_PENDING, RoutineServices_Routine_Erase_All_Start/DCM_E_FORCE_RCRRP]
        4 x arg:
          OpStatus: type=Dcm_OpStatusType, direction=IN
          routineInfo: type=Dcm_StartDataOut_Routine_Erase_All_Start_routineInfoType, direction=OUT
          Status: type=Dcm_StartDataOut_Routine_Erase_All_Start_StatusType, direction=OUT
          ErrorCode: type=Dcm_NegativeResponseCodeType, direction=OUT
      error E_NOT_OK: error-code=1
      error DCM_E_PENDING: error-code=10
      error DCM_E_FORCE_RCRRP: error-code=12
    RoutineServices_Routine_Force_External_WDG_Start
      operation Start: possible-error=[RoutineServices_Routine_Force_External_WDG_Start/E_NOT_OK, RoutineServices_Routine_Force_External_WDG_Start/DCM_E_PENDING, RoutineServices_Routine_Force_External_WDG_Start/DCM_E_FORCE_RCRRP]
        4 x arg:
          OpStatus: type=Dcm_OpStatusType, direction=IN
          routineInfo: type=Dcm_StartDataOut_Routine_Force_External_WDG_Start_routineInfoType, direction=OUT
          Status: type=Dcm_StartDataOut_Routine_Force_External_WDG_Start_StatusType, direction=OUT
          ErrorCode: type=Dcm_NegativeResponseCodeType, direction=OUT
      error E_NOT_OK: error-code=1
      error DCM_E_PENDING: error-code=10
      error DCM_E_FORCE_RCRRP: error-code=12
    DataServices_Customer_Settings_Read_BltSlckDec_Md_Stat
      operation ReadData: possible-error=[DataServices_Customer_Settings_Read_BltSlckDec_Md_Stat/E_NOT_OK, DataServices_Customer_Settings_Read_BltSlckDec_Md_Stat/DCM_E_PENDING]
        arg OpStatus: type=Dcm_OpStatusType, direction=IN
        arg Data: type=Dcm_Data1ByteType, direction=OUT
      operation ConditionCheckRead: possible-error=[DataServices_Customer_Settings_Read_BltSlckDec_Md_Stat/E_NOT_OK, DataServices_Customer_Settings_Read_BltSlckDec_Md_Stat/DCM_E_PENDING]
        arg OpStatus: type=Dcm_OpStatusType, direction=IN
        arg ErrorCode: type=Dcm_NegativeResponseCodeType, direction=OUT
      error E_NOT_OK: error-code=1
      error DCM_E_PENDING: error-code=10
    DataServices_Customer_Settings_Read_PS_Curve_Stat
      operation ReadData: possible-error=[DataServices_Customer_Settings_Read_PS_Curve_Stat/E_NOT_OK, DataServices_Customer_Settings_Read_PS_Curve_Stat/DCM_E_PENDING]
        arg OpStatus: type=Dcm_OpStatusType, direction=IN
        arg Data: type=Dcm_Data1ByteType, direction=OUT
      operation ConditionCheckRead: possible-error=[DataServices_Customer_Settings_Read_PS_Curve_Stat/E_NOT_OK, DataServices_Customer_Settings_Read_PS_Curve_Stat/DCM_E_PENDING]
        arg OpStatus: type=Dcm_OpStatusType, direction=IN
        arg ErrorCode: type=Dcm_NegativeResponseCodeType, direction=OUT
      error E_NOT_OK: error-code=1
      error DCM_E_PENDING: error-code=10
    DataServices_Trust_Model_CSR_Supplier_Signature_Read_Trust_Model_CSR_Supplier_Signature
      4 x operation, all with possible-error=[DataServices_Trust_Model_CSR_Supplier_Signature_Read_Trust_Model_CSR_Supplier_Signature/E_NOT_OK, DataServices_Trust_Model_CSR_Supplier_Signature_Read_Trust_Model_CSR_Supplier_Signature/DCM_E_PENDING]:
        ReadData
          arg OpStatus: type=Dcm_OpStatusType, direction=IN
          arg Data: type=Dcm_Data258ByteType, direction=OUT
        ReadDataLength
          arg OpStatus: type=Dcm_OpStatusType, direction=IN
          arg DataLength: type=uint16, direction=OUT
        ConditionCheckRead
          arg OpStatus: type=Dcm_OpStatusType, direction=IN
          arg ErrorCode: type=Dcm_NegativeResponseCodeType, direction=OUT
        WriteData
          4 x arg:
            Data: type=Dcm_Data258ByteType, direction=IN
            DataLength: type=uint16, direction=IN
            OpStatus: type=Dcm_OpStatusType, direction=IN
            ErrorCode: type=Dcm_NegativeResponseCodeType, direction=OUT
      error E_NOT_OK: error-code=1
      error DCM_E_PENDING: error-code=10
    DataServices_Velocity_PI_Regulation_Coefficient_Read_Input_Velocity_Coefficient
      operation ReadData: possible-error=[DataServices_Velocity_PI_Regulation_Coefficient_Read_Input_Velocity_Coefficient/E_NOT_OK, DataServices_Velocity_PI_Regulation_Coefficient_Read_Input_Velocity_Coefficient/DCM_E_PENDING]
        arg OpStatus: type=Dcm_OpStatusType, direction=IN
        arg Data: type=Dcm_Data30ByteType, direction=OUT
      operation ConditionCheckRead: possible-error=[DataServices_Velocity_PI_Regulation_Coefficient_Read_Input_Velocity_Coefficient/E_NOT_OK, DataServices_Velocity_PI_Regulation_Coefficient_Read_Input_Velocity_Coefficient/DCM_E_PENDING]
        arg OpStatus: type=Dcm_OpStatusType, direction=IN
        arg ErrorCode: type=Dcm_NegativeResponseCodeType, direction=OUT
      operation WriteData: possible-error=[DataServices_Velocity_PI_Regulation_Coefficient_Read_Input_Velocity_Coefficient/E_NOT_OK, DataServices_Velocity_PI_Regulation_Coefficient_Read_Input_Velocity_Coefficient/DCM_E_PENDING]
        arg Data: type=Dcm_Data30ByteType, direction=IN
        arg OpStatus: type=Dcm_OpStatusType, direction=IN
        arg ErrorCode: type=Dcm_NegativeResponseCodeType, direction=OUT
      error E_NOT_OK: error-code=1
      error DCM_E_PENDING: error-code=10
    DataServices_Temperature_Sensor_Calibration_Point_Read_Offset_Point
      operation ReadData: possible-error=[DataServices_Temperature_Sensor_Calibration_Point_Read_Offset_Point/E_NOT_OK, DataServices_Temperature_Sensor_Calibration_Point_Read_Offset_Point/DCM_E_PENDING]
        arg OpStatus: type=Dcm_OpStatusType, direction=IN
        arg Data: type=Dcm_Data1ByteType, direction=OUT
      operation ConditionCheckRead: possible-error=[DataServices_Temperature_Sensor_Calibration_Point_Read_Offset_Point/E_NOT_OK, DataServices_Temperature_Sensor_Calibration_Point_Read_Offset_Point/DCM_E_PENDING]
        arg OpStatus: type=Dcm_OpStatusType, direction=IN
        arg ErrorCode: type=Dcm_NegativeResponseCodeType, direction=OUT
      operation WriteData: possible-error=[DataServices_Temperature_Sensor_Calibration_Point_Read_Offset_Point/E_NOT_OK, DataServices_Temperature_Sensor_Calibration_Point_Read_Offset_Point/DCM_E_PENDING]
        arg Data: type=Dcm_Data1ByteType, direction=IN
        arg OpStatus: type=Dcm_OpStatusType, direction=IN
        arg ErrorCode: type=Dcm_NegativeResponseCodeType, direction=OUT
      error E_NOT_OK: error-code=1
      error DCM_E_PENDING: error-code=10
