[part 1 of 3: packages /MICROSAR/Dcm_swc to /MICROSAR/Dcm_swc/Interfaces]
AUTOSAR XML (schema 00049)
package /MICROSAR/Dcm_swc
  5 x mode declaration group, all with category=EXPLICIT_ORDER:
    DcmControlDtcSetting: initial-mode=ENABLEDTCSETTING, on-transition-value=2
      mode ENABLEDTCSETTING: value=0
      mode DISABLEDTCSETTING: value=1
    DcmEcuReset: initial-mode=NONE, on-transition-value=7
      7 x mode:
        NONE: value=0
        HARD: value=1
        KEYONOFF: value=2
        SOFT: value=3
        JUMPTOBOOTLOADER: value=4
        JUMPTOSYSSUPPLIERBOOTLOADER: value=5
        EXECUTE: value=6
    DcmModeRapidPowerShutDown: initial-mode=ENABLE_RAPIDPOWERSHUTDOWN, on-transition-value=2
      mode ENABLE_RAPIDPOWERSHUTDOWN: value=0
      mode DISABLE_RAPIDPOWERSHUTDOWN: value=1
    DcmCommunicationControl: initial-mode=DCM_ENABLE_RX_TX_NORM, on-transition-value=12
      12 x mode:
        DCM_ENABLE_RX_TX_NORM: value=0
        DCM_ENABLE_RX_DISABLE_TX_NORM: value=1
        DCM_DISABLE_RX_ENABLE_TX_NORM: value=2
        DCM_DISABLE_RX_TX_NORMAL: value=3
        DCM_ENABLE_RX_TX_NM: value=4
        DCM_ENABLE_RX_DISABLE_TX_NM: value=5
        DCM_DISABLE_RX_ENABLE_TX_NM: value=6
        DCM_DISABLE_RX_TX_NM: value=7
        DCM_ENABLE_RX_TX_NORM_NM: value=8
        DCM_ENABLE_RX_DISABLE_TX_NORM_NM: value=9
        DCM_DISABLE_RX_ENABLE_TX_NORM_NM: value=10
        DCM_DISABLE_RX_TX_NORM_NM: value=11
    DcmDiagnosticSessionControl: initial-mode=DEFAULT_SESSION, on-transition-value=255
      4 x mode:
        DEFAULT_SESSION: value=1
        PROGRAMMING_SESSION: value=2
        EXTENDED_SESSION: value=3
        Development: value=126
  data type mapping set DcmMappingSet  # Contains mapping for ModeDeclarationGroups which are provided by Dcm.
    mode-request-type-maps:
      implementation-data-type=Dcm_ControlDtcSettingType, mode-group=DcmControlDtcSetting
      implementation-data-type=Dcm_EcuResetType, mode-group=DcmEcuReset
      implementation-data-type=Dcm_ModeRapidPowerShutDownType, mode-group=DcmModeRapidPowerShutDown
      implementation-data-type=Dcm_DiagnosticSessionControlType, mode-group=DcmDiagnosticSessionControl
      implementation-data-type=Dcm_CommunicationModeType, mode-group=DcmCommunicationControl
package /MICROSAR/Dcm_swc/DataTypes
  236 x impl type:
    Dcm_ConfirmationStatusType: compu {0=DCM_RES_POS_OK, 1=DCM_RES_POS_NOT_OK, 2=DCM_RES_NEG_OK, 3=DCM_RES_NEG_NOT_OK}, range raw 0..3, implementation-data-type=uint8
    Dcm_OpStatusType: compu {0=DCM_INITIAL, 1=DCM_PENDING, 2=DCM_CANCEL, 3=DCM_FORCE_RCRRP_OK, 64=DCM_FORCE_RCRRP_NOT_OK}, range raw 0..64, implementation-data-type=uint8
    Dcm_NegativeResponseCodeType:
      compu {0=DCM_E_POSITIVERESPONSE, 16=DCM_E_GENERALREJECT, 17=DCM_E_SERVICENOTSUPPORTED, 18=DCM_E_SUBFUNCTIONNOTSUPPORTED, 19=DCM_E_INCORRECTMESSAGELENGTHORINVALIDFORMAT, 20=DCM_E_RESPONSETOOLONG, 33=DCM_E_BUSYREPEATREQUEST, 34=DCM_E_CONDITIONSNOTCORRECT, 36=DCM_E_REQUESTSEQUENCEERROR, 37=DCM_E_NORESPONSEFROMSUBNETCOMPONENT, 38=DCM_E_FAILUREPREVENTSEXECUTIONOFREQUESTEDACTION, 49=DCM_E_REQUESTOUTOFRANGE, 51=DCM_E_SECURITYACCESSDENIED, 52=DCM_E_AUTHENTICATIONREQUIRED, 53=DCM_E_INVALIDKEY, 54=DCM_E_EXCEEDNUMBEROFATTEMPTS, 55=DCM_E_REQUIREDTIMEDELAYNOTEXPIRED, 80=DCM_E_CVF_INVALIDTIMEPERIOD, 81=DCM_E_CVF_INVALIDSIGNATURE, 82=DCM_E_CVF_INVALIDCHAINOFTRUST, 83=DCM_E_CVF_INVALIDTYPE, 84=DCM_E_CVF_INVALIDFORMAT, 85=DCM_E_CVF_INVALIDCONTENT, 86=DCM_E_CVF_INVALIDSCOPE, 87=DCM_E_CVF_INVALIDCERTIFICATEREVOKED, 88=DCM_E_OWNERSHIPVERIFICATIONFAILED, 89=DCM_E_CHALLENGECALCULATIONFAILED, 112=DCM_E_UPLOADDOWNLOADNOTACCEPTED, 113=DCM_E_TRANSFERDATASUSPENDED, 114=DCM_E_GENERALPROGRAMMINGFAILURE, 115=DCM_E_WRONGBLOCKSEQUENCECOUNTER, 120=DCM_E_REQUESTCORRECTLYRECEIVEDRESPONSEPENDING, 126=DCM_E_SUBFUNCTIONNOTSUPPORTEDINACTIVESESSION, 127=DCM_E_SERVICENOTSUPPORTEDINACTIVESESSION, 129=DCM_E_RPMTOOHIGH, 130=DCM_E_RPMTOOLOW, 131=DCM_E_ENGINEISRUNNING, 132=DCM_E_ENGINEISNOTRUNNING, 133=DCM_E_ENGINERUNTIMETOOLOW, 134=DCM_E_TEMPERATURETOOHIGH, 135=DCM_E_TEMPERATURETOOLOW, 136=DCM_E_VEHICLESPEEDTOOHIGH, 137=DCM_E_VEHICLESPEEDTOOLOW, 138=DCM_E_THROTTLE_PEDALTOOHIGH, 139=DCM_E_THROTTLE_PEDALTOOLOW, 140=DCM_E_TRANSMISSIONRANGENOTINNEUTRAL, 141=DCM_E_TRANSMISSIONRANGENOTINGEAR, 143=DCM_E_BRAKESWITCH_NOTCLOSED, 144=DCM_E_SHIFTERLEVERNOTINPARK, 145=DCM_E_TORQUECONVERTERCLUTCHLOCKED, 146=DCM_E_VOLTAGETOOHIGH, 147=DCM_E_VOLTAGETOOLOW, 240..249=DCM_E_VMSCNC_0..DCM_E_VMSCNC_9, 250=DCM_E_VMSCNC_A, 251=DCM_E_VMSCNC_B, 252=DCM_E_VMSCNC_C, 253=DCM_E_VMSCNC_D, 254=DCM_E_VMSCNC_E}
      range raw 0..255
      implementation-data-type=uint8
    Dcm_ProtocolType: compu {0=DCM_OBD_ON_CAN, 1=DCM_OBD_ON_FLEXRAY, 2=DCM_OBD_ON_IP, 3=DCM_UDS_ON_CAN, 4=DCM_UDS_ON_FLEXRAY, 5=DCM_UDS_ON_IP, 12=DCM_NO_ACTIVE_PROTOCOL, 240..254=DCM_SUPPLIER_1..DCM_SUPPLIER_15}, range raw 0..254, implementation-data-type=uint8
    Dcm_RequestKindType: compu {0=DCM_REQ_KIND_NONE, 1=DCM_REQ_KIND_EXTERNAL, 2=DCM_REQ_KIND_ROE}, range raw 0..2, implementation-data-type=uint8
    Dcm_ControlDtcSettingType: compu {0=DCM_ENUM_ENABLEDTCSETTING, 1=DCM_ENUM_DISABLEDTCSETTING}, range raw 0..255, implementation-data-type=uint8
    Dcm_EcuResetType: compu {0=DCM_ENUM_NONE, 1=DCM_ENUM_HARD, 2=DCM_ENUM_KEYONOFF, 3=DCM_ENUM_SOFT, 4=DCM_ENUM_JUMPTOBOOTLOADER, 5=DCM_ENUM_JUMPTOSYSSUPPLIERBOOTLOADER, 6=DCM_ENUM_EXECUTE}, range raw 0..255, implementation-data-type=uint8
    Dcm_ModeRapidPowerShutDownType: compu {0=DCM_ENUM_ENABLE_RAPIDPOWERSHUTDOWN, 1=DCM_ENUM_DISABLE_RAPIDPOWERSHUTDOWN}, range raw 0..255, implementation-data-type=uint8
    Dcm_CommunicationModeType:
      compu {0=DCM_ENABLE_RX_TX_NORM, 1=DCM_ENABLE_RX_DISABLE_TX_NORM, 2=DCM_DISABLE_RX_ENABLE_TX_NORM, 3=DCM_DISABLE_RX_TX_NORMAL, 4=DCM_ENABLE_RX_TX_NM, 5=DCM_ENABLE_RX_DISABLE_TX_NM, 6=DCM_DISABLE_RX_ENABLE_TX_NM, 7=DCM_DISABLE_RX_TX_NM, 8=DCM_ENABLE_RX_TX_NORM_NM, 9=DCM_ENABLE_RX_DISABLE_TX_NORM_NM, 10=DCM_DISABLE_RX_ENABLE_TX_NORM_NM, 11=DCM_DISABLE_RX_TX_NORM_NM}
      range raw 0..255
      implementation-data-type=uint8
    Dcm_Data32ByteType: category=ARRAY, sw-calibration-access=READ-ONLY
      element Dcm_Data32ByteTypeElement: array-size=32, array-size-semantics=FIXED-SIZE, implementation-data-type=uint8
    Dcm_Data64ByteType: category=ARRAY, sw-calibration-access=READ-ONLY
      element Dcm_Data64ByteTypeElement: array-size=64, array-size-semantics=FIXED-SIZE, implementation-data-type=uint8
    Dcm_Data2ByteType: category=ARRAY, sw-calibration-access=READ-ONLY
      element Dcm_Data2ByteTypeElement: array-size=2, array-size-semantics=FIXED-SIZE, implementation-data-type=uint8
    Dcm_Data3006ByteType: category=ARRAY, sw-calibration-access=READ-ONLY
      element Dcm_Data3006ByteTypeElement: array-size=3006, array-size-semantics=FIXED-SIZE, implementation-data-type=uint8
    Dcm_Data4008ByteType: category=ARRAY, sw-calibration-access=READ-ONLY
      element Dcm_Data4008ByteTypeElement: array-size=4008, array-size-semantics=FIXED-SIZE, implementation-data-type=uint8
    Dcm_Data5ByteType: category=ARRAY, sw-calibration-access=READ-ONLY
      element Dcm_Data5ByteTypeElement: array-size=5, array-size-semantics=FIXED-SIZE, implementation-data-type=uint8
    Dcm_Data10ByteType: category=ARRAY, sw-calibration-access=READ-ONLY
      element Dcm_Data10ByteTypeElement: array-size=10, array-size-semantics=FIXED-SIZE, implementation-data-type=uint8
    Dcm_Data1002ByteType: category=ARRAY, sw-calibration-access=READ-ONLY
      element Dcm_Data1002ByteTypeElement: array-size=1002, array-size-semantics=FIXED-SIZE, implementation-data-type=uint8
    Dcm_Data1ByteType: category=ARRAY, sw-calibration-access=READ-ONLY
      element Dcm_Data1ByteTypeElement: array-size=1, array-size-semantics=FIXED-SIZE, implementation-data-type=uint8
    Dcm_Data30ByteType: category=ARRAY, sw-calibration-access=READ-ONLY
      element Dcm_Data30ByteTypeElement: array-size=30, array-size-semantics=FIXED-SIZE, implementation-data-type=uint8
    Dcm_Data20ByteType: category=ARRAY, sw-calibration-access=READ-ONLY
      element Dcm_Data20ByteTypeElement: array-size=20, array-size-semantics=FIXED-SIZE, implementation-data-type=uint8
    Dcm_Data28ByteType: category=ARRAY, sw-calibration-access=READ-ONLY
      element Dcm_Data28ByteTypeElement: array-size=28, array-size-semantics=FIXED-SIZE, implementation-data-type=uint8
    Dcm_Data22ByteType: category=ARRAY, sw-calibration-access=READ-ONLY
      element Dcm_Data22ByteTypeElement: array-size=22, array-size-semantics=FIXED-SIZE, implementation-data-type=uint8
    Dcm_Data381ByteType: category=ARRAY, sw-calibration-access=READ-ONLY
      element Dcm_Data381ByteTypeElement: array-size=381, array-size-semantics=FIXED-SIZE, implementation-data-type=uint8
    Dcm_Data48ByteType: category=ARRAY, sw-calibration-access=READ-ONLY
      element Dcm_Data48ByteTypeElement: array-size=48, array-size-semantics=FIXED-SIZE, implementation-data-type=uint8
    Dcm_Data17ByteType: category=ARRAY, sw-calibration-access=READ-ONLY
      element Dcm_Data17ByteTypeElement: array-size=17, array-size-semantics=FIXED-SIZE, implementation-data-type=uint8
    Dcm_Data15ByteType: category=ARRAY, sw-calibration-access=READ-ONLY
      element Dcm_Data15ByteTypeElement: array-size=15, array-size-semantics=FIXED-SIZE, implementation-data-type=uint8
    Dcm_Data1000ByteType: category=ARRAY, sw-calibration-access=READ-ONLY
      element Dcm_Data1000ByteTypeElement: array-size=1000, array-size-semantics=FIXED-SIZE, implementation-data-type=uint8
    Dcm_Data4092ByteType: category=ARRAY, sw-calibration-access=READ-ONLY
      element Dcm_Data4092ByteTypeElement: array-size=4092, array-size-semantics=FIXED-SIZE, implementation-data-type=uint8
    Dcm_Data254ByteType: category=ARRAY, sw-calibration-access=READ-ONLY
      element Dcm_Data254ByteTypeElement: array-size=254, array-size-semantics=FIXED-SIZE, implementation-data-type=uint8
    Dcm_Data4ByteType: category=ARRAY, sw-calibration-access=READ-ONLY
      element Dcm_Data4ByteTypeElement: array-size=4, array-size-semantics=FIXED-SIZE, implementation-data-type=uint8
    Dcm_Data33ByteType: category=ARRAY, sw-calibration-access=READ-ONLY
      element Dcm_Data33ByteTypeElement: array-size=33, array-size-semantics=FIXED-SIZE, implementation-data-type=uint8
    Dcm_Data3ByteType: category=ARRAY, sw-calibration-access=READ-ONLY
      element Dcm_Data3ByteTypeElement: array-size=3, array-size-semantics=FIXED-SIZE, implementation-data-type=uint8
    Dcm_Data16ByteType: category=ARRAY, sw-calibration-access=READ-ONLY
      element Dcm_Data16ByteTypeElement: array-size=16, array-size-semantics=FIXED-SIZE, implementation-data-type=uint8
    Dcm_Data12ByteType: category=ARRAY, sw-calibration-access=READ-ONLY
      element Dcm_Data12ByteTypeElement: array-size=12, array-size-semantics=FIXED-SIZE, implementation-data-type=uint8
    Dcm_Data6ByteType: category=ARRAY, sw-calibration-access=READ-ONLY
      element Dcm_Data6ByteTypeElement: array-size=6, array-size-semantics=FIXED-SIZE, implementation-data-type=uint8
    Dcm_StartDataOut_Routine_Check_Reprogramming_Preconditions_Start_routineInfoPrimitiveType: implementation-data-type=uint8
    Dcm_StartDataOut_Routine_Check_Reprogramming_Preconditions_Start_routineInfoType: implementation-data-type=Dcm_StartDataOut_Routine_Check_Reprogramming_Preconditions_Start_routineInfoPrimitiveType
    Dcm_StartDataOut_Routine_Check_Reprogramming_Preconditions_Start_Number_of_Unfulfilled_PreconditionsPrimitiveType: implementation-data-type=uint8
    Dcm_StartDataOut_Routine_Check_Reprogramming_Preconditions_Start_Number_of_Unfulfilled_PreconditionsType: implementation-data-type=Dcm_StartDataOut_Routine_Check_Reprogramming_Preconditions_Start_Number_of_Unfulfilled_PreconditionsPrimitiveType
    Dcm_StartFlexibleOutArrayData_Routine_Check_Reprogramming_Preconditions_Start_List_of_PreconditionsType: category=ARRAY, sw-calibration-access=READ-ONLY
      element Dcm_StartFlexibleOutArrayData_Routine_Check_Reprogramming_Preconditions_Start_List_of_PreconditionsTypeElement: array-size=100, array-size-semantics=FIXED-SIZE, implementation-data-type=uint8
    Dcm_StartFlexibleInArrayData_Routine_PreCheckProgrammingDependencies_Start_Pre_Check_InformationsType: category=ARRAY, sw-calibration-access=READ-ONLY
      element Dcm_StartFlexibleInArrayData_Routine_PreCheckProgrammingDependencies_Start_Pre_Check_InformationsTypeElement: array-size=4064, array-size-semantics=FIXED-SIZE, implementation-data-type=uint8
    Dcm_StartDataOut_Routine_PreCheckProgrammingDependencies_Start_routineInfoPrimitiveType: implementation-data-type=uint8
    Dcm_StartDataOut_Routine_PreCheckProgrammingDependencies_Start_routineInfoType: implementation-data-type=Dcm_StartDataOut_Routine_PreCheckProgrammingDependencies_Start_routineInfoPrimitiveType
    Dcm_StartDataOut_Routine_PreCheckProgrammingDependencies_Start_Dependencies_Verification_Check_ResultPrimitiveType: implementation-data-type=uint8
    Dcm_StartDataOut_Routine_PreCheckProgrammingDependencies_Start_Dependencies_Verification_Check_ResultType: implementation-data-type=Dcm_StartDataOut_Routine_PreCheckProgrammingDependencies_Start_Dependencies_Verification_Check_ResultPrimitiveType
    Dcm_StartDataOut_Routine_Reset_VINDataIdentifier_Start_routineInfoPrimitiveType: implementation-data-type=uint8
    Dcm_StartDataOut_Routine_Reset_VINDataIdentifier_Start_routineInfoType: implementation-data-type=Dcm_StartDataOut_Routine_Reset_VINDataIdentifier_Start_routineInfoPrimitiveType
    Dcm_StartDataOut_Routine_Synchronize_to_Non_volatile_Memory_Start_routineInfoPrimitiveType: implementation-data-type=uint8
    Dcm_StartDataOut_Routine_Synchronize_to_Non_volatile_Memory_Start_routineInfoType: implementation-data-type=Dcm_StartDataOut_Routine_Synchronize_to_Non_volatile_Memory_Start_routineInfoPrimitiveType
    Dcm_StopDataOut_Routine_Synchronize_to_Non_volatile_Memory_Start_routineInfoPrimitiveType: implementation-data-type=uint8
    Dcm_StopDataOut_Routine_Synchronize_to_Non_volatile_Memory_Start_routineInfoType: implementation-data-type=Dcm_StopDataOut_Routine_Synchronize_to_Non_volatile_Memory_Start_routineInfoPrimitiveType
    Dcm_RequestDataOut_Routine_Synchronize_to_Non_volatile_Memory_Start_routineInfoPrimitiveType: implementation-data-type=uint8
    Dcm_RequestDataOut_Routine_Synchronize_to_Non_volatile_Memory_Start_routineInfoType: implementation-data-type=Dcm_RequestDataOut_Routine_Synchronize_to_Non_volatile_Memory_Start_routineInfoPrimitiveType
    Dcm_StartDataIn_Routine_Authenticate_Diagnostic_User_or_Tester_Start_ConfigurationPrimitiveType: implementation-data-type=uint8
    Dcm_StartDataIn_Routine_Authenticate_Diagnostic_User_or_Tester_Start_ConfigurationType: implementation-data-type=Dcm_StartDataIn_Routine_Authenticate_Diagnostic_User_or_Tester_Start_ConfigurationPrimitiveType
    Dcm_StartDataIn_Routine_Authenticate_Diagnostic_User_or_Tester_Start_TaskPrimitiveType: implementation-data-type=uint8
    Dcm_StartDataIn_Routine_Authenticate_Diagnostic_User_or_Tester_Start_TaskType: implementation-data-type=Dcm_StartDataIn_Routine_Authenticate_Diagnostic_User_or_Tester_Start_TaskPrimitiveType
    Dcm_StartFlexibleInArrayData_Routine_Authenticate_Diagnostic_User_or_Tester_Start_Tester_AuthenticationType: category=ARRAY, sw-calibration-access=READ-ONLY
      element Dcm_StartFlexibleInArrayData_Routine_Authenticate_Diagnostic_User_or_Tester_Start_Tester_AuthenticationTypeElement: array-size=4004, array-size-semantics=FIXED-SIZE, implementation-data-type=uint8
    Dcm_StartDataOut_Routine_Authenticate_Diagnostic_User_or_Tester_Start_routineInfoPrimitiveType: implementation-data-type=uint8
    Dcm_StartDataOut_Routine_Authenticate_Diagnostic_User_or_Tester_Start_routineInfoType: implementation-data-type=Dcm_StartDataOut_Routine_Authenticate_Diagnostic_User_or_Tester_Start_routineInfoPrimitiveType
    Dcm_StartDataOut_Routine_Authenticate_Diagnostic_User_or_Tester_Start_Verification_ResultPrimitiveType: implementation-data-type=uint8
    Dcm_StartDataOut_Routine_Authenticate_Diagnostic_User_or_Tester_Start_Verification_ResultType: implementation-data-type=Dcm_StartDataOut_Routine_Authenticate_Diagnostic_User_or_Tester_Start_Verification_ResultPrimitiveType
    Dcm_StartFlexibleOutArrayData_Routine_Authenticate_Diagnostic_User_or_Tester_Start_Authentication_ResultType: category=ARRAY, sw-calibration-access=READ-ONLY
      element Dcm_StartFlexibleOutArrayData_Routine_Authenticate_Diagnostic_User_or_Tester_Start_Authentication_ResultTypeElement: array-size=3006, array-size-semantics=FIXED-SIZE, implementation-data-type=uint8
    Dcm_StartFlexibleInArrayData_Routine_Enhance_Access_Rights_Start_Enhanced_Rights_CertificateType: category=ARRAY, sw-calibration-access=READ-ONLY
      element Dcm_StartFlexibleInArrayData_Routine_Enhance_Access_Rights_Start_Enhanced_Rights_CertificateTypeElement: array-size=2002, array-size-semantics=FIXED-SIZE, implementation-data-type=uint8
    Dcm_StartDataOut_Routine_Enhance_Access_Rights_Start_routineInfoPrimitiveType: implementation-data-type=uint8
    Dcm_StartDataOut_Routine_Enhance_Access_Rights_Start_routineInfoType: implementation-data-type=Dcm_StartDataOut_Routine_Enhance_Access_Rights_Start_routineInfoPrimitiveType
    Dcm_StartDataOut_Routine_Enhance_Access_Rights_Start_Verification_ResultPrimitiveType: implementation-data-type=uint8
    Dcm_StartDataOut_Routine_Enhance_Access_Rights_Start_Verification_ResultType: implementation-data-type=Dcm_StartDataOut_Routine_Enhance_Access_Rights_Start_Verification_ResultPrimitiveType
    Dcm_StartFlexibleInArrayData_Routine_Evaluate_Data_Verification_Certificate_Start_Data_Verification_CertificateType: category=ARRAY, sw-calibration-access=READ-ONLY
      element Dcm_StartFlexibleInArrayData_Routine_Evaluate_Data_Verification_Certificate_Start_Data_Verification_CertificateTypeElement: array-size=2002, array-size-semantics=FIXED-SIZE, implementation-data-type=uint8
    Dcm_StartDataOut_Routine_Evaluate_Data_Verification_Certificate_Start_routineInfoPrimitiveType: implementation-data-type=uint8
    Dcm_StartDataOut_Routine_Evaluate_Data_Verification_Certificate_Start_routineInfoType: implementation-data-type=Dcm_StartDataOut_Routine_Evaluate_Data_Verification_Certificate_Start_routineInfoPrimitiveType
    Dcm_StartDataOut_Routine_Evaluate_Data_Verification_Certificate_Start_Verification_ResultPrimitiveType: implementation-data-type=uint8
    Dcm_StartDataOut_Routine_Evaluate_Data_Verification_Certificate_Start_Verification_ResultType: implementation-data-type=Dcm_StartDataOut_Routine_Evaluate_Data_Verification_Certificate_Start_Verification_ResultPrimitiveType
    Dcm_StartDataIn_Routine_Verify_Signature_Start_Data_to_be_checkedPrimitiveType: implementation-data-type=uint8
    Dcm_StartDataIn_Routine_Verify_Signature_Start_Data_to_be_checkedType: implementation-data-type=Dcm_StartDataIn_Routine_Verify_Signature_Start_Data_to_be_checkedPrimitiveType
    Dcm_StartDataIn_Routine_Verify_Signature_Start_Signature_ValueArrayType: implementation-data-type=uint8
    Dcm_StartDataOut_Routine_Verify_Signature_Start_routineInfoPrimitiveType: implementation-data-type=uint8
    Dcm_StartDataOut_Routine_Verify_Signature_Start_routineInfoType: implementation-data-type=Dcm_StartDataOut_Routine_Verify_Signature_Start_routineInfoPrimitiveType
    Dcm_StartDataOut_Routine_Verify_Signature_Start_Verification_ResultPrimitiveType: implementation-data-type=uint8
    Dcm_StartDataOut_Routine_Verify_Signature_Start_Verification_ResultType: implementation-data-type=Dcm_StartDataOut_Routine_Verify_Signature_Start_Verification_ResultPrimitiveType
    Dcm_StartFlexibleInArrayData_Routine_Replace_Certificates_Start_CertificatesType: category=ARRAY, sw-calibration-access=READ-ONLY
      element Dcm_StartFlexibleInArrayData_Routine_Replace_Certificates_Start_CertificatesTypeElement: array-size=4008, array-size-semantics=FIXED-SIZE, implementation-data-type=uint8
    Dcm_StartDataOut_Routine_Replace_Certificates_Start_routineInfoPrimitiveType: implementation-data-type=uint8
    Dcm_StartDataOut_Routine_Replace_Certificates_Start_routineInfoType: implementation-data-type=Dcm_StartDataOut_Routine_Replace_Certificates_Start_routineInfoPrimitiveType
    Dcm_StartDataOut_Routine_Replace_Certificates_Start_Verification_ResultPrimitiveType: implementation-data-type=uint8
    Dcm_StartDataOut_Routine_Replace_Certificates_Start_Verification_ResultType: implementation-data-type=Dcm_StartDataOut_Routine_Replace_Certificates_Start_Verification_ResultPrimitiveType
    Dcm_StartDataOut_Routine_Synchronize_Secured_System_Date_and_Time_Start_routineInfoPrimitiveType: implementation-data-type=uint8
    Dcm_StartDataOut_Routine_Synchronize_Secured_System_Date_and_Time_Start_routineInfoType: implementation-data-type=Dcm_StartDataOut_Routine_Synchronize_Secured_System_Date_and_Time_Start_routineInfoPrimitiveType
    Dcm_StartDataOut_Routine_Synchronize_Secured_System_Date_and_Time_Start_NonceArrayType: implementation-data-type=uint8
    Dcm_StartDataOut_Routine_Certificate_Self_Check_Start_routineInfoPrimitiveType: implementation-data-type=uint8
    Dcm_StartDataOut_Routine_Certificate_Self_Check_Start_routineInfoType: implementation-data-type=Dcm_StartDataOut_Routine_Certificate_Self_Check_Start_routineInfoPrimitiveType
    Dcm_StartFlexibleOutArrayData_Routine_Certificate_Self_Check_Start_Verification_ResultType: category=ARRAY, sw-calibration-access=READ-ONLY
      element Dcm_StartFlexibleOutArrayData_Routine_Certificate_Self_Check_Start_Verification_ResultTypeElement: array-size=18, array-size-semantics=FIXED-SIZE, implementation-data-type=uint8
    Dcm_StartFlexibleInArrayData_Routine_Replace_Trust_model_Certificates_Start_Trust_CertificatesType: category=ARRAY, sw-calibration-access=READ-ONLY
      element Dcm_StartFlexibleInArrayData_Routine_Replace_Trust_model_Certificates_Start_Trust_CertificatesTypeElement: array-size=3006, array-size-semantics=FIXED-SIZE, implementation-data-type=uint8
    Dcm_StartDataOut_Routine_Replace_Trust_model_Certificates_Start_routineInfoPrimitiveType: implementation-data-type=uint8
    Dcm_StartDataOut_Routine_Replace_Trust_model_Certificates_Start_routineInfoType: implementation-data-type=Dcm_StartDataOut_Routine_Replace_Trust_model_Certificates_Start_routineInfoPrimitiveType
    Dcm_StartDataOut_Routine_Replace_Trust_model_Certificates_Start_Verification_ResultPrimitiveType: implementation-data-type=uint8
    Dcm_StartDataOut_Routine_Replace_Trust_model_Certificates_Start_Verification_ResultType: implementation-data-type=Dcm_StartDataOut_Routine_Replace_Trust_model_Certificates_Start_Verification_ResultPrimitiveType
    Dcm_StartDataIn_Routine_Replace_Trust_model_Root_Certificate_Start_signature_new_RootArrayType: implementation-data-type=uint8
    Dcm_StartDataIn_Routine_Replace_Trust_model_Root_Certificate_Start_signatureArrayType: implementation-data-type=uint8
    Dcm_StartFlexibleInArrayData_Routine_Replace_Trust_model_Root_Certificate_Start_CertificatesType: category=ARRAY, sw-calibration-access=READ-ONLY
      element Dcm_StartFlexibleInArrayData_Routine_Replace_Trust_model_Root_Certificate_Start_CertificatesTypeElement: array-size=2004, array-size-semantics=FIXED-SIZE, implementation-data-type=uint8
    Dcm_StartDataOut_Routine_Replace_Trust_model_Root_Certificate_Start_routineInfoPrimitiveType: implementation-data-type=uint8
    Dcm_StartDataOut_Routine_Replace_Trust_model_Root_Certificate_Start_routineInfoType: implementation-data-type=Dcm_StartDataOut_Routine_Replace_Trust_model_Root_Certificate_Start_routineInfoPrimitiveType
    Dcm_StartDataOut_Routine_Replace_Trust_model_Root_Certificate_Start_Verification_ResultPrimitiveType: implementation-data-type=uint8
    Dcm_StartDataOut_Routine_Replace_Trust_model_Root_Certificate_Start_Verification_ResultType: implementation-data-type=Dcm_StartDataOut_Routine_Replace_Trust_model_Root_Certificate_Start_Verification_ResultPrimitiveType
    Dcm_StartDataIn_Routine_Trust_Model_SecOC_ECU_Shared_Secret_Distribution_Start_Date_and_TimeArrayType: implementation-data-type=uint8
    Dcm_StartDataIn_Routine_Trust_Model_SecOC_ECU_Shared_Secret_Distribution_Start_Tick_CountArrayType: implementation-data-type=uint8
    Dcm_StartDataIn_Routine_Trust_Model_SecOC_ECU_Shared_Secret_Distribution_Start_Tick_Count_OffsetArrayType: implementation-data-type=uint8
    Dcm_StartDataIn_Routine_Trust_Model_SecOC_ECU_Shared_Secret_Distribution_Start_Encrypted_Nonce_and_Shared_SecretArrayType: implementation-data-type=uint8
    Dcm_StartDataIn_Routine_Trust_Model_SecOC_ECU_Shared_Secret_Distribution_Start_Ephemeral_VSM_Public_KeyArrayType: implementation-data-type=uint8
    Dcm_StartDataIn_Routine_Trust_Model_SecOC_ECU_Shared_Secret_Distribution_Start_Data_SignatureArrayType: implementation-data-type=uint8
    Dcm_StartFlexibleInArrayData_Routine_Trust_Model_SecOC_ECU_Shared_Secret_Distribution_Start_CertificatesType: category=ARRAY, sw-calibration-access=READ-ONLY
      element Dcm_StartFlexibleInArrayData_Routine_Trust_Model_SecOC_ECU_Shared_Secret_Distribution_Start_CertificatesTypeElement: array-size=3006, array-size-semantics=FIXED-SIZE, implementation-data-type=uint8
    Dcm_StartDataOut_Routine_Trust_Model_SecOC_ECU_Shared_Secret_Distribution_Start_routineInfoPrimitiveType: implementation-data-type=uint8
    Dcm_StartDataOut_Routine_Trust_Model_SecOC_ECU_Shared_Secret_Distribution_Start_routineInfoType: implementation-data-type=Dcm_StartDataOut_Routine_Trust_Model_SecOC_ECU_Shared_Secret_Distribution_Start_routineInfoPrimitiveType
    Dcm_StartDataOut_Routine_Trust_Model_SecOC_ECU_Shared_Secret_Distribution_Start_Verification_ResultPrimitiveType: implementation-data-type=uint8
    Dcm_StartDataOut_Routine_Trust_Model_SecOC_ECU_Shared_Secret_Distribution_Start_Verification_ResultType: implementation-data-type=Dcm_StartDataOut_Routine_Trust_Model_SecOC_ECU_Shared_Secret_Distribution_Start_Verification_ResultPrimitiveType
    Dcm_StartDataOut_Routine_Trust_Model_Generate_Key_Pair_Start_routineInfoPrimitiveType: implementation-data-type=uint8
    Dcm_StartDataOut_Routine_Trust_Model_Generate_Key_Pair_Start_routineInfoType: implementation-data-type=Dcm_StartDataOut_Routine_Trust_Model_Generate_Key_Pair_Start_routineInfoPrimitiveType
    Dcm_StartDataOut_Routine_Trust_Model_Generate_Key_Pair_Start_Verification_ResultPrimitiveType: implementation-data-type=uint8
    Dcm_StartDataOut_Routine_Trust_Model_Generate_Key_Pair_Start_Verification_ResultType: implementation-data-type=Dcm_StartDataOut_Routine_Trust_Model_Generate_Key_Pair_Start_Verification_ResultPrimitiveType
    Dcm_StartDataOut_Routine_Trust_Model_Generate_Key_Pair_Start_CSR_SignatureArrayType: implementation-data-type=uint8
    Dcm_StartFlexibleOutArrayData_Routine_Trust_Model_Generate_Key_Pair_Start_Trust_Model_ECU_CSRType: category=ARRAY, sw-calibration-access=READ-ONLY
      element Dcm_StartFlexibleOutArrayData_Routine_Trust_Model_Generate_Key_Pair_Start_Trust_Model_ECU_CSRTypeElement: array-size=1002, array-size-semantics=FIXED-SIZE, implementation-data-type=uint8
    Dcm_StartDataIn_Routine_Get_Certificate_Entry_Start_In_Certificate_EntryPrimitiveType: implementation-data-type=uint8
    Dcm_StartDataIn_Routine_Get_Certificate_Entry_Start_In_Certificate_EntryType: implementation-data-type=Dcm_StartDataIn_Routine_Get_Certificate_Entry_Start_In_Certificate_EntryPrimitiveType
    Dcm_StartDataOut_Routine_Get_Certificate_Entry_Start_routineInfoPrimitiveType: implementation-data-type=uint8
    Dcm_StartDataOut_Routine_Get_Certificate_Entry_Start_routineInfoType: implementation-data-type=Dcm_StartDataOut_Routine_Get_Certificate_Entry_Start_routineInfoPrimitiveType
    Dcm_StartDataOut_Routine_Get_Certificate_Entry_Start_Verification_ResultPrimitiveType: implementation-data-type=uint8
    Dcm_StartDataOut_Routine_Get_Certificate_Entry_Start_Verification_ResultType: implementation-data-type=Dcm_StartDataOut_Routine_Get_Certificate_Entry_Start_Verification_ResultPrimitiveType
    Dcm_StartDataOut_Routine_Get_Certificate_Entry_Start_Out_Certificate_EntryPrimitiveType: implementation-data-type=uint8
    Dcm_StartDataOut_Routine_Get_Certificate_Entry_Start_Out_Certificate_EntryType: implementation-data-type=Dcm_StartDataOut_Routine_Get_Certificate_Entry_Start_Out_Certificate_EntryPrimitiveType
    Dcm_StartFlexibleOutArrayData_Routine_Get_Certificate_Entry_Start_Certificate_ContentType: category=ARRAY, sw-calibration-access=READ-ONLY
      element Dcm_StartFlexibleOutArrayData_Routine_Get_Certificate_Entry_Start_Certificate_ContentTypeElement: array-size=64, array-size-semantics=FIXED-SIZE, implementation-data-type=uint8
    Dcm_StartDataIn_Routine_Status_of_Post_Production_Flag_Start_In_Post_Production_FlagPrimitiveType: implementation-data-type=uint8
    Dcm_StartDataIn_Routine_Status_of_Post_Production_Flag_Start_In_Post_Production_FlagType: implementation-data-type=Dcm_StartDataIn_Routine_Status_of_Post_Production_Flag_Start_In_Post_Production_FlagPrimitiveType
    Dcm_StartDataOut_Routine_Status_of_Post_Production_Flag_Start_routineInfoPrimitiveType: implementation-data-type=uint8
    Dcm_StartDataOut_Routine_Status_of_Post_Production_Flag_Start_routineInfoType: implementation-data-type=Dcm_StartDataOut_Routine_Status_of_Post_Production_Flag_Start_routineInfoPrimitiveType
    Dcm_StartDataOut_Routine_Status_of_Post_Production_Flag_Start_Out_Post_Production_FlagPrimitiveType: implementation-data-type=uint8
    Dcm_StartDataOut_Routine_Status_of_Post_Production_Flag_Start_Out_Post_Production_FlagType: implementation-data-type=Dcm_StartDataOut_Routine_Status_of_Post_Production_Flag_Start_Out_Post_Production_FlagPrimitiveType
    Dcm_StopDataIn_Routine_Status_of_Post_Production_Flag_Start_In_Post_Production_FlagPrimitiveType: implementation-data-type=uint8
    Dcm_StopDataIn_Routine_Status_of_Post_Production_Flag_Start_In_Post_Production_FlagType: implementation-data-type=Dcm_StopDataIn_Routine_Status_of_Post_Production_Flag_Start_In_Post_Production_FlagPrimitiveType
    Dcm_StopDataOut_Routine_Status_of_Post_Production_Flag_Start_routineInfoPrimitiveType: implementation-data-type=uint8
    Dcm_StopDataOut_Routine_Status_of_Post_Production_Flag_Start_routineInfoType: implementation-data-type=Dcm_StopDataOut_Routine_Status_of_Post_Production_Flag_Start_routineInfoPrimitiveType
    Dcm_StopDataOut_Routine_Status_of_Post_Production_Flag_Start_Out_Post_Production_FlagPrimitiveType: implementation-data-type=uint8
    Dcm_StopDataOut_Routine_Status_of_Post_Production_Flag_Start_Out_Post_Production_FlagType: implementation-data-type=Dcm_StopDataOut_Routine_Status_of_Post_Production_Flag_Start_Out_Post_Production_FlagPrimitiveType
    Dcm_RequestDataOut_Routine_Status_of_Post_Production_Flag_Start_routineInfoPrimitiveType: implementation-data-type=uint8
    Dcm_RequestDataOut_Routine_Status_of_Post_Production_Flag_Start_routineInfoType: implementation-data-type=Dcm_RequestDataOut_Routine_Status_of_Post_Production_Flag_Start_routineInfoPrimitiveType
    Dcm_RequestDataOut_Routine_Status_of_Post_Production_Flag_Start_Post_Production_FlagPrimitiveType: implementation-data-type=uint8
    Dcm_RequestDataOut_Routine_Status_of_Post_Production_Flag_Start_Post_Production_FlagType: implementation-data-type=Dcm_RequestDataOut_Routine_Status_of_Post_Production_Flag_Start_Post_Production_FlagPrimitiveType
    Dcm_StartDataIn_Routine_Get_Certificate_Entry_Start_In_Certificate_IdentificationPrimitiveType: implementation-data-type=uint8
    Dcm_StartDataIn_Routine_Get_Certificate_Entry_Start_In_Certificate_IdentificationType: implementation-data-type=Dcm_StartDataIn_Routine_Get_Certificate_Entry_Start_In_Certificate_IdentificationPrimitiveType
    Dcm_StartDataOut_Routine_Get_Certificate_Entry_Start_Out_Certificate_IdentificationPrimitiveType: implementation-data-type=uint8
    Dcm_StartDataOut_Routine_Get_Certificate_Entry_Start_Out_Certificate_IdentificationType: implementation-data-type=Dcm_StartDataOut_Routine_Get_Certificate_Entry_Start_Out_Certificate_IdentificationPrimitiveType
    Dcm_StartDataOut_Routine_Trigger_Presafe_Display_Request_Start_routineInfoPrimitiveType: implementation-data-type=uint8
    Dcm_StartDataOut_Routine_Trigger_Presafe_Display_Request_Start_routineInfoType: implementation-data-type=Dcm_StartDataOut_Routine_Trigger_Presafe_Display_Request_Start_routineInfoPrimitiveType
    Dcm_StartDataOut_Routine_Trigger_Presafe_Display_Request_Start_ResultPrimitiveType: implementation-data-type=uint8
    Dcm_StartDataOut_Routine_Trigger_Presafe_Display_Request_Start_ResultType: implementation-data-type=Dcm_StartDataOut_Routine_Trigger_Presafe_Display_Request_Start_ResultPrimitiveType
    Dcm_StopDataOut_Routine_Trigger_Presafe_Display_Request_Start_routineInfoPrimitiveType: implementation-data-type=uint8
    Dcm_StopDataOut_Routine_Trigger_Presafe_Display_Request_Start_routineInfoType: implementation-data-type=Dcm_StopDataOut_Routine_Trigger_Presafe_Display_Request_Start_routineInfoPrimitiveType
    Dcm_RequestDataOut_Routine_Trigger_Presafe_Display_Request_Start_routineInfoPrimitiveType: implementation-data-type=uint8
    Dcm_RequestDataOut_Routine_Trigger_Presafe_Display_Request_Start_routineInfoType: implementation-data-type=Dcm_RequestDataOut_Routine_Trigger_Presafe_Display_Request_Start_routineInfoPrimitiveType
    Dcm_RequestDataOut_Routine_Trigger_Presafe_Display_Request_Start_ResultPrimitiveType: implementation-data-type=uint8
    Dcm_RequestDataOut_Routine_Trigger_Presafe_Display_Request_Start_ResultType: implementation-data-type=Dcm_RequestDataOut_Routine_Trigger_Presafe_Display_Request_Start_ResultPrimitiveType
    Dcm_StartDataOut_Routine_Trigger_BSR_Start_routineInfoPrimitiveType: implementation-data-type=uint8
    Dcm_StartDataOut_Routine_Trigger_BSR_Start_routineInfoType: implementation-data-type=Dcm_StartDataOut_Routine_Trigger_BSR_Start_routineInfoPrimitiveType
    Dcm_StartDataOut_Routine_Trigger_BSR_Start_ResultPrimitiveType: implementation-data-type=uint8
    Dcm_StartDataOut_Routine_Trigger_BSR_Start_ResultType: implementation-data-type=Dcm_StartDataOut_Routine_Trigger_BSR_Start_ResultPrimitiveType
    Dcm_StopDataOut_Routine_Trigger_BSR_Start_routineInfoPrimitiveType: implementation-data-type=uint8
    Dcm_StopDataOut_Routine_Trigger_BSR_Start_routineInfoType: implementation-data-type=Dcm_StopDataOut_Routine_Trigger_BSR_Start_routineInfoPrimitiveType
    Dcm_RequestDataOut_Routine_Trigger_BSR_Start_routineInfoPrimitiveType: implementation-data-type=uint8
    Dcm_RequestDataOut_Routine_Trigger_BSR_Start_routineInfoType: implementation-data-type=Dcm_RequestDataOut_Routine_Trigger_BSR_Start_routineInfoPrimitiveType
    Dcm_RequestDataOut_Routine_Trigger_BSR_Start_ResultPrimitiveType: implementation-data-type=uint8
    Dcm_RequestDataOut_Routine_Trigger_BSR_Start_ResultType: implementation-data-type=Dcm_RequestDataOut_Routine_Trigger_BSR_Start_ResultPrimitiveType
    Dcm_StartDataIn_Routine_Trigger_Tensioning_Cycle_Start_Type_of_tensioning_cyclePrimitiveType: implementation-data-type=uint8
    Dcm_StartDataIn_Routine_Trigger_Tensioning_Cycle_Start_Type_of_tensioning_cycleType: implementation-data-type=Dcm_StartDataIn_Routine_Trigger_Tensioning_Cycle_Start_Type_of_tensioning_cyclePrimitiveType
    Dcm_StartDataIn_Routine_Trigger_Tensioning_Cycle_Start_PreSafe_DurationPrimitiveType: implementation-data-type=uint8
    Dcm_StartDataIn_Routine_Trigger_Tensioning_Cycle_Start_PreSafe_DurationType: implementation-data-type=Dcm_StartDataIn_Routine_Trigger_Tensioning_Cycle_Start_PreSafe_DurationPrimitiveType
    Dcm_StartDataOut_Routine_Trigger_Tensioning_Cycle_Start_routineInfoPrimitiveType: implementation-data-type=uint8
    Dcm_StartDataOut_Routine_Trigger_Tensioning_Cycle_Start_routineInfoType: implementation-data-type=Dcm_StartDataOut_Routine_Trigger_Tensioning_Cycle_Start_routineInfoPrimitiveType
    Dcm_StartDataOut_Routine_Trigger_Tensioning_Cycle_Start_ResultPrimitiveType: implementation-data-type=uint8
    Dcm_StartDataOut_Routine_Trigger_Tensioning_Cycle_Start_ResultType: implementation-data-type=Dcm_StartDataOut_Routine_Trigger_Tensioning_Cycle_Start_ResultPrimitiveType
    Dcm_StopDataOut_Routine_Trigger_Tensioning_Cycle_Start_routineInfoPrimitiveType: implementation-data-type=uint8
    Dcm_StopDataOut_Routine_Trigger_Tensioning_Cycle_Start_routineInfoType: implementation-data-type=Dcm_StopDataOut_Routine_Trigger_Tensioning_Cycle_Start_routineInfoPrimitiveType
    Dcm_RequestDataOut_Routine_Trigger_Tensioning_Cycle_Start_routineInfoPrimitiveType: implementation-data-type=uint8
    Dcm_RequestDataOut_Routine_Trigger_Tensioning_Cycle_Start_routineInfoType: implementation-data-type=Dcm_RequestDataOut_Routine_Trigger_Tensioning_Cycle_Start_routineInfoPrimitiveType
    Dcm_RequestDataOut_Routine_Trigger_Tensioning_Cycle_Start_ResultPrimitiveType: implementation-data-type=uint8
    Dcm_RequestDataOut_Routine_Trigger_Tensioning_Cycle_Start_ResultType: implementation-data-type=Dcm_RequestDataOut_Routine_Trigger_Tensioning_Cycle_Start_ResultPrimitiveType
    Dcm_Data508ByteType: category=ARRAY, sw-calibration-access=READ-ONLY
      element Dcm_Data508ByteTypeElement: array-size=508, array-size-semantics=FIXED-SIZE, implementation-data-type=uint8
    Dcm_Data1024ByteType: category=ARRAY, sw-calibration-access=READ-ONLY
      element Dcm_Data1024ByteTypeElement: array-size=1024, array-size-semantics=FIXED-SIZE, implementation-data-type=uint8
    Dcm_Data1270ByteType: category=ARRAY, sw-calibration-access=READ-ONLY
      element Dcm_Data1270ByteTypeElement: array-size=1270, array-size-semantics=FIXED-SIZE, implementation-data-type=uint8
    Dcm_Data2540ByteType: category=ARRAY, sw-calibration-access=READ-ONLY
      element Dcm_Data2540ByteTypeElement: array-size=2540, array-size-semantics=FIXED-SIZE, implementation-data-type=uint8
    Dcm_Data8ByteType: category=ARRAY, sw-calibration-access=READ-ONLY
      element Dcm_Data8ByteTypeElement: array-size=8, array-size-semantics=FIXED-SIZE, implementation-data-type=uint8
    Dcm_StartDataIn_Routine_Cycle_Execution_Start_CyclePrimitiveType: implementation-data-type=uint8
    Dcm_StartDataIn_Routine_Cycle_Execution_Start_CycleType: implementation-data-type=Dcm_StartDataIn_Routine_Cycle_Execution_Start_CyclePrimitiveType
    Dcm_StartDataOut_Routine_Cycle_Execution_Start_routineInfoPrimitiveType: implementation-data-type=uint8
    Dcm_StartDataOut_Routine_Cycle_Execution_Start_routineInfoType: implementation-data-type=Dcm_StartDataOut_Routine_Cycle_Execution_Start_routineInfoPrimitiveType
    Dcm_StopDataOut_Routine_Cycle_Execution_Start_routineInfoPrimitiveType: implementation-data-type=uint8
    Dcm_StopDataOut_Routine_Cycle_Execution_Start_routineInfoType: implementation-data-type=Dcm_StopDataOut_Routine_Cycle_Execution_Start_routineInfoPrimitiveType
    Dcm_RequestDataOut_Routine_Cycle_Execution_Start_routineInfoPrimitiveType: implementation-data-type=uint8
    Dcm_RequestDataOut_Routine_Cycle_Execution_Start_routineInfoType: implementation-data-type=Dcm_RequestDataOut_Routine_Cycle_Execution_Start_routineInfoPrimitiveType
    Dcm_RequestDataOut_Routine_Cycle_Execution_Start_Executed_CyclePrimitiveType: implementation-data-type=uint8
    Dcm_RequestDataOut_Routine_Cycle_Execution_Start_Executed_CycleType: implementation-data-type=Dcm_RequestDataOut_Routine_Cycle_Execution_Start_Executed_CyclePrimitiveType
    Dcm_Data40ByteType: category=ARRAY, sw-calibration-access=READ-ONLY
      element Dcm_Data40ByteTypeElement: array-size=40, array-size-semantics=FIXED-SIZE, implementation-data-type=uint8
    Dcm_Data240ByteType: category=ARRAY, sw-calibration-access=READ-ONLY
      element Dcm_Data240ByteTypeElement: array-size=240, array-size-semantics=FIXED-SIZE, implementation-data-type=uint8
    Dcm_StartDataOut_Routine_Clear_Resource_Consumption_Data_Start_routineInfoPrimitiveType: implementation-data-type=uint8
    Dcm_StartDataOut_Routine_Clear_Resource_Consumption_Data_Start_routineInfoType: implementation-data-type=Dcm_StartDataOut_Routine_Clear_Resource_Consumption_Data_Start_routineInfoPrimitiveType
    Dcm_Data144ByteType: category=ARRAY, sw-calibration-access=READ-ONLY
      element Dcm_Data144ByteTypeElement: array-size=144, array-size-semantics=FIXED-SIZE, implementation-data-type=uint8
    Dcm_Data4095ByteType: category=ARRAY, sw-calibration-access=READ-ONLY
      element Dcm_Data4095ByteTypeElement: array-size=4095, array-size-semantics=FIXED-SIZE, implementation-data-type=uint8
    Dcm_Data420ByteType: category=ARRAY, sw-calibration-access=READ-ONLY
      element Dcm_Data420ByteTypeElement: array-size=420, array-size-semantics=FIXED-SIZE, implementation-data-type=uint8
    Dcm_Data1160ByteType: category=ARRAY, sw-calibration-access=READ-ONLY
      element Dcm_Data1160ByteTypeElement: array-size=1160, array-size-semantics=FIXED-SIZE, implementation-data-type=uint8
    Dcm_StartDataIn_Routine_Verify_Signature_Start_Signature_ValueType: category=ARRAY, sw-calibration-access=READ-ONLY
      element Dcm_StartDataIn_Routine_Verify_Signature_Start_Signature_ValueTypeElement: array-size=64, array-size-semantics=FIXED-SIZE, implementation-data-type=Dcm_StartDataIn_Routine_Verify_Signature_Start_Signature_ValueArrayType
    Dcm_StartDataOut_Routine_Synchronize_Secured_System_Date_and_Time_Start_NonceType: category=ARRAY, sw-calibration-access=READ-ONLY
      element Dcm_StartDataOut_Routine_Synchronize_Secured_System_Date_and_Time_Start_NonceTypeElement: array-size=32, array-size-semantics=FIXED-SIZE, implementation-data-type=Dcm_StartDataOut_Routine_Synchronize_Secured_System_Date_and_Time_Start_NonceArrayType
    Dcm_StartDataIn_Routine_Replace_Trust_model_Root_Certificate_Start_signature_new_RootType: category=ARRAY, sw-calibration-access=READ-ONLY
      element Dcm_StartDataIn_Routine_Replace_Trust_model_Root_Certificate_Start_signature_new_RootTypeElement: array-size=64, array-size-semantics=FIXED-SIZE, implementation-data-type=Dcm_StartDataIn_Routine_Replace_Trust_model_Root_Certificate_Start_signature_new_RootArrayType
    Dcm_StartDataIn_Routine_Replace_Trust_model_Root_Certificate_Start_signatureType: category=ARRAY, sw-calibration-access=READ-ONLY
      element Dcm_StartDataIn_Routine_Replace_Trust_model_Root_Certificate_Start_signatureTypeElement: array-size=64, array-size-semantics=FIXED-SIZE, implementation-data-type=Dcm_StartDataIn_Routine_Replace_Trust_model_Root_Certificate_Start_signatureArrayType
    Dcm_StartDataIn_Routine_Trust_Model_SecOC_ECU_Shared_Secret_Distribution_Start_Date_and_TimeType: category=ARRAY, sw-calibration-access=READ-ONLY
      element Dcm_StartDataIn_Routine_Trust_Model_SecOC_ECU_Shared_Secret_Distribution_Start_Date_and_TimeTypeElement: array-size=7, array-size-semantics=FIXED-SIZE, implementation-data-type=Dcm_StartDataIn_Routine_Trust_Model_SecOC_ECU_Shared_Secret_Distribution_Start_Date_and_TimeArrayType
    Dcm_StartDataIn_Routine_Trust_Model_SecOC_ECU_Shared_Secret_Distribution_Start_Tick_CountType: category=ARRAY, sw-calibration-access=READ-ONLY
      element Dcm_StartDataIn_Routine_Trust_Model_SecOC_ECU_Shared_Secret_Distribution_Start_Tick_CountTypeElement: array-size=5, array-size-semantics=FIXED-SIZE, implementation-data-type=Dcm_StartDataIn_Routine_Trust_Model_SecOC_ECU_Shared_Secret_Distribution_Start_Tick_CountArrayType
    Dcm_StartDataIn_Routine_Trust_Model_SecOC_ECU_Shared_Secret_Distribution_Start_Tick_Count_OffsetType: category=ARRAY, sw-calibration-access=READ-ONLY
      element Dcm_StartDataIn_Routine_Trust_Model_SecOC_ECU_Shared_Secret_Distribution_Start_Tick_Count_OffsetTypeElement: array-size=5, array-size-semantics=FIXED-SIZE, implementation-data-type=Dcm_StartDataIn_Routine_Trust_Model_SecOC_ECU_Shared_Secret_Distribution_Start_Tick_Count_OffsetArrayType
    Dcm_StartDataIn_Routine_Trust_Model_SecOC_ECU_Shared_Secret_Distribution_Start_Encrypted_Nonce_and_Shared_SecretType: category=ARRAY, sw-calibration-access=READ-ONLY
      element Dcm_StartDataIn_Routine_Trust_Model_SecOC_ECU_Shared_Secret_Distribution_Start_Encrypted_Nonce_and_Shared_SecretTypeElement: array-size=80, array-size-semantics=FIXED-SIZE, implementation-data-type=Dcm_StartDataIn_Routine_Trust_Model_SecOC_ECU_Shared_Secret_Distribution_Start_Encrypted_Nonce_and_Shared_SecretArrayType
    Dcm_StartDataIn_Routine_Trust_Model_SecOC_ECU_Shared_Secret_Distribution_Start_Ephemeral_VSM_Public_KeyType: category=ARRAY, sw-calibration-access=READ-ONLY
      element Dcm_StartDataIn_Routine_Trust_Model_SecOC_ECU_Shared_Secret_Distribution_Start_Ephemeral_VSM_Public_KeyTypeElement: array-size=32, array-size-semantics=FIXED-SIZE, implementation-data-type=Dcm_StartDataIn_Routine_Trust_Model_SecOC_ECU_Shared_Secret_Distribution_Start_Ephemeral_VSM_Public_KeyArrayType
    Dcm_StartDataIn_Routine_Trust_Model_SecOC_ECU_Shared_Secret_Distribution_Start_Data_SignatureType: category=ARRAY, sw-calibration-access=READ-ONLY
      element Dcm_StartDataIn_Routine_Trust_Model_SecOC_ECU_Shared_Secret_Distribution_Start_Data_SignatureTypeElement: array-size=64, array-size-semantics=FIXED-SIZE, implementation-data-type=Dcm_StartDataIn_Routine_Trust_Model_SecOC_ECU_Shared_Secret_Distribution_Start_Data_SignatureArrayType
    Dcm_StartDataOut_Routine_Trust_Model_Generate_Key_Pair_Start_CSR_SignatureType: category=ARRAY, sw-calibration-access=READ-ONLY
      element Dcm_StartDataOut_Routine_Trust_Model_Generate_Key_Pair_Start_CSR_SignatureTypeElement: array-size=64, array-size-semantics=FIXED-SIZE, implementation-data-type=Dcm_StartDataOut_Routine_Trust_Model_Generate_Key_Pair_Start_CSR_SignatureArrayType
    Dcm_Data2613ByteType: category=ARRAY, sw-calibration-access=READ-ONLY
      element Dcm_Data2613ByteTypeElement: array-size=2613, array-size-semantics=FIXED-SIZE, implementation-data-type=uint8
    Dcm_Data233ByteType: category=ARRAY, sw-calibration-access=READ-ONLY
      element Dcm_Data233ByteTypeElement: array-size=233, array-size-semantics=FIXED-SIZE, implementation-data-type=uint8
    Dcm_Data1073ByteType: category=ARRAY, sw-calibration-access=READ-ONLY
      element Dcm_Data1073ByteTypeElement: array-size=1073, array-size-semantics=FIXED-SIZE, implementation-data-type=uint8
    Dcm_SesCtrlType: compu {1=DCM_DEFAULT_SESSION, 2=DCM_PROGRAMMING_SESSION, 3=DCM_EXTENDED_DIAGNOSTIC_SESSION, 126=DCM_Development}, range raw 0..126, implementation-data-type=uint8
    Dcm_DiagnosticSessionControlType: compu {1=DCM_ENUM_DEFAULT_SESSION, 2=DCM_ENUM_PROGRAMMING_SESSION, 3=DCM_ENUM_EXTENDED_SESSION, 126=DCM_ENUM_Development}, range raw 0..255, implementation-data-type=uint8
    Dcm_Data320ByteType: category=ARRAY, sw-calibration-access=READ-ONLY
      element Dcm_Data320ByteTypeElement: array-size=320, array-size-semantics=FIXED-SIZE, implementation-data-type=uint8
    Dcm_Data510ByteType: category=ARRAY, sw-calibration-access=READ-ONLY
      element Dcm_Data510ByteTypeElement: array-size=510, array-size-semantics=FIXED-SIZE, implementation-data-type=uint8
    Dcm_Data4080ByteType: category=ARRAY, sw-calibration-access=READ-ONLY
      element Dcm_Data4080ByteTypeElement: array-size=4080, array-size-semantics=FIXED-SIZE, implementation-data-type=uint8
    Dcm_Data3060ByteType: category=ARRAY, sw-calibration-access=READ-ONLY
      element Dcm_Data3060ByteTypeElement: array-size=3060, array-size-semantics=FIXED-SIZE, implementation-data-type=uint8
    Dcm_Data1275ByteType: category=ARRAY, sw-calibration-access=READ-ONLY
      element Dcm_Data1275ByteTypeElement: array-size=1275, array-size-semantics=FIXED-SIZE, implementation-data-type=uint8
    Dcm_StartDataOut_Routine_Erase_All_Start_routineInfoPrimitiveType: implementation-data-type=uint8
    Dcm_StartDataOut_Routine_Erase_All_Start_routineInfoType: implementation-data-type=Dcm_StartDataOut_Routine_Erase_All_Start_routineInfoPrimitiveType
    Dcm_StartDataOut_Routine_Erase_All_Start_StatusPrimitiveType: implementation-data-type=uint8
    Dcm_StartDataOut_Routine_Erase_All_Start_StatusType: implementation-data-type=Dcm_StartDataOut_Routine_Erase_All_Start_StatusPrimitiveType
    Dcm_StartDataOut_Routine_Force_External_WDG_Start_routineInfoPrimitiveType: implementation-data-type=uint8
    Dcm_StartDataOut_Routine_Force_External_WDG_Start_routineInfoType: implementation-data-type=Dcm_StartDataOut_Routine_Force_External_WDG_Start_routineInfoPrimitiveType
    Dcm_StartDataOut_Routine_Force_External_WDG_Start_StatusPrimitiveType: implementation-data-type=uint8
    Dcm_StartDataOut_Routine_Force_External_WDG_Start_StatusType: implementation-data-type=Dcm_StartDataOut_Routine_Force_External_WDG_Start_StatusPrimitiveType
    Dcm_Data258ByteType: category=ARRAY, sw-calibration-access=READ-ONLY
      element Dcm_Data258ByteTypeElement: array-size=258, array-size-semantics=FIXED-SIZE, implementation-data-type=uint8
package /MICROSAR/Dcm_swc/Interfaces
  5 x mode switch interface, all with is-service=true, service-kind=DIAGNOSTIC-COMMUNICATION-MANAGER:
    DcmControlDtcSetting
      mode group DcmControlDtcSetting: type=DcmControlDtcSetting
    DcmEcuReset
      mode group DcmEcuReset: type=DcmEcuReset
    DcmModeRapidPowerShutDown
      mode group DcmModeRapidPowerShutDown: type=DcmModeRapidPowerShutDown
    DcmDiagnosticSessionControl
      mode group DcmDiagnosticSessionControl: type=DcmDiagnosticSessionControl
    DcmCommunicationControl_ComMConf_ComMChannel_RBTM_FL_BODY3_8uqv9blm85ehm0msat385m76v_03d5f5f6
      mode group DcmCommunicationControl_ComMConf_ComMChannel_RBTM_FL_BODY3_8uqv9blm85ehm0msat385m76v_03d5f5f6: type=DcmCommunicationControl
  137 x client server interface, all with is-service=true, service-kind=DIAGNOSTIC-COMMUNICATION-MANAGER:
    DCMServices
      5 x operation:
        GetActiveProtocol: possible-error=E_OK
          arg ActiveProtocol: type=Dcm_ProtocolType, direction=OUT
        GetSesCtrlType: possible-error=E_OK
          arg SesCtrlType: type=Dcm_SesCtrlType, direction=OUT
        ResetToDefaultSession: possible-error=E_OK
        SetActiveDiagnostic: possible-error=E_OK
          arg active: type=boolean, direction=IN
        GetRequestKind: possible-error=DCMServices/E_NOT_OK
          arg TesterSourceAddress: type=uint16, direction=IN
          arg RequestKind: type=Dcm_RequestKindType, direction=OUT
      error E_OK: error-code=0
      error E_NOT_OK: error-code=1
    RoutineServices_Routine_Check_Reprogramming_Preconditions_Start
      operation Start: possible-error=[RoutineServices_Routine_Check_Reprogramming_Preconditions_Start/E_NOT_OK, RoutineServices_Routine_Check_Reprogramming_Preconditions_Start/DCM_E_PENDING, RoutineServices_Routine_Check_Reprogramming_Preconditions_Start/DCM_E_FORCE_RCRRP]
        6 x arg:
          OpStatus: type=Dcm_OpStatusType, direction=IN
          routineInfo: type=Dcm_StartDataOut_Routine_Check_Reprogramming_Preconditions_Start_routineInfoType, direction=OUT
          Number_of_Unfulfilled_Preconditions: type=Dcm_StartDataOut_Routine_Check_Reprogramming_Preconditions_Start_Number_of_Unfulfilled_PreconditionsType, direction=OUT
          List_of_Preconditions: type=Dcm_StartFlexibleOutArrayData_Routine_Check_Reprogramming_Preconditions_Start_List_of_PreconditionsType, direction=OUT
          DataLength: type=uint16, direction=OUT
          ErrorCode: type=Dcm_NegativeResponseCodeType, direction=OUT
      error E_NOT_OK: error-code=1
      error DCM_E_PENDING: error-code=10
      error DCM_E_FORCE_RCRRP: error-code=12
    RoutineServices_Routine_PreCheckProgrammingDependencies_Start
      operation Start: possible-error=[RoutineServices_Routine_PreCheckProgrammingDependencies_Start/E_NOT_OK, RoutineServices_Routine_PreCheckProgrammingDependencies_Start/DCM_E_PENDING, RoutineServices_Routine_PreCheckProgrammingDependencies_Start/DCM_E_FORCE_RCRRP]
        6 x arg:
          Pre_Check_Informations: type=Dcm_StartFlexibleInArrayData_Routine_PreCheckProgrammingDependencies_Start_Pre_Check_InformationsType, direction=IN
          OpStatus: type=Dcm_OpStatusType, direction=IN
          routineInfo: type=Dcm_StartDataOut_Routine_PreCheckProgrammingDependencies_Start_routineInfoType, direction=OUT
          Dependencies_Verification_Check_Result: type=Dcm_StartDataOut_Routine_PreCheckProgrammingDependencies_Start_Dependencies_Verification_Check_ResultType, direction=OUT
          DataLength: type=uint16, direction=IN
          ErrorCode: type=Dcm_NegativeResponseCodeType, direction=OUT
      error E_NOT_OK: error-code=1
      error DCM_E_PENDING: error-code=10
      error DCM_E_FORCE_RCRRP: error-code=12
    RoutineServices_Routine_Reset_VINDataIdentifier_Start
      operation Start: possible-error=[RoutineServices_Routine_Reset_VINDataIdentifier_Start/E_NOT_OK, RoutineServices_Routine_Reset_VINDataIdentifier_Start/DCM_E_PENDING, RoutineServices_Routine_Reset_VINDataIdentifier_Start/DCM_E_FORCE_RCRRP]
        arg OpStatus: type=Dcm_OpStatusType, direction=IN
        arg routineInfo: type=Dcm_StartDataOut_Routine_Reset_VINDataIdentifier_Start_routineInfoType, direction=OUT
        arg ErrorCode: type=Dcm_NegativeResponseCodeType, direction=OUT
      error E_NOT_OK: error-code=1
      error DCM_E_PENDING: error-code=10
      error DCM_E_FORCE_RCRRP: error-code=12
    RoutineServices_Routine_Synchronize_to_Non_volatile_Memory_Start
      operation Start: possible-error=[RoutineServices_Routine_Synchronize_to_Non_volatile_Memory_Start/E_NOT_OK, RoutineServices_Routine_Synchronize_to_Non_volatile_Memory_Start/DCM_E_PENDING, RoutineServices_Routine_Synchronize_to_Non_volatile_Memory_Start/DCM_E_FORCE_RCRRP]
        arg OpStatus: type=Dcm_OpStatusType, direction=IN
        arg routineInfo: type=Dcm_StartDataOut_Routine_Synchronize_to_Non_volatile_Memory_Start_routineInfoType, direction=OUT
        arg ErrorCode: type=Dcm_NegativeResponseCodeType, direction=OUT
      operation Stop: possible-error=[RoutineServices_Routine_Synchronize_to_Non_volatile_Memory_Start/E_NOT_OK, RoutineServices_Routine_Synchronize_to_Non_volatile_Memory_Start/DCM_E_PENDING, RoutineServices_Routine_Synchronize_to_Non_volatile_Memory_Start/DCM_E_FORCE_RCRRP]
        arg OpStatus: type=Dcm_OpStatusType, direction=IN
        arg routineInfo: type=Dcm_StopDataOut_Routine_Synchronize_to_Non_volatile_Memory_Start_routineInfoType, direction=OUT
        arg ErrorCode: type=Dcm_NegativeResponseCodeType, direction=OUT
      operation RequestResults: possible-error=[RoutineServices_Routine_Synchronize_to_Non_volatile_Memory_Start/E_NOT_OK, RoutineServices_Routine_Synchronize_to_Non_volatile_Memory_Start/DCM_E_PENDING, RoutineServices_Routine_Synchronize_to_Non_volatile_Memory_Start/DCM_E_FORCE_RCRRP]
        arg OpStatus: type=Dcm_OpStatusType, direction=IN
        arg routineInfo: type=Dcm_RequestDataOut_Routine_Synchronize_to_Non_volatile_Memory_Start_routineInfoType, direction=OUT
        arg ErrorCode: type=Dcm_NegativeResponseCodeType, direction=OUT
      error E_NOT_OK: error-code=1
      error DCM_E_PENDING: error-code=10
      error DCM_E_FORCE_RCRRP: error-code=12
    RoutineServices_Routine_Authenticate_Diagnostic_User_or_Tester_Start
      operation Start: possible-error=[RoutineServices_Routine_Authenticate_Diagnostic_User_or_Tester_Start/E_NOT_OK, RoutineServices_Routine_Authenticate_Diagnostic_User_or_Tester_Start/DCM_E_PENDING, RoutineServices_Routine_Authenticate_Diagnostic_User_or_Tester_Start/DCM_E_FORCE_RCRRP]
        9 x arg:
          Configuration: type=Dcm_StartDataIn_Routine_Authenticate_Diagnostic_User_or_Tester_Start_ConfigurationType, direction=IN
          Task: type=Dcm_StartDataIn_Routine_Authenticate_Diagnostic_User_or_Tester_Start_TaskType, direction=IN
          Tester_Authentication: type=Dcm_StartFlexibleInArrayData_Routine_Authenticate_Diagnostic_User_or_Tester_Start_Tester_AuthenticationType, direction=IN
          OpStatus: type=Dcm_OpStatusType, direction=IN
          routineInfo: type=Dcm_StartDataOut_Routine_Authenticate_Diagnostic_User_or_Tester_Start_routineInfoType, direction=OUT
          Verification_Result: type=Dcm_StartDataOut_Routine_Authenticate_Diagnostic_User_or_Tester_Start_Verification_ResultType, direction=OUT
          Authentication_Result: type=Dcm_StartFlexibleOutArrayData_Routine_Authenticate_Diagnostic_User_or_Tester_Start_Authentication_ResultType, direction=OUT
          DataLength: type=uint16, direction=INOUT
          ErrorCode: type=Dcm_NegativeResponseCodeType, direction=OUT
      error E_NOT_OK: error-code=1
      error DCM_E_PENDING: error-code=10
      error DCM_E_FORCE_RCRRP: error-code=12
    RoutineServices_Routine_Enhance_Access_Rights_Start
      operation Start: possible-error=[RoutineServices_Routine_Enhance_Access_Rights_Start/E_NOT_OK, RoutineServices_Routine_Enhance_Access_Rights_Start/DCM_E_PENDING, RoutineServices_Routine_Enhance_Access_Rights_Start/DCM_E_FORCE_RCRRP]
        6 x arg:
          Enhanced_Rights_Certificate: type=Dcm_StartFlexibleInArrayData_Routine_Enhance_Access_Rights_Start_Enhanced_Rights_CertificateType, direction=IN
          OpStatus: type=Dcm_OpStatusType, direction=IN
          routineInfo: type=Dcm_StartDataOut_Routine_Enhance_Access_Rights_Start_routineInfoType, direction=OUT
          Verification_Result: type=Dcm_StartDataOut_Routine_Enhance_Access_Rights_Start_Verification_ResultType, direction=OUT
          DataLength: type=uint16, direction=IN
          ErrorCode: type=Dcm_NegativeResponseCodeType, direction=OUT
      error E_NOT_OK: error-code=1
      error DCM_E_PENDING: error-code=10
      error DCM_E_FORCE_RCRRP: error-code=12
    RoutineServices_Routine_Evaluate_Data_Verification_Certificate_Start
      operation Start: possible-error=[RoutineServices_Routine_Evaluate_Data_Verification_Certificate_Start/E_NOT_OK, RoutineServices_Routine_Evaluate_Data_Verification_Certificate_Start/DCM_E_PENDING, RoutineServices_Routine_Evaluate_Data_Verification_Certificate_Start/DCM_E_FORCE_RCRRP]
        6 x arg:
          Data_Verification_Certificate: type=Dcm_StartFlexibleInArrayData_Routine_Evaluate_Data_Verification_Certificate_Start_Data_Verification_CertificateType, direction=IN
          OpStatus: type=Dcm_OpStatusType, direction=IN
          routineInfo: type=Dcm_StartDataOut_Routine_Evaluate_Data_Verification_Certificate_Start_routineInfoType, direction=OUT
          Verification_Result: type=Dcm_StartDataOut_Routine_Evaluate_Data_Verification_Certificate_Start_Verification_ResultType, direction=OUT
          DataLength: type=uint16, direction=IN
          ErrorCode: type=Dcm_NegativeResponseCodeType, direction=OUT
      error E_NOT_OK: error-code=1
      error DCM_E_PENDING: error-code=10
      error DCM_E_FORCE_RCRRP: error-code=12
    RoutineServices_Routine_Verify_Signature_Start
      operation Start: possible-error=[RoutineServices_Routine_Verify_Signature_Start/E_NOT_OK, RoutineServices_Routine_Verify_Signature_Start/DCM_E_PENDING, RoutineServices_Routine_Verify_Signature_Start/DCM_E_FORCE_RCRRP]
        6 x arg:
          Data_to_be_checked: type=Dcm_StartDataIn_Routine_Verify_Signature_Start_Data_to_be_checkedType, direction=IN
          Signature_Value: type=Dcm_StartDataIn_Routine_Verify_Signature_Start_Signature_ValueType, direction=IN
          OpStatus: type=Dcm_OpStatusType, direction=IN
          routineInfo: type=Dcm_StartDataOut_Routine_Verify_Signature_Start_routineInfoType, direction=OUT
          Verification_Result: type=Dcm_StartDataOut_Routine_Verify_Signature_Start_Verification_ResultType, direction=OUT
          ErrorCode: type=Dcm_NegativeResponseCodeType, direction=OUT
      error E_NOT_OK: error-code=1
      error DCM_E_PENDING: error-code=10
      error DCM_E_FORCE_RCRRP: error-code=12
    RoutineServices_Routine_Replace_Certificates_Start
      operation Start: possible-error=[RoutineServices_Routine_Replace_Certificates_Start/E_NOT_OK, RoutineServices_Routine_Replace_Certificates_Start/DCM_E_PENDING, RoutineServices_Routine_Replace_Certificates_Start/DCM_E_FORCE_RCRRP]
        6 x arg:
          Certificates: type=Dcm_StartFlexibleInArrayData_Routine_Replace_Certificates_Start_CertificatesType, direction=IN
          OpStatus: type=Dcm_OpStatusType, direction=IN
          routineInfo: type=Dcm_StartDataOut_Routine_Replace_Certificates_Start_routineInfoType, direction=OUT
          Verification_Result: type=Dcm_StartDataOut_Routine_Replace_Certificates_Start_Verification_ResultType, direction=OUT
          DataLength: type=uint16, direction=IN
          ErrorCode: type=Dcm_NegativeResponseCodeType, direction=OUT
      error E_NOT_OK: error-code=1
      error DCM_E_PENDING: error-code=10
      error DCM_E_FORCE_RCRRP: error-code=12
    RoutineServices_Routine_Synchronize_Secured_System_Date_and_Time_Start
      operation Start: possible-error=[RoutineServices_Routine_Synchronize_Secured_System_Date_and_Time_Start/E_NOT_OK, RoutineServices_Routine_Synchronize_Secured_System_Date_and_Time_Start/DCM_E_PENDING, RoutineServices_Routine_Synchronize_Secured_System_Date_and_Time_Start/DCM_E_FORCE_RCRRP]
        4 x arg:
          OpStatus: type=Dcm_OpStatusType, direction=IN
          routineInfo: type=Dcm_StartDataOut_Routine_Synchronize_Secured_System_Date_and_Time_Start_routineInfoType, direction=OUT
          Nonce: type=Dcm_StartDataOut_Routine_Synchronize_Secured_System_Date_and_Time_Start_NonceType, direction=OUT
          ErrorCode: type=Dcm_NegativeResponseCodeType, direction=OUT
      error E_NOT_OK: error-code=1
      error DCM_E_PENDING: error-code=10
      error DCM_E_FORCE_RCRRP: error-code=12
    RoutineServices_Routine_Certificate_Self_Check_Start
      operation Start: possible-error=[RoutineServices_Routine_Certificate_Self_Check_Start/E_NOT_OK, RoutineServices_Routine_Certificate_Self_Check_Start/DCM_E_PENDING, RoutineServices_Routine_Certificate_Self_Check_Start/DCM_E_FORCE_RCRRP]
        5 x arg:
          OpStatus: type=Dcm_OpStatusType, direction=IN
          routineInfo: type=Dcm_StartDataOut_Routine_Certificate_Self_Check_Start_routineInfoType, direction=OUT
          Verification_Result: type=Dcm_StartFlexibleOutArrayData_Routine_Certificate_Self_Check_Start_Verification_ResultType, direction=OUT
          DataLength: type=uint16, direction=OUT
          ErrorCode: type=Dcm_NegativeResponseCodeType, direction=OUT
      error E_NOT_OK: error-code=1
      error DCM_E_PENDING: error-code=10
      error DCM_E_FORCE_RCRRP: error-code=12
    RoutineServices_Routine_Replace_Trust_model_Certificates_Start
      operation Start: possible-error=[RoutineServices_Routine_Replace_Trust_model_Certificates_Start/E_NOT_OK, RoutineServices_Routine_Replace_Trust_model_Certificates_Start/DCM_E_PENDING, RoutineServices_Routine_Replace_Trust_model_Certificates_Start/DCM_E_FORCE_RCRRP]
        6 x arg:
          Trust_Certificates: type=Dcm_StartFlexibleInArrayData_Routine_Replace_Trust_model_Certificates_Start_Trust_CertificatesType, direction=IN
          OpStatus: type=Dcm_OpStatusType, direction=IN
          routineInfo: type=Dcm_StartDataOut_Routine_Replace_Trust_model_Certificates_Start_routineInfoType, direction=OUT
          Verification_Result: type=Dcm_StartDataOut_Routine_Replace_Trust_model_Certificates_Start_Verification_ResultType, direction=OUT
          DataLength: type=uint16, direction=IN
          ErrorCode: type=Dcm_NegativeResponseCodeType, direction=OUT
      error E_NOT_OK: error-code=1
      error DCM_E_PENDING: error-code=10
      error DCM_E_FORCE_RCRRP: error-code=12
    RoutineServices_Routine_Replace_Trust_model_Root_Certificate_Start
      operation Start: possible-error=[RoutineServices_Routine_Replace_Trust_model_Root_Certificate_Start/E_NOT_OK, RoutineServices_Routine_Replace_Trust_model_Root_Certificate_Start/DCM_E_PENDING, RoutineServices_Routine_Replace_Trust_model_Root_Certificate_Start/DCM_E_FORCE_RCRRP]
        8 x arg:
          signature_new_Root: type=Dcm_StartDataIn_Routine_Replace_Trust_model_Root_Certificate_Start_signature_new_RootType, direction=IN
          signature: type=Dcm_StartDataIn_Routine_Replace_Trust_model_Root_Certificate_Start_signatureType, direction=IN
          Certificates: type=Dcm_StartFlexibleInArrayData_Routine_Replace_Trust_model_Root_Certificate_Start_CertificatesType, direction=IN
          OpStatus: type=Dcm_OpStatusType, direction=IN
          routineInfo: type=Dcm_StartDataOut_Routine_Replace_Trust_model_Root_Certificate_Start_routineInfoType, direction=OUT
          Verification_Result: type=Dcm_StartDataOut_Routine_Replace_Trust_model_Root_Certificate_Start_Verification_ResultType, direction=OUT
          DataLength: type=uint16, direction=IN
          ErrorCode: type=Dcm_NegativeResponseCodeType, direction=OUT
      error E_NOT_OK: error-code=1
      error DCM_E_PENDING: error-code=10
      error DCM_E_FORCE_RCRRP: error-code=12
    RoutineServices_Routine_Trust_Model_SecOC_ECU_Shared_Secret_Distribution_Start
      operation Start: possible-error=[RoutineServices_Routine_Trust_Model_SecOC_ECU_Shared_Secret_Distribution_Start/E_NOT_OK, RoutineServices_Routine_Trust_Model_SecOC_ECU_Shared_Secret_Distribution_Start/DCM_E_PENDING, RoutineServices_Routine_Trust_Model_SecOC_ECU_Shared_Secret_Distribution_Start/DCM_E_FORCE_RCRRP]
        12 x arg:
          Date_and_Time: type=Dcm_StartDataIn_Routine_Trust_Model_SecOC_ECU_Shared_Secret_Distribution_Start_Date_and_TimeType, direction=IN
          Tick_Count: type=Dcm_StartDataIn_Routine_Trust_Model_SecOC_ECU_Shared_Secret_Distribution_Start_Tick_CountType, direction=IN
          Tick_Count_Offset: type=Dcm_StartDataIn_Routine_Trust_Model_SecOC_ECU_Shared_Secret_Distribution_Start_Tick_Count_OffsetType, direction=IN
          Encrypted_Nonce_and_Shared_Secret: type=Dcm_StartDataIn_Routine_Trust_Model_SecOC_ECU_Shared_Secret_Distribution_Start_Encrypted_Nonce_and_Shared_SecretType, direction=IN
          Ephemeral_VSM_Public_Key: type=Dcm_StartDataIn_Routine_Trust_Model_SecOC_ECU_Shared_Secret_Distribution_Start_Ephemeral_VSM_Public_KeyType, direction=IN
          Data_Signature: type=Dcm_StartDataIn_Routine_Trust_Model_SecOC_ECU_Shared_Secret_Distribution_Start_Data_SignatureType, direction=IN
          Certificates: type=Dcm_StartFlexibleInArrayData_Routine_Trust_Model_SecOC_ECU_Shared_Secret_Distribution_Start_CertificatesType, direction=IN
          OpStatus: type=Dcm_OpStatusType, direction=IN
          routineInfo: type=Dcm_StartDataOut_Routine_Trust_Model_SecOC_ECU_Shared_Secret_Distribution_Start_routineInfoType, direction=OUT
          Verification_Result: type=Dcm_StartDataOut_Routine_Trust_Model_SecOC_ECU_Shared_Secret_Distribution_Start_Verification_ResultType, direction=OUT
          DataLength: type=uint16, direction=IN
          ErrorCode: type=Dcm_NegativeResponseCodeType, direction=OUT
      error E_NOT_OK: error-code=1
      error DCM_E_PENDING: error-code=10
      error DCM_E_FORCE_RCRRP: error-code=12
    RoutineServices_Routine_Trust_Model_Generate_Key_Pair_Start
      operation Start: possible-error=[RoutineServices_Routine_Trust_Model_Generate_Key_Pair_Start/E_NOT_OK, RoutineServices_Routine_Trust_Model_Generate_Key_Pair_Start/DCM_E_PENDING, RoutineServices_Routine_Trust_Model_Generate_Key_Pair_Start/DCM_E_FORCE_RCRRP]
        7 x arg:
          OpStatus: type=Dcm_OpStatusType, direction=IN
          routineInfo: type=Dcm_StartDataOut_Routine_Trust_Model_Generate_Key_Pair_Start_routineInfoType, direction=OUT
          Verification_Result: type=Dcm_StartDataOut_Routine_Trust_Model_Generate_Key_Pair_Start_Verification_ResultType, direction=OUT
          CSR_Signature: type=Dcm_StartDataOut_Routine_Trust_Model_Generate_Key_Pair_Start_CSR_SignatureType, direction=OUT
          Trust_Model_ECU_CSR: type=Dcm_StartFlexibleOutArrayData_Routine_Trust_Model_Generate_Key_Pair_Start_Trust_Model_ECU_CSRType, direction=OUT
          DataLength: type=uint16, direction=OUT
          ErrorCode: type=Dcm_NegativeResponseCodeType, direction=OUT
      error E_NOT_OK: error-code=1
      error DCM_E_PENDING: error-code=10
      error DCM_E_FORCE_RCRRP: error-code=12
    RoutineServices_Routine_Get_Certificate_Entry_Start
      operation Start: possible-error=[RoutineServices_Routine_Get_Certificate_Entry_Start/E_NOT_OK, RoutineServices_Routine_Get_Certificate_Entry_Start/DCM_E_PENDING, RoutineServices_Routine_Get_Certificate_Entry_Start/DCM_E_FORCE_RCRRP]
        10 x arg:
          In_Certificate_Identification: type=Dcm_StartDataIn_Routine_Get_Certificate_Entry_Start_In_Certificate_IdentificationType, direction=IN
          In_Certificate_Entry: type=Dcm_StartDataIn_Routine_Get_Certificate_Entry_Start_In_Certificate_EntryType, direction=IN
          OpStatus: type=Dcm_OpStatusType, direction=IN
          routineInfo: type=Dcm_StartDataOut_Routine_Get_Certificate_Entry_Start_routineInfoType, direction=OUT
          Verification_Result: type=Dcm_StartDataOut_Routine_Get_Certificate_Entry_Start_Verification_ResultType, direction=OUT
          Out_Certificate_Identification: type=Dcm_StartDataOut_Routine_Get_Certificate_Entry_Start_Out_Certificate_IdentificationType, direction=OUT
          Out_Certificate_Entry: type=Dcm_StartDataOut_Routine_Get_Certificate_Entry_Start_Out_Certificate_EntryType, direction=OUT
          Certificate_Content: type=Dcm_StartFlexibleOutArrayData_Routine_Get_Certificate_Entry_Start_Certificate_ContentType, direction=OUT
          DataLength: type=uint16, direction=OUT
          ErrorCode: type=Dcm_NegativeResponseCodeType, direction=OUT
      error E_NOT_OK: error-code=1
      error DCM_E_PENDING: error-code=10
      error DCM_E_FORCE_RCRRP: error-code=12
    DataServices_DID_0131_SAR_Data_Storage_Status
      operation ReadData: possible-error=[DataServices_DID_0131_SAR_Data_Storage_Status/E_NOT_OK, DataServices_DID_0131_SAR_Data_Storage_Status/DCM_E_PENDING]
        arg OpStatus: type=Dcm_OpStatusType, direction=IN
        arg Data: type=Dcm_Data1ByteType, direction=OUT
      operation ConditionCheckRead: possible-error=[DataServices_DID_0131_SAR_Data_Storage_Status/E_NOT_OK, DataServices_DID_0131_SAR_Data_Storage_Status/DCM_E_PENDING]
        arg OpStatus: type=Dcm_OpStatusType, direction=IN
        arg ErrorCode: type=Dcm_NegativeResponseCodeType, direction=OUT
      operation WriteData: possible-error=[DataServices_DID_0131_SAR_Data_Storage_Status/E_NOT_OK, DataServices_DID_0131_SAR_Data_Storage_Status/DCM_E_PENDING]
        arg Data: type=Dcm_Data1ByteType, direction=IN
        arg OpStatus: type=Dcm_OpStatusType, direction=IN
        arg ErrorCode: type=Dcm_NegativeResponseCodeType, direction=OUT
      error E_NOT_OK: error-code=1
      error DCM_E_PENDING: error-code=10
    DataServices_DID_0136_Trigger_Event_Activation_Status_Byte_2
      operation ReadData: possible-error=[DataServices_DID_0136_Trigger_Event_Activation_Status_Byte_2/E_NOT_OK, DataServices_DID_0136_Trigger_Event_Activation_Status_Byte_2/DCM_E_PENDING]
        arg OpStatus: type=Dcm_OpStatusType, direction=IN
        arg Data: type=Dcm_Data1ByteType, direction=OUT
      operation ConditionCheckRead: possible-error=[DataServices_DID_0136_Trigger_Event_Activation_Status_Byte_2/E_NOT_OK, DataServices_DID_0136_Trigger_Event_Activation_Status_Byte_2/DCM_E_PENDING]
        arg OpStatus: type=Dcm_OpStatusType, direction=IN
        arg ErrorCode: type=Dcm_NegativeResponseCodeType, direction=OUT
      operation WriteData: possible-error=[DataServices_DID_0136_Trigger_Event_Activation_Status_Byte_2/E_NOT_OK, DataServices_DID_0136_Trigger_Event_Activation_Status_Byte_2/DCM_E_PENDING]
        arg Data: type=Dcm_Data1ByteType, direction=IN
        arg OpStatus: type=Dcm_OpStatusType, direction=IN
        arg ErrorCode: type=Dcm_NegativeResponseCodeType, direction=OUT
      error E_NOT_OK: error-code=1
      error DCM_E_PENDING: error-code=10
    DataServices_DID_0136_Trigger_Event_Activation_Status_Byte_1
      operation ReadData: possible-error=[DataServices_DID_0136_Trigger_Event_Activation_Status_Byte_1/E_NOT_OK, DataServices_DID_0136_Trigger_Event_Activation_Status_Byte_1/DCM_E_PENDING]
        arg OpStatus: type=Dcm_OpStatusType, direction=IN
        arg Data: type=Dcm_Data1ByteType, direction=OUT
      operation ConditionCheckRead: possible-error=[DataServices_DID_0136_Trigger_Event_Activation_Status_Byte_1/E_NOT_OK, DataServices_DID_0136_Trigger_Event_Activation_Status_Byte_1/DCM_E_PENDING]
        arg OpStatus: type=Dcm_OpStatusType, direction=IN
        arg ErrorCode: type=Dcm_NegativeResponseCodeType, direction=OUT
      operation WriteData: possible-error=[DataServices_DID_0136_Trigger_Event_Activation_Status_Byte_1/E_NOT_OK, DataServices_DID_0136_Trigger_Event_Activation_Status_Byte_1/DCM_E_PENDING]
        arg Data: type=Dcm_Data1ByteType, direction=IN
        arg OpStatus: type=Dcm_OpStatusType, direction=IN
        arg ErrorCode: type=Dcm_NegativeResponseCodeType, direction=OUT
      error E_NOT_OK: error-code=1
      error DCM_E_PENDING: error-code=10
    DataServices_Diagnostic_Extract_Version_Read_Diagnostic_Extract_Minor_Version
      operation ReadData: possible-error=[DataServices_Diagnostic_Extract_Version_Read_Diagnostic_Extract_Minor_Version/E_NOT_OK, DataServices_Diagnostic_Extract_Version_Read_Diagnostic_Extract_Minor_Version/DCM_E_PENDING]
        arg OpStatus: type=Dcm_OpStatusType, direction=IN
        arg Data: type=Dcm_Data1ByteType, direction=OUT
      operation ConditionCheckRead: possible-error=[DataServices_Diagnostic_Extract_Version_Read_Diagnostic_Extract_Minor_Version/E_NOT_OK, DataServices_Diagnostic_Extract_Version_Read_Diagnostic_Extract_Minor_Version/DCM_E_PENDING]
        arg OpStatus: type=Dcm_OpStatusType, direction=IN
        arg ErrorCode: type=Dcm_NegativeResponseCodeType, direction=OUT
      error E_NOT_OK: error-code=1
      error DCM_E_PENDING: error-code=10
    DataServices_Diagnostic_Extract_Version_Read_CANdela_Version
      operation ReadData: possible-error=[DataServices_Diagnostic_Extract_Version_Read_CANdela_Version/E_NOT_OK, DataServices_Diagnostic_Extract_Version_Read_CANdela_Version/DCM_E_PENDING]
        arg OpStatus: type=Dcm_OpStatusType, direction=IN
        arg Data: type=Dcm_Data10ByteType, direction=OUT
      operation ConditionCheckRead: possible-error=[DataServices_Diagnostic_Extract_Version_Read_CANdela_Version/E_NOT_OK, DataServices_Diagnostic_Extract_Version_Read_CANdela_Version/DCM_E_PENDING]
        arg OpStatus: type=Dcm_OpStatusType, direction=IN
        arg ErrorCode: type=Dcm_NegativeResponseCodeType, direction=OUT
      error E_NOT_OK: error-code=1
      error DCM_E_PENDING: error-code=10
    DataServices_Diagnostic_Extract_Version_Read_Diagnostic_Extract_Major_Version
      operation ReadData: possible-error=[DataServices_Diagnostic_Extract_Version_Read_Diagnostic_Extract_Major_Version/E_NOT_OK, DataServices_Diagnostic_Extract_Version_Read_Diagnostic_Extract_Major_Version/DCM_E_PENDING]
        arg OpStatus: type=Dcm_OpStatusType, direction=IN
        arg Data: type=Dcm_Data1ByteType, direction=OUT
      operation ConditionCheckRead: possible-error=[DataServices_Diagnostic_Extract_Version_Read_Diagnostic_Extract_Major_Version/E_NOT_OK, DataServices_Diagnostic_Extract_Version_Read_Diagnostic_Extract_Major_Version/DCM_E_PENDING]
        arg OpStatus: type=Dcm_OpStatusType, direction=IN
        arg ErrorCode: type=Dcm_NegativeResponseCodeType, direction=OUT
      error E_NOT_OK: error-code=1
      error DCM_E_PENDING: error-code=10
    DataServices_Diagnostic_Extract_Version_Read_DDM_Version
      operation ReadData: possible-error=[DataServices_Diagnostic_Extract_Version_Read_DDM_Version/E_NOT_OK, DataServices_Diagnostic_Extract_Version_Read_DDM_Version/DCM_E_PENDING]
        arg OpStatus: type=Dcm_OpStatusType, direction=IN
        arg Data: type=Dcm_Data10ByteType, direction=OUT
      operation ConditionCheckRead: possible-error=[DataServices_Diagnostic_Extract_Version_Read_DDM_Version/E_NOT_OK, DataServices_Diagnostic_Extract_Version_Read_DDM_Version/DCM_E_PENDING]
        arg OpStatus: type=Dcm_OpStatusType, direction=IN
        arg ErrorCode: type=Dcm_NegativeResponseCodeType, direction=OUT
      error E_NOT_OK: error-code=1
      error DCM_E_PENDING: error-code=10
    DataServices_Diagnostic_Extract_Version_Read_Exported_Diagnostic_Variant
      operation ReadData: possible-error=[DataServices_Diagnostic_Extract_Version_Read_Exported_Diagnostic_Variant/E_NOT_OK, DataServices_Diagnostic_Extract_Version_Read_Exported_Diagnostic_Variant/DCM_E_PENDING]
        arg OpStatus: type=Dcm_OpStatusType, direction=IN
        arg Data: type=Dcm_Data30ByteType, direction=OUT
      operation ConditionCheckRead: possible-error=[DataServices_Diagnostic_Extract_Version_Read_Exported_Diagnostic_Variant/E_NOT_OK, DataServices_Diagnostic_Extract_Version_Read_Exported_Diagnostic_Variant/DCM_E_PENDING]
        arg OpStatus: type=Dcm_OpStatusType, direction=IN
        arg ErrorCode: type=Dcm_NegativeResponseCodeType, direction=OUT
      error E_NOT_OK: error-code=1
      error DCM_E_PENDING: error-code=10
    DataServices_Diagnostic_Extract_Version_Read_Diagnostic_Extract_Patch_Version
      operation ReadData: possible-error=[DataServices_Diagnostic_Extract_Version_Read_Diagnostic_Extract_Patch_Version/E_NOT_OK, DataServices_Diagnostic_Extract_Version_Read_Diagnostic_Extract_Patch_Version/DCM_E_PENDING]
        arg OpStatus: type=Dcm_OpStatusType, direction=IN
        arg Data: type=Dcm_Data1ByteType, direction=OUT
      operation ConditionCheckRead: possible-error=[DataServices_Diagnostic_Extract_Version_Read_Diagnostic_Extract_Patch_Version/E_NOT_OK, DataServices_Diagnostic_Extract_Version_Read_Diagnostic_Extract_Patch_Version/DCM_E_PENDING]
        arg OpStatus: type=Dcm_OpStatusType, direction=IN
        arg ErrorCode: type=Dcm_NegativeResponseCodeType, direction=OUT
      error E_NOT_OK: error-code=1
      error DCM_E_PENDING: error-code=10
    DataServices_Vehicle_Equipment_Read_Equipment_1
      operation ReadData: possible-error=[DataServices_Vehicle_Equipment_Read_Equipment_1/E_NOT_OK, DataServices_Vehicle_Equipment_Read_Equipment_1/DCM_E_PENDING]
        arg OpStatus: type=Dcm_OpStatusType, direction=IN
        arg Data: type=Dcm_Data1ByteType, direction=OUT
      operation ConditionCheckRead: possible-error=[DataServices_Vehicle_Equipment_Read_Equipment_1/E_NOT_OK, DataServices_Vehicle_Equipment_Read_Equipment_1/DCM_E_PENDING]
        arg OpStatus: type=Dcm_OpStatusType, direction=IN
        arg ErrorCode: type=Dcm_NegativeResponseCodeType, direction=OUT
      operation WriteData: possible-error=[DataServices_Vehicle_Equipment_Read_Equipment_1/E_NOT_OK, DataServices_Vehicle_Equipment_Read_Equipment_1/DCM_E_PENDING]
        arg Data: type=Dcm_Data1ByteType, direction=IN
        arg OpStatus: type=Dcm_OpStatusType, direction=IN
        arg ErrorCode: type=Dcm_NegativeResponseCodeType, direction=OUT
      error E_NOT_OK: error-code=1
      error DCM_E_PENDING: error-code=10
    DataServices_Vehicle_Equipment_Read_Unterspannungsbereichsschwelle
      operation ReadData: possible-error=[DataServices_Vehicle_Equipment_Read_Unterspannungsbereichsschwelle/E_NOT_OK, DataServices_Vehicle_Equipment_Read_Unterspannungsbereichsschwelle/DCM_E_PENDING]
        arg OpStatus: type=Dcm_OpStatusType, direction=IN
        arg Data: type=Dcm_Data2ByteType, direction=OUT
      operation ConditionCheckRead: possible-error=[DataServices_Vehicle_Equipment_Read_Unterspannungsbereichsschwelle/E_NOT_OK, DataServices_Vehicle_Equipment_Read_Unterspannungsbereichsschwelle/DCM_E_PENDING]
        arg OpStatus: type=Dcm_OpStatusType, direction=IN
        arg ErrorCode: type=Dcm_NegativeResponseCodeType, direction=OUT
      operation WriteData: possible-error=[DataServices_Vehicle_Equipment_Read_Unterspannungsbereichsschwelle/E_NOT_OK, DataServices_Vehicle_Equipment_Read_Unterspannungsbereichsschwelle/DCM_E_PENDING]
        arg Data: type=Dcm_Data2ByteType, direction=IN
        arg OpStatus: type=Dcm_OpStatusType, direction=IN
        arg ErrorCode: type=Dcm_NegativeResponseCodeType, direction=OUT
      error E_NOT_OK: error-code=1
      error DCM_E_PENDING: error-code=10
    DataServices_Vehicle_Equipment_Read_Unterspannungsabbruchschwelle
      operation ReadData: possible-error=[DataServices_Vehicle_Equipment_Read_Unterspannungsabbruchschwelle/E_NOT_OK, DataServices_Vehicle_Equipment_Read_Unterspannungsabbruchschwelle/DCM_E_PENDING]
        arg OpStatus: type=Dcm_OpStatusType, direction=IN
        arg Data: type=Dcm_Data2ByteType, direction=OUT
      operation ConditionCheckRead: possible-error=[DataServices_Vehicle_Equipment_Read_Unterspannungsabbruchschwelle/E_NOT_OK, DataServices_Vehicle_Equipment_Read_Unterspannungsabbruchschwelle/DCM_E_PENDING]
        arg OpStatus: type=Dcm_OpStatusType, direction=IN
        arg ErrorCode: type=Dcm_NegativeResponseCodeType, direction=OUT
      operation WriteData: possible-error=[DataServices_Vehicle_Equipment_Read_Unterspannungsabbruchschwelle/E_NOT_OK, DataServices_Vehicle_Equipment_Read_Unterspannungsabbruchschwelle/DCM_E_PENDING]
        arg Data: type=Dcm_Data2ByteType, direction=IN
        arg OpStatus: type=Dcm_OpStatusType, direction=IN
        arg ErrorCode: type=Dcm_NegativeResponseCodeType, direction=OUT
      error E_NOT_OK: error-code=1
      error DCM_E_PENDING: error-code=10
    DataServices_Vehicle_Equipment_Read_Ueberspannungsbereichsschwelle
      operation ReadData: possible-error=[DataServices_Vehicle_Equipment_Read_Ueberspannungsbereichsschwelle/E_NOT_OK, DataServices_Vehicle_Equipment_Read_Ueberspannungsbereichsschwelle/DCM_E_PENDING]
        arg OpStatus: type=Dcm_OpStatusType, direction=IN
        arg Data: type=Dcm_Data2ByteType, direction=OUT
      operation ConditionCheckRead: possible-error=[DataServices_Vehicle_Equipment_Read_Ueberspannungsbereichsschwelle/E_NOT_OK, DataServices_Vehicle_Equipment_Read_Ueberspannungsbereichsschwelle/DCM_E_PENDING]
        arg OpStatus: type=Dcm_OpStatusType, direction=IN
        arg ErrorCode: type=Dcm_NegativeResponseCodeType, direction=OUT
      operation WriteData: possible-error=[DataServices_Vehicle_Equipment_Read_Ueberspannungsbereichsschwelle/E_NOT_OK, DataServices_Vehicle_Equipment_Read_Ueberspannungsbereichsschwelle/DCM_E_PENDING]
        arg Data: type=Dcm_Data2ByteType, direction=IN
        arg OpStatus: type=Dcm_OpStatusType, direction=IN
        arg ErrorCode: type=Dcm_NegativeResponseCodeType, direction=OUT
      error E_NOT_OK: error-code=1
      error DCM_E_PENDING: error-code=10
    DataServices_Vehicle_Equipment_Read_Equipment_3
      operation ReadData: possible-error=[DataServices_Vehicle_Equipment_Read_Equipment_3/E_NOT_OK, DataServices_Vehicle_Equipment_Read_Equipment_3/DCM_E_PENDING]
        arg OpStatus: type=Dcm_OpStatusType, direction=IN
        arg Data: type=Dcm_Data1ByteType, direction=OUT
      operation ConditionCheckRead: possible-error=[DataServices_Vehicle_Equipment_Read_Equipment_3/E_NOT_OK, DataServices_Vehicle_Equipment_Read_Equipment_3/DCM_E_PENDING]
        arg OpStatus: type=Dcm_OpStatusType, direction=IN
        arg ErrorCode: type=Dcm_NegativeResponseCodeType, direction=OUT
      operation WriteData: possible-error=[DataServices_Vehicle_Equipment_Read_Equipment_3/E_NOT_OK, DataServices_Vehicle_Equipment_Read_Equipment_3/DCM_E_PENDING]
        arg Data: type=Dcm_Data1ByteType, direction=IN
        arg OpStatus: type=Dcm_OpStatusType, direction=IN
        arg ErrorCode: type=Dcm_NegativeResponseCodeType, direction=OUT
      error E_NOT_OK: error-code=1
      error DCM_E_PENDING: error-code=10
    DataServices_Vehicle_Equipment_Read_Equipment_2
      operation ReadData: possible-error=[DataServices_Vehicle_Equipment_Read_Equipment_2/E_NOT_OK, DataServices_Vehicle_Equipment_Read_Equipment_2/DCM_E_PENDING]
        arg OpStatus: type=Dcm_OpStatusType, direction=IN
        arg Data: type=Dcm_Data1ByteType, direction=OUT
      operation ConditionCheckRead: possible-error=[DataServices_Vehicle_Equipment_Read_Equipment_2/E_NOT_OK, DataServices_Vehicle_Equipment_Read_Equipment_2/DCM_E_PENDING]
        arg OpStatus: type=Dcm_OpStatusType, direction=IN
        arg ErrorCode: type=Dcm_NegativeResponseCodeType, direction=OUT
      operation WriteData: possible-error=[DataServices_Vehicle_Equipment_Read_Equipment_2/E_NOT_OK, DataServices_Vehicle_Equipment_Read_Equipment_2/DCM_E_PENDING]
        arg Data: type=Dcm_Data1ByteType, direction=IN
        arg OpStatus: type=Dcm_OpStatusType, direction=IN
        arg ErrorCode: type=Dcm_NegativeResponseCodeType, direction=OUT
      error E_NOT_OK: error-code=1
      error DCM_E_PENDING: error-code=10
    DataServices_Vehicle_Equipment_Read_Ueberspannungsabbruchschwelle
      operation ReadData: possible-error=[DataServices_Vehicle_Equipment_Read_Ueberspannungsabbruchschwelle/E_NOT_OK, DataServices_Vehicle_Equipment_Read_Ueberspannungsabbruchschwelle/DCM_E_PENDING]
        arg OpStatus: type=Dcm_OpStatusType, direction=IN
        arg Data: type=Dcm_Data2ByteType, direction=OUT
      operation ConditionCheckRead: possible-error=[DataServices_Vehicle_Equipment_Read_Ueberspannungsabbruchschwelle/E_NOT_OK, DataServices_Vehicle_Equipment_Read_Ueberspannungsabbruchschwelle/DCM_E_PENDING]
        arg OpStatus: type=Dcm_OpStatusType, direction=IN
        arg ErrorCode: type=Dcm_NegativeResponseCodeType, direction=OUT
      operation WriteData: possible-error=[DataServices_Vehicle_Equipment_Read_Ueberspannungsabbruchschwelle/E_NOT_OK, DataServices_Vehicle_Equipment_Read_Ueberspannungsabbruchschwelle/DCM_E_PENDING]
        arg Data: type=Dcm_Data2ByteType, direction=IN
        arg OpStatus: type=Dcm_OpStatusType, direction=IN
        arg ErrorCode: type=Dcm_NegativeResponseCodeType, direction=OUT
      error E_NOT_OK: error-code=1
      error DCM_E_PENDING: error-code=10
    DataServices_Backend_CA_Certificate_Identification_Read_Backend_CA_SubjectKeyIdentifier
      operation ReadData: possible-error=[DataServices_Backend_CA_Certificate_Identification_Read_Backend_CA_SubjectKeyIdentifier/E_NOT_OK, DataServices_Backend_CA_Certificate_Identification_Read_Backend_CA_SubjectKeyIdentifier/DCM_E_PENDING]
        arg OpStatus: type=Dcm_OpStatusType, direction=IN
        arg Data: type=Dcm_Data20ByteType, direction=OUT
      operation ConditionCheckRead: possible-error=[DataServices_Backend_CA_Certificate_Identification_Read_Backend_CA_SubjectKeyIdentifier/E_NOT_OK, DataServices_Backend_CA_Certificate_Identification_Read_Backend_CA_SubjectKeyIdentifier/DCM_E_PENDING]
        arg OpStatus: type=Dcm_OpStatusType, direction=IN
        arg ErrorCode: type=Dcm_NegativeResponseCodeType, direction=OUT
      error E_NOT_OK: error-code=1
      error DCM_E_PENDING: error-code=10
    DataServices_Trust_model_ECU_certificate_Read_Trust_model_ECU_Certificate
      operation ReadData: possible-error=[DataServices_Trust_model_ECU_certificate_Read_Trust_model_ECU_Certificate/E_NOT_OK, DataServices_Trust_model_ECU_certificate_Read_Trust_model_ECU_Certificate/DCM_E_PENDING]
        arg OpStatus: type=Dcm_OpStatusType, direction=IN
        arg Data: type=Dcm_Data1002ByteType, direction=OUT
      operation ReadDataLength: possible-error=[DataServices_Trust_model_ECU_certificate_Read_Trust_model_ECU_Certificate/E_NOT_OK, DataServices_Trust_model_ECU_certificate_Read_Trust_model_ECU_Certificate/DCM_E_PENDING]
        arg OpStatus: type=Dcm_OpStatusType, direction=IN
        arg DataLength: type=uint16, direction=OUT
      operation ConditionCheckRead: possible-error=[DataServices_Trust_model_ECU_certificate_Read_Trust_model_ECU_Certificate/E_NOT_OK, DataServices_Trust_model_ECU_certificate_Read_Trust_model_ECU_Certificate/DCM_E_PENDING]
        arg OpStatus: type=Dcm_OpStatusType, direction=IN
        arg ErrorCode: type=Dcm_NegativeResponseCodeType, direction=OUT
      error E_NOT_OK: error-code=1
      error DCM_E_PENDING: error-code=10
    DataServices_Seatbelt_Serial_Number_Read_Unique_Seatbelt_Serialnumber
      operation ReadData: possible-error=[DataServices_Seatbelt_Serial_Number_Read_Unique_Seatbelt_Serialnumber/E_NOT_OK, DataServices_Seatbelt_Serial_Number_Read_Unique_Seatbelt_Serialnumber/DCM_E_PENDING]
        arg OpStatus: type=Dcm_OpStatusType, direction=IN
        arg Data: type=Dcm_Data28ByteType, direction=OUT
      operation ConditionCheckRead: possible-error=[DataServices_Seatbelt_Serial_Number_Read_Unique_Seatbelt_Serialnumber/E_NOT_OK, DataServices_Seatbelt_Serial_Number_Read_Unique_Seatbelt_Serialnumber/DCM_E_PENDING]
        arg OpStatus: type=Dcm_OpStatusType, direction=IN
        arg ErrorCode: type=Dcm_NegativeResponseCodeType, direction=OUT
      operation WriteData: possible-error=[DataServices_Seatbelt_Serial_Number_Read_Unique_Seatbelt_Serialnumber/E_NOT_OK, DataServices_Seatbelt_Serial_Number_Read_Unique_Seatbelt_Serialnumber/DCM_E_PENDING]
        arg Data: type=Dcm_Data28ByteType, direction=IN
        arg OpStatus: type=Dcm_OpStatusType, direction=IN
        arg ErrorCode: type=Dcm_NegativeResponseCodeType, direction=OUT
      error E_NOT_OK: error-code=1
      error DCM_E_PENDING: error-code=10
    DataServices_PRE_SAFE_Recorder_1_read_Read_CombinedDataElement
      4 x operation, all with possible-error=[DataServices_PRE_SAFE_Recorder_1_read_Read_CombinedDataElement/E_NOT_OK, DataServices_PRE_SAFE_Recorder_1_read_Read_CombinedDataElement/DCM_E_PENDING]:
        ReadData
          arg OpStatus: type=Dcm_OpStatusType, direction=IN
          arg Data: type=Dcm_Data22ByteType, direction=OUT
        ReadDataLength
          arg OpStatus: type=Dcm_OpStatusType, direction=IN
          arg DataLength: type=uint16, direction=OUT
        ConditionCheckRead
          arg OpStatus: type=Dcm_OpStatusType, direction=IN
          arg ErrorCode: type=Dcm_NegativeResponseCodeType, direction=OUT
        WriteData
          4 x arg:
            Data: type=Dcm_Data22ByteType, direction=IN
            DataLength: type=uint16, direction=IN
            OpStatus: type=Dcm_OpStatusType, direction=IN
            ErrorCode: type=Dcm_NegativeResponseCodeType, direction=OUT
      error E_NOT_OK: error-code=1
      error DCM_E_PENDING: error-code=10
    DataServices_Minimum_Software_Version_Read_Minimum_Software_Version
      operation ReadData: possible-error=[DataServices_Minimum_Software_Version_Read_Minimum_Software_Version/E_NOT_OK, DataServices_Minimum_Software_Version_Read_Minimum_Software_Version/DCM_E_PENDING]
        arg OpStatus: type=Dcm_OpStatusType, direction=IN
        arg Data: type=Dcm_Data381ByteType, direction=OUT
      operation ReadDataLength: possible-error=[DataServices_Minimum_Software_Version_Read_Minimum_Software_Version/E_NOT_OK, DataServices_Minimum_Software_Version_Read_Minimum_Software_Version/DCM_E_PENDING]
        arg OpStatus: type=Dcm_OpStatusType, direction=IN
        arg DataLength: type=uint16, direction=OUT
      operation ConditionCheckRead: possible-error=[DataServices_Minimum_Software_Version_Read_Minimum_Software_Version/E_NOT_OK, DataServices_Minimum_Software_Version_Read_Minimum_Software_Version/DCM_E_PENDING]
        arg OpStatus: type=Dcm_OpStatusType, direction=IN
        arg ErrorCode: type=Dcm_NegativeResponseCodeType, direction=OUT
      error E_NOT_OK: error-code=1
      error DCM_E_PENDING: error-code=10
    DataServices_VINDataIdentifier_Read_VINDataIdentifier
      operation ReadData: possible-error=[DataServices_VINDataIdentifier_Read_VINDataIdentifier/E_NOT_OK, DataServices_VINDataIdentifier_Read_VINDataIdentifier/DCM_E_PENDING]
        arg OpStatus: type=Dcm_OpStatusType, direction=IN
        arg Data: type=Dcm_Data17ByteType, direction=OUT
      operation ConditionCheckRead: possible-error=[DataServices_VINDataIdentifier_Read_VINDataIdentifier/E_NOT_OK, DataServices_VINDataIdentifier_Read_VINDataIdentifier/DCM_E_PENDING]
        arg OpStatus: type=Dcm_OpStatusType, direction=IN
        arg ErrorCode: type=Dcm_NegativeResponseCodeType, direction=OUT
      operation WriteData: possible-error=[DataServices_VINDataIdentifier_Read_VINDataIdentifier/E_NOT_OK, DataServices_VINDataIdentifier_Read_VINDataIdentifier/DCM_E_PENDING]
        arg Data: type=Dcm_Data17ByteType, direction=IN
        arg OpStatus: type=Dcm_OpStatusType, direction=IN
        arg ErrorCode: type=Dcm_NegativeResponseCodeType, direction=OUT
      error E_NOT_OK: error-code=1
      error DCM_E_PENDING: error-code=10
    DataServices_Diagnostic_User_Role_Read_Cebas_UserRole
      operation ReadData: possible-error=[DataServices_Diagnostic_User_Role_Read_Cebas_UserRole/E_NOT_OK, DataServices_Diagnostic_User_Role_Read_Cebas_UserRole/DCM_E_PENDING]
        arg OpStatus: type=Dcm_OpStatusType, direction=IN
        arg Data: type=Dcm_Data1ByteType, direction=OUT
      operation ConditionCheckRead: possible-error=[DataServices_Diagnostic_User_Role_Read_Cebas_UserRole/E_NOT_OK, DataServices_Diagnostic_User_Role_Read_Cebas_UserRole/DCM_E_PENDING]
        arg OpStatus: type=Dcm_OpStatusType, direction=IN
        arg ErrorCode: type=Dcm_NegativeResponseCodeType, direction=OUT
      error E_NOT_OK: error-code=1
      error DCM_E_PENDING: error-code=10
    DataServices_Secured_System_Date_and_Time_Read_GeneralizedTime
      operation ReadData: possible-error=[DataServices_Secured_System_Date_and_Time_Read_GeneralizedTime/E_NOT_OK, DataServices_Secured_System_Date_and_Time_Read_GeneralizedTime/DCM_E_PENDING]
        arg OpStatus: type=Dcm_OpStatusType, direction=IN
        arg Data: type=Dcm_Data15ByteType, direction=OUT
      operation ConditionCheckRead: possible-error=[DataServices_Secured_System_Date_and_Time_Read_GeneralizedTime/E_NOT_OK, DataServices_Secured_System_Date_and_Time_Read_GeneralizedTime/DCM_E_PENDING]
        arg OpStatus: type=Dcm_OpStatusType, direction=IN
        arg ErrorCode: type=Dcm_NegativeResponseCodeType, direction=OUT
      error E_NOT_OK: error-code=1
      error DCM_E_PENDING: error-code=10
    DataServices_BootSoftwareVersion_Read_Boot_SW_year
      operation ReadData: possible-error=[DataServices_BootSoftwareVersion_Read_Boot_SW_year/E_NOT_OK, DataServices_BootSoftwareVersion_Read_Boot_SW_year/DCM_E_PENDING]
        arg OpStatus: type=Dcm_OpStatusType, direction=IN
        arg Data: type=Dcm_Data1ByteType, direction=OUT
      operation ConditionCheckRead: possible-error=[DataServices_BootSoftwareVersion_Read_Boot_SW_year/E_NOT_OK, DataServices_BootSoftwareVersion_Read_Boot_SW_year/DCM_E_PENDING]
        arg OpStatus: type=Dcm_OpStatusType, direction=IN
        arg ErrorCode: type=Dcm_NegativeResponseCodeType, direction=OUT
      error E_NOT_OK: error-code=1
      error DCM_E_PENDING: error-code=10
    DataServices_BootSoftwareVersion_Read_Boot_SW_patch_level
      operation ReadData: possible-error=[DataServices_BootSoftwareVersion_Read_Boot_SW_patch_level/E_NOT_OK, DataServices_BootSoftwareVersion_Read_Boot_SW_patch_level/DCM_E_PENDING]
        arg OpStatus: type=Dcm_OpStatusType, direction=IN
        arg Data: type=Dcm_Data1ByteType, direction=OUT
      operation ConditionCheckRead: possible-error=[DataServices_BootSoftwareVersion_Read_Boot_SW_patch_level/E_NOT_OK, DataServices_BootSoftwareVersion_Read_Boot_SW_patch_level/DCM_E_PENDING]
        arg OpStatus: type=Dcm_OpStatusType, direction=IN
        arg ErrorCode: type=Dcm_NegativeResponseCodeType, direction=OUT
      error E_NOT_OK: error-code=1
      error DCM_E_PENDING: error-code=10
    DataServices_BootSoftwareVersion_Read_Boot_SW_week
      operation ReadData: possible-error=[DataServices_BootSoftwareVersion_Read_Boot_SW_week/E_NOT_OK, DataServices_BootSoftwareVersion_Read_Boot_SW_week/DCM_E_PENDING]
        arg OpStatus: type=Dcm_OpStatusType, direction=IN
        arg Data: type=Dcm_Data1ByteType, direction=OUT
      operation ConditionCheckRead: possible-error=[DataServices_BootSoftwareVersion_Read_Boot_SW_week/E_NOT_OK, DataServices_BootSoftwareVersion_Read_Boot_SW_week/DCM_E_PENDING]
        arg OpStatus: type=Dcm_OpStatusType, direction=IN
        arg ErrorCode: type=Dcm_NegativeResponseCodeType, direction=OUT
      error E_NOT_OK: error-code=1
      error DCM_E_PENDING: error-code=10
    DataServices_Reprogramming_Attempt_Counter_Read_Reprogramming_Attempts
      operation ReadData: possible-error=[DataServices_Reprogramming_Attempt_Counter_Read_Reprogramming_Attempts/E_NOT_OK, DataServices_Reprogramming_Attempt_Counter_Read_Reprogramming_Attempts/DCM_E_PENDING]
        arg OpStatus: type=Dcm_OpStatusType, direction=IN
        arg Data: type=Dcm_Data508ByteType, direction=OUT
      operation ReadDataLength: possible-error=[DataServices_Reprogramming_Attempt_Counter_Read_Reprogramming_Attempts/E_NOT_OK, DataServices_Reprogramming_Attempt_Counter_Read_Reprogramming_Attempts/DCM_E_PENDING]
        arg OpStatus: type=Dcm_OpStatusType, direction=IN
        arg DataLength: type=uint16, direction=OUT
      operation ConditionCheckRead: possible-error=[DataServices_Reprogramming_Attempt_Counter_Read_Reprogramming_Attempts/E_NOT_OK, DataServices_Reprogramming_Attempt_Counter_Read_Reprogramming_Attempts/DCM_E_PENDING]
        arg OpStatus: type=Dcm_OpStatusType, direction=IN
        arg ErrorCode: type=Dcm_NegativeResponseCodeType, direction=OUT
      error E_NOT_OK: error-code=1
      error DCM_E_PENDING: error-code=10
    DataServices_Standard_Application_SW_Package_Information_Read_Standard_Application_SW_Package_Major_Version
      operation ReadData: possible-error=[DataServices_Standard_Application_SW_Package_Information_Read_Standard_Application_SW_Package_Major_Version/E_NOT_OK, DataServices_Standard_Application_SW_Package_Information_Read_Standard_Application_SW_Package_Major_Version/DCM_E_PENDING]
        arg OpStatus: type=Dcm_OpStatusType, direction=IN
        arg Data: type=Dcm_Data1ByteType, direction=OUT
      operation ConditionCheckRead: possible-error=[DataServices_Standard_Application_SW_Package_Information_Read_Standard_Application_SW_Package_Major_Version/E_NOT_OK, DataServices_Standard_Application_SW_Package_Information_Read_Standard_Application_SW_Package_Major_Version/DCM_E_PENDING]
        arg OpStatus: type=Dcm_OpStatusType, direction=IN
        arg ErrorCode: type=Dcm_NegativeResponseCodeType, direction=OUT
      error E_NOT_OK: error-code=1
      error DCM_E_PENDING: error-code=10
    DataServices_Standard_Application_SW_Package_Information_Read_Standard_Application_SW_Package_Patch_Level
      operation ReadData: possible-error=[DataServices_Standard_Application_SW_Package_Information_Read_Standard_Application_SW_Package_Patch_Level/E_NOT_OK, DataServices_Standard_Application_SW_Package_Information_Read_Standard_Application_SW_Package_Patch_Level/DCM_E_PENDING]
        arg OpStatus: type=Dcm_OpStatusType, direction=IN
        arg Data: type=Dcm_Data1ByteType, direction=OUT
      operation ConditionCheckRead: possible-error=[DataServices_Standard_Application_SW_Package_Information_Read_Standard_Application_SW_Package_Patch_Level/E_NOT_OK, DataServices_Standard_Application_SW_Package_Information_Read_Standard_Application_SW_Package_Patch_Level/DCM_E_PENDING]
        arg OpStatus: type=Dcm_OpStatusType, direction=IN
        arg ErrorCode: type=Dcm_NegativeResponseCodeType, direction=OUT
      error E_NOT_OK: error-code=1
      error DCM_E_PENDING: error-code=10
    DataServices_Standard_Application_SW_Package_Information_Read_Standard_Application_SW_Package_Minor_Version
      operation ReadData: possible-error=[DataServices_Standard_Application_SW_Package_Information_Read_Standard_Application_SW_Package_Minor_Version/E_NOT_OK, DataServices_Standard_Application_SW_Package_Information_Read_Standard_Application_SW_Package_Minor_Version/DCM_E_PENDING]
        arg OpStatus: type=Dcm_OpStatusType, direction=IN
        arg Data: type=Dcm_Data1ByteType, direction=OUT
      operation ConditionCheckRead: possible-error=[DataServices_Standard_Application_SW_Package_Information_Read_Standard_Application_SW_Package_Minor_Version/E_NOT_OK, DataServices_Standard_Application_SW_Package_Information_Read_Standard_Application_SW_Package_Minor_Version/DCM_E_PENDING]
        arg OpStatus: type=Dcm_OpStatusType, direction=IN
        arg ErrorCode: type=Dcm_NegativeResponseCodeType, direction=OUT
      error E_NOT_OK: error-code=1
      error DCM_E_PENDING: error-code=10
    DataServices_Standard_Application_SW_Package_Information_Read_Supplier_Identification
      operation ReadData: possible-error=[DataServices_Standard_Application_SW_Package_Information_Read_Supplier_Identification/E_NOT_OK, DataServices_Standard_Application_SW_Package_Information_Read_Supplier_Identification/DCM_E_PENDING]
        arg OpStatus: type=Dcm_OpStatusType, direction=IN
        arg Data: type=Dcm_Data2ByteType, direction=OUT
      operation ConditionCheckRead: possible-error=[DataServices_Standard_Application_SW_Package_Information_Read_Supplier_Identification/E_NOT_OK, DataServices_Standard_Application_SW_Package_Information_Read_Supplier_Identification/DCM_E_PENDING]
        arg OpStatus: type=Dcm_OpStatusType, direction=IN
        arg ErrorCode: type=Dcm_NegativeResponseCodeType, direction=OUT
      error E_NOT_OK: error-code=1
      error DCM_E_PENDING: error-code=10
    DataServices_Standard_Application_SW_Package_Information_Read_Standard_Application_SW_Package_Build_Version
      operation ReadData: possible-error=[DataServices_Standard_Application_SW_Package_Information_Read_Standard_Application_SW_Package_Build_Version/E_NOT_OK, DataServices_Standard_Application_SW_Package_Information_Read_Standard_Application_SW_Package_Build_Version/DCM_E_PENDING]
        arg OpStatus: type=Dcm_OpStatusType, direction=IN
        arg Data: type=Dcm_Data1ByteType, direction=OUT
      operation ConditionCheckRead: possible-error=[DataServices_Standard_Application_SW_Package_Information_Read_Standard_Application_SW_Package_Build_Version/E_NOT_OK, DataServices_Standard_Application_SW_Package_Information_Read_Standard_Application_SW_Package_Build_Version/DCM_E_PENDING]
        arg OpStatus: type=Dcm_OpStatusType, direction=IN
        arg ErrorCode: type=Dcm_NegativeResponseCodeType, direction=OUT
      error E_NOT_OK: error-code=1
      error DCM_E_PENDING: error-code=10
    DataServices_Dump_of_Vedoc_Relevant_Information_Read_PatchedObject
      operation ReadData: possible-error=[DataServices_Dump_of_Vedoc_Relevant_Information_Read_PatchedObject/E_NOT_OK, DataServices_Dump_of_Vedoc_Relevant_Information_Read_PatchedObject/DCM_E_PENDING]
        arg OpStatus: type=Dcm_OpStatusType, direction=IN
        arg Data: type=Dcm_Data48ByteType, direction=OUT
      operation ReadDataLength: possible-error=[DataServices_Dump_of_Vedoc_Relevant_Information_Read_PatchedObject/E_NOT_OK, DataServices_Dump_of_Vedoc_Relevant_Information_Read_PatchedObject/DCM_E_PENDING]
        arg OpStatus: type=Dcm_OpStatusType, direction=IN
        arg DataLength: type=uint16, direction=OUT
      operation ConditionCheckRead: possible-error=[DataServices_Dump_of_Vedoc_Relevant_Information_Read_PatchedObject/E_NOT_OK, DataServices_Dump_of_Vedoc_Relevant_Information_Read_PatchedObject/DCM_E_PENDING]
        arg OpStatus: type=Dcm_OpStatusType, direction=IN
        arg ErrorCode: type=Dcm_NegativeResponseCodeType, direction=OUT
      error E_NOT_OK: error-code=1
      error DCM_E_PENDING: error-code=10
    DataServices_ECU_Name_Read_Diagnostic_ECU_Name
      operation ReadData: possible-error=[DataServices_ECU_Name_Read_Diagnostic_ECU_Name/E_NOT_OK, DataServices_ECU_Name_Read_Diagnostic_ECU_Name/DCM_E_PENDING]
        arg OpStatus: type=Dcm_OpStatusType, direction=IN
        arg Data: type=Dcm_Data1000ByteType, direction=OUT
      operation ReadDataLength: possible-error=[DataServices_ECU_Name_Read_Diagnostic_ECU_Name/E_NOT_OK, DataServices_ECU_Name_Read_Diagnostic_ECU_Name/DCM_E_PENDING]
        arg OpStatus: type=Dcm_OpStatusType, direction=IN
        arg DataLength: type=uint16, direction=OUT
      operation ConditionCheckRead: possible-error=[DataServices_ECU_Name_Read_Diagnostic_ECU_Name/E_NOT_OK, DataServices_ECU_Name_Read_Diagnostic_ECU_Name/DCM_E_PENDING]
        arg OpStatus: type=Dcm_OpStatusType, direction=IN
        arg ErrorCode: type=Dcm_NegativeResponseCodeType, direction=OUT
      error E_NOT_OK: error-code=1
      error DCM_E_PENDING: error-code=10
    DataServices_Security_Event_Log_Read_Security_Event_Log
      operation ReadData: possible-error=[DataServices_Security_Event_Log_Read_Security_Event_Log/E_NOT_OK, DataServices_Security_Event_Log_Read_Security_Event_Log/DCM_E_PENDING]
        arg OpStatus: type=Dcm_OpStatusType, direction=IN
        arg Data: type=Dcm_Data4092ByteType, direction=OUT
      operation ReadDataLength: possible-error=[DataServices_Security_Event_Log_Read_Security_Event_Log/E_NOT_OK, DataServices_Security_Event_Log_Read_Security_Event_Log/DCM_E_PENDING]
        arg OpStatus: type=Dcm_OpStatusType, direction=IN
        arg DataLength: type=uint16, direction=OUT
      operation ConditionCheckRead: possible-error=[DataServices_Security_Event_Log_Read_Security_Event_Log/E_NOT_OK, DataServices_Security_Event_Log_Read_Security_Event_Log/DCM_E_PENDING]
        arg OpStatus: type=Dcm_OpStatusType, direction=IN
        arg ErrorCode: type=Dcm_NegativeResponseCodeType, direction=OUT
      error E_NOT_OK: error-code=1
      error DCM_E_PENDING: error-code=10
    DataServices_Adjust_ISO_15765_2_Block_Size_and_STmin_Parameter_Read_STmin_Value_as_defined_in_ISO_15765_2
      operation ReadData: possible-error=[DataServices_Adjust_ISO_15765_2_Block_Size_and_STmin_Parameter_Read_STmin_Value_as_defined_in_ISO_15765_2/E_NOT_OK, DataServices_Adjust_ISO_15765_2_Block_Size_and_STmin_Parameter_Read_STmin_Value_as_defined_in_ISO_15765_2/DCM_E_PENDING]
        arg OpStatus: type=Dcm_OpStatusType, direction=IN
        arg Data: type=Dcm_Data1ByteType, direction=OUT
      operation ConditionCheckRead: possible-error=[DataServices_Adjust_ISO_15765_2_Block_Size_and_STmin_Parameter_Read_STmin_Value_as_defined_in_ISO_15765_2/E_NOT_OK, DataServices_Adjust_ISO_15765_2_Block_Size_and_STmin_Parameter_Read_STmin_Value_as_defined_in_ISO_15765_2/DCM_E_PENDING]
        arg OpStatus: type=Dcm_OpStatusType, direction=IN
        arg ErrorCode: type=Dcm_NegativeResponseCodeType, direction=OUT
      operation WriteData: possible-error=[DataServices_Adjust_ISO_15765_2_Block_Size_and_STmin_Parameter_Read_STmin_Value_as_defined_in_ISO_15765_2/E_NOT_OK, DataServices_Adjust_ISO_15765_2_Block_Size_and_STmin_Parameter_Read_STmin_Value_as_defined_in_ISO_15765_2/DCM_E_PENDING]
        arg Data: type=Dcm_Data1ByteType, direction=IN
        arg OpStatus: type=Dcm_OpStatusType, direction=IN
        arg ErrorCode: type=Dcm_NegativeResponseCodeType, direction=OUT
      error E_NOT_OK: error-code=1
      error DCM_E_PENDING: error-code=10
    DataServices_Adjust_ISO_15765_2_Block_Size_and_STmin_Parameter_Read_Block_Size_Value_as_defined_in_ISO_15765_2
      operation ReadData: possible-error=[DataServices_Adjust_ISO_15765_2_Block_Size_and_STmin_Parameter_Read_Block_Size_Value_as_defined_in_ISO_15765_2/E_NOT_OK, DataServices_Adjust_ISO_15765_2_Block_Size_and_STmin_Parameter_Read_Block_Size_Value_as_defined_in_ISO_15765_2/DCM_E_PENDING]
        arg OpStatus: type=Dcm_OpStatusType, direction=IN
        arg Data: type=Dcm_Data1ByteType, direction=OUT
      operation ConditionCheckRead: possible-error=[DataServices_Adjust_ISO_15765_2_Block_Size_and_STmin_Parameter_Read_Block_Size_Value_as_defined_in_ISO_15765_2/E_NOT_OK, DataServices_Adjust_ISO_15765_2_Block_Size_and_STmin_Parameter_Read_Block_Size_Value_as_defined_in_ISO_15765_2/DCM_E_PENDING]
        arg OpStatus: type=Dcm_OpStatusType, direction=IN
        arg ErrorCode: type=Dcm_NegativeResponseCodeType, direction=OUT
      operation WriteData: possible-error=[DataServices_Adjust_ISO_15765_2_Block_Size_and_STmin_Parameter_Read_Block_Size_Value_as_defined_in_ISO_15765_2/E_NOT_OK, DataServices_Adjust_ISO_15765_2_Block_Size_and_STmin_Parameter_Read_Block_Size_Value_as_defined_in_ISO_15765_2/DCM_E_PENDING]
        arg Data: type=Dcm_Data1ByteType, direction=IN
        arg OpStatus: type=Dcm_OpStatusType, direction=IN
        arg ErrorCode: type=Dcm_NegativeResponseCodeType, direction=OUT
      error E_NOT_OK: error-code=1
      error DCM_E_PENDING: error-code=10
    DataServices_SSA_Version_Information_Read_SSA_Patch_Level
      operation ReadData: possible-error=[DataServices_SSA_Version_Information_Read_SSA_Patch_Level/E_NOT_OK, DataServices_SSA_Version_Information_Read_SSA_Patch_Level/DCM_E_PENDING]
        arg OpStatus: type=Dcm_OpStatusType, direction=IN
        arg Data: type=Dcm_Data1ByteType, direction=OUT
      operation ConditionCheckRead: possible-error=[DataServices_SSA_Version_Information_Read_SSA_Patch_Level/E_NOT_OK, DataServices_SSA_Version_Information_Read_SSA_Patch_Level/DCM_E_PENDING]
        arg OpStatus: type=Dcm_OpStatusType, direction=IN
        arg ErrorCode: type=Dcm_NegativeResponseCodeType, direction=OUT
      error E_NOT_OK: error-code=1
      error DCM_E_PENDING: error-code=10
    DataServices_SSA_Version_Information_Read_SSA_Major_Version
      operation ReadData: possible-error=[DataServices_SSA_Version_Information_Read_SSA_Major_Version/E_NOT_OK, DataServices_SSA_Version_Information_Read_SSA_Major_Version/DCM_E_PENDING]
        arg OpStatus: type=Dcm_OpStatusType, direction=IN
        arg Data: type=Dcm_Data1ByteType, direction=OUT
      operation ConditionCheckRead: possible-error=[DataServices_SSA_Version_Information_Read_SSA_Major_Version/E_NOT_OK, DataServices_SSA_Version_Information_Read_SSA_Major_Version/DCM_E_PENDING]
        arg OpStatus: type=Dcm_OpStatusType, direction=IN
        arg ErrorCode: type=Dcm_NegativeResponseCodeType, direction=OUT
      error E_NOT_OK: error-code=1
      error DCM_E_PENDING: error-code=10
    DataServices_SSA_Version_Information_Read_SSA_Minor_Version
      operation ReadData: possible-error=[DataServices_SSA_Version_Information_Read_SSA_Minor_Version/E_NOT_OK, DataServices_SSA_Version_Information_Read_SSA_Minor_Version/DCM_E_PENDING]
        arg OpStatus: type=Dcm_OpStatusType, direction=IN
        arg Data: type=Dcm_Data1ByteType, direction=OUT
      operation ConditionCheckRead: possible-error=[DataServices_SSA_Version_Information_Read_SSA_Minor_Version/E_NOT_OK, DataServices_SSA_Version_Information_Read_SSA_Minor_Version/DCM_E_PENDING]
        arg OpStatus: type=Dcm_OpStatusType, direction=IN
        arg ErrorCode: type=Dcm_NegativeResponseCodeType, direction=OUT
      error E_NOT_OK: error-code=1
      error DCM_E_PENDING: error-code=10
    DataServices_SoftwareSupplier_Read_Software_Logical_Block_Supplier_Identification
      operation ReadData: possible-error=[DataServices_SoftwareSupplier_Read_Software_Logical_Block_Supplier_Identification/E_NOT_OK, DataServices_SoftwareSupplier_Read_Software_Logical_Block_Supplier_Identification/DCM_E_PENDING]
        arg OpStatus: type=Dcm_OpStatusType, direction=IN
        arg Data: type=Dcm_Data254ByteType, direction=OUT
      operation ReadDataLength: possible-error=[DataServices_SoftwareSupplier_Read_Software_Logical_Block_Supplier_Identification/E_NOT_OK, DataServices_SoftwareSupplier_Read_Software_Logical_Block_Supplier_Identification/DCM_E_PENDING]
        arg OpStatus: type=Dcm_OpStatusType, direction=IN
        arg DataLength: type=uint16, direction=OUT
      operation ConditionCheckRead: possible-error=[DataServices_SoftwareSupplier_Read_Software_Logical_Block_Supplier_Identification/E_NOT_OK, DataServices_SoftwareSupplier_Read_Software_Logical_Block_Supplier_Identification/DCM_E_PENDING]
        arg OpStatus: type=Dcm_OpStatusType, direction=IN
        arg ErrorCode: type=Dcm_NegativeResponseCodeType, direction=OUT
      error E_NOT_OK: error-code=1
      error DCM_E_PENDING: error-code=10
    DataServices_DDS_Package_Release_Read_DDS_Package_Release_of_Boot_Software_Month_Boot
      operation ReadData: possible-error=[DataServices_DDS_Package_Release_Read_DDS_Package_Release_of_Boot_Software_Month_Boot/E_NOT_OK, DataServices_DDS_Package_Release_Read_DDS_Package_Release_of_Boot_Software_Month_Boot/DCM_E_PENDING]
        arg OpStatus: type=Dcm_OpStatusType, direction=IN
        arg Data: type=Dcm_Data1ByteType, direction=OUT
      operation ConditionCheckRead: possible-error=[DataServices_DDS_Package_Release_Read_DDS_Package_Release_of_Boot_Software_Month_Boot/E_NOT_OK, DataServices_DDS_Package_Release_Read_DDS_Package_Release_of_Boot_Software_Month_Boot/DCM_E_PENDING]
        arg OpStatus: type=Dcm_OpStatusType, direction=IN
        arg ErrorCode: type=Dcm_NegativeResponseCodeType, direction=OUT
      error E_NOT_OK: error-code=1
      error DCM_E_PENDING: error-code=10
    DataServices_DDS_Package_Release_Read_DDS_Package_Release_of_Application_Software_Year_Appl
      operation ReadData: possible-error=[DataServices_DDS_Package_Release_Read_DDS_Package_Release_of_Application_Software_Year_Appl/E_NOT_OK, DataServices_DDS_Package_Release_Read_DDS_Package_Release_of_Application_Software_Year_Appl/DCM_E_PENDING]
        arg OpStatus: type=Dcm_OpStatusType, direction=IN
        arg Data: type=Dcm_Data1ByteType, direction=OUT
      operation ConditionCheckRead: possible-error=[DataServices_DDS_Package_Release_Read_DDS_Package_Release_of_Application_Software_Year_Appl/E_NOT_OK, DataServices_DDS_Package_Release_Read_DDS_Package_Release_of_Application_Software_Year_Appl/DCM_E_PENDING]
        arg OpStatus: type=Dcm_OpStatusType, direction=IN
        arg ErrorCode: type=Dcm_NegativeResponseCodeType, direction=OUT
      error E_NOT_OK: error-code=1
      error DCM_E_PENDING: error-code=10
    DataServices_DDS_Package_Release_Read_DDS_Package_Release_of_Application_Software_Month_Appl
      operation ReadData: possible-error=[DataServices_DDS_Package_Release_Read_DDS_Package_Release_of_Application_Software_Month_Appl/E_NOT_OK, DataServices_DDS_Package_Release_Read_DDS_Package_Release_of_Application_Software_Month_Appl/DCM_E_PENDING]
        arg OpStatus: type=Dcm_OpStatusType, direction=IN
        arg Data: type=Dcm_Data1ByteType, direction=OUT
      operation ConditionCheckRead: possible-error=[DataServices_DDS_Package_Release_Read_DDS_Package_Release_of_Application_Software_Month_Appl/E_NOT_OK, DataServices_DDS_Package_Release_Read_DDS_Package_Release_of_Application_Software_Month_Appl/DCM_E_PENDING]
        arg OpStatus: type=Dcm_OpStatusType, direction=IN
        arg ErrorCode: type=Dcm_NegativeResponseCodeType, direction=OUT
      error E_NOT_OK: error-code=1
      error DCM_E_PENDING: error-code=10
    DataServices_DDS_Package_Release_Read_DDS_Package_Release_of_Boot_Software_Year_Boot
      operation ReadData: possible-error=[DataServices_DDS_Package_Release_Read_DDS_Package_Release_of_Boot_Software_Year_Boot/E_NOT_OK, DataServices_DDS_Package_Release_Read_DDS_Package_Release_of_Boot_Software_Year_Boot/DCM_E_PENDING]
        arg OpStatus: type=Dcm_OpStatusType, direction=IN
        arg Data: type=Dcm_Data1ByteType, direction=OUT
      operation ConditionCheckRead: possible-error=[DataServices_DDS_Package_Release_Read_DDS_Package_Release_of_Boot_Software_Year_Boot/E_NOT_OK, DataServices_DDS_Package_Release_Read_DDS_Package_Release_of_Boot_Software_Year_Boot/DCM_E_PENDING]
        arg OpStatus: type=Dcm_OpStatusType, direction=IN
        arg ErrorCode: type=Dcm_NegativeResponseCodeType, direction=OUT
      error E_NOT_OK: error-code=1
      error DCM_E_PENDING: error-code=10
    DataServices_Security_Event_Log_Current_Counter_Values_Read_Security_Event_Log_Current_Counter_Values
      operation ReadData: possible-error=[DataServices_Security_Event_Log_Current_Counter_Values_Read_Security_Event_Log_Current_Counter_Values/E_NOT_OK, DataServices_Security_Event_Log_Current_Counter_Values_Read_Security_Event_Log_Current_Counter_Values/DCM_E_PENDING]
        arg OpStatus: type=Dcm_OpStatusType, direction=IN
        arg Data: type=Dcm_Data1024ByteType, direction=OUT
      operation ReadDataLength: possible-error=[DataServices_Security_Event_Log_Current_Counter_Values_Read_Security_Event_Log_Current_Counter_Values/E_NOT_OK, DataServices_Security_Event_Log_Current_Counter_Values_Read_Security_Event_Log_Current_Counter_Values/DCM_E_PENDING]
        arg OpStatus: type=Dcm_OpStatusType, direction=IN
        arg DataLength: type=uint16, direction=OUT
      operation ConditionCheckRead: possible-error=[DataServices_Security_Event_Log_Current_Counter_Values_Read_Security_Event_Log_Current_Counter_Values/E_NOT_OK, DataServices_Security_Event_Log_Current_Counter_Values_Read_Security_Event_Log_Current_Counter_Values/DCM_E_PENDING]
        arg OpStatus: type=Dcm_OpStatusType, direction=IN
        arg ErrorCode: type=Dcm_NegativeResponseCodeType, direction=OUT
      error E_NOT_OK: error-code=1
      error DCM_E_PENDING: error-code=10
    DataServices_Supported_configuration_mechanisms_Read_Config_mechanisms
      operation ReadData: possible-error=[DataServices_Supported_configuration_mechanisms_Read_Config_mechanisms/E_NOT_OK, DataServices_Supported_configuration_mechanisms_Read_Config_mechanisms/DCM_E_PENDING]
        arg OpStatus: type=Dcm_OpStatusType, direction=IN
        arg Data: type=Dcm_Data1ByteType, direction=OUT
      operation ConditionCheckRead: possible-error=[DataServices_Supported_configuration_mechanisms_Read_Config_mechanisms/E_NOT_OK, DataServices_Supported_configuration_mechanisms_Read_Config_mechanisms/DCM_E_PENDING]
        arg OpStatus: type=Dcm_OpStatusType, direction=IN
        arg ErrorCode: type=Dcm_NegativeResponseCodeType, direction=OUT
      error E_NOT_OK: error-code=1
      error DCM_E_PENDING: error-code=10
    DataServices_CAN_input_Read_Neues_Bitfeld_6
      operation ReadData: possible-error=[DataServices_CAN_input_Read_Neues_Bitfeld_6/E_NOT_OK, DataServices_CAN_input_Read_Neues_Bitfeld_6/DCM_E_PENDING]
        arg OpStatus: type=Dcm_OpStatusType, direction=IN
        arg Data: type=Dcm_Data1ByteType, direction=OUT
      operation ConditionCheckRead: possible-error=[DataServices_CAN_input_Read_Neues_Bitfeld_6/E_NOT_OK, DataServices_CAN_input_Read_Neues_Bitfeld_6/DCM_E_PENDING]
        arg OpStatus: type=Dcm_OpStatusType, direction=IN
        arg ErrorCode: type=Dcm_NegativeResponseCodeType, direction=OUT
      error E_NOT_OK: error-code=1
      error DCM_E_PENDING: error-code=10
    DataServices_CAN_input_Read_Neues_Bitfeld_5
      operation ReadData: possible-error=[DataServices_CAN_input_Read_Neues_Bitfeld_5/E_NOT_OK, DataServices_CAN_input_Read_Neues_Bitfeld_5/DCM_E_PENDING]
        arg OpStatus: type=Dcm_OpStatusType, direction=IN
        arg Data: type=Dcm_Data1ByteType, direction=OUT
      operation ConditionCheckRead: possible-error=[DataServices_CAN_input_Read_Neues_Bitfeld_5/E_NOT_OK, DataServices_CAN_input_Read_Neues_Bitfeld_5/DCM_E_PENDING]
        arg OpStatus: type=Dcm_OpStatusType, direction=IN
        arg ErrorCode: type=Dcm_NegativeResponseCodeType, direction=OUT
      error E_NOT_OK: error-code=1
      error DCM_E_PENDING: error-code=10
    DataServices_CAN_input_Read_Neues_Bitfeld_4
      operation ReadData: possible-error=[DataServices_CAN_input_Read_Neues_Bitfeld_4/E_NOT_OK, DataServices_CAN_input_Read_Neues_Bitfeld_4/DCM_E_PENDING]
        arg OpStatus: type=Dcm_OpStatusType, direction=IN
        arg Data: type=Dcm_Data1ByteType, direction=OUT
      operation ConditionCheckRead: possible-error=[DataServices_CAN_input_Read_Neues_Bitfeld_4/E_NOT_OK, DataServices_CAN_input_Read_Neues_Bitfeld_4/DCM_E_PENDING]
        arg OpStatus: type=Dcm_OpStatusType, direction=IN
        arg ErrorCode: type=Dcm_NegativeResponseCodeType, direction=OUT
      error E_NOT_OK: error-code=1
      error DCM_E_PENDING: error-code=10
    DataServices_CAN_input_Read_Neues_Bitfeld_3
      operation ReadData: possible-error=[DataServices_CAN_input_Read_Neues_Bitfeld_3/E_NOT_OK, DataServices_CAN_input_Read_Neues_Bitfeld_3/DCM_E_PENDING]
        arg OpStatus: type=Dcm_OpStatusType, direction=IN
        arg Data: type=Dcm_Data1ByteType, direction=OUT
      operation ConditionCheckRead: possible-error=[DataServices_CAN_input_Read_Neues_Bitfeld_3/E_NOT_OK, DataServices_CAN_input_Read_Neues_Bitfeld_3/DCM_E_PENDING]
        arg OpStatus: type=Dcm_OpStatusType, direction=IN
        arg ErrorCode: type=Dcm_NegativeResponseCodeType, direction=OUT
      error E_NOT_OK: error-code=1
      error DCM_E_PENDING: error-code=10
    DataServices_CAN_input_Read_Supply_battery_voltage
      operation ReadData: possible-error=[DataServices_CAN_input_Read_Supply_battery_voltage/E_NOT_OK, DataServices_CAN_input_Read_Supply_battery_voltage/DCM_E_PENDING]
        arg OpStatus: type=Dcm_OpStatusType, direction=IN
        arg Data: type=Dcm_Data1ByteType, direction=OUT
      operation ConditionCheckRead: possible-error=[DataServices_CAN_input_Read_Supply_battery_voltage/E_NOT_OK, DataServices_CAN_input_Read_Supply_battery_voltage/DCM_E_PENDING]
        arg OpStatus: type=Dcm_OpStatusType, direction=IN
        arg ErrorCode: type=Dcm_NegativeResponseCodeType, direction=OUT
      error E_NOT_OK: error-code=1
      error DCM_E_PENDING: error-code=10
    DataServices_CAN_input_Read_Neues_Bitfeld_2
      operation ReadData: possible-error=[DataServices_CAN_input_Read_Neues_Bitfeld_2/E_NOT_OK, DataServices_CAN_input_Read_Neues_Bitfeld_2/DCM_E_PENDING]
        arg OpStatus: type=Dcm_OpStatusType, direction=IN
        arg Data: type=Dcm_Data1ByteType, direction=OUT
      operation ConditionCheckRead: possible-error=[DataServices_CAN_input_Read_Neues_Bitfeld_2/E_NOT_OK, DataServices_CAN_input_Read_Neues_Bitfeld_2/DCM_E_PENDING]
        arg OpStatus: type=Dcm_OpStatusType, direction=IN
        arg ErrorCode: type=Dcm_NegativeResponseCodeType, direction=OUT
      error E_NOT_OK: error-code=1
      error DCM_E_PENDING: error-code=10
    DataServices_CAN_input_Read_Neues_Bitfeld_1
      operation ReadData: possible-error=[DataServices_CAN_input_Read_Neues_Bitfeld_1/E_NOT_OK, DataServices_CAN_input_Read_Neues_Bitfeld_1/DCM_E_PENDING]
        arg OpStatus: type=Dcm_OpStatusType, direction=IN
        arg Data: type=Dcm_Data1ByteType, direction=OUT
      operation ConditionCheckRead: possible-error=[DataServices_CAN_input_Read_Neues_Bitfeld_1/E_NOT_OK, DataServices_CAN_input_Read_Neues_Bitfeld_1/DCM_E_PENDING]
        arg OpStatus: type=Dcm_OpStatusType, direction=IN
        arg ErrorCode: type=Dcm_NegativeResponseCodeType, direction=OUT
      error E_NOT_OK: error-code=1
      error DCM_E_PENDING: error-code=10
    DataServices_SecOC_Vehicle_Shared_Secret_Hash_Read_SecOC_Vehicle_Shared_Secret_Hash
      operation ReadData: possible-error=[DataServices_SecOC_Vehicle_Shared_Secret_Hash_Read_SecOC_Vehicle_Shared_Secret_Hash/E_NOT_OK, DataServices_SecOC_Vehicle_Shared_Secret_Hash_Read_SecOC_Vehicle_Shared_Secret_Hash/DCM_E_PENDING]
        arg OpStatus: type=Dcm_OpStatusType, direction=IN
        arg Data: type=Dcm_Data4ByteType, direction=OUT
      operation ConditionCheckRead: possible-error=[DataServices_SecOC_Vehicle_Shared_Secret_Hash_Read_SecOC_Vehicle_Shared_Secret_Hash/E_NOT_OK, DataServices_SecOC_Vehicle_Shared_Secret_Hash_Read_SecOC_Vehicle_Shared_Secret_Hash/DCM_E_PENDING]
        arg OpStatus: type=Dcm_OpStatusType, direction=IN
        arg ErrorCode: type=Dcm_NegativeResponseCodeType, direction=OUT
      error E_NOT_OK: error-code=1
      error DCM_E_PENDING: error-code=10
    DataServices_Trust_model_ECU_CSR_Read_Trust_model_ECU_CSR
      operation ReadData: possible-error=[DataServices_Trust_model_ECU_CSR_Read_Trust_model_ECU_CSR/E_NOT_OK, DataServices_Trust_model_ECU_CSR_Read_Trust_model_ECU_CSR/DCM_E_PENDING]
        arg OpStatus: type=Dcm_OpStatusType, direction=IN
        arg Data: type=Dcm_Data1002ByteType, direction=OUT
      operation ReadDataLength: possible-error=[DataServices_Trust_model_ECU_CSR_Read_Trust_model_ECU_CSR/E_NOT_OK, DataServices_Trust_model_ECU_CSR_Read_Trust_model_ECU_CSR/DCM_E_PENDING]
        arg OpStatus: type=Dcm_OpStatusType, direction=IN
        arg DataLength: type=uint16, direction=OUT
      operation ConditionCheckRead: possible-error=[DataServices_Trust_model_ECU_CSR_Read_Trust_model_ECU_CSR/E_NOT_OK, DataServices_Trust_model_ECU_CSR_Read_Trust_model_ECU_CSR/DCM_E_PENDING]
        arg OpStatus: type=Dcm_OpStatusType, direction=IN
        arg ErrorCode: type=Dcm_NegativeResponseCodeType, direction=OUT
      error E_NOT_OK: error-code=1
      error DCM_E_PENDING: error-code=10
    DataServices_Root_CA_Certificate_Read_Root_CA_Certificate
      operation ReadData: possible-error=[DataServices_Root_CA_Certificate_Read_Root_CA_Certificate/E_NOT_OK, DataServices_Root_CA_Certificate_Read_Root_CA_Certificate/DCM_E_PENDING]
        arg OpStatus: type=Dcm_OpStatusType, direction=IN
        arg Data: type=Dcm_Data1002ByteType, direction=OUT
      operation ReadDataLength: possible-error=[DataServices_Root_CA_Certificate_Read_Root_CA_Certificate/E_NOT_OK, DataServices_Root_CA_Certificate_Read_Root_CA_Certificate/DCM_E_PENDING]
        arg OpStatus: type=Dcm_OpStatusType, direction=IN
        arg DataLength: type=uint16, direction=OUT
      operation ConditionCheckRead: possible-error=[DataServices_Root_CA_Certificate_Read_Root_CA_Certificate/E_NOT_OK, DataServices_Root_CA_Certificate_Read_Root_CA_Certificate/DCM_E_PENDING]
        arg OpStatus: type=Dcm_OpStatusType, direction=IN
        arg ErrorCode: type=Dcm_NegativeResponseCodeType, direction=OUT
      error E_NOT_OK: error-code=1
      error DCM_E_PENDING: error-code=10
    DataServices_ECUSerialNumberDataIdentifier_Read_ECU_Serial_Number
      operation ReadData: possible-error=[DataServices_ECUSerialNumberDataIdentifier_Read_ECU_Serial_Number/E_NOT_OK, DataServices_ECUSerialNumberDataIdentifier_Read_ECU_Serial_Number/DCM_E_PENDING]
        arg OpStatus: type=Dcm_OpStatusType, direction=IN
        arg Data: type=Dcm_Data33ByteType, direction=OUT
      operation ReadDataLength: possible-error=[DataServices_ECUSerialNumberDataIdentifier_Read_ECU_Serial_Number/E_NOT_OK, DataServices_ECUSerialNumberDataIdentifier_Read_ECU_Serial_Number/DCM_E_PENDING]
        arg OpStatus: type=Dcm_OpStatusType, direction=IN
        arg DataLength: type=uint16, direction=OUT
      operation ConditionCheckRead: possible-error=[DataServices_ECUSerialNumberDataIdentifier_Read_ECU_Serial_Number/E_NOT_OK, DataServices_ECUSerialNumberDataIdentifier_Read_ECU_Serial_Number/DCM_E_PENDING]
        arg OpStatus: type=Dcm_OpStatusType, direction=IN
        arg ErrorCode: type=Dcm_NegativeResponseCodeType, direction=OUT
      error E_NOT_OK: error-code=1
      error DCM_E_PENDING: error-code=10
    DataServices_VIN_Status_Read_VIN_Lock_Status
      operation ReadData: possible-error=[DataServices_VIN_Status_Read_VIN_Lock_Status/E_NOT_OK, DataServices_VIN_Status_Read_VIN_Lock_Status/DCM_E_PENDING]
        arg OpStatus: type=Dcm_OpStatusType, direction=IN
        arg Data: type=Dcm_Data1ByteType, direction=OUT
      operation ConditionCheckRead: possible-error=[DataServices_VIN_Status_Read_VIN_Lock_Status/E_NOT_OK, DataServices_VIN_Status_Read_VIN_Lock_Status/DCM_E_PENDING]
        arg OpStatus: type=Dcm_OpStatusType, direction=IN
        arg ErrorCode: type=Dcm_NegativeResponseCodeType, direction=OUT
      error E_NOT_OK: error-code=1
      error DCM_E_PENDING: error-code=10
    DataServices_VIN_Status_Read_VIN_Status
      operation ReadData: possible-error=[DataServices_VIN_Status_Read_VIN_Status/E_NOT_OK, DataServices_VIN_Status_Read_VIN_Status/DCM_E_PENDING]
        arg OpStatus: type=Dcm_OpStatusType, direction=IN
        arg Data: type=Dcm_Data1ByteType, direction=OUT
      operation ConditionCheckRead: possible-error=[DataServices_VIN_Status_Read_VIN_Status/E_NOT_OK, DataServices_VIN_Status_Read_VIN_Status/DCM_E_PENDING]
        arg OpStatus: type=Dcm_OpStatusType, direction=IN
        arg ErrorCode: type=Dcm_NegativeResponseCodeType, direction=OUT
      error E_NOT_OK: error-code=1
      error DCM_E_PENDING: error-code=10
    DataServices_Status_SSA_Pre_Compile_Switches_Read_Precompile_switch
      operation ReadData: possible-error=[DataServices_Status_SSA_Pre_Compile_Switches_Read_Precompile_switch/E_NOT_OK, DataServices_Status_SSA_Pre_Compile_Switches_Read_Precompile_switch/DCM_E_PENDING]
        arg OpStatus: type=Dcm_OpStatusType, direction=IN
        arg Data: type=Dcm_Data4ByteType, direction=OUT
      operation ConditionCheckRead: possible-error=[DataServices_Status_SSA_Pre_Compile_Switches_Read_Precompile_switch/E_NOT_OK, DataServices_Status_SSA_Pre_Compile_Switches_Read_Precompile_switch/DCM_E_PENDING]
        arg OpStatus: type=Dcm_OpStatusType, direction=IN
        arg ErrorCode: type=Dcm_NegativeResponseCodeType, direction=OUT
      error E_NOT_OK: error-code=1
      error DCM_E_PENDING: error-code=10
    DataServices_PRE_SAFE_Recorder_2_read_Read_CombinedDataElement
      4 x operation, all with possible-error=[DataServices_PRE_SAFE_Recorder_2_read_Read_CombinedDataElement/E_NOT_OK, DataServices_PRE_SAFE_Recorder_2_read_Read_CombinedDataElement/DCM_E_PENDING]:
        ReadData
          arg OpStatus: type=Dcm_OpStatusType, direction=IN
          arg Data: type=Dcm_Data22ByteType, direction=OUT
        ReadDataLength
          arg OpStatus: type=Dcm_OpStatusType, direction=IN
          arg DataLength: type=uint16, direction=OUT
        ConditionCheckRead
          arg OpStatus: type=Dcm_OpStatusType, direction=IN
          arg ErrorCode: type=Dcm_NegativeResponseCodeType, direction=OUT
        WriteData
          4 x arg:
            Data: type=Dcm_Data22ByteType, direction=IN
            DataLength: type=uint16, direction=IN
            OpStatus: type=Dcm_OpStatusType, direction=IN
            ErrorCode: type=Dcm_NegativeResponseCodeType, direction=OUT
      error E_NOT_OK: error-code=1
      error DCM_E_PENDING: error-code=10
    DataServices_BSR_Counter_read_Read_BSR_Counter
      operation ReadData: possible-error=[DataServices_BSR_Counter_read_Read_BSR_Counter/E_NOT_OK, DataServices_BSR_Counter_read_Read_BSR_Counter/DCM_E_PENDING]
        arg OpStatus: type=Dcm_OpStatusType, direction=IN
        arg Data: type=Dcm_Data3ByteType, direction=OUT
      operation ConditionCheckRead: possible-error=[DataServices_BSR_Counter_read_Read_BSR_Counter/E_NOT_OK, DataServices_BSR_Counter_read_Read_BSR_Counter/DCM_E_PENDING]
        arg OpStatus: type=Dcm_OpStatusType, direction=IN
        arg ErrorCode: type=Dcm_NegativeResponseCodeType, direction=OUT
      error E_NOT_OK: error-code=1
      error DCM_E_PENDING: error-code=10
    DataServices_Vehicle_Odometer_in_Low_Resolution_Read_Vehicle_Odometer_in_Low_Resolution
      operation ReadData: possible-error=[DataServices_Vehicle_Odometer_in_Low_Resolution_Read_Vehicle_Odometer_in_Low_Resolution/E_NOT_OK, DataServices_Vehicle_Odometer_in_Low_Resolution_Read_Vehicle_Odometer_in_Low_Resolution/DCM_E_PENDING]
        arg OpStatus: type=Dcm_OpStatusType, direction=IN
        arg Data: type=Dcm_Data2ByteType, direction=OUT
      operation ConditionCheckRead: possible-error=[DataServices_Vehicle_Odometer_in_Low_Resolution_Read_Vehicle_Odometer_in_Low_Resolution/E_NOT_OK, DataServices_Vehicle_Odometer_in_Low_Resolution_Read_Vehicle_Odometer_in_Low_Resolution/DCM_E_PENDING]
        arg OpStatus: type=Dcm_OpStatusType, direction=IN
        arg ErrorCode: type=Dcm_NegativeResponseCodeType, direction=OUT
      error E_NOT_OK: error-code=1
      error DCM_E_PENDING: error-code=10
    DataServices_HardwareSupplier_Read_Hardware_Supplier_Identification
      operation ReadData: possible-error=[DataServices_HardwareSupplier_Read_Hardware_Supplier_Identification/E_NOT_OK, DataServices_HardwareSupplier_Read_Hardware_Supplier_Identification/DCM_E_PENDING]
        arg OpStatus: type=Dcm_OpStatusType, direction=IN
        arg Data: type=Dcm_Data2ByteType, direction=OUT
      operation ConditionCheckRead: possible-error=[DataServices_HardwareSupplier_Read_Hardware_Supplier_Identification/E_NOT_OK, DataServices_HardwareSupplier_Read_Hardware_Supplier_Identification/DCM_E_PENDING]
        arg OpStatus: type=Dcm_OpStatusType, direction=IN
        arg ErrorCode: type=Dcm_NegativeResponseCodeType, direction=OUT
      error E_NOT_OK: error-code=1
      error DCM_E_PENDING: error-code=10
    DataServices_MercedesCarGroupSoftware_Read_Software_Logical_Block_Numbers
      operation ReadData: possible-error=[DataServices_MercedesCarGroupSoftware_Read_Software_Logical_Block_Numbers/E_NOT_OK, DataServices_MercedesCarGroupSoftware_Read_Software_Logical_Block_Numbers/DCM_E_PENDING]
        arg OpStatus: type=Dcm_OpStatusType, direction=IN
        arg Data: type=Dcm_Data1270ByteType, direction=OUT
      operation ReadDataLength: possible-error=[DataServices_MercedesCarGroupSoftware_Read_Software_Logical_Block_Numbers/E_NOT_OK, DataServices_MercedesCarGroupSoftware_Read_Software_Logical_Block_Numbers/DCM_E_PENDING]
        arg OpStatus: type=Dcm_OpStatusType, direction=IN
        arg DataLength: type=uint16, direction=OUT
      operation ConditionCheckRead: possible-error=[DataServices_MercedesCarGroupSoftware_Read_Software_Logical_Block_Numbers/E_NOT_OK, DataServices_MercedesCarGroupSoftware_Read_Software_Logical_Block_Numbers/DCM_E_PENDING]
        arg OpStatus: type=Dcm_OpStatusType, direction=IN
        arg ErrorCode: type=Dcm_NegativeResponseCodeType, direction=OUT
      error E_NOT_OK: error-code=1
      error DCM_E_PENDING: error-code=10
    DataServices_SecOC_PDU_Data_IDs_and_Key_CMACs_Read_Secured_PDU_Data_IDs_and_Key_CMACs
      operation ReadData: possible-error=[DataServices_SecOC_PDU_Data_IDs_and_Key_CMACs_Read_Secured_PDU_Data_IDs_and_Key_CMACs/E_NOT_OK, DataServices_SecOC_PDU_Data_IDs_and_Key_CMACs_Read_Secured_PDU_Data_IDs_and_Key_CMACs/DCM_E_PENDING]
        arg OpStatus: type=Dcm_OpStatusType, direction=IN
        arg Data: type=Dcm_Data4092ByteType, direction=OUT
      operation ReadDataLength: possible-error=[DataServices_SecOC_PDU_Data_IDs_and_Key_CMACs_Read_Secured_PDU_Data_IDs_and_Key_CMACs/E_NOT_OK, DataServices_SecOC_PDU_Data_IDs_and_Key_CMACs_Read_Secured_PDU_Data_IDs_and_Key_CMACs/DCM_E_PENDING]
        arg OpStatus: type=Dcm_OpStatusType, direction=IN
        arg DataLength: type=uint16, direction=OUT
      operation ConditionCheckRead: possible-error=[DataServices_SecOC_PDU_Data_IDs_and_Key_CMACs_Read_Secured_PDU_Data_IDs_and_Key_CMACs/E_NOT_OK, DataServices_SecOC_PDU_Data_IDs_and_Key_CMACs_Read_Secured_PDU_Data_IDs_and_Key_CMACs/DCM_E_PENDING]
        arg OpStatus: type=Dcm_OpStatusType, direction=IN
        arg ErrorCode: type=Dcm_NegativeResponseCodeType, direction=OUT
      error E_NOT_OK: error-code=1
      error DCM_E_PENDING: error-code=10
    DataServices_Current_Operating_Time_Read_Current_Operating_Time
      operation ReadData: possible-error=[DataServices_Current_Operating_Time_Read_Current_Operating_Time/E_NOT_OK, DataServices_Current_Operating_Time_Read_Current_Operating_Time/DCM_E_PENDING]
        arg OpStatus: type=Dcm_OpStatusType, direction=IN
        arg Data: type=Dcm_Data4ByteType, direction=OUT
      operation ConditionCheckRead: possible-error=[DataServices_Current_Operating_Time_Read_Current_Operating_Time/E_NOT_OK, DataServices_Current_Operating_Time_Read_Current_Operating_Time/DCM_E_PENDING]
        arg OpStatus: type=Dcm_OpStatusType, direction=IN
        arg ErrorCode: type=Dcm_NegativeResponseCodeType, direction=OUT
      error E_NOT_OK: error-code=1
      error DCM_E_PENDING: error-code=10
    DataServices_Current_Operating_Time_Read_Operating_Time_Status
      operation ReadData: possible-error=[DataServices_Current_Operating_Time_Read_Operating_Time_Status/E_NOT_OK, DataServices_Current_Operating_Time_Read_Operating_Time_Status/DCM_E_PENDING]
        arg OpStatus: type=Dcm_OpStatusType, direction=IN
        arg Data: type=Dcm_Data1ByteType, direction=OUT
      operation ConditionCheckRead: possible-error=[DataServices_Current_Operating_Time_Read_Operating_Time_Status/E_NOT_OK, DataServices_Current_Operating_Time_Read_Operating_Time_Status/DCM_E_PENDING]
        arg OpStatus: type=Dcm_OpStatusType, direction=IN
        arg ErrorCode: type=Dcm_NegativeResponseCodeType, direction=OUT
      error E_NOT_OK: error-code=1
      error DCM_E_PENDING: error-code=10
    DataServices_Trust_model_Root_CA_certificate_Read_Trust_model_Root_CA_certificate
      operation ReadData: possible-error=[DataServices_Trust_model_Root_CA_certificate_Read_Trust_model_Root_CA_certificate/E_NOT_OK, DataServices_Trust_model_Root_CA_certificate_Read_Trust_model_Root_CA_certificate/DCM_E_PENDING]
        arg OpStatus: type=Dcm_OpStatusType, direction=IN
        arg Data: type=Dcm_Data1002ByteType, direction=OUT
      operation ReadDataLength: possible-error=[DataServices_Trust_model_Root_CA_certificate_Read_Trust_model_Root_CA_certificate/E_NOT_OK, DataServices_Trust_model_Root_CA_certificate_Read_Trust_model_Root_CA_certificate/DCM_E_PENDING]
        arg OpStatus: type=Dcm_OpStatusType, direction=IN
        arg DataLength: type=uint16, direction=OUT
      operation ConditionCheckRead: possible-error=[DataServices_Trust_model_Root_CA_certificate_Read_Trust_model_Root_CA_certificate/E_NOT_OK, DataServices_Trust_model_Root_CA_certificate_Read_Trust_model_Root_CA_certificate/DCM_E_PENDING]
        arg OpStatus: type=Dcm_OpStatusType, direction=IN
        arg ErrorCode: type=Dcm_NegativeResponseCodeType, direction=OUT
      error E_NOT_OK: error-code=1
      error DCM_E_PENDING: error-code=10
    DataServices_RandomNumber_Read_Generated_Random_Number_Result
      operation ReadData: possible-error=[DataServices_RandomNumber_Read_Generated_Random_Number_Result/E_NOT_OK, DataServices_RandomNumber_Read_Generated_Random_Number_Result/DCM_E_PENDING]
        arg OpStatus: type=Dcm_OpStatusType, direction=IN
        arg Data: type=Dcm_Data1ByteType, direction=OUT
      operation ConditionCheckRead: possible-error=[DataServices_RandomNumber_Read_Generated_Random_Number_Result/E_NOT_OK, DataServices_RandomNumber_Read_Generated_Random_Number_Result/DCM_E_PENDING]
        arg OpStatus: type=Dcm_OpStatusType, direction=IN
        arg ErrorCode: type=Dcm_NegativeResponseCodeType, direction=OUT
      error E_NOT_OK: error-code=1
      error DCM_E_PENDING: error-code=10
    DataServices_RandomNumber_Read_Generated_Random_Number
      operation ReadData: possible-error=[DataServices_RandomNumber_Read_Generated_Random_Number/E_NOT_OK, DataServices_RandomNumber_Read_Generated_Random_Number/DCM_E_PENDING]
        arg OpStatus: type=Dcm_OpStatusType, direction=IN
        arg Data: type=Dcm_Data32ByteType, direction=OUT
      operation ConditionCheckRead: possible-error=[DataServices_RandomNumber_Read_Generated_Random_Number/E_NOT_OK, DataServices_RandomNumber_Read_Generated_Random_Number/DCM_E_PENDING]
        arg OpStatus: type=Dcm_OpStatusType, direction=IN
        arg ErrorCode: type=Dcm_NegativeResponseCodeType, direction=OUT
      error E_NOT_OK: error-code=1
      error DCM_E_PENDING: error-code=10
    DataServices_MercedesCarGroupHardware_Read_Hardware_Part_Number
      operation ReadData: possible-error=[DataServices_MercedesCarGroupHardware_Read_Hardware_Part_Number/E_NOT_OK, DataServices_MercedesCarGroupHardware_Read_Hardware_Part_Number/DCM_E_PENDING]
        arg OpStatus: type=Dcm_OpStatusType, direction=IN
        arg Data: type=Dcm_Data10ByteType, direction=OUT
      operation ConditionCheckRead: possible-error=[DataServices_MercedesCarGroupHardware_Read_Hardware_Part_Number/E_NOT_OK, DataServices_MercedesCarGroupHardware_Read_Hardware_Part_Number/DCM_E_PENDING]
        arg OpStatus: type=Dcm_OpStatusType, direction=IN
        arg ErrorCode: type=Dcm_NegativeResponseCodeType, direction=OUT
      error E_NOT_OK: error-code=1
      error DCM_E_PENDING: error-code=10
    DataServices_Internal_ECU_information_Read_ECU_Temperature
      operation ReadData: possible-error=[DataServices_Internal_ECU_information_Read_ECU_Temperature/E_NOT_OK, DataServices_Internal_ECU_information_Read_ECU_Temperature/DCM_E_PENDING]
        arg OpStatus: type=Dcm_OpStatusType, direction=IN
        arg Data: type=Dcm_Data2ByteType, direction=OUT
      operation ConditionCheckRead: possible-error=[DataServices_Internal_ECU_information_Read_ECU_Temperature/E_NOT_OK, DataServices_Internal_ECU_information_Read_ECU_Temperature/DCM_E_PENDING]
        arg OpStatus: type=Dcm_OpStatusType, direction=IN
        arg ErrorCode: type=Dcm_NegativeResponseCodeType, direction=OUT
      error E_NOT_OK: error-code=1
      error DCM_E_PENDING: error-code=10
    DataServices_Internal_ECU_information_Read_MOTOR_Current
      operation ReadData: possible-error=[DataServices_Internal_ECU_information_Read_MOTOR_Current/E_NOT_OK, DataServices_Internal_ECU_information_Read_MOTOR_Current/DCM_E_PENDING]
        arg OpStatus: type=Dcm_OpStatusType, direction=IN
        arg Data: type=Dcm_Data2ByteType, direction=OUT
      operation ConditionCheckRead: possible-error=[DataServices_Internal_ECU_information_Read_MOTOR_Current/E_NOT_OK, DataServices_Internal_ECU_information_Read_MOTOR_Current/DCM_E_PENDING]
        arg OpStatus: type=Dcm_OpStatusType, direction=IN
        arg ErrorCode: type=Dcm_NegativeResponseCodeType, direction=OUT
      error E_NOT_OK: error-code=1
      error DCM_E_PENDING: error-code=10
    DataServices_Internal_ECU_information_Read_Autosar_System_State_EcuM_State
      operation ReadData: possible-error=[DataServices_Internal_ECU_information_Read_Autosar_System_State_EcuM_State/E_NOT_OK, DataServices_Internal_ECU_information_Read_Autosar_System_State_EcuM_State/DCM_E_PENDING]
        arg OpStatus: type=Dcm_OpStatusType, direction=IN
        arg Data: type=Dcm_Data1ByteType, direction=OUT
      operation ConditionCheckRead: possible-error=[DataServices_Internal_ECU_information_Read_Autosar_System_State_EcuM_State/E_NOT_OK, DataServices_Internal_ECU_information_Read_Autosar_System_State_EcuM_State/DCM_E_PENDING]
        arg OpStatus: type=Dcm_OpStatusType, direction=IN
        arg ErrorCode: type=Dcm_NegativeResponseCodeType, direction=OUT
      error E_NOT_OK: error-code=1
      error DCM_E_PENDING: error-code=10
    DataServices_Backend_CA_Certificate_Read_Backend_CA_Certificate
      operation ReadData: possible-error=[DataServices_Backend_CA_Certificate_Read_Backend_CA_Certificate/E_NOT_OK, DataServices_Backend_CA_Certificate_Read_Backend_CA_Certificate/DCM_E_PENDING]
        arg OpStatus: type=Dcm_OpStatusType, direction=IN
        arg Data: type=Dcm_Data1002ByteType, direction=OUT
      operation ReadDataLength: possible-error=[DataServices_Backend_CA_Certificate_Read_Backend_CA_Certificate/E_NOT_OK, DataServices_Backend_CA_Certificate_Read_Backend_CA_Certificate/DCM_E_PENDING]
        arg OpStatus: type=Dcm_OpStatusType, direction=IN
        arg DataLength: type=uint16, direction=OUT
      operation ConditionCheckRead: possible-error=[DataServices_Backend_CA_Certificate_Read_Backend_CA_Certificate/E_NOT_OK, DataServices_Backend_CA_Certificate_Read_Backend_CA_Certificate/DCM_E_PENDING]
        arg OpStatus: type=Dcm_OpStatusType, direction=IN
        arg ErrorCode: type=Dcm_NegativeResponseCodeType, direction=OUT
      error E_NOT_OK: error-code=1
      error DCM_E_PENDING: error-code=10
    DataServices_Trust_model_Intermediate_CA_certificate_Read_Trust_model_Intermediate_CA_Certificate
      operation ReadData: possible-error=[DataServices_Trust_model_Intermediate_CA_certificate_Read_Trust_model_Intermediate_CA_Certificate/E_NOT_OK, DataServices_Trust_model_Intermediate_CA_certificate_Read_Trust_model_Intermediate_CA_Certificate/DCM_E_PENDING]
        arg OpStatus: type=Dcm_OpStatusType, direction=IN
        arg Data: type=Dcm_Data1002ByteType, direction=OUT
      operation ReadDataLength: possible-error=[DataServices_Trust_model_Intermediate_CA_certificate_Read_Trust_model_Intermediate_CA_Certificate/E_NOT_OK, DataServices_Trust_model_Intermediate_CA_certificate_Read_Trust_model_Intermediate_CA_Certificate/DCM_E_PENDING]
        arg OpStatus: type=Dcm_OpStatusType, direction=IN
        arg DataLength: type=uint16, direction=OUT
      operation ConditionCheckRead: possible-error=[DataServices_Trust_model_Intermediate_CA_certificate_Read_Trust_model_Intermediate_CA_Certificate/E_NOT_OK, DataServices_Trust_model_Intermediate_CA_certificate_Read_Trust_model_Intermediate_CA_Certificate/DCM_E_PENDING]
        arg OpStatus: type=Dcm_OpStatusType, direction=IN
        arg ErrorCode: type=Dcm_NegativeResponseCodeType, direction=OUT
      error E_NOT_OK: error-code=1
      error DCM_E_PENDING: error-code=10
    DataServices_Diagnostic_Authentication_Certificate_Identification_Read_Diagnostic_Authentication_Certificate_Serial_Number
      operation ReadData: possible-error=[DataServices_Diagnostic_Authentication_Certificate_Identification_Read_Diagnostic_Authentication_Certificate_Serial_Number/E_NOT_OK, DataServices_Diagnostic_Authentication_Certificate_Identification_Read_Diagnostic_Authentication_Certificate_Serial_Number/DCM_E_PENDING]
        arg OpStatus: type=Dcm_OpStatusType, direction=IN
        arg Data: type=Dcm_Data16ByteType, direction=OUT
      operation ReadDataLength: possible-error=[DataServices_Diagnostic_Authentication_Certificate_Identification_Read_Diagnostic_Authentication_Certificate_Serial_Number/E_NOT_OK, DataServices_Diagnostic_Authentication_Certificate_Identification_Read_Diagnostic_Authentication_Certificate_Serial_Number/DCM_E_PENDING]
        arg OpStatus: type=Dcm_OpStatusType, direction=IN
        arg DataLength: type=uint16, direction=OUT
      operation ConditionCheckRead: possible-error=[DataServices_Diagnostic_Authentication_Certificate_Identification_Read_Diagnostic_Authentication_Certificate_Serial_Number/E_NOT_OK, DataServices_Diagnostic_Authentication_Certificate_Identification_Read_Diagnostic_Authentication_Certificate_Serial_Number/DCM_E_PENDING]
        arg OpStatus: type=Dcm_OpStatusType, direction=IN
        arg ErrorCode: type=Dcm_NegativeResponseCodeType, direction=OUT
      error E_NOT_OK: error-code=1
      error DCM_E_PENDING: error-code=10
    DataServices_Diagnostic_Authentication_Certificate_Identification_Read_Diagnostic_Authentication_Certificate_Issuer
      operation ReadData: possible-error=[DataServices_Diagnostic_Authentication_Certificate_Identification_Read_Diagnostic_Authentication_Certificate_Issuer/E_NOT_OK, DataServices_Diagnostic_Authentication_Certificate_Identification_Read_Diagnostic_Authentication_Certificate_Issuer/DCM_E_PENDING]
        arg OpStatus: type=Dcm_OpStatusType, direction=IN
        arg Data: type=Dcm_Data15ByteType, direction=OUT
      operation ConditionCheckRead: possible-error=[DataServices_Diagnostic_Authentication_Certificate_Identification_Read_Diagnostic_Authentication_Certificate_Issuer/E_NOT_OK, DataServices_Diagnostic_Authentication_Certificate_Identification_Read_Diagnostic_Authentication_Certificate_Issuer/DCM_E_PENDING]
        arg OpStatus: type=Dcm_OpStatusType, direction=IN
        arg ErrorCode: type=Dcm_NegativeResponseCodeType, direction=OUT
      error E_NOT_OK: error-code=1
      error DCM_E_PENDING: error-code=10
    DataServices_SecOC_PDU_Data_IDs_and_Key_Checksum_Read_Secured_PDU_Data_IDs_and_Key_Checksum
      operation ReadData: possible-error=[DataServices_SecOC_PDU_Data_IDs_and_Key_Checksum_Read_Secured_PDU_Data_IDs_and_Key_Checksum/E_NOT_OK, DataServices_SecOC_PDU_Data_IDs_and_Key_Checksum_Read_Secured_PDU_Data_IDs_and_Key_Checksum/DCM_E_PENDING]
        arg OpStatus: type=Dcm_OpStatusType, direction=IN
        arg Data: type=Dcm_Data4092ByteType, direction=OUT
      operation ReadDataLength: possible-error=[DataServices_SecOC_PDU_Data_IDs_and_Key_Checksum_Read_Secured_PDU_Data_IDs_and_Key_Checksum/E_NOT_OK, DataServices_SecOC_PDU_Data_IDs_and_Key_Checksum_Read_Secured_PDU_Data_IDs_and_Key_Checksum/DCM_E_PENDING]
        arg OpStatus: type=Dcm_OpStatusType, direction=IN
        arg DataLength: type=uint16, direction=OUT
      operation ConditionCheckRead: possible-error=[DataServices_SecOC_PDU_Data_IDs_and_Key_Checksum_Read_Secured_PDU_Data_IDs_and_Key_Checksum/E_NOT_OK, DataServices_SecOC_PDU_Data_IDs_and_Key_Checksum_Read_Secured_PDU_Data_IDs_and_Key_Checksum/DCM_E_PENDING]
        arg OpStatus: type=Dcm_OpStatusType, direction=IN
        arg ErrorCode: type=Dcm_NegativeResponseCodeType, direction=OUT
      error E_NOT_OK: error-code=1
      error DCM_E_PENDING: error-code=10
    DataServices_System_Time_read_Read_System_time
      operation ReadData: possible-error=[DataServices_System_Time_read_Read_System_time/E_NOT_OK, DataServices_System_Time_read_Read_System_time/DCM_E_PENDING]
        arg OpStatus: type=Dcm_OpStatusType, direction=IN
        arg Data: type=Dcm_Data4ByteType, direction=OUT
      operation ConditionCheckRead: possible-error=[DataServices_System_Time_read_Read_System_time/E_NOT_OK, DataServices_System_Time_read_Read_System_time/DCM_E_PENDING]
        arg OpStatus: type=Dcm_OpStatusType, direction=IN
        arg ErrorCode: type=Dcm_NegativeResponseCodeType, direction=OUT
      error E_NOT_OK: error-code=1
      error DCM_E_PENDING: error-code=10
    DataServices_Trust_Model_Request_ephemeral_public_key_Read_Data_Signature
      operation ReadData: possible-error=[DataServices_Trust_Model_Request_ephemeral_public_key_Read_Data_Signature/E_NOT_OK, DataServices_Trust_Model_Request_ephemeral_public_key_Read_Data_Signature/DCM_E_PENDING]
        arg OpStatus: type=Dcm_OpStatusType, direction=IN
        arg Data: type=Dcm_Data64ByteType, direction=OUT
      operation ConditionCheckRead: possible-error=[DataServices_Trust_Model_Request_ephemeral_public_key_Read_Data_Signature/E_NOT_OK, DataServices_Trust_Model_Request_ephemeral_public_key_Read_Data_Signature/DCM_E_PENDING]
        arg OpStatus: type=Dcm_OpStatusType, direction=IN
        arg ErrorCode: type=Dcm_NegativeResponseCodeType, direction=OUT
      error E_NOT_OK: error-code=1
      error DCM_E_PENDING: error-code=10
    DataServices_Trust_Model_Request_ephemeral_public_key_Read_Ephemeral_ECU_Public_Key
      operation ReadData: possible-error=[DataServices_Trust_Model_Request_ephemeral_public_key_Read_Ephemeral_ECU_Public_Key/E_NOT_OK, DataServices_Trust_Model_Request_ephemeral_public_key_Read_Ephemeral_ECU_Public_Key/DCM_E_PENDING]
        arg OpStatus: type=Dcm_OpStatusType, direction=IN
        arg Data: type=Dcm_Data32ByteType, direction=OUT
      operation ConditionCheckRead: possible-error=[DataServices_Trust_Model_Request_ephemeral_public_key_Read_Ephemeral_ECU_Public_Key/E_NOT_OK, DataServices_Trust_Model_Request_ephemeral_public_key_Read_Ephemeral_ECU_Public_Key/DCM_E_PENDING]
        arg OpStatus: type=Dcm_OpStatusType, direction=IN
        arg ErrorCode: type=Dcm_NegativeResponseCodeType, direction=OUT
      error E_NOT_OK: error-code=1
      error DCM_E_PENDING: error-code=10
    DataServices_Trust_Model_Request_ephemeral_public_key_Read_Certificates
      operation ReadData: possible-error=[DataServices_Trust_Model_Request_ephemeral_public_key_Read_Certificates/E_NOT_OK, DataServices_Trust_Model_Request_ephemeral_public_key_Read_Certificates/DCM_E_PENDING]
        arg OpStatus: type=Dcm_OpStatusType, direction=IN
        arg Data: type=Dcm_Data3006ByteType, direction=OUT
      operation ReadDataLength: possible-error=[DataServices_Trust_Model_Request_ephemeral_public_key_Read_Certificates/E_NOT_OK, DataServices_Trust_Model_Request_ephemeral_public_key_Read_Certificates/DCM_E_PENDING]
        arg OpStatus: type=Dcm_OpStatusType, direction=IN
        arg DataLength: type=uint16, direction=OUT
      operation ConditionCheckRead: possible-error=[DataServices_Trust_Model_Request_ephemeral_public_key_Read_Certificates/E_NOT_OK, DataServices_Trust_Model_Request_ephemeral_public_key_Read_Certificates/DCM_E_PENDING]
        arg OpStatus: type=Dcm_OpStatusType, direction=IN
        arg ErrorCode: type=Dcm_NegativeResponseCodeType, direction=OUT
      error E_NOT_OK: error-code=1
      error DCM_E_PENDING: error-code=10
    DataServices_Trust_Model_Request_ephemeral_public_key_Read_Nonce
      operation ReadData: possible-error=[DataServices_Trust_Model_Request_ephemeral_public_key_Read_Nonce/E_NOT_OK, DataServices_Trust_Model_Request_ephemeral_public_key_Read_Nonce/DCM_E_PENDING]
        arg OpStatus: type=Dcm_OpStatusType, direction=IN
        arg Data: type=Dcm_Data32ByteType, direction=OUT
      operation ConditionCheckRead: possible-error=[DataServices_Trust_Model_Request_ephemeral_public_key_Read_Nonce/E_NOT_OK, DataServices_Trust_Model_Request_ephemeral_public_key_Read_Nonce/DCM_E_PENDING]
        arg OpStatus: type=Dcm_OpStatusType, direction=IN
        arg ErrorCode: type=Dcm_NegativeResponseCodeType, direction=OUT
      error E_NOT_OK: error-code=1
      error DCM_E_PENDING: error-code=10
    DataServices_HW_input_Read_Voltage_KL30t
      operation ReadData: possible-error=[DataServices_HW_input_Read_Voltage_KL30t/E_NOT_OK, DataServices_HW_input_Read_Voltage_KL30t/DCM_E_PENDING]
        arg OpStatus: type=Dcm_OpStatusType, direction=IN
        arg Data: type=Dcm_Data1ByteType, direction=OUT
      operation ConditionCheckRead: possible-error=[DataServices_HW_input_Read_Voltage_KL30t/E_NOT_OK, DataServices_HW_input_Read_Voltage_KL30t/DCM_E_PENDING]
        arg OpStatus: type=Dcm_OpStatusType, direction=IN
        arg ErrorCode: type=Dcm_NegativeResponseCodeType, direction=OUT
      error E_NOT_OK: error-code=1
      error DCM_E_PENDING: error-code=10
    DataServices_HW_input_Read_Voltage_Motor
      operation ReadData: possible-error=[DataServices_HW_input_Read_Voltage_Motor/E_NOT_OK, DataServices_HW_input_Read_Voltage_Motor/DCM_E_PENDING]
        arg OpStatus: type=Dcm_OpStatusType, direction=IN
        arg Data: type=Dcm_Data1ByteType, direction=OUT
      operation ConditionCheckRead: possible-error=[DataServices_HW_input_Read_Voltage_Motor/E_NOT_OK, DataServices_HW_input_Read_Voltage_Motor/DCM_E_PENDING]
        arg OpStatus: type=Dcm_OpStatusType, direction=IN
        arg ErrorCode: type=Dcm_NegativeResponseCodeType, direction=OUT
      error E_NOT_OK: error-code=1
      error DCM_E_PENDING: error-code=10
    DataServices_Diagnostic_Trace_Memory_Read_Diagnostic_Trace_Memory
      operation ReadData: possible-error=[DataServices_Diagnostic_Trace_Memory_Read_Diagnostic_Trace_Memory/E_NOT_OK, DataServices_Diagnostic_Trace_Memory_Read_Diagnostic_Trace_Memory/DCM_E_PENDING]
        arg OpStatus: type=Dcm_OpStatusType, direction=IN
        arg Data: type=Dcm_Data12ByteType, direction=OUT
      operation ConditionCheckRead: possible-error=[DataServices_Diagnostic_Trace_Memory_Read_Diagnostic_Trace_Memory/E_NOT_OK, DataServices_Diagnostic_Trace_Memory_Read_Diagnostic_Trace_Memory/DCM_E_PENDING]
        arg OpStatus: type=Dcm_OpStatusType, direction=IN
        arg ErrorCode: type=Dcm_NegativeResponseCodeType, direction=OUT
      operation WriteData: possible-error=[DataServices_Diagnostic_Trace_Memory_Read_Diagnostic_Trace_Memory/E_NOT_OK, DataServices_Diagnostic_Trace_Memory_Read_Diagnostic_Trace_Memory/DCM_E_PENDING]
        arg Data: type=Dcm_Data12ByteType, direction=IN
        arg OpStatus: type=Dcm_OpStatusType, direction=IN
        arg ErrorCode: type=Dcm_NegativeResponseCodeType, direction=OUT
      error E_NOT_OK: error-code=1
      error DCM_E_PENDING: error-code=10
    DataServices_ReadFingerprint_Read_Software_Fingerprint_s
      operation ReadData: possible-error=[DataServices_ReadFingerprint_Read_Software_Fingerprint_s/E_NOT_OK, DataServices_ReadFingerprint_Read_Software_Fingerprint_s/DCM_E_PENDING]
        arg OpStatus: type=Dcm_OpStatusType, direction=IN
        arg Data: type=Dcm_Data2540ByteType, direction=OUT
      operation ReadDataLength: possible-error=[DataServices_ReadFingerprint_Read_Software_Fingerprint_s/E_NOT_OK, DataServices_ReadFingerprint_Read_Software_Fingerprint_s/DCM_E_PENDING]
        arg OpStatus: type=Dcm_OpStatusType, direction=IN
        arg DataLength: type=uint16, direction=OUT
      operation ConditionCheckRead: possible-error=[DataServices_ReadFingerprint_Read_Software_Fingerprint_s/E_NOT_OK, DataServices_ReadFingerprint_Read_Software_Fingerprint_s/DCM_E_PENDING]
        arg OpStatus: type=Dcm_OpStatusType, direction=IN
        arg ErrorCode: type=Dcm_NegativeResponseCodeType, direction=OUT
      error E_NOT_OK: error-code=1
      error DCM_E_PENDING: error-code=10
    DataServices_Trust_model_full_chain_of_trust_certificates_Read_Trust_model_certificates
      operation ReadData: possible-error=[DataServices_Trust_model_full_chain_of_trust_certificates_Read_Trust_model_certificates/E_NOT_OK, DataServices_Trust_model_full_chain_of_trust_certificates_Read_Trust_model_certificates/DCM_E_PENDING]
        arg OpStatus: type=Dcm_OpStatusType, direction=IN
        arg Data: type=Dcm_Data4008ByteType, direction=OUT
      operation ReadDataLength: possible-error=[DataServices_Trust_model_full_chain_of_trust_certificates_Read_Trust_model_certificates/E_NOT_OK, DataServices_Trust_model_full_chain_of_trust_certificates_Read_Trust_model_certificates/DCM_E_PENDING]
        arg OpStatus: type=Dcm_OpStatusType, direction=IN
        arg DataLength: type=uint16, direction=OUT
      operation ConditionCheckRead: possible-error=[DataServices_Trust_model_full_chain_of_trust_certificates_Read_Trust_model_certificates/E_NOT_OK, DataServices_Trust_model_full_chain_of_trust_certificates_Read_Trust_model_certificates/DCM_E_PENDING]
        arg OpStatus: type=Dcm_OpStatusType, direction=IN
        arg ErrorCode: type=Dcm_NegativeResponseCodeType, direction=OUT
      error E_NOT_OK: error-code=1
      error DCM_E_PENDING: error-code=10
    DataServices_ZZZ_Vehicle_Equipment_Development_Read_Zykluszeit_Messtechnik
      operation ReadData: possible-error=[DataServices_ZZZ_Vehicle_Equipment_Development_Read_Zykluszeit_Messtechnik/E_NOT_OK, DataServices_ZZZ_Vehicle_Equipment_Development_Read_Zykluszeit_Messtechnik/DCM_E_PENDING]
        arg OpStatus: type=Dcm_OpStatusType, direction=IN
        arg Data: type=Dcm_Data1ByteType, direction=OUT
      operation ConditionCheckRead: possible-error=[DataServices_ZZZ_Vehicle_Equipment_Development_Read_Zykluszeit_Messtechnik/E_NOT_OK, DataServices_ZZZ_Vehicle_Equipment_Development_Read_Zykluszeit_Messtechnik/DCM_E_PENDING]
        arg OpStatus: type=Dcm_OpStatusType, direction=IN
        arg ErrorCode: type=Dcm_NegativeResponseCodeType, direction=OUT
      operation WriteData: possible-error=[DataServices_ZZZ_Vehicle_Equipment_Development_Read_Zykluszeit_Messtechnik/E_NOT_OK, DataServices_ZZZ_Vehicle_Equipment_Development_Read_Zykluszeit_Messtechnik/DCM_E_PENDING]
        arg Data: type=Dcm_Data1ByteType, direction=IN
        arg OpStatus: type=Dcm_OpStatusType, direction=IN
        arg ErrorCode: type=Dcm_NegativeResponseCodeType, direction=OUT
      error E_NOT_OK: error-code=1
      error DCM_E_PENDING: error-code=10
    DataServices_ZZZ_Vehicle_Equipment_Development_Read_Bitfield
      operation ReadData: possible-error=[DataServices_ZZZ_Vehicle_Equipment_Development_Read_Bitfield/E_NOT_OK, DataServices_ZZZ_Vehicle_Equipment_Development_Read_Bitfield/DCM_E_PENDING]
        arg OpStatus: type=Dcm_OpStatusType, direction=IN
        arg Data: type=Dcm_Data2ByteType, direction=OUT
      operation ConditionCheckRead: possible-error=[DataServices_ZZZ_Vehicle_Equipment_Development_Read_Bitfield/E_NOT_OK, DataServices_ZZZ_Vehicle_Equipment_Development_Read_Bitfield/DCM_E_PENDING]
        arg OpStatus: type=Dcm_OpStatusType, direction=IN
        arg ErrorCode: type=Dcm_NegativeResponseCodeType, direction=OUT
      operation WriteData: possible-error=[DataServices_ZZZ_Vehicle_Equipment_Development_Read_Bitfield/E_NOT_OK, DataServices_ZZZ_Vehicle_Equipment_Development_Read_Bitfield/DCM_E_PENDING]
        arg Data: type=Dcm_Data2ByteType, direction=IN
        arg OpStatus: type=Dcm_OpStatusType, direction=IN
        arg ErrorCode: type=Dcm_NegativeResponseCodeType, direction=OUT
      error E_NOT_OK: error-code=1
      error DCM_E_PENDING: error-code=10
    DataServices_PRE_SAFE_Counter_read_Read_CombinedDataElement
      4 x operation, all with possible-error=[DataServices_PRE_SAFE_Counter_read_Read_CombinedDataElement/E_NOT_OK, DataServices_PRE_SAFE_Counter_read_Read_CombinedDataElement/DCM_E_PENDING]:
        ReadData
          arg OpStatus: type=Dcm_OpStatusType, direction=IN
          arg Data: type=Dcm_Data8ByteType, direction=OUT
        ReadDataLength
          arg OpStatus: type=Dcm_OpStatusType, direction=IN
          arg DataLength: type=uint16, direction=OUT
        ConditionCheckRead
          arg OpStatus: type=Dcm_OpStatusType, direction=IN
          arg ErrorCode: type=Dcm_NegativeResponseCodeType, direction=OUT
        WriteData
          4 x arg:
            Data: type=Dcm_Data8ByteType, direction=IN
            DataLength: type=uint16, direction=IN
            OpStatus: type=Dcm_OpStatusType, direction=IN
            ErrorCode: type=Dcm_NegativeResponseCodeType, direction=OUT
      error E_NOT_OK: error-code=1
      error DCM_E_PENDING: error-code=10
    DataServices_Trust_model_Backend_CA_certificate_Read_Trust_model_Backend_CA_certificate
      operation ReadData: possible-error=[DataServices_Trust_model_Backend_CA_certificate_Read_Trust_model_Backend_CA_certificate/E_NOT_OK, DataServices_Trust_model_Backend_CA_certificate_Read_Trust_model_Backend_CA_certificate/DCM_E_PENDING]
        arg OpStatus: type=Dcm_OpStatusType, direction=IN
        arg Data: type=Dcm_Data1002ByteType, direction=OUT
      operation ReadDataLength: possible-error=[DataServices_Trust_model_Backend_CA_certificate_Read_Trust_model_Backend_CA_certificate/E_NOT_OK, DataServices_Trust_model_Backend_CA_certificate_Read_Trust_model_Backend_CA_certificate/DCM_E_PENDING]
        arg OpStatus: type=Dcm_OpStatusType, direction=IN
        arg DataLength: type=uint16, direction=OUT
      operation ConditionCheckRead: possible-error=[DataServices_Trust_model_Backend_CA_certificate_Read_Trust_model_Backend_CA_certificate/E_NOT_OK, DataServices_Trust_model_Backend_CA_certificate_Read_Trust_model_Backend_CA_certificate/DCM_E_PENDING]
        arg OpStatus: type=Dcm_OpStatusType, direction=IN
        arg ErrorCode: type=Dcm_NegativeResponseCodeType, direction=OUT
      error E_NOT_OK: error-code=1
      error DCM_E_PENDING: error-code=10
    DataServices_ActiveDiagnosticInformation_Read_Session
      operation ReadData: possible-error=[DataServices_ActiveDiagnosticInformation_Read_Session/E_NOT_OK, DataServices_ActiveDiagnosticInformation_Read_Session/DCM_E_PENDING]
        arg OpStatus: type=Dcm_OpStatusType, direction=IN
        arg Data: type=Dcm_Data1ByteType, direction=OUT
      operation ConditionCheckRead: possible-error=[DataServices_ActiveDiagnosticInformation_Read_Session/E_NOT_OK, DataServices_ActiveDiagnosticInformation_Read_Session/DCM_E_PENDING]
        arg OpStatus: type=Dcm_OpStatusType, direction=IN
        arg ErrorCode: type=Dcm_NegativeResponseCodeType, direction=OUT
      error E_NOT_OK: error-code=1
      error DCM_E_PENDING: error-code=10
    DataServices_ActiveDiagnosticInformation_Read_Identification
      operation ReadData: possible-error=[DataServices_ActiveDiagnosticInformation_Read_Identification/E_NOT_OK, DataServices_ActiveDiagnosticInformation_Read_Identification/DCM_E_PENDING]
        arg OpStatus: type=Dcm_OpStatusType, direction=IN
        arg Data: type=Dcm_Data3ByteType, direction=OUT
      operation ConditionCheckRead: possible-error=[DataServices_ActiveDiagnosticInformation_Read_Identification/E_NOT_OK, DataServices_ActiveDiagnosticInformation_Read_Identification/DCM_E_PENDING]
        arg OpStatus: type=Dcm_OpStatusType, direction=IN
        arg ErrorCode: type=Dcm_NegativeResponseCodeType, direction=OUT
      error E_NOT_OK: error-code=1
      error DCM_E_PENDING: error-code=10
    DataServices_Real_Time_Offset_Read_TickCount
      operation ReadData: possible-error=[DataServices_Real_Time_Offset_Read_TickCount/E_NOT_OK, DataServices_Real_Time_Offset_Read_TickCount/DCM_E_PENDING]
        arg OpStatus: type=Dcm_OpStatusType, direction=IN
        arg Data: type=Dcm_Data5ByteType, direction=OUT
      operation ConditionCheckRead: possible-error=[DataServices_Real_Time_Offset_Read_TickCount/E_NOT_OK, DataServices_Real_Time_Offset_Read_TickCount/DCM_E_PENDING]
        arg OpStatus: type=Dcm_OpStatusType, direction=IN
        arg ErrorCode: type=Dcm_NegativeResponseCodeType, direction=OUT
      error E_NOT_OK: error-code=1
      error DCM_E_PENDING: error-code=10
    DataServices_Real_Time_Offset_Read_Real_Time_Offset
      operation ReadData: possible-error=[DataServices_Real_Time_Offset_Read_Real_Time_Offset/E_NOT_OK, DataServices_Real_Time_Offset_Read_Real_Time_Offset/DCM_E_PENDING]
        arg OpStatus: type=Dcm_OpStatusType, direction=IN
        arg Data: type=Dcm_Data15ByteType, direction=OUT
      operation ConditionCheckRead: possible-error=[DataServices_Real_Time_Offset_Read_Real_Time_Offset/E_NOT_OK, DataServices_Real_Time_Offset_Read_Real_Time_Offset/DCM_E_PENDING]
        arg OpStatus: type=Dcm_OpStatusType, direction=IN
        arg ErrorCode: type=Dcm_NegativeResponseCodeType, direction=OUT
      error E_NOT_OK: error-code=1
      error DCM_E_PENDING: error-code=10
    DataServices_SoftwareVersion_Read_Software_Logical_Block_Version_Information
      operation ReadData: possible-error=[DataServices_SoftwareVersion_Read_Software_Logical_Block_Version_Information/E_NOT_OK, DataServices_SoftwareVersion_Read_Software_Logical_Block_Version_Information/DCM_E_PENDING]
        arg OpStatus: type=Dcm_OpStatusType, direction=IN
        arg Data: type=Dcm_Data381ByteType, direction=OUT
      operation ReadDataLength: possible-error=[DataServices_SoftwareVersion_Read_Software_Logical_Block_Version_Information/E_NOT_OK, DataServices_SoftwareVersion_Read_Software_Logical_Block_Version_Information/DCM_E_PENDING]
        arg OpStatus: type=Dcm_OpStatusType, direction=IN
        arg DataLength: type=uint16, direction=OUT
      operation ConditionCheckRead: possible-error=[DataServices_SoftwareVersion_Read_Software_Logical_Block_Version_Information/E_NOT_OK, DataServices_SoftwareVersion_Read_Software_Logical_Block_Version_Information/DCM_E_PENDING]
        arg OpStatus: type=Dcm_OpStatusType, direction=IN
        arg ErrorCode: type=Dcm_NegativeResponseCodeType, direction=OUT
      error E_NOT_OK: error-code=1
      error DCM_E_PENDING: error-code=10
    DataServices_CAN_output_Read_CANoutput1
      operation ReadData: possible-error=[DataServices_CAN_output_Read_CANoutput1/E_NOT_OK, DataServices_CAN_output_Read_CANoutput1/DCM_E_PENDING]
        arg OpStatus: type=Dcm_OpStatusType, direction=IN
        arg Data: type=Dcm_Data1ByteType, direction=OUT
      operation ConditionCheckRead: possible-error=[DataServices_CAN_output_Read_CANoutput1/E_NOT_OK, DataServices_CAN_output_Read_CANoutput1/DCM_E_PENDING]
        arg OpStatus: type=Dcm_OpStatusType, direction=IN
        arg ErrorCode: type=Dcm_NegativeResponseCodeType, direction=OUT
      error E_NOT_OK: error-code=1
      error DCM_E_PENDING: error-code=10
    DataServices_Access_Control_List_Version_Read_Basic_ACL_Version_Generation_Time_GTC
      operation ReadData: possible-error=[DataServices_Access_Control_List_Version_Read_Basic_ACL_Version_Generation_Time_GTC/E_NOT_OK, DataServices_Access_Control_List_Version_Read_Basic_ACL_Version_Generation_Time_GTC/DCM_E_PENDING]
        arg OpStatus: type=Dcm_OpStatusType, direction=IN
        arg Data: type=Dcm_Data15ByteType, direction=OUT
      operation ConditionCheckRead: possible-error=[DataServices_Access_Control_List_Version_Read_Basic_ACL_Version_Generation_Time_GTC/E_NOT_OK, DataServices_Access_Control_List_Version_Read_Basic_ACL_Version_Generation_Time_GTC/DCM_E_PENDING]
        arg OpStatus: type=Dcm_OpStatusType, direction=IN
        arg ErrorCode: type=Dcm_NegativeResponseCodeType, direction=OUT
      error E_NOT_OK: error-code=1
      error DCM_E_PENDING: error-code=10
    DataServices_Access_Control_List_Version_Read_ECU_indvidual_ACL_Version_Generation_Time_GTC
      operation ReadData: possible-error=[DataServices_Access_Control_List_Version_Read_ECU_indvidual_ACL_Version_Generation_Time_GTC/E_NOT_OK, DataServices_Access_Control_List_Version_Read_ECU_indvidual_ACL_Version_Generation_Time_GTC/DCM_E_PENDING]
        arg OpStatus: type=Dcm_OpStatusType, direction=IN
        arg Data: type=Dcm_Data15ByteType, direction=OUT
      operation ConditionCheckRead: possible-error=[DataServices_Access_Control_List_Version_Read_ECU_indvidual_ACL_Version_Generation_Time_GTC/E_NOT_OK, DataServices_Access_Control_List_Version_Read_ECU_indvidual_ACL_Version_Generation_Time_GTC/DCM_E_PENDING]
        arg OpStatus: type=Dcm_OpStatusType, direction=IN
        arg ErrorCode: type=Dcm_NegativeResponseCodeType, direction=OUT
      error E_NOT_OK: error-code=1
      error DCM_E_PENDING: error-code=10
    DataServices_Access_Control_List_Version_Read_Basic_ACL_Hash
      operation ReadData: possible-error=[DataServices_Access_Control_List_Version_Read_Basic_ACL_Hash/E_NOT_OK, DataServices_Access_Control_List_Version_Read_Basic_ACL_Hash/DCM_E_PENDING]
        arg OpStatus: type=Dcm_OpStatusType, direction=IN
        arg Data: type=Dcm_Data64ByteType, direction=OUT
      operation ConditionCheckRead: possible-error=[DataServices_Access_Control_List_Version_Read_Basic_ACL_Hash/E_NOT_OK, DataServices_Access_Control_List_Version_Read_Basic_ACL_Hash/DCM_E_PENDING]
        arg OpStatus: type=Dcm_OpStatusType, direction=IN
        arg ErrorCode: type=Dcm_NegativeResponseCodeType, direction=OUT
      error E_NOT_OK: error-code=1
      error DCM_E_PENDING: error-code=10
    DataServices_Access_Control_List_Version_Read_Basic_ACL_Version_Candela_File_Version_Patch
      operation ReadData: possible-error=[DataServices_Access_Control_List_Version_Read_Basic_ACL_Version_Candela_File_Version_Patch/E_NOT_OK, DataServices_Access_Control_List_Version_Read_Basic_ACL_Version_Candela_File_Version_Patch/DCM_E_PENDING]
        arg OpStatus: type=Dcm_OpStatusType, direction=IN
        arg Data: type=Dcm_Data1ByteType, direction=OUT
      operation ConditionCheckRead: possible-error=[DataServices_Access_Control_List_Version_Read_Basic_ACL_Version_Candela_File_Version_Patch/E_NOT_OK, DataServices_Access_Control_List_Version_Read_Basic_ACL_Version_Candela_File_Version_Patch/DCM_E_PENDING]
        arg OpStatus: type=Dcm_OpStatusType, direction=IN
        arg ErrorCode: type=Dcm_NegativeResponseCodeType, direction=OUT
      error E_NOT_OK: error-code=1
      error DCM_E_PENDING: error-code=10
    DataServices_Access_Control_List_Version_Read_ECU_indvidual_ACL_Version_Candela_File_Version_Patch
      operation ReadData: possible-error=[DataServices_Access_Control_List_Version_Read_ECU_indvidual_ACL_Version_Candela_File_Version_Patch/E_NOT_OK, DataServices_Access_Control_List_Version_Read_ECU_indvidual_ACL_Version_Candela_File_Version_Patch/DCM_E_PENDING]
        arg OpStatus: type=Dcm_OpStatusType, direction=IN
        arg Data: type=Dcm_Data1ByteType, direction=OUT
      operation ConditionCheckRead: possible-error=[DataServices_Access_Control_List_Version_Read_ECU_indvidual_ACL_Version_Candela_File_Version_Patch/E_NOT_OK, DataServices_Access_Control_List_Version_Read_ECU_indvidual_ACL_Version_Candela_File_Version_Patch/DCM_E_PENDING]
        arg OpStatus: type=Dcm_OpStatusType, direction=IN
        arg ErrorCode: type=Dcm_NegativeResponseCodeType, direction=OUT
      error E_NOT_OK: error-code=1
      error DCM_E_PENDING: error-code=10
    DataServices_Access_Control_List_Version_Read_ECU_indvidual_ACL_Hash
      operation ReadData: possible-error=[DataServices_Access_Control_List_Version_Read_ECU_indvidual_ACL_Hash/E_NOT_OK, DataServices_Access_Control_List_Version_Read_ECU_indvidual_ACL_Hash/DCM_E_PENDING]
        arg OpStatus: type=Dcm_OpStatusType, direction=IN
        arg Data: type=Dcm_Data64ByteType, direction=OUT
      operation ConditionCheckRead: possible-error=[DataServices_Access_Control_List_Version_Read_ECU_indvidual_ACL_Hash/E_NOT_OK, DataServices_Access_Control_List_Version_Read_ECU_indvidual_ACL_Hash/DCM_E_PENDING]
        arg OpStatus: type=Dcm_OpStatusType, direction=IN
        arg ErrorCode: type=Dcm_NegativeResponseCodeType, direction=OUT
      error E_NOT_OK: error-code=1
      error DCM_E_PENDING: error-code=10
    DataServices_Access_Control_List_Version_Read_ECU_indvidual_ACL_Version_Candela_File_Version_Minor
      operation ReadData: possible-error=[DataServices_Access_Control_List_Version_Read_ECU_indvidual_ACL_Version_Candela_File_Version_Minor/E_NOT_OK, DataServices_Access_Control_List_Version_Read_ECU_indvidual_ACL_Version_Candela_File_Version_Minor/DCM_E_PENDING]
        arg OpStatus: type=Dcm_OpStatusType, direction=IN
        arg Data: type=Dcm_Data1ByteType, direction=OUT
      operation ConditionCheckRead: possible-error=[DataServices_Access_Control_List_Version_Read_ECU_indvidual_ACL_Version_Candela_File_Version_Minor/E_NOT_OK, DataServices_Access_Control_List_Version_Read_ECU_indvidual_ACL_Version_Candela_File_Version_Minor/DCM_E_PENDING]
        arg OpStatus: type=Dcm_OpStatusType, direction=IN
        arg ErrorCode: type=Dcm_NegativeResponseCodeType, direction=OUT
      error E_NOT_OK: error-code=1
      error DCM_E_PENDING: error-code=10
    DataServices_Access_Control_List_Version_Read_ECU_indvidual_ACL_Version_Candela_File_Version_Major
      operation ReadData: possible-error=[DataServices_Access_Control_List_Version_Read_ECU_indvidual_ACL_Version_Candela_File_Version_Major/E_NOT_OK, DataServices_Access_Control_List_Version_Read_ECU_indvidual_ACL_Version_Candela_File_Version_Major/DCM_E_PENDING]
        arg OpStatus: type=Dcm_OpStatusType, direction=IN
        arg Data: type=Dcm_Data1ByteType, direction=OUT
      operation ConditionCheckRead: possible-error=[DataServices_Access_Control_List_Version_Read_ECU_indvidual_ACL_Version_Candela_File_Version_Major/E_NOT_OK, DataServices_Access_Control_List_Version_Read_ECU_indvidual_ACL_Version_Candela_File_Version_Major/DCM_E_PENDING]
        arg OpStatus: type=Dcm_OpStatusType, direction=IN
        arg ErrorCode: type=Dcm_NegativeResponseCodeType, direction=OUT
      error E_NOT_OK: error-code=1
      error DCM_E_PENDING: error-code=10
    DataServices_Access_Control_List_Version_Read_Basic_ACL_Version_Candela_File_Version_Minor
      operation ReadData: possible-error=[DataServices_Access_Control_List_Version_Read_Basic_ACL_Version_Candela_File_Version_Minor/E_NOT_OK, DataServices_Access_Control_List_Version_Read_Basic_ACL_Version_Candela_File_Version_Minor/DCM_E_PENDING]
        arg OpStatus: type=Dcm_OpStatusType, direction=IN
        arg Data: type=Dcm_Data1ByteType, direction=OUT
      operation ConditionCheckRead: possible-error=[DataServices_Access_Control_List_Version_Read_Basic_ACL_Version_Candela_File_Version_Minor/E_NOT_OK, DataServices_Access_Control_List_Version_Read_Basic_ACL_Version_Candela_File_Version_Minor/DCM_E_PENDING]
        arg OpStatus: type=Dcm_OpStatusType, direction=IN
        arg ErrorCode: type=Dcm_NegativeResponseCodeType, direction=OUT
      error E_NOT_OK: error-code=1
      error DCM_E_PENDING: error-code=10
    DataServices_Access_Control_List_Version_Read_Basic_ACL_Version_Candela_File_Version_Major
      operation ReadData: possible-error=[DataServices_Access_Control_List_Version_Read_Basic_ACL_Version_Candela_File_Version_Major/E_NOT_OK, DataServices_Access_Control_List_Version_Read_Basic_ACL_Version_Candela_File_Version_Major/DCM_E_PENDING]
        arg OpStatus: type=Dcm_OpStatusType, direction=IN
        arg Data: type=Dcm_Data1ByteType, direction=OUT
      operation ConditionCheckRead: possible-error=[DataServices_Access_Control_List_Version_Read_Basic_ACL_Version_Candela_File_Version_Major/E_NOT_OK, DataServices_Access_Control_List_Version_Read_Basic_ACL_Version_Candela_File_Version_Major/DCM_E_PENDING]
        arg OpStatus: type=Dcm_OpStatusType, direction=IN
        arg ErrorCode: type=Dcm_NegativeResponseCodeType, direction=OUT
      error E_NOT_OK: error-code=1
      error DCM_E_PENDING: error-code=10
    DataServices_SecOC_Local_TickCount_Read_TickCount
      operation ReadData: possible-error=[DataServices_SecOC_Local_TickCount_Read_TickCount/E_NOT_OK, DataServices_SecOC_Local_TickCount_Read_TickCount/DCM_E_PENDING]
        arg OpStatus: type=Dcm_OpStatusType, direction=IN
        arg Data: type=Dcm_Data6ByteType, direction=OUT
      operation ConditionCheckRead: possible-error=[DataServices_SecOC_Local_TickCount_Read_TickCount/E_NOT_OK, DataServices_SecOC_Local_TickCount_Read_TickCount/DCM_E_PENDING]
        arg OpStatus: type=Dcm_OpStatusType, direction=IN
        arg ErrorCode: type=Dcm_NegativeResponseCodeType, direction=OUT
      error E_NOT_OK: error-code=1
      error DCM_E_PENDING: error-code=10
    DataServices_HardwareVersion_Read_HW_year
      operation ReadData: possible-error=[DataServices_HardwareVersion_Read_HW_year/E_NOT_OK, DataServices_HardwareVersion_Read_HW_year/DCM_E_PENDING]
        arg OpStatus: type=Dcm_OpStatusType, direction=IN
        arg Data: type=Dcm_Data1ByteType, direction=OUT
      operation ConditionCheckRead: possible-error=[DataServices_HardwareVersion_Read_HW_year/E_NOT_OK, DataServices_HardwareVersion_Read_HW_year/DCM_E_PENDING]
        arg OpStatus: type=Dcm_OpStatusType, direction=IN
        arg ErrorCode: type=Dcm_NegativeResponseCodeType, direction=OUT
      error E_NOT_OK: error-code=1
      error DCM_E_PENDING: error-code=10
    DataServices_HardwareVersion_Read_HW_week
      operation ReadData: possible-error=[DataServices_HardwareVersion_Read_HW_week/E_NOT_OK, DataServices_HardwareVersion_Read_HW_week/DCM_E_PENDING]
        arg OpStatus: type=Dcm_OpStatusType, direction=IN
        arg Data: type=Dcm_Data1ByteType, direction=OUT
      operation ConditionCheckRead: possible-error=[DataServices_HardwareVersion_Read_HW_week/E_NOT_OK, DataServices_HardwareVersion_Read_HW_week/DCM_E_PENDING]
        arg OpStatus: type=Dcm_OpStatusType, direction=IN
        arg ErrorCode: type=Dcm_NegativeResponseCodeType, direction=OUT
      error E_NOT_OK: error-code=1
      error DCM_E_PENDING: error-code=10
    DataServices_HardwareVersion_Read_HW_patch_level
      operation ReadData: possible-error=[DataServices_HardwareVersion_Read_HW_patch_level/E_NOT_OK, DataServices_HardwareVersion_Read_HW_patch_level/DCM_E_PENDING]
        arg OpStatus: type=Dcm_OpStatusType, direction=IN
        arg Data: type=Dcm_Data1ByteType, direction=OUT
      operation ConditionCheckRead: possible-error=[DataServices_HardwareVersion_Read_HW_patch_level/E_NOT_OK, DataServices_HardwareVersion_Read_HW_patch_level/DCM_E_PENDING]
        arg OpStatus: type=Dcm_OpStatusType, direction=IN
        arg ErrorCode: type=Dcm_NegativeResponseCodeType, direction=OUT
      error E_NOT_OK: error-code=1
      error DCM_E_PENDING: error-code=10
    ServiceRequestNotification
      operation Indication: possible-error=[ServiceRequestNotification/E_NOT_OK, E_REQUEST_NOT_ACCEPTED]
        6 x arg:
          SID: type=uint8, direction=IN
          RequestData: type=Dcm_Data4095ByteType, direction=IN
          DataSize: type=uint16, direction=IN
          ReqType: type=uint8, direction=IN
          SourceAddress: type=uint16, direction=IN
          ErrorCode: type=Dcm_NegativeResponseCodeType, direction=OUT
      operation Confirmation: possible-error=ServiceRequestNotification/E_NOT_OK
        4 x arg, all with direction=IN:
          SID: type=uint8
          ReqType: type=uint8
          SourceAddress: type=uint16
          ConfirmationStatus: type=Dcm_ConfirmationStatusType
      error E_NOT_OK: error-code=1
      error E_REQUEST_NOT_ACCEPTED: error-code=8
    DataServices_ECU_Location_Read_Side_Allocation
      operation ReadData: possible-error=[DataServices_ECU_Location_Read_Side_Allocation/E_NOT_OK, DataServices_ECU_Location_Read_Side_Allocation/DCM_E_PENDING]
        arg OpStatus: type=Dcm_OpStatusType, direction=IN
        arg Data: type=Dcm_Data1ByteType, direction=OUT
      operation WriteData: possible-error=[DataServices_ECU_Location_Read_Side_Allocation/E_NOT_OK, DataServices_ECU_Location_Read_Side_Allocation/DCM_E_PENDING]
        arg Data: type=Dcm_Data1ByteType, direction=IN
        arg OpStatus: type=Dcm_OpStatusType, direction=IN
        arg ErrorCode: type=Dcm_NegativeResponseCodeType, direction=OUT
      error E_NOT_OK: error-code=1
      error DCM_E_PENDING: error-code=10
    DataServices_Cycle_configuration_Read_Cycles
      operation ReadData: possible-error=[DataServices_Cycle_configuration_Read_Cycles/E_NOT_OK, DataServices_Cycle_configuration_Read_Cycles/DCM_E_PENDING]
        arg OpStatus: type=Dcm_OpStatusType, direction=IN
        arg Data: type=Dcm_Data420ByteType, direction=OUT
      operation WriteData: possible-error=[DataServices_Cycle_configuration_Read_Cycles/E_NOT_OK, DataServices_Cycle_configuration_Read_Cycles/DCM_E_PENDING]
        arg Data: type=Dcm_Data420ByteType, direction=IN
        arg OpStatus: type=Dcm_OpStatusType, direction=IN
        arg ErrorCode: type=Dcm_NegativeResponseCodeType, direction=OUT
      error E_NOT_OK: error-code=1
      error DCM_E_PENDING: error-code=10
    DataServices_Steps_library_Read_Steps
      operation ReadData: possible-error=[DataServices_Steps_library_Read_Steps/E_NOT_OK, DataServices_Steps_library_Read_Steps/DCM_E_PENDING]
        arg OpStatus: type=Dcm_OpStatusType, direction=IN
        arg Data: type=Dcm_Data1160ByteType, direction=OUT
      operation WriteData: possible-error=[DataServices_Steps_library_Read_Steps/E_NOT_OK, DataServices_Steps_library_Read_Steps/DCM_E_PENDING]
        arg Data: type=Dcm_Data1160ByteType, direction=IN
        arg OpStatus: type=Dcm_OpStatusType, direction=IN
        arg ErrorCode: type=Dcm_NegativeResponseCodeType, direction=OUT
      error E_NOT_OK: error-code=1
      error DCM_E_PENDING: error-code=10
  mode switch interface DcmCommunicationControl_ComMConf_ComMChannel_RBTM_FR_BODY3_4xwwtd59665s787n6ctawh7k8_23a94727: is-service=true, service-kind=DIAGNOSTIC-COMMUNICATION-MANAGER
    mode group DcmCommunicationControl_ComMConf_ComMChannel_RBTM_FR_BODY3_4xwwtd59665s787n6ctawh7k8_23a94727: type=DcmCommunicationControl
