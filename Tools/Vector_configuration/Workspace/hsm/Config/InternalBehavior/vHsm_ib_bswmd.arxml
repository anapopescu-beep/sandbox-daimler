AUTOSAR XML (schema 4-0-3)
package /MICROSAR/vHsm_ib_bswmd/BswModuleDescriptions
  bsw module description vHsm
    provided-entrys:
      vHsm_MainFunction_vHsmSchedulableEntities_HighPrio
      vHsm_MainFunction_vHsmSchedulableEntities_Unmapped
      vHsm_MainFunction
    bsw internal behavior vHsmBehavior
      exclusive area VHSM_EXCLUSIVE_AREA_0  # This critical section protects deserialized driver object locking resources. Therefore the critical section enclosed with VHSM_EXCLUSIVE_AREA_0 should never be interrupted by any other API. For more details, see DocTechRef.
      exclusive area VHSM_EXCLUSIVE_AREA_1  # This critical section protects from interrupts while running from RAM. Therefore the critical section enclosed with VHSM_EXCLUSIVE_AREA_1 should never be interrupted by any ISR except when special measures are taken that an ISR does not lead to code flash access e.g. by mapping the vector table and ISRs to RAM.
      bsw schedulable entity vHsm_MainFunction_vHsmSchedulableEntities_HighPrio: implemented-entry=vHsm_MainFunction_vHsmSchedulableEntities_HighPrio
      bsw schedulable entity vHsm_MainFunction_vHsmSchedulableEntities_Unmapped: implemented-entry=vHsm_MainFunction_vHsmSchedulableEntities_Unmapped
      bsw schedulable entity vHsm_MainFunction: implemented-entry=vHsm_MainFunction
      bsw timing event vHsm_MainFunction_vHsmSchedulableEntities_HighPrioTimingEvent0: starts-on-event=vHsm_MainFunction_vHsmSchedulableEntities_HighPrio, period=1000
      bsw timing event vHsm_MainFunction_vHsmSchedulableEntities_UnmappedTimingEvent0: starts-on-event=vHsm_MainFunction_vHsmSchedulableEntities_Unmapped, period=1000
      bsw background event vHsm_MainFunctionBackgroundEvent0: starts-on-event=vHsm_MainFunction
  bsw module entry vHsm_MainFunction_vHsmSchedulableEntities_HighPrio: call-type=SCHEDULED, execution-context=TASK
  bsw module entry vHsm_MainFunction_vHsmSchedulableEntities_Unmapped: call-type=SCHEDULED, execution-context=TASK
  bsw module entry vHsm_MainFunction: call-type=SCHEDULED, execution-context=TASK
