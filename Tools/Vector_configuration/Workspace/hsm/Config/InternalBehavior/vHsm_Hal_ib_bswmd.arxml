AUTOSAR XML (schema 4-3-0)
package /MICROSAR/vHsm_Hal_ib_bswmd
  bsw module description BswModuleDescriptions
    bsw internal behavior vHsm_Hal
