AUTOSAR XML (schema 4-0-3)
package /MICROSAR/Crypto_30_Hwa_ib_bswmd/BswModuleDescriptions
  bsw module description Crypto: provided-entrys=Crypto_30_Hwa_MainFunction
    bsw internal behavior Crypto_30_Hwa
      4 x exclusive area:
        CRYPTO_30_HWA_EXCLUSIVE_AREA_0  # This critical section protects the HAL driver objects on locking and freeing. Also LibCv key read locking is donewith the protection of this exclusive area.
        CRYPTO_30_HWA_EXCLUSIVE_AREA_1  # This critical section protects protects hardware access to AES/AEAD/CMAC crypto accelerators
        CRYPTO_30_HWA_EXCLUSIVE_AREA_2  # This critical section protects hardware access to Hash crypto accelerators
        CRYPTO_30_HWA_EXCLUSIVE_AREA_3  # This critical section protects hardware access to Trng crypto accelerators
      bsw schedulable entity Crypto_30_Hwa_MainFunction: implemented-entry=Crypto_30_Hwa_MainFunction
      bsw background event Crypto_30_Hwa_MainFunctionBackgroundEvent0: starts-on-event=Crypto_30_Hwa_MainFunction
  bsw module entry Crypto_30_Hwa_MainFunction: call-type=SCHEDULED, execution-context=TASK
