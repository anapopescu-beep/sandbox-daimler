AUTOSAR XML (schema 4-2-2)
package /AURIX2G/EcucDefs/Fls_ib_bswmd/BswModuleDescriptions
  bsw module entry Fls_17_Dmu_MainFunction: call-type=SCHEDULED, execution-context=TASK
