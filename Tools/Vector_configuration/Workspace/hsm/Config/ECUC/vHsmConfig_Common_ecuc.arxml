[part 2 of 2: package /ActiveEcuC]
AUTOSAR XML (schema 4-3-0)
package /ActiveEcuC  (continued)
  module config vHsm_Core: definition=Crypto, implementation-config-variant=VARIANT-PRE-COMPILE, module-description=Crypto_Impl
    CryptoDriverObjects
      vHsm_Core (CryptoDriverObject):
        CryptoDriverObjectId = 0
        CryptoDriverObjectQueueSize = 1
        CryptoPrimitiveRef = vHsmSecureBoot
        CryptoPrimitiveRef = CryptoPrimitives/vHsmFirmwareUpdate
        CryptoPrimitiveRef = vHsmSecureBootUpdate
        CryptoPrimitiveRef = vHsmSecureSoftwareDownload
        CryptoPrimitiveRef = vHsmSecureBootConfirmation
        CryptoPrimitiveRef = vHsmPersistency
      vHsm_KeyManagement (CryptoDriverObject): CryptoDriverObjectId=1, CryptoDriverObjectQueueSize=1, CryptoPrimitiveRef=vHsmKeyM
    CryptoPrimitives
      5 x CryptoPrimitive, all with CryptoPrimitiveAlgorithmSecondaryFamily=CRYPTO_ALGOFAM_NOT_SET, CryptoPrimitiveAlgorithmMode=CRYPTO_ALGOMODE_NOT_SET:
        vHsmSecureBoot: CryptoPrimitiveAlgorithmMode=CRYPTO_ALGOMODE_CMAC, CryptoPrimitiveService=CRYPTO_MAC_VERIFY, CryptoPrimitiveAlgorithmFamily=CRYPTO_ALGOFAM_CUSTOM_VHSM_SECURE_BOOT, CryptoPrimitiveAlgorithmMode=CRYPTO_ALGOMODE_CUSTOM_SECURE_BOOT_FORCE_SEQUENTIAL, CryptoPrimitiveAlgorithmFamilyCustomRef=Crypto_30_vHsm_Core_SecureBoot, CryptoPrimitiveAlgorithmModeCustomRef=Crypto_30_vHsm_Core_ForceSequential
        vHsmKeyM: CryptoPrimitiveAlgorithmFamily=CRYPTO_ALGOFAM_NOT_SET, CryptoPrimitiveService=CRYPTO_RANDOM
        vHsmFirmwareUpdate: CryptoPrimitiveAlgorithmFamily=CRYPTO_ALGOFAM_CUSTOM_VHSM_FIRMWARE_UPDATE, CryptoPrimitiveAlgorithmMode=CRYPTO_ALGOMODE_GCM, CryptoPrimitiveService=CRYPTO_AEADENCRYPT, CryptoPrimitiveAlgorithmFamilyCustomRef=Crypto_30_vHsm_Core_FirmwareUpdate
        vHsmSecureSoftwareDownload: CryptoPrimitiveAlgorithmFamily=CRYPTO_ALGOFAM_CUSTOM_VHSM_SOFTWARE_DOWNLOAD, CryptoPrimitiveService=CRYPTO_SIGNATURE_VERIFY, CryptoPrimitiveAlgorithmSecondaryFamilyCustomRef=Crypto_30_vHsm_Core_SoftwareDownload
        vHsmSecureBootUpdate: CryptoPrimitiveAlgorithmFamily=CRYPTO_ALGOFAM_CUSTOM_VHSM_SECURE_BOOT_UPDATE, CryptoPrimitiveService=CRYPTO_SIGNATURE_VERIFY, CryptoPrimitiveAlgorithmFamilyCustomRef=Crypto_30_vHsm_Core_SecureBootUpdate
      5 x CryptoPrimitiveAlgorithmFamilyCustom:
        Crypto_30_vHsm_Core_SoftwareDownload: CryptoPrimitiveAlgorithmFamilyCustomId=161
        Crypto_30_vHsm_Core_SecureBoot: CryptoPrimitiveAlgorithmFamilyCustomId=160
        Crypto_30_vHsm_Core_FirmwareUpdate: CryptoPrimitiveAlgorithmFamilyCustomId=163
        Crypto_30_vHsm_Core_SecureBootUpdate: CryptoPrimitiveAlgorithmFamilyCustomId=164
        Crypto_30_vHsm_Core_Persistency: CryptoPrimitiveAlgorithmFamilyCustomId=192
      3 x CryptoPrimitiveAlgorithmModeCustom:
        Crypto_30_vHsm_Core_ForceSequential: CryptoPrimitiveAlgorithmModeCustomId=133
        Crypto_30_vHsm_Core_PersistDeferred: CryptoPrimitiveAlgorithmModeCustomId=152
        Crypto_30_vHsm_Core_Repersist: CryptoPrimitiveAlgorithmModeCustomId=153
      Crypto_30_vHsm_Core_SecureBootConfirmation (CryptoPrimitiveAlgorithmFamilyCustom): CryptoPrimitiveAlgorithmFamilyCustomId=165
      vHsmSecureBootConfirmation (CryptoPrimitive):
        CryptoPrimitiveAlgorithmFamily = CRYPTO_ALGOFAM_CUSTOM
        CryptoPrimitiveAlgorithmMode = CRYPTO_ALGOMODE_NOT_SET
        CryptoPrimitiveAlgorithmSecondaryFamily = CRYPTO_ALGOFAM_NOT_SET
        CryptoPrimitiveService = CRYPTO_SIGNATURE_VERIFY
        CryptoPrimitiveAlgorithmFamilyCustomRef = Crypto_30_vHsm_Core_SecureBootConfirmation
      vHsmPersistency (CryptoPrimitive):
        CryptoPrimitiveAlgorithmFamily = CRYPTO_ALGOFAM_CUSTOM
        CryptoPrimitiveAlgorithmMode = CRYPTO_ALGOMODE_CUSTOM
        CryptoPrimitiveAlgorithmSecondaryFamily = CRYPTO_ALGOFAM_NOT_SET
        CryptoPrimitiveService = CRYPTO_RANDOM
        CryptoPrimitiveAlgorithmFamilyCustomRef = Crypto_30_vHsm_Core_Persistency
        CryptoPrimitiveAlgorithmModeCustomRef = Crypto_30_vHsm_Core_PersistDeferred
        CryptoPrimitiveAlgorithmModeCustomRef = Crypto_30_vHsm_Core_Repersist
    CryptoKeys
      3 x CryptoKey, all with CryptoKeyDeriveIterations=1:
        vHsmInfo: CryptoKeyId=30000, CryptoKeyTypeRef=vHsmInfo_Type, CryptoKeyAggregationRef=CryptoKeys/vHsm_Info
        vHsmSecureBootGroupInfo: CryptoKeyId=30001, CryptoKeyTypeRef=vHsmSecureBootGroupInfo_Type
        vHsmLog: CryptoKeyId=30002, CryptoKeyTypeRef=vHsmLog_Type
    CryptoKeyElements
      8 x CryptoKeyElement, all with CryptoKeyElementPersist=false, CryptoKeyElementAllowPartialAccess=false:
        vHsmInfo_Version: CryptoKeyElementId=3020, CryptoKeyElementSize=3, CryptoKeyElementReadAccess=RA_ALLOWED, CryptoKeyElementWriteAccess=WA_DENIED
        vHsmInfo_PerformPersist: CryptoKeyElementId=3022, CryptoKeyElementSize=1, CryptoKeyElementReadAccess=RA_ALLOWED, CryptoKeyElementWriteAccess=WA_DENIED
        vHsmInfo_PerformRepersist: CryptoKeyElementSize=1, CryptoKeyElementReadAccess=RA_DENIED, CryptoKeyElementWriteAccess=WA_ALLOWED, CryptoKeyElementId=3036
        vHsmInfo_StartFirmwareUpdater: CryptoKeyElementId=3038, CryptoKeyElementSize=1, CryptoKeyElementReadAccess=RA_DENIED, CryptoKeyElementWriteAccess=WA_ALLOWED
        vHsmInfo_SecureBootEnd: CryptoKeyElementId=3028, CryptoKeyElementSize=1, CryptoKeyElementReadAccess=RA_ALLOWED, CryptoKeyElementWriteAccess=WA_ALLOWED
        vHsmInfo_SecureBootResult: CryptoKeyElementId=3037, CryptoKeyElementSize=1, CryptoKeyElementReadAccess=RA_ALLOWED, CryptoKeyElementWriteAccess=WA_DENIED
        vHsmSecureBootInfo_GroupState: CryptoKeyElementId=0, CryptoKeyElementSize=2, CryptoKeyElementReadAccess=RA_ALLOWED, CryptoKeyElementWriteAccess=WA_DENIED
        vHsmLog_EventId: CryptoKeyElementId=0, CryptoKeyElementSize=1, CryptoKeyElementReadAccess=RA_ALLOWED, CryptoKeyElementWriteAccess=WA_DENIED
    CryptoKeyTypes
      3 x CryptoKeyType:
        vHsmSecureBootGroupInfo_Type: CryptoKeyElementRef=vHsmSecureBootInfo_GroupState
        vHsmInfo_Type: CryptoKeyElementRef=vHsmInfo_Version, CryptoKeyElementRef=vHsmInfo_PerformPersist, CryptoKeyElementRef=vHsmInfo_PerformRepersist, CryptoKeyElementRef=vHsmInfo_StartFirmwareUpdater, CryptoKeyElementRef=vHsmInfo_SecureBootEnd, CryptoKeyElementRef=vHsmInfo_SecureBootResult
        vHsmLog_Type: CryptoKeyElementRef=vHsmLog_EventId
  module config vHsm_Custom: definition=Crypto, implementation-config-variant=VARIANT-PRE-COMPILE, module-description=Crypto_Impl
    CryptoDriverObjects
      vHsm_Custom (CryptoDriverObject): CryptoDriverObjectId=0, CryptoDriverObjectQueueSize=1, CryptoPrimitiveRef=Dummy
    CryptoPrimitives
      Dummy (CryptoPrimitive):
        CryptoPrimitiveAlgorithmFamily = CRYPTO_ALGOFAM_NOT_SET
        CryptoPrimitiveAlgorithmMode = CRYPTO_ALGOMODE_NOT_SET
        CryptoPrimitiveAlgorithmSecondaryFamily = CRYPTO_ALGOFAM_NOT_SET
        CryptoPrimitiveService = CRYPTO_RANDOM
  module config Csm: implementation-config-variant=VARIANT-PRE-COMPILE, module-description=Csm_Impl
    3 x CsmPrimitives:
      SigGenEd25519
        CsmSignatureGenerate
          SigGenEd25519 (CsmSignatureGenerateConfig):
            CsmSignatureGenerateAlgorithmFamily = CRYPTO_ALGOFAM_ED25519
            CsmSignatureGenerateAlgorithmMode = CRYPTO_ALGOMODE_NOT_SET
            CsmSignatureGenerateProcessing = CSM_SYNCHRONOUS
            CsmSignatureGenerateKeyLength = 32
            CsmSignatureGenerateAlgorithmSecondaryFamily = CRYPTO_ALGOFAM_SHA2_512
            CsmSignatureGenerateDataMaxLength = 8192
            CsmSignatureGenerateAlgorithmFamiliy = CRYPTO_ALGOFAM_ED25519
            CsmSignatureGenerateResultLength = 64
            CsmSignatureGenerateSwcInterfaceVersion = CSM_ASR_VERSION_4_03
      CsmPrimitives_Encrypt
        CsmEncrypt
          CsmPrimitives_Encrypt (CsmEncryptConfig):
            CsmEncryptAlgorithmFamiliy = CRYPTO_ALGOFAM_AES
            CsmEncryptAlgorithmFamily = CRYPTO_ALGOFAM_AES
            CsmEncryptAlgorithmMode = CRYPTO_ALGOMODE_CBC
            CsmEncryptAlgorithmSecondaryFamily = CRYPTO_ALGOFAM_CUSTOM
            CsmEncryptProcessing = CSM_SYNCHRONOUS
            CsmEncryptAlgorithmKeyLength = 16
            CsmEncryptAlgorithmSecondaryFamilyCustomRef = Crypto_30_Hwa_PaddingPKCS7
      CsmPrimitives_Decrypt
        CsmDecrypt
          CsmPrimitives_Decrypt (CsmDecryptConfig):
            CsmDecryptAlgorithmFamiliy = CRYPTO_ALGOFAM_AES
            CsmDecryptAlgorithmFamily = CRYPTO_ALGOFAM_AES
            CsmDecryptAlgorithmKeyLength = 16
            CsmDecryptAlgorithmMode = CRYPTO_ALGOMODE_CBC
            CsmDecryptAlgorithmSecondaryFamily = CRYPTO_ALGOFAM_CUSTOM
            CsmDecryptProcessing = CSM_SYNCHRONOUS
            CsmDecryptAlgorithmSecondaryFamilyCustomRef = Crypto_30_Hwa_PaddingPKCS7
    CsmQueues
      7 x CsmQueue, all with CsmQueueSize=1, CsmTriggerAsynchJobsInCallback=false, CsmJobSharing=true:
        CsmQueue_KeyM: CsmChannelRef=Crypto_30_vHsm_KeyM_LibCv
        CsmQueue_LibCv: CsmChannelRef=Crypto_30_vHsm_LibCv
        CsmQueue_Hwa: CsmChannelRef=Crypto_30_vHsm_Hwa
        CsmQueue_FirmwareUpdate_Decrypt: CsmChannelRef=Crypto_30_vHsm_LibCv_vHsmUpd_Dec
        CsmQueue_FirmwareUpdate_Encrypt: CsmChannelRef=Crypto_30_vHsm_LibCv_vHsmUpd_Enc
        CsmQueue_FirmwareUpdate_SignatureVerify: CsmChannelRef=Crypto_30_vHsm_LibCv_vHsmUpd_Sig
        CsmQueue_FirmwareUpdate_MacGenerate: CsmChannelRef=Crypto_30_vHsm_LibCv_vHsmUpd_Mac
    CsmPrimitives_CsmHash (CsmPrimitives)
      CsmHash
        CsmPrimitives_CsmHash (CsmHashConfig):
          CsmHashAlgorithmFamiliy = CRYPTO_ALGOFAM_SHA2_256
          CsmHashAlgorithmFamily = CRYPTO_ALGOFAM_SHA2_256
          CsmHashAlgorithmMode = CRYPTO_ALGOMODE_NOT_SET
          CsmHashAlgorithmSecondaryFamily = CRYPTO_ALGOFAM_NOT_SET
          CsmHashProcessing = CSM_SYNCHRONOUS
          CsmHashResultLength = 32
    CsmGeneral:
      CsmAsymPrivateKeyMaxLength = 32
      CsmAsymPublicKeyMaxLength = 1024
      CsmDevErrorDetect = true
      CsmMainFunctionPeriod = 0.01
      CsmSymKeyMaxLength = 16
      CsmUseDeprecated = false
      CsmVersionInfoApi = false
      CsmCallbackStartNotification = false
      CsmCustomIncludeFiles = Crypto_30_LibCv_Custom.h
      CsmCancelationDuringProcessing = false
      CsmSafeBswChecks = false
      CsmJobTypeLayout:
        CsmJobTypeLayoutAsr430Compatibility = true
        CsmJobTypeLayoutVarMembers = true
        CsmJobTypeLayoutInput64 = false
        CsmJobTypeLayoutOutput64Ptr = false
        CsmJobTypeLayoutRedirectionInfoRef = false
    CsmKeys
      63 x CsmKey, all with CsmKeyUsePort=false:
        CsmKey_KeyM_Cert_Root: CsmKeyId=8, CsmKeyRef=CryIf/KeyM_Cert_Root
        CsmKey_KeyM_Cert_Intermediate: CsmKeyId=7, CsmKeyRef=CryIf/KeyM_Cert_Root
        CsmKey_KeyM_ECC_Root: CsmKeyId=10, CsmKeyRef=CryIf/KeyM_ECC_Root
        CsmKey_KeyM_ECC_Intermediate: CsmKeyId=9, CsmKeyRef=CryIf/KeyM_ECC_Intermediate
        CsmKey_ROM_KEY_0: CsmKeyId=17, CsmKeyRef=vHsm_RomKey0
        CsmKey_vHsm_FirmwareUpdate_Decrypt: CsmKeyId=55, CsmKeyRef=CryIf/vHsm_FirmwareUpdate_Decrypt
        CsmKey_vHsm_FirmwareUpdate_Encrypt: CsmKeyId=56, CsmKeyRef=CryIf/vHsm_FirmwareUpdate_Encrypt
        CsmKey_vHsm_FirmwareUpdate_Mac: CsmKeyId=57, CsmKeyRef=CryIf/vHsm_FirmwareUpdate_Mac
        CsmKey_vHsm_FirmwareUpdate_Signature: CsmKeyId=58, CsmKeyRef=CryIf/vHsm_FirmwareUpdate_Signature
        CsmKey_vHsmLog: CsmKeyId=53, CsmKeyRef=vHsm_Log
        CsmKey_vHsm_Info: CsmKeyId=60, CsmKeyRef=CryIf/vHsm_Info
        CsmKey_vHsm_Hardware: CsmKeyId=59, CsmKeyRef=CryIf/vHsm_Hardware
        CsmKey_vHsm_Custom: CsmKeyId=54, CsmKeyRef=CryIf/vHsm_Custom
        CsmKey_Ssa_RandomSeed: CsmKeyId=32, CsmKeyRef=CryIf/Ssa_RandomSeed
        CsmKey_Ssa_SecurityAccessPublicKey: CsmKeyId=35, CsmKeyRef=CryIf/Ssa_SecurityAccessPublicKey
        CsmKey_Ssa_SharedSecretExchangeKey: CsmKeyId=36, CsmKeyRef=CryIf/Ssa_SharedSecretExchangeKey
        CsmKey_Ssa_SharedSecretHash: CsmKeyId=37, CsmKeyRef=CryIf/Ssa_SharedSecretHash
        CsmKey_Ssa_BackendCert: CsmKeyId=30, CsmKeyRef=CryIf/Ssa_BackendCert
        CsmKey_Ssa_AesRamKey: CsmKeyId=28, CsmKeyRef=CryIf/Ssa_AesRamKey
        CsmKey_Ssa_RootCert: CsmKeyId=34, CsmKeyRef=CryIf/Ssa_RootCert
        CsmKey_Ssa_RealTime: CsmKeyId=33, CsmKeyRef=CryIf/Ssa_RealTime
        CsmKey_SSA_SecOC_Int_MacVerify_Ign_Stat: CsmKeyId=24, CsmKeyRef=CryIf/SSA_SecOC_Int_MacVerify_Ign_Stat
        CsmKey_Ssa_SignatureRamKey: CsmKeyId=38, CsmKeyRef=CryIf/Ssa_SignatureRamKey
        CsmKey_SSA_SecOC_Int_MacVerify_VehSpd_8: CsmKeyId=27, CsmKeyRef=CryIf/SSA_SecOC_Int_MacVerify_VehSpd_8
        CsmKey_SSA_SecOC_Int_MacVerify_PN14_Master_Stat1: CsmKeyId=25, CsmKeyRef=CryIf/SSA_SecOC_Int_MacVerify_PN14_Master_Stat1
        CsmKey_KeyM_SigVerifyKey_TrustModelRoot: CsmKeyId=16, CsmKeyRef=CryIf/KeyM_SigVerifyKey_TrustModelRoot
        CsmKey_SSA_SecOC_Int_MacVerify_DI_OdoSpeedometer: CsmKeyId=23, CsmKeyRef=CryIf/SSA_SecOC_Int_MacVerify_DI_OdoSpeedometer
        CsmKey_KeyM_SigVerifyKey_TrustModelIntermediate: CsmKeyId=14, CsmKeyRef=CryIf/KeyM_SigVerifyKey_TrustModelIntermediate
        CsmKey_Ssa_VIN: CsmKeyId=51, CsmKeyRef=CryIf/Ssa_VIN
        CsmKey_Ssa_Authentication: CsmKeyId=29, CsmKeyRef=CryIf/Ssa_Authentication
        CsmKey_KeyM_SigVerifyKey_TrustModelBackend: CsmKeyId=11, CsmKeyRef=CryIf/KeyM_SigVerifyKey_TrustModelBackend
        CsmKey_Ssa_TickCount: CsmKeyId=40, CsmKeyRef=CryIf/Ssa_TickCount
        CsmKey_SSA_SecOC_Int_MacVerify_PT4_PTCoor4: CsmKeyId=26, CsmKeyRef=CryIf/SSA_SecOC_Int_MacVerify_PT4_PTCoor4
        CsmKey_vHsmInfo: CsmKeyId=52, CsmKeyRef=CryIf/vHsm_Info
        CsmKey_Ssa_PduKeysMac: CsmKeyId=31, CsmKeyRef=CryIf/Ssa_PduKeysMac
        CsmKey_SSA_SecOC_Int_MacGen_COM_C04_Pdu03_secured_044596e0_Tx: CsmKeyId=18, CsmKeyRef=CryIf/SSA_SecOC_Int_MacGen_COM_C04_Pdu03_secured_044596e0_Tx
        CsmKey_SSA_SecOC_Int_MacGen_COM_C04_Pdu20_secured_393d7a18_Tx: CsmKeyId=19, CsmKeyRef=CryIf/SSA_SecOC_Int_MacGen_COM_C04_Pdu20_secured_393d7a18_Tx
        CsmKey_SSA_SecOC_Int_MacGen_COM_C04_Pdu21_secured_2e466e5b_Tx: CsmKeyId=20, CsmKeyRef=CryIf/SSA_SecOC_Int_MacGen_COM_C04_Pdu21_secured_2e466e5b_Tx
        CsmKey_SSA_SecOC_Int_MacVerify_COM_C0X_Pdu20_secured_3ef6961f_Rx: CsmKeyId=21, CsmKeyRef=CryIf/SSA_SecOC_Int_MacVerify_COM_C0X_Pdu20_secured_3ef6961f_Rx
        CsmKey_SSA_SecOC_Int_MacVerify_COM_C0X_Pdu21_secured_298d825c_Rx: CsmKeyId=22, CsmKeyRef=CryIf/SSA_SecOC_Int_MacVerify_COM_C0X_Pdu21_secured_298d825c_Rx
        CsmKey_KeyM_SigVerifyKey_TrustModelBackendPeer: CsmKeyId=12, CsmKeyRef=CryIf/KeyM_SigVerifyKey_TrustModelBackendPeer
        CsmKey_KeyM_SigVerifyKey_TrustModelEcuPeer: CsmKeyId=13, CsmKeyRef=CryIf/KeyM_SigVerifyKey_TrustModelEcuPeer
        CsmKey_KeyM_SigVerifyKey_TrustModelIntermediatePeer: CsmKeyId=15, CsmKeyRef=CryIf/KeyM_SigVerifyKey_TrustModelIntermediatePeer
        CsmKey_vHsm_TRNG: CsmKeyId=62, CsmKeyRef=CryIf/vHsm_TRNG
        CsmKey_Ssa_SignatureRamKey_replacementAuthority: CsmKeyId=39, CsmKeyRef=CryIfKey_Ssa_SignatureRamKey_replacementAuthority
        CsmKey_Ssa_TrustModelEcuPublicCsr_StagingKey: CsmKeyId=43, CsmKeyRef=CryIf/Ssa_TrustModelEcuPublicCsr_StagingKey
        CsmKey_Ssa_TrustModelEcuPublic_LiveKey: CsmKeyId=44, CsmKeyRef=CryIf/Ssa_TrustModelEcuPublic_LiveKey
        CsmKey_Ssa_TrustModelPrivateEcuUnique_StagingKey: CsmKeyId=46, CsmKeyRef=CryIfKey_Ssa_TrustModelPrivateEcuUnique_StagingKey
        CsmKey_Ssa_TrustModelPrivateEcu_LiveKey: CsmKeyId=47, CsmKeyRef=CryIf/Ssa_TrustModelPrivateEcu_LiveKey
        CsmKey_Ssa_TrustModelBackendCert_inHSM: CsmKeyId=41, CsmKeyRef=CryIfKey_Ssa_TrustModelBackendCert_inHSM
        CsmKey_Ssa_TrustModelEcuCert_inHSM: CsmKeyId=42, CsmKeyRef=CryIfKey_Ssa_TrustModelEcuCert_inHSM
        CsmKey_Ssa_TrustModelIntermediateCert_inHSM: CsmKeyId=45, CsmKeyRef=CryIfKey_Ssa_TrustModelIntermediateCert_inHSM
        CsmKey_Ssa_TrustModelRootCert_inHSM: CsmKeyId=48, CsmKeyRef=CryIfKey_Ssa_TrustModelRootCert_inHSM
        CsmKey_Ssa_TrustModel_Ecu_CsrPrivateKey: CsmKeyId=49, CsmKeyRef=CryIfKey_Ssa_TrustModel_Ecu_CsrPrivateKey
        CsmKey_Ssa_TrustModel_Ecu_CsrPublicKey: CsmKeyId=50, CsmKeyRef=CryIfKey_Ssa_TrustModel_Ecu_CsrPublicKey
        CsmKey_vHsm_Info_01: CsmKeyId=61, CsmKeyRef=CryIfKey_vHsm_Info
        CsmKey_KeyMCertificate_OSSL_X509_ECDSA_P384_CA: CsmKeyId=5, CsmKeyRef=CryIfKey_KeyMCertificate_OSSL_X509_ECDSA_P384_CA
        CsmKey_KeyMCertificate_OSSL_X509_ECDSA_P384_IA: CsmKeyId=6, CsmKeyRef=CryIfKey_KeyMCertificate_OSSL_X509_ECDSA_P384_IA
        CsmKey_Fbl_Decrypt_Aes128: CsmKeyId=0, CsmKeyRef=CryIfKey_Fbl_Decrypt_Aes128
        CsmKey_Fbl_Rng_Fips186: CsmKeyId=2, CsmKeyRef=CryIfKey_Fbl_Rng_Fips186
        CsmKey_Fbl_Signature_Ed25519: CsmKeyId=4, CsmKeyRef=CryIfKey_Fbl_Signature_Ed25519
        CsmKey_Fbl_HashDummy: CsmKeyId=1, CsmKeyRef=CryIfKey_Fbl_HashDummy
        CsmKey_Fbl_SecurityAccess_Ed25519: CsmKeyId=3, CsmKeyRef=CryIfKey_Fbl_SecurityAccess_Ed25519
    CsmJobs
      16 x CsmJob, all with CsmJobUsePort=false, CsmProcessingMode=CRYPTO_PROCESSING_SYNC, CsmJobInterfaceUsePort=CRYPTO_USE_FNC:
        CsmJob_KeyStorage_Encrypt: CsmJobId=9, CsmJobPriority=0, CsmJobKeyRef=CsmKey_ROM_KEY_0, CsmJobPrimitiveRef=Csm/CsmPrimitives_Encrypt, CsmJobQueueRef=CsmQueue_Hwa
        CsmJob_KeyStorage_Decrypt: CsmJobId=8, CsmJobPriority=0, CsmJobKeyRef=CsmKey_ROM_KEY_0, CsmJobPrimitiveRef=Csm/CsmPrimitives_Decrypt, CsmJobQueueRef=CsmQueue_Hwa
        CsmJob_KeyM_ECC_Root: CsmJobId=7, CsmJobPriority=1, CsmJobKeyRef=CsmKey_KeyM_ECC_Root, CsmJobPrimitiveRef=Csm/CsmPrimitives_ECC_P256R1, CsmJobQueueRef=CsmQueue_KeyM
        CsmJob_KeyM_ECC_Intermediate: CsmJobId=6, CsmJobPriority=1, CsmJobKeyRef=CsmKey_KeyM_ECC_Intermediate, CsmJobPrimitiveRef=Csm/CsmPrimitives_ECC_P256R1, CsmJobQueueRef=CsmQueue_KeyM
        CsmJob_Random: CsmJobId=10, CsmJobPriority=1, CsmJobKeyRef=CsmKey_vHsm_TRNG, CsmJobPrimitiveRef=Csm/CsmPrimitives_RandomTrng, CsmJobQueueRef=CsmQueue_Hwa
        CsmJob_FirmwareUpdate_MacGenerate: CsmJobId=4, CsmJobPriority=1, CsmJobKeyRef=CsmKey_vHsm_FirmwareUpdate_Mac, CsmJobPrimitiveRef=Csm/CsmPrimitives_FirmwareUpdate_MacGenerate, CsmJobQueueRef=CsmQueue_FirmwareUpdate_MacGenerate
        CsmJob_FirmwareUpdate_SignatureVerify: CsmJobId=5, CsmJobPriority=1, CsmJobKeyRef=CsmKey_vHsm_FirmwareUpdate_Signature, CsmJobPrimitiveRef=Csm/CsmPrimitives_FirmwareUpdate_SignatureVerify, CsmJobQueueRef=CsmQueue_FirmwareUpdate_SignatureVerify
        CsmJob_FirmwareUpdate_Encrypt: CsmJobId=3, CsmJobPriority=1, CsmJobKeyRef=CsmKey_vHsm_FirmwareUpdate_Encrypt, CsmJobPrimitiveRef=Csm/CsmPrimitives_FirmwareUpdate_Encrypt, CsmJobQueueRef=CsmQueue_FirmwareUpdate_Encrypt
        CsmJob_FirmwareUpdate_Decrypt: CsmJobId=2, CsmJobPriority=1, CsmJobKeyRef=CsmKey_vHsm_FirmwareUpdate_Decrypt, CsmJobPrimitiveRef=Csm/CsmPrimitives_FirmwareUpdate_Decrypt, CsmJobQueueRef=CsmQueue_FirmwareUpdate_Decrypt
        SSA_KeyPairGenerationEd25519: CsmJobId=15, CsmJobPriority=1, CsmJobKeyRef=CsmKey_Ssa_TrustModelPrivateEcuUnique_StagingKey, CsmJobPrimitiveRef=Csm/CsmPrimitives_Ed25519KeyGen, CsmJobQueueRef=CsmQueue_LibCv
        CsmJob_DecryptionAes128NoneCbc: CsmJobId=0, CsmJobPriority=0, CsmJobKeyRef=CsmKey_Fbl_Decrypt_Aes128, CsmJobPrimitiveRef=Csm/CsmPrimitives_Dec_Aes128NoneCbc, CsmJobQueueRef=CsmQueue_Hwa
        CsmJob_RandomGenerate: CsmJobId=11, CsmJobPriority=0, CsmJobKeyRef=CsmKey_Fbl_Rng_Fips186, CsmJobPrimitiveRef=Csm/CsmPrimitives_RandomGenerate, CsmJobQueueRef=CsmQueue_Hwa
        CsmJob_DecryptionAes128PkcsCbc: CsmJobId=1, CsmJobPriority=0, CsmJobKeyRef=CsmKey_Fbl_Decrypt_Aes128, CsmJobPrimitiveRef=Csm/CsmPrimitives_Dec_Aes128PkcsCbc, CsmJobQueueRef=CsmQueue_Hwa
        CsmJob_SigAsymVer_Ed25519Sha512: CsmJobId=14, CsmJobPriority=0, CsmJobKeyRef=CsmKey_Fbl_Signature_Ed25519, CsmJobPrimitiveRef=Csm/CsmPrimitives_SigAsymVer_EdDsa25519Sha512, CsmJobQueueRef=CsmQueue_Hwa
        CsmJob_Sha512: CsmJobId=13, CsmJobPriority=0, CsmJobKeyRef=CsmKey_Fbl_HashDummy, CsmJobPrimitiveRef=Csm/CsmPrimitives_Sha512, CsmJobQueueRef=CsmQueue_LibCv
        CsmJob_SecurityAccess_Ed25519Sha512: CsmJobId=12, CsmJobPriority=0, CsmJobKeyRef=CsmKey_Fbl_SecurityAccess_Ed25519, CsmJobPrimitiveRef=Csm/CsmPrimitives_SigAsymVer_EdDsa25519Sha512, CsmJobQueueRef=CsmQueue_Hwa
    13 x CsmPrimitives:
      CsmPrimitives_ECC_P256R1
        CsmSignatureVerify
          CsmPrimitives_ECC_P256R1 (CsmSignatureVerifyConfig):
            CsmSignatureVerifyAlgorithmFamiliy = CRYPTO_ALGOFAM_ECCNIST
            CsmSignatureVerifyAlgorithmFamily = CRYPTO_ALGOFAM_ECCNIST
            CsmSignatureVerifyAlgorithmMode = CRYPTO_ALGOMODE_CUSTOM
            CsmSignatureVerifyAlgorithmSecondaryFamily = CRYPTO_ALGOFAM_SHA2_256
            CsmSignatureVerifyCompareLength = 384
            CsmSignatureVerifyProcessing = CSM_SYNCHRONOUS
            CsmSignatureVerifyKeyLength = 32
            CsmSignatureVerifyAlgorithmModeCustom = CRYPTO_ALGOMODE_CUSTOM_P256R1
      CsmPrimitives_FirmwareUpdate_Decrypt
        CsmDecrypt
          CsmPrimitives_FirmwareUpdate_Decrypt (CsmDecryptConfig):
            CsmDecryptAlgorithmFamiliy = CRYPTO_ALGOFAM_AES
            CsmDecryptAlgorithmFamily = CRYPTO_ALGOFAM_AES
            CsmDecryptAlgorithmKeyLength = 16
            CsmDecryptAlgorithmMode = CRYPTO_ALGOMODE_CBC
            CsmDecryptAlgorithmSecondaryFamily = CRYPTO_ALGOFAM_NOT_SET
            CsmDecryptProcessing = CSM_SYNCHRONOUS
      CsmPrimitives_FirmwareUpdate_Encrypt
        CsmEncrypt
          CsmPrimitives_FirmwareUpdate_Encrypt (CsmEncryptConfig):
            CsmEncryptAlgorithmFamiliy = CRYPTO_ALGOFAM_AES
            CsmEncryptAlgorithmFamily = CRYPTO_ALGOFAM_AES
            CsmEncryptAlgorithmMode = CRYPTO_ALGOMODE_CBC
            CsmEncryptAlgorithmSecondaryFamily = CRYPTO_ALGOFAM_NOT_SET
            CsmEncryptProcessing = CSM_SYNCHRONOUS
            CsmEncryptAlgorithmKeyLength = 16
      CsmPrimitives_FirmwareUpdate_SignatureVerify
        CsmSignatureVerify
          CsmPrimitives_FirmwareUpdate_SignatureVerify (CsmSignatureVerifyConfig):
            CsmSignatureVerifyAlgorithmFamiliy = CRYPTO_ALGOFAM_ED25519
            CsmSignatureVerifyAlgorithmFamily = CRYPTO_ALGOFAM_ED25519
            CsmSignatureVerifyAlgorithmMode = CRYPTO_ALGOMODE_NOT_SET
            CsmSignatureVerifyAlgorithmSecondaryFamily = CRYPTO_ALGOFAM_SHA2_512
            CsmSignatureVerifyCompareLength = 384
            CsmSignatureVerifyProcessing = CSM_SYNCHRONOUS
            CsmSignatureVerifyKeyLength = 32
      CsmPrimitives_FirmwareUpdate_MacGenerate
        CsmMacGenerate
          CsmPrimitives_FirmwareUpdate_MacGenerate (CsmMacGenerateConfig):
            CsmMacGenerateAlgorithmFamiliy = CRYPTO_ALGOFAM_AES
            CsmMacGenerateAlgorithmFamily = CRYPTO_ALGOFAM_AES
            CsmMacGenerateAlgorithmKeyLength = 16
            CsmMacGenerateAlgorithmMode = CRYPTO_ALGOMODE_CMAC
            CsmMacGenerateAlgorithmSecondaryFamily = CRYPTO_ALGOFAM_NOT_SET
            CsmMacGenerateProcessing = CSM_SYNCHRONOUS
            CsmMacGenerateResultLength = 16
            CsmMacGenerateDataMaxLength = 16
      CsmPrimitives_RandomTrng
        CsmRandomGenerate
          CsmPrimitives_RandomTrng (CsmRandomGenerateConfig):
            CsmRandomGenerateAlgorithmFamiliy = CRYPTO_ALGOFAM_RNG
            CsmRandomGenerateAlgorithmFamily = CRYPTO_ALGOFAM_RNG
            CsmRandomGenerateAlgorithmMode = CRYPTO_ALGOMODE_NOT_SET
            CsmRandomGenerateAlgorithmSecondaryFamily = CRYPTO_ALGOFAM_NOT_SET
            CsmRandomGenerateProcessing = CSM_SYNCHRONOUS
            CsmRandomGenerateResultLength = 16
      CsmPrimitives_RandomDrbg
        CsmRandomGenerate
          CsmPrimitives_RandomDrbg (CsmRandomGenerateConfig):
            CsmRandomGenerateAlgorithmFamiliy = CRYPTO_ALGOFAM_CUSTOM
            CsmRandomGenerateAlgorithmFamily = CRYPTO_ALGOFAM_CUSTOM
            CsmRandomGenerateAlgorithmMode = CRYPTO_ALGOMODE_NOT_SET
            CsmRandomGenerateAlgorithmSecondaryFamily = CRYPTO_ALGOFAM_CUSTOM
            CsmRandomGenerateProcessing = CSM_SYNCHRONOUS
            CsmRandomGenerateResultLength = 16
            CsmRandomGenerateAlgorithmFamilyCustom = CRYPTO_ALGOFAM_CUSTOM_DRBG
            CsmRandomGenerateAlgorithmSecondaryFamilyCustom = CRYPTO_ALGOFAM_AES
      CsmPrimitives_Ed25519KeyGen
        CsmJobKeyGenerate
          CsmPrimitives_Ed25519KeyGen (CsmJobKeyGenerateConfig):
            CsmJobKeyGenerateAlgorithmFamiliy = CRYPTO_ALGOFAM_ED25519
            CsmJobKeyGenerateAlgorithmFamily = CRYPTO_ALGOFAM_ED25519
            CsmJobKeyGenerateAlgorithmMode = CRYPTO_ALGOMODE_NOT_SET
            CsmJobKeyGenerateAlgorithmSecondaryFamily = CRYPTO_ALGOFAM_NOT_SET
      CsmPrimitives_Dec_Aes128NoneCbc
        CsmDecrypt
          CsmPrimitives_Dec_Aes128NoneCbc (CsmDecryptConfig):
            CsmDecryptAlgorithmFamiliy = CRYPTO_ALGOFAM_AES
            CsmDecryptAlgorithmFamily = CRYPTO_ALGOFAM_AES
            CsmDecryptAlgorithmKeyLength = 16
            CsmDecryptAlgorithmMode = CRYPTO_ALGOMODE_CBC
            CsmDecryptAlgorithmSecondaryFamily = CRYPTO_ALGOFAM_NOT_SET
            CsmDecryptProcessing = CSM_SYNCHRONOUS
      CsmPrimitives_RandomGenerate
        CsmRandomGenerate
          CsmPrimitives_RandomGenerate (CsmRandomGenerateConfig):
            CsmRandomGenerateAlgorithmFamiliy = CRYPTO_ALGOFAM_RNG
            CsmRandomGenerateAlgorithmFamily = CRYPTO_ALGOFAM_RNG
            CsmRandomGenerateAlgorithmMode = CRYPTO_ALGOMODE_NOT_SET
            CsmRandomGenerateAlgorithmSecondaryFamily = CRYPTO_ALGOFAM_NOT_SET
            CsmRandomGenerateProcessing = CSM_SYNCHRONOUS
            CsmRandomGenerateResultLength = 4
      CsmPrimitives_Dec_Aes128PkcsCbc
        CsmDecrypt
          CsmPrimitives_Dec_Aes128PkcsCbc (CsmDecryptConfig):
            CsmDecryptAlgorithmFamiliy = CRYPTO_ALGOFAM_AES
            CsmDecryptAlgorithmFamily = CRYPTO_ALGOFAM_AES
            CsmDecryptAlgorithmKeyLength = 16
            CsmDecryptAlgorithmMode = CRYPTO_ALGOMODE_CBC
            CsmDecryptAlgorithmSecondaryFamily = CRYPTO_ALGOFAM_CUSTOM
            CsmDecryptProcessing = CSM_SYNCHRONOUS
            CsmDecryptAlgorithmSecondaryFamilyCustomRef = Crypto_30_Hwa_PaddingPKCS7
      CsmPrimitives_SigAsymVer_EdDsa25519Sha512
        CsmSignatureVerify
          CsmPrimitives_SigAsymVer_EdDsa25519Sha512 (CsmSignatureVerifyConfig):
            CsmSignatureVerifyAlgorithmFamiliy = CRYPTO_ALGOFAM_ED25519
            CsmSignatureVerifyAlgorithmFamily = CRYPTO_ALGOFAM_ED25519
            CsmSignatureVerifyAlgorithmMode = CRYPTO_ALGOMODE_CUSTOM
            CsmSignatureVerifyAlgorithmSecondaryFamily = CRYPTO_ALGOFAM_SHA2_512
            CsmSignatureVerifyCompareLength = 64
            CsmSignatureVerifyProcessing = CSM_SYNCHRONOUS
            CsmSignatureVerifyKeyLength = 32
            CsmSignatureVerifyAlgorithmModeCustomRef = Crypto_30_Hwa_Ed25519Ph
      CsmPrimitives_Sha512
        CsmHash
          CsmPrimitives_Sha512 (CsmHashConfig):
            CsmHashAlgorithmFamiliy = CRYPTO_ALGOFAM_SHA2_512
            CsmHashAlgorithmFamily = CRYPTO_ALGOFAM_SHA2_512
            CsmHashAlgorithmMode = CRYPTO_ALGOMODE_NOT_SET
            CsmHashAlgorithmSecondaryFamily = CRYPTO_ALGOFAM_NOT_SET
            CsmHashProcessing = CSM_SYNCHRONOUS
            CsmHashResultLength = 64
  module config Dem_Stub: definition=Dem, implementation-config-variant=VARIANT-PRE-COMPILE
    DemConfigSet
      DemEventParameter_Dummy_001 (DemEventParameter): DemEventAvailable=false, DemEventId=1, DemEventKind=DEM_EVENT_KIND_BSW
        DemEventClass: DemAgingAllowed=false, DemConsiderPtoStatus=false, DemEventPriority=1, DemFFPrestorageSupported=false, DemOperationCycleRef=DemOperationCycle
          DemDebounceAlgorithmClass
            DemDebounceCounterBased:
              DemDebounceBehavior = DEM_DEBOUNCE_FREEZE
              DemDebounceCounterDecrementStepSize = 1
              DemDebounceCounterFailedThreshold = 1
              DemDebounceCounterIncrementStepSize = 1
              DemDebounceCounterJumpDown = false
              DemDebounceCounterJumpDownValue = 0
              DemDebounceCounterJumpUp = false
              DemDebounceCounterJumpUpValue = 0
              DemDebounceCounterPassedThreshold = -1
              DemDebounceCounterStorage = false
      DemEventParameter: DemEventAvailable=false, DemEventId=1, DemEventKind=DEM_EVENT_KIND_BSW
        DemEventClass: DemAgingAllowed=false, DemConsiderPtoStatus=false, DemEventPriority=1, DemFFPrestorageSupported=false, DemOperationCycleRef=DemOperationCycle
          DemDebounceAlgorithmClass
            DemDebounceCounterBased:
              DemDebounceBehavior = DEM_DEBOUNCE_FREEZE
              DemDebounceCounterDecrementStepSize = 1
              DemDebounceCounterFailedThreshold = 1
              DemDebounceCounterIncrementStepSize = 1
              DemDebounceCounterJumpDown = false
              DemDebounceCounterJumpDownValue = 0
              DemDebounceCounterJumpUp = false
              DemDebounceCounterJumpUpValue = 0
              DemDebounceCounterPassedThreshold = -1
              DemDebounceCounterStorage = false
    DemGeneral:
      DemAgingCycleCounterProcessing = DEM_PROCESS_AGINGCTR_EXTERN
      DemAgingRequieresTestedCycle = false
      DemAvailabilitySupport = DEM_NO_AVAILABILITY
      DemBswErrorBufferSize = 0
      DemClearDTCBehavior = DEM_CLRRESP_NONVOLATILE_FINISH
      DemClearDTCLimitation = DEM_ALL_SUPPORTED_DTCS
      DemDataElementDefaultEndianness = BIG_ENDIAN
      DemDebounceCounterBasedSupport = false
      DemDebounceTimeBasedSupport = false
      DemDevErrorDetect = false
      DemDtcStatusAvailabilityMask = 0
      DemEnableConditionSupport = false
      DemEventCombinationSupport = DEM_EVCOMB_DISABLED
      DemEventDisplacementStrategy = DEM_DISPLACEMENT_NONE
      DemEventMemoryEntryStorageTrigger = DEM_STORAGE_ON_TEST_FAILED
      DemGeneralInterfaceSupport = false
      DemMaxNumberEventEntryMirror = 0
      DemMaxNumberEventEntryPermanent = 0
      DemMaxNumberEventEntryPrimary = 1
      DemMaxNumberEventEntrySecondary = 0
      DemMaxNumberPrestoredFF = 0
      DemOBDSupport = DEM_OBD_MASTER_ECU
      DemOccurrenceCounterProcessing = DEM_PROCESS_OCCCTR_CDTC
      DemOperationCycleStatusStorage = false
      DemPTOSupport = false
      DemResetConfirmedBitOnOverflow = true
      DemStatusBitHandlingTestFailedSinceLastClear = DEM_STATUS_BIT_NORMAL
      DemStatusBitStorageTestFailed = false
      DemStorageConditionSupport = false
      DemSuppressionSupport = DEM_NO_SUPPRESSION
      DemTaskTime = 0.001
      DemTriggerDcmReports = false
      DemTriggerDltReports = false
      DemTriggerFiMReports = false
      DemTriggerMonitorInitBeforeClearOk = false
      DemTypeOfDTCSupported = DEM_DTC_TRANSLATION_ISO11992_4
      DemTypeOfFreezeFrameRecordNumeration = DEM_FF_RECNUM_CALCULATED
      DemVersionInfoApi = false
      DemOperationCycleProcessing = DEM_PROCESS_OPCYC_STATE
      DemOperationCycle: DemOperationCycleAutomaticEnd=false, DemOperationCycleAutostart=false, DemOperationCycleType=DEM_OPCYC_OTHER
      DemClient: DemClientId=0
  module config Det_Stub: definition=Det, implementation-config-variant=VARIANT-PRE-COMPILE
    DetGeneral: DetVersionInfoApi=false
  module config KeyM: implementation-config-variant=VARIANT-PRE-COMPILE, module-description=KeyM_Impl
    KeyMCertificate_OSSL_X509_ECDSA_P384_IA (KeyMCertificate):
      KeyMCertAlgorithmType = ECC
      KeyMCertFormatType = X509
      KeyMCertificateId = 1
      KeyMCertificateMaxLength = 600
      KeyMCertificateName = KeyMCertificate_OSSL_X509_ECDSA_P384_IA
      KeyMCertificateStorage = KEYM_STORAGE_IN_CSM
      KeyMCertAlgorithmFamily = ECDSA
      KeyMCertUsePort = false
      KeyMCertStartUpHandling = NONE
      KeyMCertificateGetCurrentTimeCalloutFunc = Appl_KeyMCertificateGetCurrentTimeCalloutFunc
      KeyMCertUpperHierarchicalType = PRESET_ISSUER
      KeyMCertAllowUnconfiguredElements = false
      KeyMCertAllowFlexibleElementOrder = true
      KeyMCertCsmSignatureVerifyJobRef = CsmJob_KeyM_ECC_Intermediate
      KeyMCertUpperHierarchicalCertRef = KeyM/KeyMCertificate_OSSL_X509_ECDSA_P384_CA
      KeyMCertificateCsmKeyTargetRef = CsmKey_KeyM_Cert_Intermediate
      KeyMCertCsmSignatureVerifyKeyRef = CsmKey_KeyM_ECC_Intermediate
      22 x KeyMCertificateElement, all with KeyMCertificateElementOptional=false:
        Version_010: KeyMCertificateElementHasIteration=false, KeyMCertificateElementId=0, KeyMCertificateElementMaxLength=1, KeyMCertificateElementOfStructure=CertificateVersionNumber, KeyMCertificateElementObjectType=2
        SerialNo_010: KeyMCertificateElementHasIteration=false, KeyMCertificateElementId=1, KeyMCertificateElementMaxLength=16, KeyMCertificateElementOfStructure=CertificateSerialNumber, KeyMCertificateElementObjectType=2
        SigAlgoId_010: KeyMCertificateElementHasIteration=false, KeyMCertificateElementId=2, KeyMCertificateElementMaxLength=1, KeyMCertificateElementOfStructure=CertificateSignatureAlgorithmID, KeyMCertificateElementObjectType=6, KeyMCertificateElementObjectId=1.2.840.10045.4.3.4
        validityNotBefore_010: KeyMCertificateElementHasIteration=false, KeyMCertificateElementId=8, KeyMCertificateElementMaxLength=1, KeyMCertificateElementOfStructure=CertificateValidityPeriodNotBefore, KeyMCertificateElementObjectType=23
        validityNotAfter_010: KeyMCertificateElementHasIteration=false, KeyMCertificateElementId=9, KeyMCertificateElementMaxLength=1, KeyMCertificateElementOfStructure=CertificateValidityPeriodNotAfter, KeyMCertificateElementObjectType=23
        Subject_CommonName_006: KeyMCertificateElementHasIteration=false, KeyMCertificateElementId=10, KeyMCertificateElementMaxLength=10, KeyMCertificateElementOfStructure=CertificateSubjectName, KeyMCertificateElementObjectType=12, KeyMCertificateElementObjectId=2.5.4.3
        SubjectPublicKeyInfoAlgo_010: KeyMCertificateElementHasIteration=false, KeyMCertificateElementId=14, KeyMCertificateElementMaxLength=1, KeyMCertificateElementOfStructure=CertificateSubjectPublicKeyInfo_PublicKeyAlgorithm, KeyMCertificateElementObjectType=6, KeyMCertificateElementObjectId=1.2.840.10045.2.1
        SubjectPublicKeyInfoKey_010: KeyMCertificateElementHasIteration=false, KeyMCertificateElementId=16, KeyMCertificateElementMaxLength=32, KeyMCertificateElementOfStructure=CertificateSubjectPublicKeyInfo_SubjectPublicKey, KeyMCertificateElementObjectType=3
        ext2_010: KeyMCertificateElementHasIteration=false, KeyMCertificateElementId=18, KeyMCertificateElementMaxLength=1, KeyMCertificateElementOfStructure=CertificateExtension, KeyMCertificateElementObjectType=4, KeyMCertificateElementObjectId=2.5.29.14
        ext3_010: KeyMCertificateElementHasIteration=false, KeyMCertificateElementId=19, KeyMCertificateElementMaxLength=1, KeyMCertificateElementOfStructure=CertificateExtension, KeyMCertificateElementObjectType=128, KeyMCertificateElementObjectId=2.5.29.35
        ext1_010: KeyMCertificateElementHasIteration=false, KeyMCertificateElementId=17, KeyMCertificateElementMaxLength=20, KeyMCertificateElementOfStructure=CertificateExtension, KeyMCertificateElementObjectType=1, KeyMCertificateElementObjectId=2.5.29.19
        Issuer_CommonName_006: KeyMCertificateElementHasIteration=false, KeyMCertificateElementId=7, KeyMCertificateElementMaxLength=10, KeyMCertificateElementOfStructure=CertificateIssuerName, KeyMCertificateElementObjectType=12, KeyMCertificateElementObjectId=2.5.4.3
        signatureAlgorithm_010: KeyMCertificateElementHasIteration=false, KeyMCertificateElementId=20, KeyMCertificateElementMaxLength=1, KeyMCertificateElementOfStructure=CertificateSignatureAlgorithm, KeyMCertificateElementObjectType=6, KeyMCertificateElementObjectId=1.2.840.10045.4.3.4
        signatureValue_010: KeyMCertificateElementHasIteration=true, KeyMCertificateElementId=21, KeyMCertificateElementMaxLength=64, KeyMCertificateElementOfStructure=CertificateSignature, KeyMCertificateElementObjectType=2
        SubjectPublicKeyInfoAlgo_Curve_005: KeyMCertificateElementHasIteration=false, KeyMCertificateElementId=15, KeyMCertificateElementMaxLength=1, KeyMCertificateElementOfStructure=CertificateSubjectPublicKeyInfo_PublicKeyAlgorithm, KeyMCertificateElementObjectType=6, KeyMCertificateElementObjectId=1.3.132.0.34
        Issuer_StateOrProvinceName_006: KeyMCertificateElementHasIteration=false, KeyMCertificateElementId=4, KeyMCertificateElementMaxLength=10, KeyMCertificateElementOfStructure=CertificateIssuerName, KeyMCertificateElementObjectType=12, KeyMCertificateElementObjectId=2.5.4.8
        Issuer_LocalityName_006: KeyMCertificateElementHasIteration=false, KeyMCertificateElementId=5, KeyMCertificateElementMaxLength=10, KeyMCertificateElementOfStructure=CertificateIssuerName, KeyMCertificateElementObjectType=12, KeyMCertificateElementObjectId=2.5.4.7
        Issuer_OrganizationName_006: KeyMCertificateElementHasIteration=false, KeyMCertificateElementId=6, KeyMCertificateElementMaxLength=10, KeyMCertificateElementOfStructure=CertificateIssuerName, KeyMCertificateElementObjectType=12, KeyMCertificateElementObjectId=2.5.4.10
        Issuer_CountryName_006: KeyMCertificateElementHasIteration=false, KeyMCertificateElementId=3, KeyMCertificateElementMaxLength=10, KeyMCertificateElementOfStructure=CertificateIssuerName, KeyMCertificateElementObjectType=19, KeyMCertificateElementObjectId=2.5.4.6
        Subject_StateOrProvinceName_006: KeyMCertificateElementHasIteration=false, KeyMCertificateElementId=11, KeyMCertificateElementMaxLength=10, KeyMCertificateElementOfStructure=CertificateSubjectName, KeyMCertificateElementObjectType=12, KeyMCertificateElementObjectId=2.5.4.8
        Subject_OrganizationName_006: KeyMCertificateElementHasIteration=false, KeyMCertificateElementId=13, KeyMCertificateElementMaxLength=10, KeyMCertificateElementOfStructure=CertificateSubjectName, KeyMCertificateElementObjectType=12, KeyMCertificateElementObjectId=2.5.4.10
        Subject_CountryName_005: KeyMCertificateElementHasIteration=false, KeyMCertificateElementId=12, KeyMCertificateElementMaxLength=10, KeyMCertificateElementOfStructure=CertificateSubjectName, KeyMCertificateElementObjectType=19, KeyMCertificateElementObjectId=2.5.4.6
    KeyMCertificate_OSSL_X509_ECDSA_P384_CA (KeyMCertificate):
      KeyMCertAlgorithmType = ECC
      KeyMCertFormatType = X509
      KeyMCertificateId = 0
      KeyMCertificateMaxLength = 600
      KeyMCertificateName = KeyMCertificate_OSSL_X509_ECDSA_P384_CA
      KeyMCertificateStorage = KEYM_STORAGE_IN_CSM
      KeyMCertAlgorithmFamily = ECDSA
      KeyMCertUsePort = false
      KeyMCertStartUpHandling = NONE
      KeyMCertificateGetCurrentTimeCalloutFunc = Appl_KeyMCertificateGetCurrentTimeCalloutFunc
      KeyMCertUpperHierarchicalType = PRESET_ISSUER
      KeyMCertAllowUnconfiguredElements = false
      KeyMCertAllowFlexibleElementOrder = true
      KeyMCertCsmSignatureVerifyJobRef = CsmJob_KeyM_ECC_Root
      KeyMCertUpperHierarchicalCertRef = KeyM/KeyMCertificate_OSSL_X509_ECDSA_P384_CA
      KeyMCertificateCsmKeyTargetRef = CsmKey_KeyM_Cert_Root
      KeyMCertCsmSignatureVerifyKeyRef = CsmKey_KeyM_ECC_Root
      23 x KeyMCertificateElement, all with KeyMCertificateElementOptional=false:
        Version_009: KeyMCertificateElementHasIteration=false, KeyMCertificateElementId=0, KeyMCertificateElementMaxLength=1, KeyMCertificateElementOfStructure=CertificateVersionNumber, KeyMCertificateElementObjectType=2
        SerialNo_009: KeyMCertificateElementHasIteration=false, KeyMCertificateElementId=1, KeyMCertificateElementMaxLength=16, KeyMCertificateElementOfStructure=CertificateSerialNumber, KeyMCertificateElementObjectType=2
        SigAlgoId_009: KeyMCertificateElementHasIteration=false, KeyMCertificateElementId=2, KeyMCertificateElementMaxLength=1, KeyMCertificateElementOfStructure=CertificateSignatureAlgorithmID, KeyMCertificateElementObjectType=6, KeyMCertificateElementObjectId=1.2.840.10045.4.3.4
        validityNotBefore_009: KeyMCertificateElementHasIteration=false, KeyMCertificateElementId=8, KeyMCertificateElementMaxLength=1, KeyMCertificateElementOfStructure=CertificateValidityPeriodNotBefore, KeyMCertificateElementObjectType=23
        validityNotAfter_009: KeyMCertificateElementHasIteration=false, KeyMCertificateElementId=9, KeyMCertificateElementMaxLength=1, KeyMCertificateElementOfStructure=CertificateValidityPeriodNotAfter, KeyMCertificateElementObjectType=23
        Subject_CommonName_005: KeyMCertificateElementHasIteration=false, KeyMCertificateElementId=14, KeyMCertificateElementMaxLength=10, KeyMCertificateElementOfStructure=CertificateSubjectName, KeyMCertificateElementObjectType=12, KeyMCertificateElementObjectId=2.5.4.3
        SubjectPublicKeyInfoAlgo_009: KeyMCertificateElementHasIteration=false, KeyMCertificateElementId=15, KeyMCertificateElementMaxLength=1, KeyMCertificateElementOfStructure=CertificateSubjectPublicKeyInfo_PublicKeyAlgorithm, KeyMCertificateElementObjectType=6, KeyMCertificateElementObjectId=1.2.840.10045.2.1
        SubjectPublicKeyInfoKey_009: KeyMCertificateElementHasIteration=false, KeyMCertificateElementId=17, KeyMCertificateElementMaxLength=32, KeyMCertificateElementOfStructure=CertificateSubjectPublicKeyInfo_SubjectPublicKey, KeyMCertificateElementObjectType=3
        ext1_009: KeyMCertificateElementHasIteration=false, KeyMCertificateElementId=18, KeyMCertificateElementMaxLength=1, KeyMCertificateElementOfStructure=CertificateExtension, KeyMCertificateElementObjectType=4, KeyMCertificateElementObjectId=2.5.29.14
        ext2_009: KeyMCertificateElementHasIteration=false, KeyMCertificateElementId=19, KeyMCertificateElementMaxLength=1, KeyMCertificateElementOfStructure=CertificateExtension, KeyMCertificateElementObjectType=128, KeyMCertificateElementObjectId=2.5.29.35
        ext3_009: KeyMCertificateElementHasIteration=false, KeyMCertificateElementId=20, KeyMCertificateElementMaxLength=20, KeyMCertificateElementOfStructure=CertificateExtension, KeyMCertificateElementObjectType=6, KeyMCertificateElementObjectId=2.5.29.19
        Issuer_CommonName_005: KeyMCertificateElementHasIteration=false, KeyMCertificateElementId=7, KeyMCertificateElementMaxLength=10, KeyMCertificateElementOfStructure=CertificateIssuerName, KeyMCertificateElementObjectType=12, KeyMCertificateElementObjectId=2.5.4.3
        signatureAlgorithm_009: KeyMCertificateElementHasIteration=false, KeyMCertificateElementId=21, KeyMCertificateElementMaxLength=1, KeyMCertificateElementOfStructure=CertificateSignatureAlgorithm, KeyMCertificateElementObjectType=6, KeyMCertificateElementObjectId=1.2.840.10045.4.3.4
        signatureValue_009: KeyMCertificateElementHasIteration=true, KeyMCertificateElementId=22, KeyMCertificateElementMaxLength=64, KeyMCertificateElementOfStructure=CertificateSignature, KeyMCertificateElementObjectType=2
        SubjectPublicKeyInfoAlgo_Curve_004: KeyMCertificateElementHasIteration=false, KeyMCertificateElementId=16, KeyMCertificateElementMaxLength=1, KeyMCertificateElementOfStructure=CertificateSubjectPublicKeyInfo_PublicKeyAlgorithm, KeyMCertificateElementObjectType=6, KeyMCertificateElementObjectId=1.3.132.0.34
        Issuer_StateOrProvinceName_005: KeyMCertificateElementHasIteration=false, KeyMCertificateElementId=4, KeyMCertificateElementMaxLength=10, KeyMCertificateElementOfStructure=CertificateIssuerName, KeyMCertificateElementObjectType=12, KeyMCertificateElementObjectId=2.5.4.8
        Issuer_LocalityName_005: KeyMCertificateElementHasIteration=false, KeyMCertificateElementId=5, KeyMCertificateElementMaxLength=10, KeyMCertificateElementOfStructure=CertificateIssuerName, KeyMCertificateElementObjectType=12, KeyMCertificateElementObjectId=2.5.4.7
        Issuer_OrganizationName_005: KeyMCertificateElementHasIteration=false, KeyMCertificateElementId=6, KeyMCertificateElementMaxLength=10, KeyMCertificateElementOfStructure=CertificateIssuerName, KeyMCertificateElementObjectType=12, KeyMCertificateElementObjectId=2.5.4.10
        Issuer_CountryName_005: KeyMCertificateElementHasIteration=false, KeyMCertificateElementId=3, KeyMCertificateElementMaxLength=10, KeyMCertificateElementOfStructure=CertificateIssuerName, KeyMCertificateElementObjectType=19, KeyMCertificateElementObjectId=2.5.4.6
        Subject_StateOrProvinceName_005: KeyMCertificateElementHasIteration=false, KeyMCertificateElementId=11, KeyMCertificateElementMaxLength=10, KeyMCertificateElementOfStructure=CertificateSubjectName, KeyMCertificateElementObjectType=12, KeyMCertificateElementObjectId=2.5.4.8
        Subject_LocalityName_005: KeyMCertificateElementHasIteration=false, KeyMCertificateElementId=12, KeyMCertificateElementMaxLength=10, KeyMCertificateElementOfStructure=CertificateSubjectName, KeyMCertificateElementObjectType=12, KeyMCertificateElementObjectId=2.5.4.7
        Subject_OrganizationName_005: KeyMCertificateElementHasIteration=false, KeyMCertificateElementId=13, KeyMCertificateElementMaxLength=10, KeyMCertificateElementOfStructure=CertificateSubjectName, KeyMCertificateElementObjectType=12, KeyMCertificateElementObjectId=2.5.4.10
        Subject_CountryName_004: KeyMCertificateElementHasIteration=false, KeyMCertificateElementId=10, KeyMCertificateElementMaxLength=10, KeyMCertificateElementOfStructure=CertificateSubjectName, KeyMCertificateElementObjectType=19, KeyMCertificateElementObjectId=2.5.4.6
    KeyMGeneral:
      KeyMCertificateManagerEnabled = true
      KeyMCertificateChainMaxDepth = 2
      KeyMCryptoKeyHandlerPrepareEnabled = false
      KeyMCryptoKeyHandlerServiceCertificateEnabled = false
      KeyMCryptoKeyHandlerStartFinalizeEnabled = false
      KeyMCryptoKeyHandlerUpdateEnabled = false
      KeyMCryptoKeyHandlerVerifyEnabled = false
      KeyMCryptoKeyManagerEnabled = false
      KeyMDevErrorDetect = true
      KeyMKeyCertNameMaxLength = 39
      KeyMMainFunctionPeriod = 0.01
      KeyMVersionInfoApi = false
      KeyMNvWriteBlockFctName = vHsm_NvM_WriteBlock
      KeyMParseMaxNestingLevel = 20
      KeyMServiceCertificateFunctionEnabled = true
      KeyMCertificateSigningRequestEnabled = false
      KeyMSafeBswChecks = false
  module config MemIf: implementation-config-variant=VARIANT-PRE-COMPILE, module-description=MemIf_Impl
    MemIfGeneral: MemIfDevErrorDetect=false, MemIfVersionInfoApi=false, MemIfSafeBswChecks=false
    MemIfMemHwA: MemIfMemHwAId=0, MemIfMemHwARef=FeeGeneral
  module config NvM: implementation-config-variant=VARIANT-PRE-COMPILE, module-description=NvM_Impl
    NvMCommon:
      NvMApiConfigClass = NVM_API_CONFIG_CLASS_2
      NvMBswMMultiBlockJobStatusInformation = false
      NvMCompiledConfigId = 1
      NvMCrcNumOfBytes = 64
      NvMDatasetSelectionBits = 4
      NvMDevErrorDetect = true
      NvMDrvModeSwitch = true
      NvMDynamicConfiguration = true
      NvMJobPrioritization = false
      NvMPollingMode = true
      NvMSetRamBlockStatusApi = true
      NvMSizeStandardJobQueue = 4
      NvMVersionInfoApi = false
      NvMMaxNoOfWriteRetries = 1
      NvMMainFunctionPeriod = 0.01
      NvMUseBlockIdCheck = false
      NvMRepairRedundantBlocksApi = false
      NvMSafeBswChecks = false
      NvMDetectedLossOfRedundancyCallback = NULL_PTR
    NvMCommonVendorParams: NvMKillWriteAllApi=false, NvMCfgCbkIncludeList=Crypto_30_LibCv.h, NvMCfgCbkIncludeList=vHsm_Cfg.h, NvMDataIntegrityIntBuffer=true
    9 x NvMBlockDescriptor, all with NvMBlockJobPriority=127, NvMBlockManagementType=NVM_BLOCK_REDUNDANT, NvMBlockUseCrc=true, NvMBlockWriteProt=false, NvMBswMBlockStatusInformation=false, NvMNvBlockNum=2, NvMResistantToChangedSw=true, NvMWriteBlockOnce=false, NvMUseServicePorts=false, NvMBlockUseCRCCompMechanism=false, NvMSelectBlockForReadAll=true, NvMBlockUseSetRamBlockStatus=true, NvMInvokeCallbacksForReadAll=true, NvMInvokeCallbacksForWriteAll=true, NvMCheckLossOfRedundancy=false:
      Keys_Immediate: NvMBlockUseSyncMechanism=true, NvMNvBlockLength=280, NvMNvramBlockIdentifier=2, NvMUseJobendCallback=true, NvMUseInitCallback=true, NvMBlockCrcType=NVM_CRC32, NvMReadRamBlockFromNvCallback=Crypto_30_LibCv_NvBlock_ReadFrom_CryptoNvBlock_Immediate, NvMWriteRamBlockToNvCallback=Crypto_30_LibCv_NvBlock_WriteTo_CryptoNvBlock_Immediate, NvMInitBlockCallback=Crypto_30_LibCv_NvBlock_Init_CryptoNvBlock_Immediate, NvMSingleBlockCallback=Crypto_30_LibCv_NvBlock_Callback_CryptoNvBlock_Immediate, NvMSelectBlockForWriteAll=false
        NvMTargetBlockReference
          NvMFeeRef: NvMNameOfFeeBlock=Keys_Immediate
      NvMConfigBlock: NvMNvramBlockIdentifier=1, NvMNvBlockLength=2, NvMUseInitCallback=false, NvMSelectBlockForWriteAll=true, NvMCalcRamBlockCrc=false, NvMRomBlockDataAddress=NULL_PTR, NvMBlockPostReadTransformCallback=NULL_PTR, NvMBlockPreWriteTransformCallback=NULL_PTR, NvMBlockCrcType=NVM_CRC16, NvMUseJobendCallback=false, NvMBlockUseSyncMechanism=false
        NvMTargetBlockReference
          NvMFeeRef: NvMNameOfFeeBlock=NvMConfigBlock
      Keys_Deferred: NvMBlockUseSyncMechanism=true, NvMNvBlockLength=70, NvMNvramBlockIdentifier=4, NvMUseJobendCallback=true, NvMUseInitCallback=true, NvMReadRamBlockFromNvCallback=Crypto_30_LibCv_NvBlock_ReadFrom_CryptoNvBlock_Deferred, NvMWriteRamBlockToNvCallback=Crypto_30_LibCv_NvBlock_WriteTo_CryptoNvBlock_Deferred, NvMInitBlockCallback=Crypto_30_LibCv_NvBlock_Init_CryptoNvBlock_Deferred, NvMSingleBlockCallback=Crypto_30_LibCv_NvBlock_Callback_CryptoNvBlock_Deferred, NvMSelectBlockForWriteAll=true, NvMBlockCrcType=NVM_CRC32, NvMCalcRamBlockCrc=false, NvMNvBlockNVRAMDataLength=80
        NvMTargetBlockReference
          NvMFeeRef: NvMNameOfFeeBlock=Keys_Deferred
      Keys_Deferred_SecOC: NvMBlockUseSyncMechanism=true, NvMNvBlockLength=400, NvMNvramBlockIdentifier=6, NvMUseJobendCallback=true, NvMUseInitCallback=true, NvMReadRamBlockFromNvCallback=Crypto_30_LibCv_NvBlock_ReadFrom_CryptoNvBlock_Deferred_SecOC, NvMWriteRamBlockToNvCallback=Crypto_30_LibCv_NvBlock_WriteTo_CryptoNvBlock_Deferred_SecOC, NvMInitBlockCallback=Crypto_30_LibCv_NvBlock_Init_CryptoNvBlock_Deferred_SecOC, NvMSingleBlockCallback=Crypto_30_LibCv_NvBlock_Callback_CryptoNvBlock_Deferred_SecOC, NvMSelectBlockForWriteAll=true, NvMBlockCrcType=NVM_CRC32, NvMCalcRamBlockCrc=false, NvMNvBlockNVRAMDataLength=416
        NvMTargetBlockReference
          NvMFeeRef: NvMNameOfFeeBlock=Keys_Deferred_SecOC
      Keys_Deferred_SharedSecretHash: NvMBlockUseSyncMechanism=true, NvMNvBlockLength=16, NvMNvramBlockIdentifier=7, NvMUseJobendCallback=true, NvMUseInitCallback=true, NvMReadRamBlockFromNvCallback=Crypto_30_LibCv_NvBlock_ReadFrom_CryptoNvBlock_Deferred_SharedSecretHash, NvMWriteRamBlockToNvCallback=Crypto_30_LibCv_NvBlock_WriteTo_CryptoNvBlock_Deferred_SharedSecretHash, NvMInitBlockCallback=Crypto_30_LibCv_NvBlock_Init_CryptoNvBlock_Deferred_SharedSecretHash, NvMSingleBlockCallback=Crypto_30_LibCv_NvBlock_Callback_CryptoNvBlock_Deferred_SharedSecretHash, NvMSelectBlockForWriteAll=true, NvMBlockCrcType=NVM_CRC32, NvMCalcRamBlockCrc=false, NvMNvBlockNVRAMDataLength=32
        NvMTargetBlockReference
          NvMFeeRef: NvMNameOfFeeBlock=Keys_Deferred_SharedSecretHash
      Keys_Deferred_TrustModel_NoRoot: NvMBlockUseSyncMechanism=true, NvMNvBlockLength=3018, NvMNvramBlockIdentifier=8, NvMUseJobendCallback=true, NvMUseInitCallback=true, NvMReadRamBlockFromNvCallback=Crypto_30_LibCv_NvBlock_ReadFrom_CryptoNvBlock_Deferred_TrustModel_NoRoot, NvMWriteRamBlockToNvCallback=Crypto_30_LibCv_NvBlock_WriteTo_CryptoNvBlock_Deferred_TrustModel_NoRoot, NvMInitBlockCallback=Crypto_30_LibCv_NvBlock_Init_CryptoNvBlock_Deferred_TrustModel_NoRoot, NvMSingleBlockCallback=Crypto_30_LibCv_NvBlock_Callback_CryptoNvBlock_Deferred_TrustModel_NoRoot, NvMSelectBlockForWriteAll=true, NvMBlockCrcType=NVM_CRC32
        NvMTargetBlockReference
          NvMFeeRef: NvMNameOfFeeBlock=FeeKeys_Deferred_TrustModel_NoRoot
      Keys_Deferred_TrustModel_Root: NvMBlockUseSyncMechanism=true, NvMNvBlockLength=1010, NvMNvramBlockIdentifier=9, NvMUseJobendCallback=true, NvMUseInitCallback=true, NvMReadRamBlockFromNvCallback=Crypto_30_LibCv_NvBlock_ReadFrom_CryptoNvBlock_Deferred_TrustModel_Root, NvMWriteRamBlockToNvCallback=Crypto_30_LibCv_NvBlock_WriteTo_CryptoNvBlock_Deferred_TrustModel_Root, NvMInitBlockCallback=Crypto_30_LibCv_NvBlock_Init_CryptoNvBlock_Deferred_TrustModel_Root, NvMSingleBlockCallback=Crypto_30_LibCv_NvBlock_Callback_CryptoNvBlock_Deferred_TrustModel_Root, NvMSelectBlockForWriteAll=true, NvMBlockCrcType=NVM_CRC32
        NvMTargetBlockReference
          NvMFeeRef: NvMNameOfFeeBlock=FeeKeys_Deferred_TrustModel_Root
      Keys_Immediate_BackendCert: NvMBlockUseSyncMechanism=true, NvMNvBlockLength=922, NvMNvramBlockIdentifier=5, NvMUseJobendCallback=true, NvMUseInitCallback=true, NvMBlockCrcType=NVM_CRC32, NvMReadRamBlockFromNvCallback=Crypto_30_LibCv_NvBlock_ReadFrom_CryptoNvBlock_Immediate_BackendCert, NvMWriteRamBlockToNvCallback=Crypto_30_LibCv_NvBlock_WriteTo_CryptoNvBlock_Immediate_BackendCert, NvMInitBlockCallback=Crypto_30_LibCv_NvBlock_Init_CryptoNvBlock_Immediate_BackendCert, NvMSingleBlockCallback=Crypto_30_LibCv_NvBlock_Callback_CryptoNvBlock_Immediate_BackendCert, NvMSelectBlockForWriteAll=false
        NvMTargetBlockReference
          NvMFeeRef: NvMNameOfFeeBlock=Keys_Immediate_BackendCert
      Keys_Immediate_RootCert: NvMBlockUseSyncMechanism=true, NvMNvBlockLength=922, NvMNvramBlockIdentifier=3, NvMUseJobendCallback=true, NvMUseInitCallback=true, NvMBlockCrcType=NVM_CRC32, NvMReadRamBlockFromNvCallback=Crypto_30_LibCv_NvBlock_ReadFrom_CryptoNvBlock_Immediate_RootCert, NvMWriteRamBlockToNvCallback=Crypto_30_LibCv_NvBlock_WriteTo_CryptoNvBlock_Immediate_RootCert, NvMInitBlockCallback=Crypto_30_LibCv_NvBlock_Init_CryptoNvBlock_Immediate_RootCert, NvMSingleBlockCallback=Crypto_30_LibCv_NvBlock_Callback_CryptoNvBlock_Immediate_RootCert, NvMSelectBlockForWriteAll=false
        NvMTargetBlockReference
          NvMFeeRef: NvMNameOfFeeBlock=Keys_Immediate_RootCert
  module config Rte: implementation-config-variant=VARIANT-PRE-COMPILE, module-description=Rte_Impl
    RteOsInteraction
      Rte_Al_TE2_vHsmMainFunctionTask_0_10ms (RteUsedOsActivation):
        RteExpectedActivationOffset = 0
        RteExpectedTickDuration = 0
        RteActivationOsAlarmRef = Os/Rte_Al_TE2_vHsmMainFunctionTask_0_10ms
        RteActivationOsTaskRef = Os/vHsmMainFunctionTask
    RteGeneration:
      RteGenerationMode = COMPATIBILITY_MODE
      RteIocInteractionReturnValue = RTE_IOC
      RteValueRangeCheckEnabled = false
      RteCalibrationSupport = NONE
      RteCodeVendorId = 30
      RteDevErrorDetect = false
      RteDevErrorDetectUninit = false
      RteMeasurementSupport = false
      RteOptimizationMode = MEMORY
      RteVfbTraceEnabled = false
    RteInitializationBehavior: RteInitializationStrategy=RTE_INITIALIZATION_STRATEGY_AT_DATA_DECLARATION, RteSectionInitializationPolicy=INIT
    RteBswGeneral: RteSchMVersionInfoApi=false, RteUseComShadowSignalApi=false
    NvM_EcuSwComposition (RteSwComponentInstance): RteSoftwareComponentInstanceRef=NvM
      Timer_NvM_MainFunction (RteEventToTaskMapping):
        RteImmediateRestart = false
        RtePositionInTask = 8
        RteCyclicTriggerImplementation = None
        RteEventRef = Timer_NvM_MainFunction
        RteMappedToTaskRef = Os/vHsmMainFunctionTask
        RteUsedOsEventRef = Rte_Ev_Run1_NvM_NvM_MainFunction
    Csm_EcuSwComposition (RteSwComponentInstance): RteSoftwareComponentInstanceRef=Csm
      Timer_Csm_MainFunction (RteEventToTaskMapping):
        RteImmediateRestart = false
        RtePositionInTask = 6
        RteCyclicTriggerImplementation = None
        RteEventRef = Timer_Csm_MainFunction
        RteMappedToTaskRef = Os/vHsmMainFunctionTask
        RteUsedOsEventRef = Rte_Ev_Run1_Csm_Csm_MainFunction
    5 x RteBswModuleInstance:
      Crypto_30_LibCv: RteBswImplementationRef=Crypto_Impl, RteBswModuleConfigurationRef=Crypto_30_LibCv
        Crypto_30_LibCv_MainFunctionTimingEvent0 (RteBswEventToTaskMapping):
          RteBswImmediateRestart = false
          RteBswPositionInTask = 4
          RteCyclicTriggerImplementation = None
          RteBswEventRef = Crypto_30_LibCv_MainFunctionTimingEvent0
          RteBswMappedToTaskRef = Os/vHsmMainFunctionTask
          RteBswUsedOsEventRef = Rte_Ev_Run1_Crypto_30_LibCv_Crypto_30_LibCv_MainFunction
        CRYPTO_30_LIBCV_EXCLUSIVE_AREA_0 (RteBswExclusiveAreaImpl): RteExclusiveAreaImplMechanism=ALL_INTERRUPT_BLOCKING, RteBswExclusiveAreaRef=CRYPTO_30_LIBCV_EXCLUSIVE_AREA_0
        CRYPTO_30_LIBCV_EXCLUSIVE_AREA_1 (RteBswExclusiveAreaImpl): RteExclusiveAreaImplMechanism=ALL_INTERRUPT_BLOCKING, RteBswExclusiveAreaRef=CRYPTO_30_LIBCV_EXCLUSIVE_AREA_1
      vHsm: RteBswImplementationRef=vHsm_Impl, RteBswModuleConfigurationRef=vHsm
        VHSM_EXCLUSIVE_AREA_0 (RteBswExclusiveAreaImpl): RteExclusiveAreaImplMechanism=ALL_INTERRUPT_BLOCKING, RteBswExclusiveAreaRef=VHSM_EXCLUSIVE_AREA_0
        3 x RteBswEventToTaskMapping, all with RteBswImmediateRestart=false:
          vHsm_MainFunctionBackgroundEvent0: RteBswPositionInTask=7, RteBswEventRef=vHsm_MainFunctionBackgroundEvent0, RteBswMappedToTaskRef=Os/vHsmMainFunctionTask
          vHsm_MainFunction_vHsmSchedulableEntities_UnmappedTimingEvent0: RteBswPositionInTask=9, RteCyclicTriggerImplementation=None, RteBswEventRef=vHsm_MainFunction_vHsmSchedulableEntities_UnmappedTimingEvent0, RteBswMappedToTaskRef=OsTask
          vHsm_MainFunction_vHsmSchedulableEntities_HighPrioTimingEvent0: RteBswPositionInTask=9, RteCyclicTriggerImplementation=None, RteBswEventRef=vHsm_MainFunction_vHsmSchedulableEntities_HighPrioTimingEvent0, RteBswMappedToTaskRef=Ostask_HighPrio
        VHSM_EXCLUSIVE_AREA_1 (RteBswExclusiveAreaImpl): RteExclusiveAreaImplMechanism=ALL_INTERRUPT_BLOCKING, RteBswExclusiveAreaRef=VHSM_EXCLUSIVE_AREA_1
      NvM: RteBswImplementationRef=NvM_Impl, RteBswModuleConfigurationRef=NvM
        NvM_MainFunctionTimingEvent0 (RteBswEventToTaskMapping):
          RteBswImmediateRestart = false
          RteBswPositionInTask = 8
          RteCyclicTriggerImplementation = None
          RteBswEventRef = NvM_MainFunctionTimingEvent0
          RteBswMappedToTaskRef = Os/vHsmMainFunctionTask
          RteBswUsedOsEventRef = Rte_Ev_RunS1_NvM_NvM_MainFunction
        NVM_EXCLUSIVE_AREA_0 (RteBswExclusiveAreaImpl): RteExclusiveAreaImplMechanism=ALL_INTERRUPT_BLOCKING, RteBswExclusiveAreaRef=NVM_EXCLUSIVE_AREA_0
      Csm: RteBswImplementationRef=Csm_Impl, RteBswModuleConfigurationRef=Csm
        Csm_MainFunctionTimingEvent0 (RteBswEventToTaskMapping):
          RteBswImmediateRestart = false
          RteBswPositionInTask = 6
          RteCyclicTriggerImplementation = None
          RteBswEventRef = Csm_MainFunctionTimingEvent0
          RteBswMappedToTaskRef = Os/vHsmMainFunctionTask
          RteBswUsedOsEventRef = Rte_Ev_RunS1_Csm_Csm_MainFunction
        CSM_EXCLUSIVE_AREA_0 (RteBswExclusiveAreaImpl): RteExclusiveAreaImplMechanism=ALL_INTERRUPT_BLOCKING, RteBswExclusiveAreaRef=CSM_EXCLUSIVE_AREA_0
      Rte: RteBswImplementationRef=Rte_Impl, RteBswModuleConfigurationRef=Rte
    Os_OsCore0_swc_EcuSwComposition (RteSwComponentInstance): RteSoftwareComponentInstanceRef=Os_OsCore0_swc
      OpEventGetCounterValue_GetCounterValue_OsService_SystemTimer (RteEventToTaskMapping): RteImmediateRestart=false, RteCyclicTriggerImplementation=None, RteEventRef=OpEventGetCounterValue_GetCounterValue_OsService_SystemTimer
      OpEventGetElapsedValue_GetElapsedValue_OsService_SystemTimer (RteEventToTaskMapping): RteImmediateRestart=false, RteEventRef=OpEventGetElapsedValue_GetElapsedValue_OsService_SystemTimer
    KeyM (RteBswModuleInstance): RteBswImplementationRef=KeyM_Impl, RteBswModuleConfigurationRef=KeyM
      KeyM_MainFunctionTimingEvent0 (RteBswEventToTaskMapping):
        RteBswImmediateRestart = false
        RteCyclicTriggerImplementation = None
        RteBswPositionInTask = 3
        RteBswEventRef = KeyM_MainFunctionTimingEvent0
        RteBswMappedToTaskRef = Os/vHsmMainFunctionTask
        RteBswUsedOsEventRef = Rte_Ev_RunS1_KeyM_KeyM_MainFunction
      KeyM_MainBackgroundFunctionBackgroundEvent0 (RteBswEventToTaskMapping):
        RteBswImmediateRestart = false
        RteCyclicTriggerImplementation = None
        RteBswPositionInTask = 2
        RteBswEventRef = KeyM_MainBackgroundFunctionBackgroundEvent0
        RteBswMappedToTaskRef = Os/vHsmMainFunctionTask
      KEYM_EXCLUSIVE_AREA_0 (RteBswExclusiveAreaImpl): RteExclusiveAreaImplMechanism=ALL_INTERRUPT_BLOCKING, RteBswExclusiveAreaRef=KEYM_EXCLUSIVE_AREA_0
      KEYM_EXCLUSIVE_AREA_1 (RteBswExclusiveAreaImpl): RteExclusiveAreaImplMechanism=ALL_INTERRUPT_BLOCKING, RteBswExclusiveAreaRef=KEYM_EXCLUSIVE_AREA_1
    KeyM_EcuSwComposition (RteSwComponentInstance): RteSoftwareComponentInstanceRef=KeyM
      Timer_KeyM_MainFunction (RteEventToTaskMapping):
        RteImmediateRestart = false
        RtePositionInTask = 3
        RteCyclicTriggerImplementation = None
        RteEventRef = Timer_KeyM_MainFunction
        RteMappedToTaskRef = Os/vHsmMainFunctionTask
        RteUsedOsEventRef = Rte_Ev_Run1_KeyM_KeyM_MainFunction
    4 x RteBswModuleInstance:
      Fee_0: RteBswImplementationRef=Fee_Impl, RteBswModuleConfigurationRef=Fee
        Fee_MainFunctionTimingEvent0 (RteBswEventToTaskMapping):
          RteBswImmediateRestart = false
          RteBswPositionInTask = 0
          RteBswEventRef = Fee_MainFunctionTimingEvent0
          RteBswMappedToTaskRef = Os/vHsmMainFunctionTask
          RteBswUsedOsEventRef = Rte_Ev_Cyclic2_vHsmMainFunctionTask_0_10ms
          RteBswUsedOsAlarmRef = Os/Rte_Al_TE2_vHsmMainFunctionTask_0_10ms
      Fls_0: RteBswImplementationRef=Fls_Impl, RteBswModuleConfigurationRef=Fls
        Fls_17_Dmu_MainFunctionTimingEvent0 (RteBswEventToTaskMapping):
          RteBswImmediateRestart = false
          RteBswPositionInTask = 1
          RteBswEventRef = Fls_17_Dmu_MainFunctionTimingEvent0
          RteBswMappedToTaskRef = Os/vHsmMainFunctionTask
          RteBswUsedOsEventRef = Rte_Ev_Cyclic2_vHsmMainFunctionTask_0_10ms
          RteBswUsedOsAlarmRef = Os/Rte_Al_TE2_vHsmMainFunctionTask_0_10ms
      Crypto_30_Hwa: RteBswImplementationRef=Crypto_Impl, RteBswModuleConfigurationRef=Crypto_30_Hwa
        Crypto_30_Hwa_MainFunctionBackgroundEvent0 (RteBswEventToTaskMapping):
          RteBswImmediateRestart = false
          RteBswPositionInTask = 5
          RteBswEventRef = Crypto_30_Hwa_MainFunctionBackgroundEvent0
          RteBswMappedToTaskRef = Os/vHsmMainFunctionTask
        4 x RteBswExclusiveAreaImpl, all with RteExclusiveAreaImplMechanism=ALL_INTERRUPT_BLOCKING:
          CRYPTO_30_HWA_EXCLUSIVE_AREA_{0..3}: RteBswExclusiveAreaRef=CRYPTO_30_HWA_EXCLUSIVE_AREA_{0..3}
      vHsm_Hal: RteBswImplementationRef=vHsm_Hal_Impl, RteBswModuleConfigurationRef=vHsm_Hal
  module config vSecPrim: implementation-config-variant=VARIANT-PRE-COMPILE, module-description=vSecPrim_Impl
    vSecPrimGeneral:
      vSecPrimClearWorkspaceEnabled = true
      vSecPrimRSAMaxKeySize = RSA_MAX_KEY_SIZE_2048
      vSecPrimECPMaxKeySize = ECP_MAX_KEY_SIZE_256
      vSecPrimSupportUInt64 = true
      vSecPrimWatchdogLevel = WD_LEVEL_0
      vSecPrimSizeOfEsltLength = SIZE_UINT32
      vSecPrimCTRDRBGAES128SecurityStrength = SECURITY_STRENGTH_128
      vSecPrimDrbgReseedInterval = 4294967295
      vSecPrimSPAKE2pMaxAADSize = 16
      vSecPrimSPAKE2pPreambleOKMLength = 64
      vSecPrimUseVstdLib = true
    vSecPrimBasicAlgorithms
      vSecPrimHash:
        vSecPrimSHA1Enabled = true
        vSecPrimRIPEMD160Enabled = false
        vSecPrimSHA2_256Enabled = true
        vSecPrimSHA2_512Enabled = true
        vSecPrimMD5Enabled = false
        vSecPrimSHA3Enabled = false
      vSecPrimRandomNumberGeneration: vSecPrimFIPS186Enabled=true, vSecPrimCtrDrbgEnabled=true, vSecPrimHashDrbgEnabled=false
    vSecPrimSymmetricAlgorithms
      vSecPrimCipher:
        vSecPrimAes128Enabled = true
        vSecPrimAes192Enabled = false
        vSecPrimAes256Enabled = false
        vSecPrimGcmEnabled = true
        vSecPrimDesEnabled = false
        vSecPrimRC2Enabled = false
        vSecPrimTDesEnabled = false
        vSecPrimAeadChaCha20Poly1305Enabled = false
        vSecPrimChaCha20Enabled = false
        vSecPrimAesCcmEnabled = false
      vSecPrimMac:
        vSecPrimSipHashEnabled = false
        vSecPrimCmacEnabled = true
        vSecPrimHMacSHA1Enabled = true
        vSecPrimHMacRMD160Enabled = false
        vSecPrimHMacSHA2_256Enabled = true
        vSecPrimGMacEnabled = false
        vSecPrimPoly1305Enabled = false
        vSecPrimHMacSHA2_384Enabled = false
    vSecPrimAsymmetricAlgorithms
      vSecPrimSignature:
        vSecPrimRSA_PSS_RIPEMD160Enabled = false
        vSecPrimRSA_PSS_SHA1Enabled = false
        vSecPrimRSA_PSS_SHA2_256Enabled = false
        vSecPrimRSA_V15_RIPEMD160Enabled = false
        vSecPrimRSA_V15_SHA1Enabled = false
        vSecPrimRSA_V15_SHA2_256Enabled = false
        vSecPrimECDSA_25519Enabled = true
        vSecPrimECDSA_GenericEnabled = true
      vSecPrimKeyExchange: vSecPrimECDH_25519Enabled=true, vSecPrimECDH_GenericEnabled=false, vSecPrimECBD_GenericEnabled=false, vSecPrimSPAKE2pEnabled=false
      vSecPrimKeyDerivation:
        vSecPrimPKCS5Enabled = false
        vSecPrimANSI_X963Enabled = false
        vSecPrimANSI_X963_SHA256Enabled = false
        vSecPrimPKCS5HMacSHA256Enabled = false
        vSecPrimANSI_X963_SHA512Enabled = false
        vSecPrimHKDF_HMAC_SHA256Enabled = false
        vSecPrimHKDF_SHA2_256_OnestepEnabled = false
      vSecPrimCipher: vSecPrimRSA_OAEP_SHA1Enabled=false, vSecPrimRSA_OAEP_SHA2_256Enabled=false, vSecPrimRSA_V15Enabled=false
      vSecPrimKeyGeneration: vSecPrimECCEnabled=false
    vSecPrimOptimization:
      vSecPrimAesSpeedUp = SPEED_UP_LEVEL_3
      vSecPrimSha1SpeedUp = SPEED_UP_LEVEL_0
      vSecPrimSha256SpeedUp = SPEED_UP_LEVEL_1
      vSecPrimSha512SpeedUp = SPEED_UP_LEVEL_0
      vSecPrimChaCha20SpeedUp = SPEED_UP_LEVEL_0
