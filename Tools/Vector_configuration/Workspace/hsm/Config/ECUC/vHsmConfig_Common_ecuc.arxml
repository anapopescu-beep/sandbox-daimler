[part 1 of 2: package /ActiveEcuC]
AUTOSAR XML (schema 4-3-0)
package /ActiveEcuC
  module config EcuC: implementation-config-variant=VARIANT-PRE-COMPILE, module-description=EcuC_Impl
    EcucGeneral:
      DummyFunction = false
      DummyStatement = true
      StructAlignment = Auto
      ArrayAlignment = Auto
      StructInArrayAlignment = Auto
      SizeOfEnum = Size32Bit
      SizeOfROMPointer = Size32Bit
      SizeOfRAMPointer = Size32Bit
      DummyStatementKind = VoidCast
      CPUType = CPU32Bit
      SizeOfInt = Size32Bit
      ByteOrder = LITTLE_ENDIAN
      BitOrder = LSB_to_MSB
      AtomicBitAccessInBitfield = false
      AtomicVariableAccess = Atomic32BitAccess
      BitFieldDataType = INT
      ConditionalGenerating = true
      EcucBswImplementationCodeType = EcuCSourceCode
      EcuCUseStdReturnTypeForRte = false
      BswInitialization
        25 x InitFunction:
          Crypto_30_LibCv_Init: Header=Crypto_30_LibCv.h, InitPhase=INIT_TWO_DRV, ModuleRef=Crypto_30_LibCv  # /ActiveEcuC/Crypto_30_LibCv PLAIN_TEXT Initializes the Crypto Driver
          Crypto_30_LibCv_InitMemory: Header=Crypto_30_LibCv.h, InitPhase=INIT_MEMORY, ModuleRef=Crypto_30_LibCv  # /ActiveEcuC/Crypto_30_LibCv PLAIN_TEXT Initializes variables of the Crypto Driver
          CryIf_InitMemory: Header=CryIf.h, InitPhase=INIT_MEMORY, ModuleRef=CryIf  # /ActiveEcuC/CryIf PLAIN_TEXT Initializes variables of the Crypto Interface
          CryIf_Init: Header=CryIf.h, InitPhase=INIT_TWO_IF, ModuleRef=CryIf  # /ActiveEcuC/CryIf PLAIN_TEXT Initializes the Crypto Interface
          vHsm_Init: Header=vHsm.h, InitPhase=NO_INIT, ModuleRef=vHsm  # /ActiveEcuC/vHsm PLAIN_TEXT Initializes memory of the vHsm.
          vHsm_Hal_Init: Header=vHsm_Hal.h, InitPhase=NO_INIT, ModuleRef=Crypto_30_Hwa  # /ActiveEcuC/vHsm_Hal PLAIN_TEXT Initializes the Crypto vHsm_Hal - Fix call from vHsm_Init
          vHsm_Hal_InitMemory: Header=vHsm_Hal.h, InitPhase=INIT_MEMORY, ModuleRef=Crypto_30_Hwa  # /ActiveEcuC/vHsm_Hal PLAIN_TEXT Initializes variables of the Crypto vHsm_Hal
          NvM_Init: Header=NvM.h, InitPhase=INIT_TWO_SYS, ModuleRef=NvM  # /ActiveEcuC/NvM PLAIN_TEXT Initialization of the NVRAM Manager, to make it ready for NvM_ReadAll being requested
          Csm_Init: Header=Csm.h, InitPhase=INIT_TWO_SYS, ModuleRef=Csm  # /ActiveEcuC/Csm PLAIN_TEXT Initializes the Crypto Service Manager
          Csm_InitMemory: Header=Csm.h, InitPhase=INIT_MEMORY, ModuleRef=Csm  # /ActiveEcuC/Csm PLAIN_TEXT Initializes variables of the Crypto Service Manager
          Rte_InitMemory: Header=Rte_Main.h, InitPhase=INIT_MEMORY, ModuleRef=Rte  # /ActiveEcuC/Rte PLAIN_TEXT Automatically generated by EcuCBswInitFctConfigurationService.
          Rte_Start: Header=Rte_Main.h, InitPhase=INIT_THREE, ModuleRef=Rte  # /ActiveEcuC/Rte PLAIN_TEXT Automatically generated by EcuCBswInitFctConfigurationService.
          SchM_Init: Header=Rte_Main.h, InitPhase=NO_INIT, ModuleRef=Rte  # /ActiveEcuC/Rte PLAIN_TEXT Automatically generated by EcuCBswInitFctConfigurationService.
          Rte_StartTiming: Header=Rte_Main.h, InitPhase=NO_INIT, ModuleRef=Rte  # /ActiveEcuC/Rte PLAIN_TEXT Automatically generated by EcuCBswInitFctConfigurationService.
          Brs_Init: Header=, InitPhase=NO_INIT, ModuleRef=vBRS  # /ActiveEcuC/vBRS PLAIN_TEXT Automatically generated by EcuCBswInitFctConfigurationService.
          vBaseEnv_Init: Header=, InitPhase=NO_INIT, ModuleRef=vBaseEnv  # /ActiveEcuC/vBaseEnv PLAIN_TEXT Created vBaseEnv_Init by Extended Init XML Service
          KeyM_Init: Header=KeyM.h, InitPhase=INIT_TWO_SYS, ConfigType=KeyM_ConfigType, ConfigPtrName=NULL_PTR, ConfigPtrClass=KEYM_INIT_DATA, ModuleRef=KeyM  # /ActiveEcuC/KeyM PLAIN_TEXT Initializes the MICROSAR KeyM
          KeyM_InitMemory: Header=KeyM.h, InitPhase=INIT_MEMORY, ModuleRef=KeyM  # /ActiveEcuC/KeyM PLAIN_TEXT Initializes variables of the MICROSAR KeyM
          Crypto_30_KeyM_Init: Header=Crypto_30_KeyM.h, InitPhase=INIT_TWO_SYS, ModuleRef=Crypto_30_KeyM  # /ActiveEcuC/Crypto_30_KeyM PLAIN_TEXT Initializes the MICROSAR Crypto_30_KeyM
          Crypto_30_KeyM_InitMemory: Header=Crypto_30_KeyM.h, InitPhase=INIT_MEMORY, ModuleRef=Crypto_30_KeyM  # /ActiveEcuC/Crypto_30_KeyM PLAIN_TEXT Initializes variables of the MICROSAR Crypto_30_KeyM
          Fee_Init: Header=Fee.h, InitPhase=INIT_ONE, ConfigType=Fee_ConfigType, ConfigPtrName=&Fee_Config, ConfigPtrClass=const, ModuleRef=Fee  # /ActiveEcuC/Fee PLAIN_TEXT Created Fee_Init by Extended Init XML Service
          Fls_17_Dmu_Init: Header=Fls_17_Dmu.h, InitPhase=INIT_ONE, ConfigType=Fls_17_Dmu_ConfigType, ConfigPtrName=&Fls_17_Dmu_Config, ConfigPtrClass=const, ModuleRef=Fls  # /ActiveEcuC/Fls PLAIN_TEXT Created Fls_17_Dmu_Init by Extended Init XML Service
          Crypto_30_Hwa_Init: Header=Crypto_30_Hwa.h, InitPhase=INIT_TWO_DRV, ModuleRef=Crypto_30_Hwa  # /ActiveEcuC/Crypto_30_Hwa PLAIN_TEXT Initializes the Crypto_30_Hwa
          Crypto_30_Hwa_InitMemory: Header=Crypto_30_Hwa.h, InitPhase=INIT_MEMORY, ModuleRef=Crypto_30_Hwa  # /ActiveEcuC/Crypto_30_Hwa PLAIN_TEXT Initializes variables of the Crypto_30_Hwa
          vLinkGen_Init: Header=vLinkGen_Lcfg.h, InitPhase=NO_INIT, ModuleRef=vLinkGen  # /ActiveEcuC/vLinkGen PLAIN_TEXT Dummy initialization of the vLinkGen
    EcucPduCollection: PduIdTypeEnum=UINT8, PduLengthTypeEnum=UINT8
    EcucHardware
      EcucCoreDefinition: EcucCoreId=0
  module config Os: implementation-config-variant=VARIANT-PRE-COMPILE, module-description=Os_Impl
    SystemTimer (OsCounter):
      OsCounterMaxAllowedValue = 2147483647
      OsCounterMinCycle = 1
      OsCounterType = HARDWARE
      OsSecondsPerTick = 0.001
      OsCounterTicksPerBase = 100000
      OsCounterAccessingApplication = SystemApplication_OsCore0
      OsDriver: OsDriverHighResolution=false, OsDriverIsrRef=CounterIsr_SystemTimer, OsDriverHardwareTimerChannelRef=SysTick_Ch0
    OsOS:
      OsScalabilityClass = SC1
      OsStackMonitoring = true
      OsStatus = EXTENDED
      OsUseGetServiceId = false
      OsUseParameterAccess = false
      OsUseResScheduler = false
      OsForcibleTermination = false
      OsGenerateCalloutStubs = true
      OsGenerateMemMap = COMPLETE
      OsGenerateMemMapForNearAddressing = false
      OsGenerateMemMapForThreads = false
      OsServiceProtection = false
      OsStackUsageMeasurement = false
      OsUseXSignalAsyncApiCalls = false
      OsFpuUsage = NONE
      OsNumberOfCores = 1
      OsUseCase = STANDARD
      OsUseArti = false
      OsSystemTimer = SystemTimer
      OsMasterCore = OsCore0
      OsHooks: OsErrorHook=true, OsPostTaskHook=false, OsPreTaskHook=false, OsShutdownHook=true, OsStartupHook=true, OsPanicHook=true, OsProtectionHook=false
      OsStackSummary
        12 x OsStack, all with OsStackCore=OsCore0:
          OsCore0_Error: OsStackSize=1024, OsStackType=CORE_ERROR_STACK, OsStackUser=OsCore0
          OsCore0_Init: OsStackSize=1024, OsStackType=CORE_INIT_STACK, OsStackUser=OsCore0
          OsCore0_Kernel: OsStackSize=1024, OsStackType=CORE_KERNEL_STACK, OsStackUser=OsCore0
          OsCore0_Task_Prio4294967295: OsStackSize=1024, OsStackType=TASK_SHARED_PRIORITY_STACK, OsStackUser=IdleTask_OsCore0
          OsCore0_Isr_Core: OsStackSize=1024, OsStackType=ISR_SHARED_CORE_STACK, OsStackUser=CounterIsr_SystemTimer, OsStackUser=vHsm_Hal_InternalRequestIsr
          OsCore0_Task_Prio4294967294: OsStackSize=4096, OsStackType=TASK_SHARED_PRIORITY_STACK, OsStackUser=Default_Init_Task
          OsCore0_Task_Prio10: OsStackSize=4096, OsStackType=TASK_SHARED_PRIORITY_STACK, OsStackUser=OsTask
          OsCore0_Task_Prio20: OsStackSize=4096, OsStackType=TASK_SHARED_PRIORITY_STACK, OsStackUser=Ostask_HighPrio
          vHsmMainFunctionTask: OsStackSize=4096, OsStackType=TASK_EXTENDED_STACK, OsStackUser=Os/vHsmMainFunctionTask
          OsCore0_Startup: OsStackSize=1024, OsStackType=CORE_STARTUP_STACK, OsStackUser=OsCore0
          OsCore0_Shutdown: OsStackSize=1024, OsStackType=CORE_SHUTDOWN_STACK, OsStackUser=OsCore0
          OsCore0_Task_Prio4294967293: OsStackSize=256, OsStackType=TASK_SHARED_PRIORITY_STACK, OsStackUser=Default_Init_Task_Trusted
    OSDEFAULTAPPMODE (OsAppMode)
    OS_APPMODE_ANY (OsAppMode)
    OsCore0 (OsCore):
      OsCoreIsAutostart = true
      OsCoreIsAutosar = true
      OsCoreEntrySymbol = _start
      OsCorePhysicalCoreRef = Core0
      OsCoreIdleTask = IdleTask_OsCore0
      OsCoreSystemApplication = SystemApplication_OsCore0
      OsCoreEcucCoreRef = EcucCoreDefinition
      OsCoreStacks:
        OsCoreKernelStackSize = 1024
        OsCoreStartupStackSize = 1024
        OsCoreShutdownStackSize = 1024
        OsCoreErrorStackSize = 1024
        OsCoreProtectionStackSize = 1024
        OsCoreInitStackSize = 1024
    IdleTask_OsCore0 (OsTask):
      OsTaskActivation = 1
      OsTaskPriority = 4294967295
      OsTaskSchedule = FULL
      OsTaskStackSharing = false
      OsTaskStackSize = 1024
      OsTaskType = AUTO
      OsTaskUsesFpu = false
      OsTaskAccessingApplication = SystemApplication_OsCore0
      OsTaskAutostart: OsTaskAppModeRef=OS_APPMODE_ANY
    SystemApplication_OsCore0 (OsApplication):
      OsTrusted = true
      OsTrustedApplicationDelayTimingViolationCall = false
      OsTrustedApplicationWithProtection = false
      OsApplicationIsPrivileged = true
      OsAppUseTrustedFunctionStubs = false
      OsAppCounterRef = SystemTimer
      OsAppTaskRef = IdleTask_OsCore0
      OsAppIsrRef = CounterIsr_SystemTimer
      OsAppTaskRef = OsTask
      OsAppTaskRef = Default_Init_Task
      OsAppTaskRef = Os/vHsmMainFunctionTask
      OsAppTaskRef = Ostask_HighPrio
      OsApplicationCoreRef = EcucCoreDefinition
      OsAppIsrRef = vHsm_Hal_ExternalRequestIsr
      OsAppTaskRef = Default_Init_Task_Trusted
      OsAppIsrRef = vHsm_Hal_InternalRequestIsr
      OsAppAlarmRef = Os/Rte_Al_TE2_vHsmMainFunctionTask_0_10ms
      OsApplicationHooks: OsAppErrorHook=false, OsAppShutdownHook=false, OsAppStartupHook=false
    CounterIsr_SystemTimer (OsIsr):
      OsIsrCategory = CATEGORY_2
      OsIsrInterruptType = EXTERNAL
      OsIsrInterruptSource = 15
      OsIsrInterruptPriority = 64
      OsIsrStackSize = 1024
      OsIsrEnableNesting = false
      OsIsrUsesFpu = false
      OsIsrInitialEnableInterruptSource = false
      OsIsrSpecialFunctionName = Os_TimerPitIsr
    4 x OsTask, all with OsTaskStackSharing=false, OsTaskStackSize=4096, OsTaskType=AUTO, OsTaskUsesFpu=false, OsTaskAccessingApplication=SystemApplication_OsCore0:
      OsTask: OsTaskActivation=10, OsTaskPriority=10, OsTaskSchedule=FULL
      Default_Init_Task: OsTaskActivation=1, OsTaskPriority=4294967294, OsTaskSchedule=NON
        OsTaskAutostart: OsTaskAppModeRef=OSDEFAULTAPPMODE
      vHsmMainFunctionTask: OsTaskActivation=1, OsTaskPriority=0, OsTaskSchedule=FULL, OsTaskEventRef=Rte_Ev_Run1_NvM_NvM_MainFunction, OsTaskEventRef=Rte_Ev_RunS1_NvM_NvM_MainFunction, OsTaskEventRef=Rte_Ev_Run1_Crypto_30_LibCv_Crypto_30_LibCv_MainFunction, OsTaskEventRef=Rte_Ev_Run1_Csm_Csm_MainFunction, OsTaskEventRef=Rte_Ev_RunS1_Csm_Csm_MainFunction, OsTaskEventRef=Rte_Ev_Run1_KeyM_KeyM_MainFunction, OsTaskEventRef=Rte_Ev_RunS1_KeyM_KeyM_MainFunction, OsTaskEventRef=Rte_Ev_Cyclic2_vHsmMainFunctionTask_0_10ms
      Ostask_HighPrio: OsTaskActivation=10, OsTaskPriority=20, OsTaskSchedule=FULL
    Rte_Ev_Run1_NvM_NvM_MainFunction (OsEvent)
    Rte_Ev_RunS1_NvM_NvM_MainFunction (OsEvent)
    vHsm_Hal_ExternalRequestIsr (OsIsr):
      OsIsrCategory = CATEGORY_1
      OsIsrInterruptType = EXTERNAL
      OsIsrInterruptSource = 19
      OsIsrInterruptPriority = 32
      OsIsrStackSize = 4096
      OsIsrEnableNesting = false
      OsIsrUsesFpu = false
      OsIsrInitialEnableInterruptSource = false
    3 x OsEvent:
      Rte_Ev_Run1_Crypto_30_LibCv_Crypto_30_LibCv_MainFunction
      Rte_Ev_Run1_Csm_Csm_MainFunction
      Rte_Ev_RunS1_Csm_Csm_MainFunction
    Default_Init_Task_Trusted (OsTask):
      OsTaskActivation = 1
      OsTaskPriority = 4294967293
      OsTaskSchedule = NON
      OsTaskStackSharing = false
      OsTaskStackSize = 256
      OsTaskType = BASIC
      OsTaskUsesFpu = false
      OsTaskAccessingApplication = SystemApplication_OsCore0
      OsTaskAutostart: OsTaskAppModeRef=OSDEFAULTAPPMODE
    vHsm_Hal_InternalRequestIsr (OsIsr):
      OsIsrCategory = CATEGORY_2
      OsIsrInterruptType = EXTERNAL
      OsIsrInterruptSource = 17
      OsIsrInterruptPriority = 96
      OsIsrStackSize = 1024
      OsIsrEnableNesting = false
      OsIsrUsesFpu = false
      OsIsrInitialEnableInterruptSource = true
    OsPublishedInformation: OsKernelVersion=7, OsPlatformName=Arm
      Generic_CortexM_Mp (OsDerivativeInformation):
        OsMpuAlignment = SIZE
        OsMpuEndAddressAccessible = true
        OsStackAlignment = 0
        OsExceptionVectorTableAlignment = 0
        OsInterruptVectorTableAlignment = 2048
        OsHardwareManuals = ARMv7-M Architecture Reference Manual edition: ARM DDI 0403E.b (ID120114), 02 December 2014
        OsMpuPrivilegedRegionsConfigurable = false
        Core0 (OsPhysicalCore):
          OsPhysicalCoreId = 0
          OsPhysicalCoreExceptionSources = 8
          OsPhysicalCoreIsAutostart = true
          OsPhysicalCoreMasterStartAllowed = false
          OsPhysicalCorePrivelegedHwAccess = true
          OsPhysicalCoreType = Cortex-M
          OsPhysicalCoreDefaultEntrySymbol = _start
          OsPhysicalCoreStackProtectionUnit = Core0_MPU
          Core0_MPU (OsPhysicalCoreMpu): OsPhysicalCoreMpuMaxRegions=16, OsPhysicalCoreMpuId=0, OsPhysicalCoreMpuType=Cortex-M
        SysTick (OsHardwareTimer): OsHardwareTimerBaseAddress=3758153744, OsHardwareTimerId=0, OsHardwareTimerSize=24, OsHardwareTimerUnit=PIT, OsHardwareTimerType=SysTick
          SysTick_Ch0 (OsHardwareTimerChannel): OsHardwareTimerChannelId=0, OsHardwareTimerChannelIntSource=15, OsHardwareTimerChannelOffset=0
        OsMemoryRegionSpecifics
          10 x OsMemoryRegionAccess:
            SUPERVISOR_R: OsMemoryRegionAccessRights=R, OsMemoryRegionAccessType=SUPERVISOR
            SUPERVISOR_RW: OsMemoryRegionAccessRights=RW, OsMemoryRegionAccessType=SUPERVISOR
            USER_R: OsMemoryRegionAccessRights=R, OsMemoryRegionAccessType=USER
            USER_RW: OsMemoryRegionAccessRights=RW, OsMemoryRegionAccessType=USER
            SUPERVISOR_NONE: OsMemoryRegionAccessRights=NONE, OsMemoryRegionAccessType=SUPERVISOR
            USER_NONE: OsMemoryRegionAccessRights=NONE, OsMemoryRegionAccessType=USER
            SUPERVISOR_RX: OsMemoryRegionAccessRights=RX, OsMemoryRegionAccessType=SUPERVISOR
            SUPERVISOR_RWX: OsMemoryRegionAccessRights=RWX, OsMemoryRegionAccessType=SUPERVISOR
            USER_RX: OsMemoryRegionAccessRights=RX, OsMemoryRegionAccessType=USER
            USER_RWX: OsMemoryRegionAccessRights=RWX, OsMemoryRegionAccessType=USER
          8 x OsMemoryRegionFlag:
            SHAREABLE
            TYPE_STRONGLY_ORDERED
            TYPE_NON_CACHEABLE
            TYPE_CACHEABLE_WRITEBACK_ALLOCATE
            TYPE_SHARED_DEVICE
            TYPE_NON_SHARED_DEVICE
            TYPE_CACHEABLE_WRITETHROUGH_NO_ALLOCATE
            TYPE_CACHEABLE_WRITEBACK_NO_ALLOCATE
        OsMemoryRegionDefaults_AppNT (OsMemoryRegionDefaults):
          OsMemoryRegionDefIdentifier = 1
          OsMemoryRegionDefType = APPLICATION_NONPRIVILEGED
          OsMemoryRegionDefProtectionUnitSlot = 14
          OsMemoryRegionDefAccessRights = SUPERVISOR_RW
          OsMemoryRegionDefAccessRights = USER_RW
          OsMemoryRegionDefFlags = TYPE_CACHEABLE_WRITEBACK_ALLOCATE
        NVIC (OsSystemIntCtrl):
          OsSystemIntCtrlMaxPrios = 256
          OsSystemIntCtrlMaxSources = 512
          OsSystemIntCtrlPrioOrder = DESC
          OsSystemIntCtrlBaseAddress = 3758153728
          OsSystemIntCtrlType = NVIC
    Rte_Ev_Run1_KeyM_KeyM_MainFunction (OsEvent)
    Rte_Ev_RunS1_KeyM_KeyM_MainFunction (OsEvent)
    Rte_Al_TE2_vHsmMainFunctionTask_0_10ms (OsAlarm): OsAlarmCounterRef=SystemTimer, OsAlarmAccessingApplication=SystemApplication_OsCore0
      OsAlarmAction
        OsAlarmSetEvent: OsAlarmSetEventRef=Rte_Ev_Cyclic2_vHsmMainFunctionTask_0_10ms, OsAlarmSetEventTaskRef=Os/vHsmMainFunctionTask
    Rte_Ev_Cyclic2_vHsmMainFunctionTask_0_10ms (OsEvent)
  module config vHsm: implementation-config-variant=VARIANT-PRE-COMPILE, module-description=vHsm_Impl
    vHsmGeneral:
      vHsmSoftResetLimit = 8
      vHsmDevErrorDetect = true
      vHsmRedirection = false
      vHsmEnableRamLoopCallout = true
      vHsmGenerateRandomIpcValues = false
      vHsmGenerateRandomStackProtectionCanary = false
      vHsmInvalidNvMBlockBehaviour = VHSM_IGNORE_INVALID_BLOCKS
      vHsmUserConfigurationFile = $(DpaProjectFolder)\Config\UserConfig\vHsm.cfg
      vHsmAdditionalSettings = ENABLE_API_GET_IPC_ADDRESS
      vHsmAdditionalSettings = ENABLE_API_PREPARE_JOB_DATA
      vHsmAdditionalSettings = ENABLE_UNALIGNED_ACCESS
      vHsmForceInterruptTriggering = false
      vHsmSupportSaveRestoreContext = false
      vHsmRandomCsmJobRef = CsmJob_Random
      9 x vHsmMemoryArea:
        TC3xx_HostAccessWindow: vHsmMemoryAreaStart=4026859520, vHsmMemoryAreaStop=4026925055, vHsmMemoryAreaType=VHSM_MEMORY_AREA_READWRITE, vHsmMemoryAreaId=3, vHsmMemoryAreaUser=HSM, vHsmMemoryAreaPriority=11
        TC3xx_CPU0_CPU1_CPU2: vHsmMemoryAreaStart=1342177280, vHsmMemoryAreaStop=2147483647, vHsmMemoryAreaType=VHSM_MEMORY_AREA_READ, vHsmMemoryAreaId=0, vHsmMemoryAreaPriority=0, vHsmMemoryAreaUser=BOTH
        TC3xx_CPU3_CPU4: vHsmMemoryAreaStart=805306368, vHsmMemoryAreaStop=1107296255, vHsmMemoryAreaType=VHSM_MEMORY_AREA_READ, vHsmMemoryAreaId=1, vHsmMemoryAreaUser=BOTH, vHsmMemoryAreaPriority=0
        TC3xx_CPU5: vHsmMemoryAreaStart=268435456, vHsmMemoryAreaStop=536870911, vHsmMemoryAreaType=VHSM_MEMORY_AREA_READ, vHsmMemoryAreaId=2, vHsmMemoryAreaUser=BOTH, vHsmMemoryAreaPriority=0
        TC3xx_LMURAM_noncached: vHsmMemoryAreaStart=2952790016, vHsmMemoryAreaStop=2953969663, vHsmMemoryAreaType=VHSM_MEMORY_AREA_READWRITE, vHsmMemoryAreaId=6, vHsmMemoryAreaUser=BOTH, vHsmMemoryAreaPriority=0
        TC3xx_LMURAM_cached_HSM: vHsmMemoryAreaStart=2415919104, vHsmMemoryAreaStop=2417098751, vHsmMemoryAreaType=VHSM_MEMORY_AREA_READ, vHsmMemoryAreaId=5, vHsmMemoryAreaUser=HSM, vHsmMemoryAreaPriority=10
        TC3xx_PFLASH_noncached: vHsmMemoryAreaStart=2684616704, vHsmMemoryAreaStop=2701131775, vHsmMemoryAreaType=VHSM_MEMORY_AREA_READ, vHsmMemoryAreaId=8, vHsmMemoryAreaUser=BOTH, vHsmMemoryAreaPriority=0
        TC3xx_PFLASH_cached: vHsmMemoryAreaStart=2147745792, vHsmMemoryAreaStop=2164260863, vHsmMemoryAreaType=VHSM_MEMORY_AREA_READ, vHsmMemoryAreaId=7, vHsmMemoryAreaUser=BOTH, vHsmMemoryAreaPriority=0
        TC3xx_LMURAM_cached_HOST: vHsmMemoryAreaStart=2415919104, vHsmMemoryAreaStop=2417098751, vHsmMemoryAreaType=VHSM_MEMORY_AREA_READWRITE, vHsmMemoryAreaId=4, vHsmMemoryAreaUser=HOST, vHsmMemoryAreaPriority=0
    vHsmChannelMapping: vHsmKeyManagementChannel=Crypto_30_vHsm_KeyManagement
    vHsmKeyMapping:
      vHsmInternalOnlyKeys = CryIf/vHsm_FirmwareUpdate_Mac
      vHsmInternalOnlyKeys = CryIf/vHsm_FirmwareUpdate_Encrypt
      vHsmInternalOnlyKeys = CryIf/vHsm_FirmwareUpdate_Decrypt
      UID (vHsmRandomInit): vHsmRandomInitKey=CryptoKeys/vHsm_Info, vHsmRandomInitKeyElement=vHsm_Info_Uid
      vHsm_Custom (vHsmKeyRouting): vHsmCryptoModuleRef=vHsm_Custom, vHsmRoutedKeys=CryIf/vHSM_Custom_HSM_Version
    vHsmIpc: vHsmIpcChannels=2, vHsmIpcProtocolVersion=3
      vHsmIpcInstance:
        vHsmDriverPreconfigDestination = $(DpaProjectFolder)\ApplPreConfig\Crypto_30_vHsm_bswmd_Pre.arxml
        vHsmIpcAddress = 0xB0000000
        vHsmIpcHardwareUnit = 0
        vHsmIpcInstanceId = 0
        vHsmResponseInterruptFlagSetAddress = 4026794024
        vHsmResponseInterruptFlagSetMask = 1
        vHsmDriverObjectMapping = Crypto_30_vHsm_KeyManagement
        vHsmDriverObjectMapping = Crypto_30_vHsm_LibCv_HighPrio
        vHsmDriverObjectMapping = Crypto_30_vHsm_KeyM_LibCv
        vHsmDriverObjectMapping = Crypto_30_vHsm_Core
        vHsmDriverObjectMapping = Crypto_30_vHsm_LibCv
        vHsmDriverObjectMapping = Crypto_30_vHsm_Hwa_HighPrio
        vHsmDriverObjectMapping = Crypto_30_vHsm_Hwa
    vHsmFirmwareUpdate:
      vHsmUpdaterAddress = VHSM_FIRMWARE_UPDATER
      vHsmJumpToUpdaterRestriction = false
      vHsmFirmwareUpdateCsmJobMacGenerateRef = CsmJob_FirmwareUpdate_MacGenerate
      vHsmFirmwareUpdateCsmJobSignatureVerifyRef = CsmJob_FirmwareUpdate_SignatureVerify
      vHsmFirmwareUpdateCsmJobEncryptRef = CsmJob_FirmwareUpdate_Encrypt
      vHsmFirmwareUpdateCsmJobDecryptRef = CsmJob_FirmwareUpdate_Decrypt
    vHsmScheduling: vHsmInterruptMode=true, vHsmOsSupport=true, vHsmIsrForProcessing=CATEGORY_1
      vHsmSchedulableEntities_HighPrio (vHsmSchedulableEntities): vHsmSchedulableEntityId=0, vHsmChannelRef=Crypto_30_vHsm_LibCv_HighPrio, vHsmChannelRef=Crypto_30_vHsm_Hwa_HighPrio
      vHsmSchedulableEntities_Unmapped (vHsmSchedulableEntities):
        vHsmSchedulableEntityId = 1
        vHsmChannelRef = Crypto_30_vHsm_LibCv_vHsmUpd_Mac
        vHsmChannelRef = Crypto_30_vHsm_KeyM_LibCv
        vHsmChannelRef = Crypto_30_vHsm_LibCv
        vHsmChannelRef = Crypto_30_vHsm_KeyManagement
        vHsmChannelRef = Crypto_30_vHsm_Core
        vHsmChannelRef = Crypto_30_vHsm_LibCv_vHsmUpd_Dec
        vHsmChannelRef = Crypto_30_vHsm_Hwa
        vHsmChannelRef = Crypto_30_vHsm_LibCv_vHsmUpd_Enc
        vHsmChannelRef = Crypto_30_vHsm_KeyM
        vHsmChannelRef = Crypto_30_vHsm_LibCv_vHsmUpd_Sig
    vHsmPublishedInformation
      TC3xx (vHsmDerivativeInformation)
        vHsmIpcHardwareUnit: vHsmIpcHardwareUnitId=0
          Host:
            vHsmHost2HsmAddress = 4026794040
            vHsmHsm2HostAddress = 4026794036
            vHsmRequestInterruptFlagSetAddress = 4026794016
            vHsmResponseInterruptFlagClearAddress = 4026794024
            vHsmResponseInterruptFlagClearValue = 1
          Hsm: vHsmHost2HsmAddress=4026794040, vHsmHsm2HostAddress=4026794036, vHsmResponseInterruptFlagSetAddress=4026794024
  module config vSet: implementation-config-variant=VARIANT-PRE-COMPILE, module-description=vSet_Impl
    vSetGeneral: vSetDummyStatementKind=VoidCast
    vSetPlatform:
      vSetSizeOfInt = Size32Bit
      vSetSizeOfROMPointer = Size32Bit
      vSetCPUType = CPU32Bit
      vSetSizeOfRAMPointer = Size32Bit
      vSetBitOrder = LSB_to_MSB
      vSetByteOrder = LITTLE_ENDIAN
      vSetSizeOfEnum = Size32Bit
    vSetCalibration
    vSetBswInitialization
      23 x vSetInitFunction:
        Crypto_30_KeyM_Init: vSetHeader=Crypto_30_KeyM.h, vSetModuleRef=Crypto_30_KeyM  # /ActiveEcuC/Crypto_30_KeyM PLAIN_TEXT Initializes the MICROSAR Crypto_30_KeyM
          vSetInitFunctionInstance: vSetInitPhase=INIT_TWO_SYS
        Crypto_30_KeyM_InitMemory: vSetHeader=Crypto_30_KeyM.h, vSetModuleRef=Crypto_30_KeyM  # /ActiveEcuC/Crypto_30_KeyM PLAIN_TEXT Initializes variables of the MICROSAR Crypto_30_KeyM
          vSetInitFunctionInstance: vSetInitPhase=INIT_MEMORY
        CryIf_Init: vSetHeader=CryIf.h, vSetModuleRef=CryIf  # /ActiveEcuC/CryIf PLAIN_TEXT Initializes the Crypto Interface
          vSetInitFunctionInstance: vSetInitPhase=INIT_TWO_IF
        CryIf_InitMemory: vSetHeader=CryIf.h, vSetModuleRef=CryIf  # /ActiveEcuC/CryIf PLAIN_TEXT Initializes variables of the Crypto Interface
          vSetInitFunctionInstance: vSetInitPhase=INIT_MEMORY
        Crypto_30_Hwa_Init: vSetHeader=Crypto_30_Hwa.h, vSetModuleRef=Crypto_30_Hwa  # /ActiveEcuC/Crypto_30_Hwa PLAIN_TEXT Initializes the Crypto_30_Hwa
          vSetInitFunctionInstance: vSetInitPhase=INIT_TWO_DRV
        Crypto_30_Hwa_InitMemory: vSetHeader=Crypto_30_Hwa.h, vSetModuleRef=Crypto_30_Hwa  # /ActiveEcuC/Crypto_30_Hwa PLAIN_TEXT Initializes variables of the Crypto_30_Hwa
          vSetInitFunctionInstance: vSetInitPhase=INIT_MEMORY
        Crypto_30_LibCv_InitMemory: vSetHeader=Crypto_30_LibCv.h, vSetModuleRef=Crypto_30_LibCv  # /ActiveEcuC/Crypto_30_LibCv PLAIN_TEXT Initializes variables of the Crypto Driver
          vSetInitFunctionInstance: vSetInitPhase=INIT_MEMORY
        Crypto_30_LibCv_Init: vSetHeader=Crypto_30_LibCv.h, vSetModuleRef=Crypto_30_LibCv  # /ActiveEcuC/Crypto_30_LibCv PLAIN_TEXT Initializes the Crypto Driver
          vSetInitFunctionInstance: vSetInitPhase=INIT_TWO_DRV
        Csm_Init: vSetHeader=Csm.h, vSetModuleRef=Csm  # /ActiveEcuC/Csm PLAIN_TEXT Initializes the Crypto Service Manager
          vSetInitFunctionInstance: vSetInitPhase=INIT_TWO_SYS
        Csm_InitMemory: vSetHeader=Csm.h, vSetModuleRef=Csm  # /ActiveEcuC/Csm PLAIN_TEXT Initializes variables of the Crypto Service Manager
          vSetInitFunctionInstance: vSetInitPhase=INIT_MEMORY
        Fee_Init: vSetHeader=Fee.h, vSetConfigType=Fee_ConfigType, vSetConfigPtrClass=const, vSetModuleRef=Fee  # /ActiveEcuC/Fee PLAIN_TEXT Created Fee_Init by Extended Init XML Service
          vSetInitFunctionInstance: vSetInitPhase=INIT_ONE, vSetConfigPtrName=&Fee_Config
        Fls_17_Dmu_Init: vSetHeader=Fls_17_Dmu.h, vSetConfigType=Fls_17_Dmu_ConfigType, vSetConfigPtrClass=const, vSetModuleRef=Fls  # /ActiveEcuC/Fls PLAIN_TEXT Created Fls_17_Dmu_Init by Extended Init XML Service
          vSetInitFunctionInstance: vSetInitPhase=INIT_ONE, vSetConfigPtrName=&Fls_17_Dmu_Config
        KeyM_InitMemory: vSetHeader=KeyM.h, vSetModuleRef=KeyM  # /ActiveEcuC/KeyM PLAIN_TEXT Initializes variables of the MICROSAR KeyM
          vSetInitFunctionInstance: vSetInitPhase=INIT_MEMORY
        KeyM_Init: vSetHeader=KeyM.h, vSetConfigType=KeyM_ConfigType, vSetConfigPtrClass=KEYM_INIT_DATA, vSetModuleRef=KeyM  # /ActiveEcuC/KeyM PLAIN_TEXT Initializes the MICROSAR KeyM
          vSetInitFunctionInstance: vSetInitPhase=INIT_TWO_SYS, vSetConfigPtrName=NULL_PTR
        NvM_Init: vSetHeader=NvM.h, vSetModuleRef=NvM  # /ActiveEcuC/NvM PLAIN_TEXT Initialization of the NVRAM Manager, to make it ready for NvM_ReadAll being requested
          vSetInitFunctionInstance: vSetInitPhase=INIT_TWO_SYS
        SchM_Init: vSetHeader=Rte_Main.h, vSetModuleRef=Rte  # /ActiveEcuC/Rte PLAIN_TEXT Automatically generated by BswInitFctConfigurationService.
          vSetInitFunctionInstance: vSetInitPhase=NO_INIT
        Rte_Start: vSetHeader=Rte_Main.h, vSetModuleRef=Rte  # /ActiveEcuC/Rte PLAIN_TEXT Automatically generated by BswInitFctConfigurationService.
          vSetInitFunctionInstance: vSetInitPhase=INIT_THREE
        Rte_InitMemory: vSetHeader=Rte_Main.h, vSetModuleRef=Rte  # /ActiveEcuC/Rte PLAIN_TEXT Automatically generated by BswInitFctConfigurationService.
          vSetInitFunctionInstance: vSetInitPhase=INIT_MEMORY
        Rte_StartTiming: vSetHeader=Rte_Main.h, vSetModuleRef=Rte  # /ActiveEcuC/Rte PLAIN_TEXT Automatically generated by BswInitFctConfigurationService.
          vSetInitFunctionInstance: vSetInitPhase=NO_INIT
        Brs_Init: vSetHeader=, vSetModuleRef=vBRS  # /ActiveEcuC/vBRS PLAIN_TEXT Automatically generated by BswInitFctConfigurationService.
          vSetInitFunctionInstance: vSetInitPhase=NO_INIT
        vBaseEnv_Init: vSetHeader=, vSetModuleRef=vBaseEnv  # /ActiveEcuC/vBaseEnv PLAIN_TEXT Created vBaseEnv_Init by Extended Init XML Service
          vSetInitFunctionInstance: vSetInitPhase=NO_INIT
        vHsm_Init: vSetHeader=vHsm.h, vSetModuleRef=vHsm  # /ActiveEcuC/vHsm PLAIN_TEXT Initializes memory of the vHsm.
          vSetInitFunctionInstance: vSetInitPhase=NO_INIT
        vLinkGen_Init: vSetHeader=vLinkGen_Lcfg.h, vSetModuleRef=vLinkGen  # /ActiveEcuC/vLinkGen PLAIN_TEXT Dummy initialization of the vLinkGen
          vSetInitFunctionInstance: vSetInitPhase=NO_INIT
  module config Crypto_30_KeyM: definition=Crypto, implementation-config-variant=VARIANT-PRE-COMPILE, module-description=Crypto_Impl
    CryptoDriverObjects
      Crypto_30_KeyM (CryptoDriverObject):
        CryptoDriverObjectId = 0
        CryptoDriverObjectQueueSize = 1
        CryptoPrimitiveRef = KeyM_ServiceCertificate
        CryptoPrimitiveRef = KeyM_CertElementGet
        CryptoPrimitiveRef = KeyM_RemoteHandling
    CryptoKeyTypes
      KeyType_KeyM_Certificate (CryptoKeyType):
        CryptoKeyElementRef = KeyM_Certificate
        CryptoKeyElementRef = KeyM_GetStatus
        CryptoKeyElementRef = KeyM_VerifyCertificate
        CryptoKeyElementRef = KeyM_VerifyCertificates
    CryptoKeyElements
      4 x CryptoKeyElement, all with CryptoKeyElementPersist=false:
        KeyM_Certificate: CryptoKeyElementWriteAccess=WA_ALLOWED, CryptoKeyElementReadAccess=RA_ALLOWED, CryptoKeyElementAllowPartialAccess=true, CryptoKeyElementId=3080, CryptoKeyElementSize=600
        KeyM_GetStatus: CryptoKeyElementWriteAccess=WA_DENIED, CryptoKeyElementReadAccess=RA_ALLOWED, CryptoKeyElementSize=1, CryptoKeyElementAllowPartialAccess=false, CryptoKeyElementId=3081
        KeyM_VerifyCertificate: CryptoKeyElementWriteAccess=WA_ALLOWED, CryptoKeyElementReadAccess=RA_DENIED, CryptoKeyElementAllowPartialAccess=true, CryptoKeyElementId=3082, CryptoKeyElementSize=1
        KeyM_VerifyCertificates: CryptoKeyElementWriteAccess=WA_ALLOWED, CryptoKeyElementReadAccess=RA_DENIED, CryptoKeyElementAllowPartialAccess=false, CryptoKeyElementId=3083, CryptoKeyElementSize=2
    CryptoPrimitives
      3 x CryptoPrimitive, all with CryptoPrimitiveAlgorithmSecondaryFamily=CRYPTO_ALGOFAM_NOT_SET, CryptoPrimitiveAlgorithmFamily=CRYPTO_ALGOFAM_CUSTOM, CryptoPrimitiveAlgorithmMode=CRYPTO_ALGOMODE_CUSTOM, CryptoPrimitiveAlgorithmFamilyCustomRef=Crypto_30_KeyM_vHsm_KeyM:
        KeyM_CertElementGet: CryptoPrimitiveService=CRYPTO_AEADENCRYPT, CryptoPrimitiveAlgorithmModeCustomRef=Crypto_30_KeyM_CertElementGet, CryptoPrimitiveAlgorithmModeCustomRef=Crypto_30_KeyM_CertElementGetFirst, CryptoPrimitiveAlgorithmModeCustomRef=Crypto_30_KeyM_CertElementGetNext
        KeyM_ServiceCertificate: CryptoPrimitiveService=CRYPTO_AEADDECRYPT, CryptoPrimitiveAlgorithmModeCustomRef=Crypto_30_KeyM_ServiceCertificate
        KeyM_InitCSR: CryptoPrimitiveService=CRYPTO_AEADENCRYPT, CryptoPrimitiveAlgorithmModeCustomRef=Crypto_30_KeyM_InitCSR
      Crypto_30_KeyM_vHsm_KeyM (CryptoPrimitiveAlgorithmFamilyCustom): CryptoPrimitiveAlgorithmFamilyCustomId=170
      5 x CryptoPrimitiveAlgorithmModeCustom:
        Crypto_30_KeyM_ServiceCertificate: CryptoPrimitiveAlgorithmModeCustomId=140
        Crypto_30_KeyM_CertElementGet: CryptoPrimitiveAlgorithmModeCustomId=141
        Crypto_30_KeyM_CertElementGetFirst: CryptoPrimitiveAlgorithmModeCustomId=142
        Crypto_30_KeyM_CertElementGetNext: CryptoPrimitiveAlgorithmModeCustomId=143
        Crypto_30_KeyM_InitCSR: CryptoPrimitiveAlgorithmModeCustomId=139
      KeyM_RemoteHandling (CryptoPrimitive):
        CryptoPrimitiveService = CRYPTO_AEADDECRYPT
        CryptoPrimitiveAlgorithmFamily = CRYPTO_ALGOFAM_AES
        CryptoPrimitiveAlgorithmMode = CRYPTO_ALGOMODE_GCM
        CryptoPrimitiveAlgorithmSecondaryFamily = CRYPTO_ALGOFAM_NOT_SET
    CryptoKeys
      KeyMCertificate_OSSL_X509_ECDSA_P384_CA (CryptoKey): CryptoKeyDeriveIterations=1, CryptoKeyId=0, CryptoKeyTypeRef=KeyType_KeyM_Certificate
      KeyMCertificate_OSSL_X509_ECDSA_P384_IA (CryptoKey): CryptoKeyDeriveIterations=1, CryptoKeyId=1, CryptoKeyTypeRef=KeyType_KeyM_Certificate
    CryptoGeneral: CryptoMaxEntriesCsrInfo=16
  module config Crc: implementation-config-variant=VARIANT-PRE-COMPILE, module-description=Crc_Impl
    CrcGeneral:
      Crc16Mode = CRC_16_RUNTIME
      Crc32Mode = CRC_32_RUNTIME
      Crc8H2FMode = CRC_8H2F_RUNTIME
      Crc8Mode = CRC_8_RUNTIME
      CrcVersionInfoApi = false
      Crc32P4Mode = CRC_32P4_RUNTIME
      Crc64Mode = CRC_64_RUNTIME
  module config CryIf: implementation-config-variant=VARIANT-PRE-COMPILE, module-description=CryIf_Impl
    5 x CryIfChannel:
      Crypto_30_vHsm_LibCv_vHsmUpd_Mac: CryIfChannelId=10, CryIfDriverObjectRef=vHsm_LibCv_vHsmUpd_Mac
      Crypto_30_vHsm_LibCv_vHsmUpd_Sig: CryIfChannelId=11, CryIfDriverObjectRef=vHsm_LibCv_vHsmUpd_Sig
      Crypto_30_vHsm_LibCv_vHsmUpd_Enc: CryIfChannelId=9, CryIfDriverObjectRef=vHsm_LibCv_vHsmUpd_Enc
      Crypto_30_vHsm_LibCv_vHsmUpd_Dec: CryIfChannelId=8, CryIfDriverObjectRef=vHsm_LibCv_vHsmUpd_Dec
      Crypto_30_vHsm_Core: CryIfChannelId=0, CryIfDriverObjectRef=vHsm_Core
    CryIfGeneral:
      CryIfDevErrorDetect = false
      CryIfVersionInfoApi = false
      CryIfMaxNumberOfKeyElements = 1
      CryIfMaxSizeOfKeyElement = 1
      CryIfRedirection = false
      CryIfSafeBswChecks = false
    3 x CryIfChannel:
      Crypto_30_vHsm_Hwa: CryIfChannelId=1, CryIfDriverObjectRef=vHsm_Hwa
      Crypto_30_vHsm_LibCv: CryIfChannelId=6, CryIfDriverObjectRef=vHsm_LibCv
      Crypto_30_vHsm_KeyManagement: CryIfChannelId=5, CryIfDriverObjectRef=vHsm_KeyManagement
    4 x CryIfCryptoModule, all with CryIfCancelJobApiUsesJobType=true:
      CryIfCryptoModule_vHsm_Hwa: CryIfSupportsKeyElementCopyPartial=false, CryIfCryptoModuleRef=Crypto_30_Hwa
      CryIfCryptoModule_vHsm_Core: CryIfSupportsKeyElementCopyPartial=false, CryIfCryptoModuleRef=vHsm_Core
      CryIfCryptoModule_LibCv: CryIfSupportsKeyElementCopyPartial=true, CryIfCryptoModuleRef=Crypto_30_LibCv
      CryIfCryptoModule_vHsm_Custom: CryIfSupportsKeyElementCopyPartial=false, CryIfCryptoModuleRef=vHsm_Custom
    6 x CryIfKey:
      vHsm_Hardware: CryIfKeyId=53, CryIfKeyRef=vHsm_Hal_Hardware
      vHsm_FirmwareUpdate_Signature: CryIfKeyId=61, CryIfKeyRef=CryptoKeys/vHsm_FirmwareUpdate_Signature
      vHsm_Custom: CryIfKeyId=48, CryIfKeyRef=CryptoKeys/vHsm_Custom
      vHsm_FirmwareUpdate_Decrypt: CryIfKeyId=55, CryIfKeyRef=CryptoKeys/vHsm_FirmwareUpdate_Decrypt
      vHsm_FirmwareUpdate_Encrypt: CryIfKeyId=58, CryIfKeyRef=CryptoKeys/vHsm_FirmwareUpdate_Encrypt
      vHsm_FirmwareUpdate_Mac: CryIfKeyId=59, CryIfKeyRef=CryptoKeys/vHsm_FirmwareUpdate_Mac
    Crypto_30_vHsm_LibCv_HighPrio (CryIfChannel): CryIfChannelId=7, CryIfDriverObjectRef=vHsm_LibCv_HighPrio
    3 x CryIfKey:
      KeyM_Cert_Root: CryIfKeyId=16, CryIfKeyRef=CryptoKeys/KeyM_Cert_Root
      KeyM_ECC_Root: CryIfKeyId=18, CryIfKeyRef=CryptoKeys/KeyM_ECC_Root
      KeyM_ECC_Intermediate: CryIfKeyId=17, CryIfKeyRef=CryptoKeys/KeyM_ECC_Intermediate
    Crypto_30_vHsm_KeyM_LibCv (CryIfChannel): CryIfChannelId=4, CryIfDriverObjectRef=vHsm_LibCv_KeyM
    vHsm_RomKey0 (CryIfKey): CryIfKeyId=57, CryIfKeyRef=RomKey0
    vHsm_Log (CryIfKey): CryIfKeyId=56, CryIfKeyRef=vHsmLog
    CryIfCryptoModule_Crypto_30_KeyM (CryIfCryptoModule): CryIfSupportsKeyElementCopyPartial=false, CryIfCancelJobApiUsesJobType=true, CryIfCryptoModuleRef=Crypto_30_KeyM
    21 x CryIfKey:
      Ssa_RandomSeed: CryIfKeyId=39, CryIfKeyRef=CryptoKeys/Ssa_RandomSeed
      Ssa_SecurityAccessPublicKey: CryIfKeyId=42, CryIfKeyRef=CryptoKeys/Ssa_SecurityAccessPublicKey
      Ssa_SharedSecretExchangeKey: CryIfKeyId=43, CryIfKeyRef=CryptoKeys/Ssa_SharedSecretExchangeKey
      Ssa_SharedSecretHash: CryIfKeyId=44, CryIfKeyRef=CryptoKeys/Ssa_SharedSecretHash
      Ssa_BackendCert: CryIfKeyId=37, CryIfKeyRef=CryptoKeys/Ssa_BackendCert
      Ssa_AesRamKey: CryIfKeyId=35, CryIfKeyRef=CryptoKeys/Ssa_AesRamKey
      Ssa_RootCert: CryIfKeyId=41, CryIfKeyRef=CryptoKeys/Ssa_RootCert
      Ssa_RealTime: CryIfKeyId=40, CryIfKeyRef=CryptoKeys/Ssa_RealTime
      SSA_SecOC_Int_MacVerify_Ign_Stat: CryIfKeyId=31, CryIfKeyRef=CryptoKeys/SSA_SecOC_Int_MacVerify_Ign_Stat
      Ssa_SignatureRamKey: CryIfKeyId=45, CryIfKeyRef=CryptoKeys/Ssa_SignatureRamKey
      SSA_SecOC_Int_MacVerify_VehSpd_8: CryIfKeyId=34, CryIfKeyRef=CryptoKeys/SSA_SecOC_Int_MacVerify_VehSpd_8
      SSA_SecOC_Int_MacVerify_PN14_Master_Stat1: CryIfKeyId=32, CryIfKeyRef=CryptoKeys/SSA_SecOC_Int_MacVerify_PN14_Master_Stat1
      KeyM_SigVerifyKey_TrustModelRoot: CryIfKeyId=24, CryIfKeyRef=CryptoKeys/KeyM_SigVerifyKey_TrustModelRoot
      SSA_SecOC_Int_MacVerify_DI_OdoSpeedometer: CryIfKeyId=30, CryIfKeyRef=CryptoKeys/SSA_SecOC_Int_MacVerify_DI_OdoSpeedometer
      KeyM_SigVerifyKey_TrustModelIntermediate: CryIfKeyId=22, CryIfKeyRef=CryptoKeys/KeyM_SigVerifyKey_TrustModelIntermediate
      Ssa_VIN: CryIfKeyId=51, CryIfKeyRef=CryptoKeys/Ssa_VIN
      Ssa_Authentication: CryIfKeyId=36, CryIfKeyRef=CryptoKeys/Ssa_Authentication
      KeyM_SigVerifyKey_TrustModelBackend: CryIfKeyId=19, CryIfKeyRef=CryptoKeys/KeyM_SigVerifyKey_TrustModelBackend
      Ssa_TickCount: CryIfKeyId=46, CryIfKeyRef=CryptoKeys/Ssa_TickCount
      SSA_SecOC_Int_MacVerify_PT4_PTCoor4: CryIfKeyId=33, CryIfKeyRef=CryptoKeys/SSA_SecOC_Int_MacVerify_PT4_PTCoor4
      vHsm_Info: CryIfKeyId=54, CryIfKeyRef=vHsmInfo
    Crypto_30_vHsm_Hwa_HighPrio (CryIfChannel): CryIfChannelId=2, CryIfDriverObjectRef=vHsm_Hwa_HighPrio
    10 x CryIfKey:
      Ssa_PduKeysMac: CryIfKeyId=38, CryIfKeyRef=CryptoKeys/Ssa_PduKeysMac
      SSA_SecOC_Int_MacGen_COM_C04_Pdu03_secured_044596e0_Tx: CryIfKeyId=25, CryIfKeyRef=CryptoKeys/SSA_SecOC_Int_MacGen_COM_C04_Pdu03_secured_044596e0_Tx
      SSA_SecOC_Int_MacGen_COM_C04_Pdu20_secured_393d7a18_Tx: CryIfKeyId=26, CryIfKeyRef=CryptoKeys/SSA_SecOC_Int_MacGen_COM_C04_Pdu20_secured_393d7a18_Tx
      SSA_SecOC_Int_MacGen_COM_C04_Pdu21_secured_2e466e5b_Tx: CryIfKeyId=27, CryIfKeyRef=CryptoKeys/SSA_SecOC_Int_MacGen_COM_C04_Pdu21_secured_2e466e5b_Tx
      SSA_SecOC_Int_MacVerify_COM_C0X_Pdu20_secured_3ef6961f_Rx: CryIfKeyId=28, CryIfKeyRef=CryptoKeys/SSA_SecOC_Int_MacVerify_COM_C0X_Pdu20_secured_3ef6961f_Rx
      SSA_SecOC_Int_MacVerify_COM_C0X_Pdu21_secured_298d825c_Rx: CryIfKeyId=29, CryIfKeyRef=CryptoKeys/SSA_SecOC_Int_MacVerify_COM_C0X_Pdu21_secured_298d825c_Rx
      KeyM_SigVerifyKey_TrustModelBackendPeer: CryIfKeyId=20, CryIfKeyRef=CryptoKeys/KeyM_SigVerifyKey_TrustModelBackendPeer
      KeyM_SigVerifyKey_TrustModelEcuPeer: CryIfKeyId=21, CryIfKeyRef=CryptoKeys/KeyM_SigVerifyKey_TrustModelEcuPeer
      KeyM_SigVerifyKey_TrustModelIntermediatePeer: CryIfKeyId=23, CryIfKeyRef=CryptoKeys/KeyM_SigVerifyKey_TrustModelIntermediatePeer
      vHsm_TRNG: CryIfKeyId=60, CryIfKeyRef=CryptoKeys/vHsm_TRNG
    Crypto_30_vHsm_KeyM (CryIfChannel): CryIfChannelId=3, CryIfDriverObjectRef=Crypto_30_KeyM
    20 x CryIfKey:
      CryIfKey_Ssa_SignatureRamKey_replacementAuthority: CryIfKeyId=7, CryIfKeyRef=Ssa_SignatureRamKey_replacementAuthority
      CryIfKey_Ssa_TrustModelPrivateEcuUnique_StagingKey: CryIfKeyId=11, CryIfKeyRef=Ssa_TrustModelPrivateEcuUnique_StagingKey
      Ssa_TrustModelEcuPublicCsr_StagingKey: CryIfKeyId=47, CryIfKeyRef=CryptoKeys/Ssa_TrustModelEcuPublicCsr_StagingKey
      Ssa_TrustModelEcuPublic_LiveKey: CryIfKeyId=49, CryIfKeyRef=CryptoKeys/Ssa_TrustModelEcuPublic_LiveKey
      Ssa_TrustModelPrivateEcu_LiveKey: CryIfKeyId=50, CryIfKeyRef=CryptoKeys/Ssa_TrustModelPrivateEcu_LiveKey
      CryIfKey_Ssa_TrustModelBackendCert_inHSM: CryIfKeyId=8, CryIfKeyRef=Ssa_TrustModelBackendCert_inHSM
      CryIfKey_Ssa_TrustModelEcuCert_inHSM: CryIfKeyId=9, CryIfKeyRef=Ssa_TrustModelEcuCert_inHSM
      CryIfKey_Ssa_TrustModelIntermediateCert_inHSM: CryIfKeyId=10, CryIfKeyRef=Ssa_TrustModelIntermediateCert_inHSM
      CryIfKey_Ssa_TrustModelRootCert_inHSM: CryIfKeyId=12, CryIfKeyRef=Ssa_TrustModelRootCert_inHSM
      CryIfKey_Ssa_TrustModel_Ecu_CsrPrivateKey: CryIfKeyId=13, CryIfKeyRef=Ssa_TrustModel_Ecu_CsrPrivateKey
      CryIfKey_Ssa_TrustModel_Ecu_CsrPublicKey: CryIfKeyId=14, CryIfKeyRef=Ssa_TrustModel_Ecu_CsrPublicKey
      CryIfKey_vHsm_Info: CryIfKeyId=15, CryIfKeyRef=CryptoKeys/vHsm_Info
      CryIfKey_KeyMCertificate_OSSL_X509_ECDSA_P384_CA: CryIfKeyId=5, CryIfKeyRef=CryptoKeys/KeyMCertificate_OSSL_X509_ECDSA_P384_CA
      CryIfKey_KeyMCertificate_OSSL_X509_ECDSA_P384_IA: CryIfKeyId=6, CryIfKeyRef=CryptoKeys/KeyMCertificate_OSSL_X509_ECDSA_P384_IA
      CryIfKey_Fbl_Decrypt_Aes128: CryIfKeyId=0, CryIfKeyRef=CryptoKey_Fbl_Decrypt_Aes128
      CryIfKey_Fbl_Rng_Fips186: CryIfKeyId=2, CryIfKeyRef=CryptoKey_Fbl_Fips186
      CryIfKey_Fbl_Signature_Ed25519: CryIfKeyId=4, CryIfKeyRef=CryptoKey_Fbl_Signature_Ed25519
      CryIfKey_Fbl_HashDummy: CryIfKeyId=1, CryIfKeyRef=CryptoKey_Fbl_HashDummy
      CryIfKey_Fbl_SecurityAccess_Ed25519: CryIfKeyId=3, CryIfKeyRef=CryptoKey_Fbl_SecurityAccess_Ed25519
      vHSM_Custom_HSM_Version: CryIfKeyId=52, CryIfKeyRef=CryptoKeys/vHSM_Custom_HSM_Version
  module config Crypto_30_LibCv: definition=Crypto, implementation-config-variant=VARIANT-PRE-COMPILE, module-description=Crypto_Impl
    CryptoPrimitives
      161 x CryptoPrimitive:
        vHsm_Signature_EcDsaEd25519Verify: CryptoPrimitiveAlgorithmMode=CRYPTO_ALGOMODE_NOT_SET, CryptoPrimitiveService=CRYPTO_SIGNATURE_VERIFY, CryptoPrimitiveAlgorithmFamily=CRYPTO_ALGOFAM_ED25519, CryptoPrimitiveAlgorithmSecondaryFamily=CRYPTO_ALGOFAM_SHA2_512
        vHsm_Signature_RsaPkcs1Sha1Verify: CryptoPrimitiveAlgorithmFamily=CRYPTO_ALGOFAM_RSA, CryptoPrimitiveService=CRYPTO_SIGNATURE_VERIFY, CryptoPrimitiveAlgorithmMode=CRYPTO_ALGOMODE_RSASSA_PKCS1_v1_5, CryptoPrimitiveAlgorithmSecondaryFamily=CRYPTO_ALGOFAM_SHA1
        vHsm_FirmwareUpdate_AesDecrypt: CryptoPrimitiveAlgorithmSecondaryFamily=CRYPTO_ALGOFAM_NOT_SET, CryptoPrimitiveAlgorithmMode=CRYPTO_ALGOMODE_CBC, CryptoPrimitiveService=CRYPTO_DECRYPT, CryptoPrimitiveAlgorithmFamily=CRYPTO_ALGOFAM_AES
        vHsm_FirmwareUpdate_AesEncrypt: CryptoPrimitiveAlgorithmSecondaryFamily=CRYPTO_ALGOFAM_NOT_SET, CryptoPrimitiveService=CRYPTO_ENCRYPT, CryptoPrimitiveAlgorithmFamily=CRYPTO_ALGOFAM_AES, CryptoPrimitiveAlgorithmMode=CRYPTO_ALGOMODE_CBC
        vHsm_FirmwareUpdate_AesCmacGenerate: CryptoPrimitiveAlgorithmSecondaryFamily=CRYPTO_ALGOFAM_NOT_SET, CryptoPrimitiveAlgorithmMode=CRYPTO_ALGOMODE_CMAC, CryptoPrimitiveService=CRYPTO_MAC_GENERATE, CryptoPrimitiveAlgorithmFamily=CRYPTO_ALGOFAM_AES
        AesGCMEncrypt: CryptoPrimitiveAlgorithmSecondaryFamily=CRYPTO_ALGOFAM_NOT_SET, CryptoPrimitiveAlgorithmMode=CRYPTO_ALGOMODE_GCM, CryptoPrimitiveService=CRYPTO_AEADENCRYPT, CryptoPrimitiveAlgorithmFamily=CRYPTO_ALGOFAM_AES
        AesGCMDecrypt: CryptoPrimitiveAlgorithmSecondaryFamily=CRYPTO_ALGOFAM_NOT_SET, CryptoPrimitiveAlgorithmMode=CRYPTO_ALGOMODE_GCM, CryptoPrimitiveService=CRYPTO_AEADDECRYPT, CryptoPrimitiveAlgorithmFamily=CRYPTO_ALGOFAM_AES
        AesEncrypt: CryptoPrimitiveAlgorithmSecondaryFamily=CRYPTO_ALGOFAM_NOT_SET, CryptoPrimitiveAlgorithmMode=CRYPTO_ALGOMODE_ECB, CryptoPrimitiveService=CRYPTO_ENCRYPT, CryptoPrimitiveAlgorithmFamily=CRYPTO_ALGOFAM_AES, CryptoPrimitiveAlgorithmMode=CRYPTO_ALGOMODE_CBC, CryptoPrimitiveAlgorithmSecondaryFamily=CRYPTO_ALGOFAM_CUSTOM_PADDING_PKCS7, CryptoPrimitiveAlgorithmSecondaryFamily=CRYPTO_ALGOFAM_PADDING_ONEWITHZEROS, CryptoPrimitiveAlgorithmMode=CRYPTO_ALGOMODE_CTR, CryptoPrimitiveAlgorithmSecondaryFamilyCustomRef=Crypto_30_LibCv_PaddingPKCS7
        AesDecrypt: CryptoPrimitiveAlgorithmSecondaryFamily=CRYPTO_ALGOFAM_NOT_SET, CryptoPrimitiveAlgorithmMode=CRYPTO_ALGOMODE_ECB, CryptoPrimitiveService=CRYPTO_DECRYPT, CryptoPrimitiveAlgorithmFamily=CRYPTO_ALGOFAM_AES, CryptoPrimitiveAlgorithmMode=CRYPTO_ALGOMODE_CBC, CryptoPrimitiveAlgorithmSecondaryFamily=CRYPTO_ALGOFAM_CUSTOM_PADDING_PKCS7, CryptoPrimitiveAlgorithmSecondaryFamily=CRYPTO_ALGOFAM_PADDING_ONEWITHZEROS, CryptoPrimitiveAlgorithmMode=CRYPTO_ALGOMODE_CTR, CryptoPrimitiveAlgorithmSecondaryFamilyCustomRef=Crypto_30_LibCv_PaddingPKCS7
        SHA1: CryptoPrimitiveAlgorithmSecondaryFamily=CRYPTO_ALGOFAM_NOT_SET, CryptoPrimitiveAlgorithmMode=CRYPTO_ALGOMODE_NOT_SET, CryptoPrimitiveService=CRYPTO_HASH, CryptoPrimitiveAlgorithmFamily=CRYPTO_ALGOFAM_SHA1
        SHA256: CryptoPrimitiveAlgorithmSecondaryFamily=CRYPTO_ALGOFAM_NOT_SET, CryptoPrimitiveAlgorithmMode=CRYPTO_ALGOMODE_NOT_SET, CryptoPrimitiveService=CRYPTO_HASH, CryptoPrimitiveAlgorithmFamily=CRYPTO_ALGOFAM_SHA2_256
        SHA512: CryptoPrimitiveAlgorithmSecondaryFamily=CRYPTO_ALGOFAM_NOT_SET, CryptoPrimitiveAlgorithmMode=CRYPTO_ALGOMODE_NOT_SET, CryptoPrimitiveService=CRYPTO_HASH, CryptoPrimitiveAlgorithmFamily=CRYPTO_ALGOFAM_SHA2_512
        AesCmacGenerate: CryptoPrimitiveAlgorithmSecondaryFamily=CRYPTO_ALGOFAM_NOT_SET, CryptoPrimitiveAlgorithmMode=CRYPTO_ALGOMODE_CMAC, CryptoPrimitiveService=CRYPTO_MAC_GENERATE, CryptoPrimitiveAlgorithmFamily=CRYPTO_ALGOFAM_AES
        AesCmacVerify: CryptoPrimitiveAlgorithmSecondaryFamily=CRYPTO_ALGOFAM_NOT_SET, CryptoPrimitiveAlgorithmMode=CRYPTO_ALGOMODE_CMAC, CryptoPrimitiveService=CRYPTO_MAC_VERIFY, CryptoPrimitiveAlgorithmFamily=CRYPTO_ALGOFAM_AES
        RngFips186: CryptoPrimitiveAlgorithmMode=CRYPTO_ALGOMODE_NOT_SET, CryptoPrimitiveService=CRYPTO_RANDOM, CryptoPrimitiveAlgorithmFamily=CRYPTO_ALGOFAM_RNG, CryptoPrimitiveAlgorithmSecondaryFamily=CRYPTO_ALGOFAM_NOT_SET
        EcDsaGenerate: CryptoPrimitiveAlgorithmSecondaryFamily=CRYPTO_ALGOFAM_NOT_SET, CryptoPrimitiveAlgorithmMode=CRYPTO_ALGOMODE_NOT_SET, CryptoPrimitiveService=CRYPTO_SIGNATURE_GENERATE, CryptoPrimitiveAlgorithmFamily=CRYPTO_ALGOFAM_ED25519, CryptoPrimitiveAlgorithmSecondaryFamily=CRYPTO_ALGOFAM_SHA2_512
        EcDsaVerify: CryptoPrimitiveAlgorithmSecondaryFamily=CRYPTO_ALGOFAM_NOT_SET, CryptoPrimitiveAlgorithmMode=CRYPTO_ALGOMODE_NOT_SET, CryptoPrimitiveService=CRYPTO_SIGNATURE_VERIFY, CryptoPrimitiveAlgorithmFamily=CRYPTO_ALGOFAM_ED25519, CryptoPrimitiveAlgorithmSecondaryFamily=CRYPTO_ALGOFAM_SHA2_512
        SipHashGenerate: CryptoPrimitiveService=CRYPTO_MAC_GENERATE, CryptoPrimitiveAlgorithmFamily=CRYPTO_ALGOFAM_SIPHASH, CryptoPrimitiveAlgorithmMode=CRYPTO_ALGOMODE_SIPHASH_2_4, CryptoPrimitiveAlgorithmSecondaryFamily=CRYPTO_ALGOFAM_NOT_SET
        SipHashVerify: CryptoPrimitiveService=CRYPTO_MAC_VERIFY, CryptoPrimitiveAlgorithmFamily=CRYPTO_ALGOFAM_SIPHASH, CryptoPrimitiveAlgorithmMode=CRYPTO_ALGOMODE_SIPHASH_2_4, CryptoPrimitiveAlgorithmSecondaryFamily=CRYPTO_ALGOFAM_NOT_SET
        RsaPkcs1Sha1Generate: CryptoPrimitiveAlgorithmFamily=CRYPTO_ALGOFAM_RSA, CryptoPrimitiveService=CRYPTO_SIGNATURE_GENERATE, CryptoPrimitiveAlgorithmMode=CRYPTO_ALGOMODE_RSASSA_PKCS1_v1_5, CryptoPrimitiveAlgorithmSecondaryFamily=CRYPTO_ALGOFAM_SHA1
        RsaPkcs1Sha1Verify: CryptoPrimitiveAlgorithmFamily=CRYPTO_ALGOFAM_RSA, CryptoPrimitiveService=CRYPTO_SIGNATURE_VERIFY, CryptoPrimitiveAlgorithmMode=CRYPTO_ALGOMODE_RSASSA_PKCS1_v1_5, CryptoPrimitiveAlgorithmSecondaryFamily=CRYPTO_ALGOFAM_SHA1
        RsaPkcs1Sha256Generate: CryptoPrimitiveAlgorithmFamily=CRYPTO_ALGOFAM_RSA, CryptoPrimitiveService=CRYPTO_SIGNATURE_GENERATE, CryptoPrimitiveAlgorithmMode=CRYPTO_ALGOMODE_RSASSA_PKCS1_v1_5, CryptoPrimitiveAlgorithmSecondaryFamily=CRYPTO_ALGOFAM_SHA2_256
        RsaPkcs1Sha256Verify: CryptoPrimitiveAlgorithmFamily=CRYPTO_ALGOFAM_RSA, CryptoPrimitiveService=CRYPTO_SIGNATURE_VERIFY, CryptoPrimitiveAlgorithmMode=CRYPTO_ALGOMODE_RSASSA_PKCS1_v1_5, CryptoPrimitiveAlgorithmSecondaryFamily=CRYPTO_ALGOFAM_SHA2_256
        RsaPssSha1Generate: CryptoPrimitiveAlgorithmFamily=CRYPTO_ALGOFAM_RSA, CryptoPrimitiveService=CRYPTO_SIGNATURE_GENERATE, CryptoPrimitiveAlgorithmMode=CRYPTO_ALGOMODE_RSASSA_PSS, CryptoPrimitiveAlgorithmSecondaryFamily=CRYPTO_ALGOFAM_SHA1
        RsaPssSha1Verify: CryptoPrimitiveAlgorithmFamily=CRYPTO_ALGOFAM_RSA, CryptoPrimitiveService=CRYPTO_SIGNATURE_VERIFY, CryptoPrimitiveAlgorithmMode=CRYPTO_ALGOMODE_RSASSA_PSS, CryptoPrimitiveAlgorithmSecondaryFamily=CRYPTO_ALGOFAM_SHA1
        RsaPssSha256Generate: CryptoPrimitiveAlgorithmFamily=CRYPTO_ALGOFAM_RSA, CryptoPrimitiveService=CRYPTO_SIGNATURE_GENERATE, CryptoPrimitiveAlgorithmMode=CRYPTO_ALGOMODE_RSASSA_PSS, CryptoPrimitiveAlgorithmSecondaryFamily=CRYPTO_ALGOFAM_SHA2_256
        RsaPssSha256Verify: CryptoPrimitiveAlgorithmFamily=CRYPTO_ALGOFAM_RSA, CryptoPrimitiveService=CRYPTO_SIGNATURE_VERIFY, CryptoPrimitiveAlgorithmMode=CRYPTO_ALGOMODE_RSASSA_PSS, CryptoPrimitiveAlgorithmSecondaryFamily=CRYPTO_ALGOFAM_SHA2_256
        RsaPkcs1Decrypt: CryptoPrimitiveAlgorithmFamily=CRYPTO_ALGOFAM_RSA, CryptoPrimitiveService=CRYPTO_DECRYPT, CryptoPrimitiveAlgorithmMode=CRYPTO_ALGOMODE_RSAES_PKCS1_v1_5, CryptoPrimitiveAlgorithmSecondaryFamily=CRYPTO_ALGOFAM_NOT_SET
        RsaPkcs1Encrypt: CryptoPrimitiveAlgorithmFamily=CRYPTO_ALGOFAM_RSA, CryptoPrimitiveService=CRYPTO_ENCRYPT, CryptoPrimitiveAlgorithmMode=CRYPTO_ALGOMODE_RSAES_PKCS1_v1_5, CryptoPrimitiveAlgorithmSecondaryFamily=CRYPTO_ALGOFAM_NOT_SET
        EccNistP256R1Generate: CryptoPrimitiveAlgorithmFamily=CRYPTO_ALGOFAM_ECCNIST, CryptoPrimitiveAlgorithmMode=CRYPTO_ALGOMODE_CUSTOM_P256R1, CryptoPrimitiveService=CRYPTO_SIGNATURE_GENERATE, CryptoPrimitiveAlgorithmSecondaryFamily=CRYPTO_ALGOFAM_SHA2_256, CryptoPrimitiveAlgorithmSecondaryFamily=CRYPTO_ALGOFAM_NOT_SET
        EccNistP256R1Verify: CryptoPrimitiveAlgorithmFamily=CRYPTO_ALGOFAM_ECCNIST, CryptoPrimitiveAlgorithmMode=CRYPTO_ALGOMODE_CUSTOM_P256R1, CryptoPrimitiveService=CRYPTO_SIGNATURE_VERIFY, CryptoPrimitiveAlgorithmSecondaryFamily=CRYPTO_ALGOFAM_SHA2_256, CryptoPrimitiveAlgorithmSecondaryFamily=CRYPTO_ALGOFAM_NOT_SET
        EccAnsiP256R1Generate: CryptoPrimitiveAlgorithmFamily=CRYPTO_ALGOFAM_CUSTOM_ECCANSI, CryptoPrimitiveAlgorithmMode=CRYPTO_ALGOMODE_CUSTOM_P256R1, CryptoPrimitiveService=CRYPTO_SIGNATURE_GENERATE, CryptoPrimitiveAlgorithmSecondaryFamily=CRYPTO_ALGOFAM_SHA2_256, CryptoPrimitiveAlgorithmSecondaryFamily=CRYPTO_ALGOFAM_NOT_SET
        EccSecP256R1Generate: CryptoPrimitiveAlgorithmFamily=CRYPTO_ALGOFAM_CUSTOM_ECCSEC, CryptoPrimitiveAlgorithmMode=CRYPTO_ALGOMODE_CUSTOM_P256R1, CryptoPrimitiveService=CRYPTO_SIGNATURE_GENERATE, CryptoPrimitiveAlgorithmSecondaryFamily=CRYPTO_ALGOFAM_SHA2_256, CryptoPrimitiveAlgorithmSecondaryFamily=CRYPTO_ALGOFAM_NOT_SET
        EccAnsiP256R1Verify: CryptoPrimitiveAlgorithmFamily=CRYPTO_ALGOFAM_CUSTOM_ECCANSI, CryptoPrimitiveAlgorithmMode=CRYPTO_ALGOMODE_CUSTOM_P256R1, CryptoPrimitiveService=CRYPTO_SIGNATURE_VERIFY, CryptoPrimitiveAlgorithmSecondaryFamily=CRYPTO_ALGOFAM_SHA2_256, CryptoPrimitiveAlgorithmSecondaryFamily=CRYPTO_ALGOFAM_NOT_SET
        EccSecP256R1Verify: CryptoPrimitiveAlgorithmFamily=CRYPTO_ALGOFAM_CUSTOM_ECCSEC, CryptoPrimitiveAlgorithmMode=CRYPTO_ALGOMODE_CUSTOM_P256R1, CryptoPrimitiveService=CRYPTO_SIGNATURE_VERIFY, CryptoPrimitiveAlgorithmSecondaryFamily=CRYPTO_ALGOFAM_SHA2_256, CryptoPrimitiveAlgorithmSecondaryFamily=CRYPTO_ALGOFAM_NOT_SET
        EcDsaEd25519Generate: CryptoPrimitiveAlgorithmSecondaryFamily=CRYPTO_ALGOFAM_NOT_SET, CryptoPrimitiveAlgorithmMode=CRYPTO_ALGOMODE_NOT_SET, CryptoPrimitiveService=CRYPTO_SIGNATURE_GENERATE, CryptoPrimitiveAlgorithmFamily=CRYPTO_ALGOFAM_ED25519, CryptoPrimitiveAlgorithmSecondaryFamily=CRYPTO_ALGOFAM_SHA2_512
        EcDsaEd25519Verify: CryptoPrimitiveAlgorithmSecondaryFamily=CRYPTO_ALGOFAM_NOT_SET, CryptoPrimitiveAlgorithmMode=CRYPTO_ALGOMODE_NOT_SET, CryptoPrimitiveService=CRYPTO_SIGNATURE_VERIFY, CryptoPrimitiveAlgorithmFamily=CRYPTO_ALGOFAM_ED25519, CryptoPrimitiveAlgorithmSecondaryFamily=CRYPTO_ALGOFAM_SHA2_512
        HmacSha1Generate: CryptoPrimitiveAlgorithmFamily=CRYPTO_ALGOFAM_SHA1, CryptoPrimitiveAlgorithmMode=CRYPTO_ALGOMODE_HMAC, CryptoPrimitiveAlgorithmSecondaryFamily=CRYPTO_ALGOFAM_NOT_SET, CryptoPrimitiveService=CRYPTO_MAC_GENERATE
        HmacSha1Verify: CryptoPrimitiveAlgorithmFamily=CRYPTO_ALGOFAM_SHA1, CryptoPrimitiveAlgorithmMode=CRYPTO_ALGOMODE_HMAC, CryptoPrimitiveAlgorithmSecondaryFamily=CRYPTO_ALGOFAM_NOT_SET, CryptoPrimitiveService=CRYPTO_MAC_VERIFY
        HmacSha256Generate: CryptoPrimitiveAlgorithmFamily=CRYPTO_ALGOFAM_SHA2_256, CryptoPrimitiveAlgorithmMode=CRYPTO_ALGOMODE_HMAC, CryptoPrimitiveAlgorithmSecondaryFamily=CRYPTO_ALGOFAM_NOT_SET, CryptoPrimitiveService=CRYPTO_MAC_GENERATE
        HmacSha256Verify: CryptoPrimitiveAlgorithmFamily=CRYPTO_ALGOFAM_SHA2_256, CryptoPrimitiveAlgorithmMode=CRYPTO_ALGOMODE_HMAC, CryptoPrimitiveAlgorithmSecondaryFamily=CRYPTO_ALGOFAM_NOT_SET, CryptoPrimitiveService=CRYPTO_MAC_VERIFY
        RngFips186Sha1: CryptoPrimitiveAlgorithmMode=CRYPTO_ALGOMODE_NOT_SET, CryptoPrimitiveService=CRYPTO_RANDOM, CryptoPrimitiveAlgorithmFamily=CRYPTO_ALGOFAM_CUSTOM_FIPS186, CryptoPrimitiveAlgorithmSecondaryFamily=CRYPTO_ALGOFAM_SHA1, CryptoPrimitiveAlgorithmFamilyCustomRef=Crypto_30_LibCv_FIPS186
        EccNistP256R1GenerateWithoutPreHashing: CryptoPrimitiveAlgorithmFamily=CRYPTO_ALGOFAM_ECCNIST, CryptoPrimitiveAlgorithmMode=CRYPTO_ALGOMODE_CUSTOM_P256R1, CryptoPrimitiveService=CRYPTO_SIGNATURE_GENERATE, CryptoPrimitiveAlgorithmSecondaryFamily=CRYPTO_ALGOFAM_NOT_SET, CryptoPrimitiveAlgorithmModeCustomRef=Crypto_30_LibCv_P256r1
        EccNistP256R1VerifyWithoutPreHashing: CryptoPrimitiveAlgorithmFamily=CRYPTO_ALGOFAM_ECCNIST, CryptoPrimitiveAlgorithmMode=CRYPTO_ALGOMODE_CUSTOM_P256R1, CryptoPrimitiveService=CRYPTO_SIGNATURE_VERIFY, CryptoPrimitiveAlgorithmSecondaryFamily=CRYPTO_ALGOFAM_NOT_SET, CryptoPrimitiveAlgorithmModeCustomRef=Crypto_30_LibCv_P256r1
        EccAnsiP256R1GenerateWithoutPreHashing: CryptoPrimitiveAlgorithmFamily=CRYPTO_ALGOFAM_CUSTOM_ECCANSI, CryptoPrimitiveAlgorithmMode=CRYPTO_ALGOMODE_CUSTOM_P256R1, CryptoPrimitiveService=CRYPTO_SIGNATURE_GENERATE, CryptoPrimitiveAlgorithmSecondaryFamily=CRYPTO_ALGOFAM_NOT_SET, CryptoPrimitiveAlgorithmFamilyCustomRef=Crypto_30_LibCv_ECCANSI, CryptoPrimitiveAlgorithmModeCustomRef=Crypto_30_LibCv_P256r1
        EccSecP256R1GenerateWithoutPreHashing: CryptoPrimitiveAlgorithmFamily=CRYPTO_ALGOFAM_CUSTOM_ECCSEC, CryptoPrimitiveAlgorithmMode=CRYPTO_ALGOMODE_CUSTOM_P256R1, CryptoPrimitiveService=CRYPTO_SIGNATURE_GENERATE, CryptoPrimitiveAlgorithmSecondaryFamily=CRYPTO_ALGOFAM_NOT_SET, CryptoPrimitiveAlgorithmFamilyCustomRef=Crypto_30_LibCv_ECCSEC, CryptoPrimitiveAlgorithmModeCustomRef=Crypto_30_LibCv_P256r1
        EccAnsiP256R1VerifyWithoutPreHashing: CryptoPrimitiveAlgorithmFamily=CRYPTO_ALGOFAM_CUSTOM_ECCANSI, CryptoPrimitiveAlgorithmMode=CRYPTO_ALGOMODE_CUSTOM_P256R1, CryptoPrimitiveService=CRYPTO_SIGNATURE_VERIFY, CryptoPrimitiveAlgorithmSecondaryFamily=CRYPTO_ALGOFAM_NOT_SET, CryptoPrimitiveAlgorithmFamilyCustomRef=Crypto_30_LibCv_ECCANSI, CryptoPrimitiveAlgorithmModeCustomRef=Crypto_30_LibCv_P256r1
        EccSecP256R1VerifyWithoutPreHashing: CryptoPrimitiveAlgorithmFamily=CRYPTO_ALGOFAM_CUSTOM_ECCSEC, CryptoPrimitiveAlgorithmMode=CRYPTO_ALGOMODE_CUSTOM_P256R1, CryptoPrimitiveService=CRYPTO_SIGNATURE_VERIFY, CryptoPrimitiveAlgorithmSecondaryFamily=CRYPTO_ALGOFAM_NOT_SET, CryptoPrimitiveAlgorithmFamilyCustomRef=Crypto_30_LibCv_ECCSEC, CryptoPrimitiveAlgorithmModeCustomRef=Crypto_30_LibCv_P256r1
        EccNistP256R1GenerateSha1: CryptoPrimitiveAlgorithmFamily=CRYPTO_ALGOFAM_ECCNIST, CryptoPrimitiveAlgorithmMode=CRYPTO_ALGOMODE_CUSTOM_P256R1, CryptoPrimitiveService=CRYPTO_SIGNATURE_GENERATE, CryptoPrimitiveAlgorithmSecondaryFamily=CRYPTO_ALGOFAM_SHA1, CryptoPrimitiveAlgorithmModeCustomRef=Crypto_30_LibCv_P256r1
        EccNistP256R1GenerateSha256: CryptoPrimitiveAlgorithmFamily=CRYPTO_ALGOFAM_ECCNIST, CryptoPrimitiveAlgorithmMode=CRYPTO_ALGOMODE_CUSTOM_P256R1, CryptoPrimitiveService=CRYPTO_SIGNATURE_GENERATE, CryptoPrimitiveAlgorithmSecondaryFamily=CRYPTO_ALGOFAM_SHA2_256, CryptoPrimitiveAlgorithmModeCustomRef=Crypto_30_LibCv_P256r1
        EccNistP256R1VerifySha1: CryptoPrimitiveAlgorithmFamily=CRYPTO_ALGOFAM_ECCNIST, CryptoPrimitiveAlgorithmMode=CRYPTO_ALGOMODE_CUSTOM_P256R1, CryptoPrimitiveService=CRYPTO_SIGNATURE_VERIFY, CryptoPrimitiveAlgorithmSecondaryFamily=CRYPTO_ALGOFAM_SHA1, CryptoPrimitiveAlgorithmModeCustomRef=Crypto_30_LibCv_P256r1
        EccNistP256R1VerifySha256: CryptoPrimitiveAlgorithmFamily=CRYPTO_ALGOFAM_ECCNIST, CryptoPrimitiveAlgorithmMode=CRYPTO_ALGOMODE_CUSTOM_P256R1, CryptoPrimitiveService=CRYPTO_SIGNATURE_VERIFY, CryptoPrimitiveAlgorithmSecondaryFamily=CRYPTO_ALGOFAM_SHA2_256, CryptoPrimitiveAlgorithmModeCustomRef=Crypto_30_LibCv_P256r1
        EccAnsiP256R1GenerateSha1: CryptoPrimitiveAlgorithmFamily=CRYPTO_ALGOFAM_CUSTOM_ECCANSI, CryptoPrimitiveAlgorithmMode=CRYPTO_ALGOMODE_CUSTOM_P256R1, CryptoPrimitiveService=CRYPTO_SIGNATURE_GENERATE, CryptoPrimitiveAlgorithmSecondaryFamily=CRYPTO_ALGOFAM_SHA1, CryptoPrimitiveAlgorithmFamilyCustomRef=Crypto_30_LibCv_ECCANSI, CryptoPrimitiveAlgorithmModeCustomRef=Crypto_30_LibCv_P256r1
        EccAnsiP256R1GenerateSha256: CryptoPrimitiveAlgorithmFamily=CRYPTO_ALGOFAM_CUSTOM_ECCANSI, CryptoPrimitiveAlgorithmMode=CRYPTO_ALGOMODE_CUSTOM_P256R1, CryptoPrimitiveService=CRYPTO_SIGNATURE_GENERATE, CryptoPrimitiveAlgorithmSecondaryFamily=CRYPTO_ALGOFAM_SHA2_256, CryptoPrimitiveAlgorithmFamilyCustomRef=Crypto_30_LibCv_ECCANSI, CryptoPrimitiveAlgorithmModeCustomRef=Crypto_30_LibCv_P256r1
        EccAnsiP256R1VerifySha1: CryptoPrimitiveAlgorithmFamily=CRYPTO_ALGOFAM_CUSTOM_ECCANSI, CryptoPrimitiveAlgorithmMode=CRYPTO_ALGOMODE_CUSTOM_P256R1, CryptoPrimitiveService=CRYPTO_SIGNATURE_VERIFY, CryptoPrimitiveAlgorithmSecondaryFamily=CRYPTO_ALGOFAM_SHA1, CryptoPrimitiveAlgorithmFamilyCustomRef=Crypto_30_LibCv_ECCANSI, CryptoPrimitiveAlgorithmModeCustomRef=Crypto_30_LibCv_P256r1
        EccAnsiP256R1VerifySha256: CryptoPrimitiveAlgorithmFamily=CRYPTO_ALGOFAM_CUSTOM_ECCANSI, CryptoPrimitiveAlgorithmMode=CRYPTO_ALGOMODE_CUSTOM_P256R1, CryptoPrimitiveService=CRYPTO_SIGNATURE_VERIFY, CryptoPrimitiveAlgorithmSecondaryFamily=CRYPTO_ALGOFAM_SHA2_256, CryptoPrimitiveAlgorithmFamilyCustomRef=Crypto_30_LibCv_ECCANSI, CryptoPrimitiveAlgorithmModeCustomRef=Crypto_30_LibCv_P256r1
        EccSecP256R1GenerateSha1: CryptoPrimitiveAlgorithmFamily=CRYPTO_ALGOFAM_CUSTOM_ECCSEC, CryptoPrimitiveAlgorithmMode=CRYPTO_ALGOMODE_CUSTOM_P256R1, CryptoPrimitiveService=CRYPTO_SIGNATURE_GENERATE, CryptoPrimitiveAlgorithmSecondaryFamily=CRYPTO_ALGOFAM_SHA1, CryptoPrimitiveAlgorithmFamilyCustomRef=Crypto_30_LibCv_ECCSEC, CryptoPrimitiveAlgorithmModeCustomRef=Crypto_30_LibCv_P256r1
        EccSecP256R1GenerateSha256: CryptoPrimitiveAlgorithmFamily=CRYPTO_ALGOFAM_CUSTOM_ECCSEC, CryptoPrimitiveAlgorithmMode=CRYPTO_ALGOMODE_CUSTOM_P256R1, CryptoPrimitiveService=CRYPTO_SIGNATURE_GENERATE, CryptoPrimitiveAlgorithmSecondaryFamily=CRYPTO_ALGOFAM_SHA2_256, CryptoPrimitiveAlgorithmFamilyCustomRef=Crypto_30_LibCv_ECCSEC, CryptoPrimitiveAlgorithmModeCustomRef=Crypto_30_LibCv_P256r1
        EccSecP256R1VerifySha1: CryptoPrimitiveAlgorithmFamily=CRYPTO_ALGOFAM_CUSTOM_ECCSEC, CryptoPrimitiveAlgorithmMode=CRYPTO_ALGOMODE_CUSTOM_P256R1, CryptoPrimitiveService=CRYPTO_SIGNATURE_VERIFY, CryptoPrimitiveAlgorithmSecondaryFamily=CRYPTO_ALGOFAM_SHA1, CryptoPrimitiveAlgorithmFamilyCustomRef=Crypto_30_LibCv_ECCSEC, CryptoPrimitiveAlgorithmModeCustomRef=Crypto_30_LibCv_P256r1
        EccSecP256R1VerifySha256: CryptoPrimitiveAlgorithmFamily=CRYPTO_ALGOFAM_CUSTOM_ECCSEC, CryptoPrimitiveAlgorithmMode=CRYPTO_ALGOMODE_CUSTOM_P256R1, CryptoPrimitiveService=CRYPTO_SIGNATURE_VERIFY, CryptoPrimitiveAlgorithmSecondaryFamily=CRYPTO_ALGOFAM_SHA2_256, CryptoPrimitiveAlgorithmFamilyCustomRef=Crypto_30_LibCv_ECCSEC, CryptoPrimitiveAlgorithmModeCustomRef=Crypto_30_LibCv_P256r1
        RngDrbgAes128: CryptoPrimitiveAlgorithmMode=CRYPTO_ALGOMODE_NOT_SET, CryptoPrimitiveService=CRYPTO_RANDOM, CryptoPrimitiveAlgorithmFamily=CRYPTO_ALGOFAM_CUSTOM_DRBG, CryptoPrimitiveAlgorithmSecondaryFamily=CRYPTO_ALGOFAM_AES, CryptoPrimitiveAlgorithmFamilyCustomRef=Crypto_30_LibCv_DRBG
        RsaPkcs1CrtSha1Generate: CryptoPrimitiveAlgorithmFamily=CRYPTO_ALGOFAM_RSA, CryptoPrimitiveService=CRYPTO_SIGNATURE_GENERATE, CryptoPrimitiveAlgorithmMode=CRYPTO_ALGOMODE_CUSTOM_RSASSA_PKCS1_v1_5_CRT, CryptoPrimitiveAlgorithmSecondaryFamily=CRYPTO_ALGOFAM_SHA1, CryptoPrimitiveAlgorithmModeCustomRef=Crypto_30_LibCv_RSASSA_PKCS1_v1_5_CRT
        RsaPkcs1CrtSha256Generate: CryptoPrimitiveAlgorithmFamily=CRYPTO_ALGOFAM_RSA, CryptoPrimitiveService=CRYPTO_SIGNATURE_GENERATE, CryptoPrimitiveAlgorithmMode=CRYPTO_ALGOMODE_CUSTOM_RSASSA_PKCS1_v1_5_CRT, CryptoPrimitiveAlgorithmSecondaryFamily=CRYPTO_ALGOFAM_SHA2_256, CryptoPrimitiveAlgorithmModeCustomRef=Crypto_30_LibCv_RSASSA_PKCS1_v1_5_CRT
        RngDrbgAes128Df: CryptoPrimitiveAlgorithmMode=CRYPTO_ALGOMODE_CUSTOM_USE_DF, CryptoPrimitiveService=CRYPTO_RANDOM, CryptoPrimitiveAlgorithmFamily=CRYPTO_ALGOFAM_CUSTOM_DRBG, CryptoPrimitiveAlgorithmSecondaryFamily=CRYPTO_ALGOFAM_AES, CryptoPrimitiveAlgorithmFamilyCustomRef=Crypto_30_LibCv_DRBG, CryptoPrimitiveAlgorithmModeCustomRef=Crypto_30_LibCv_UseDF
        EccNistP384R1GenerateWithoutPreHashing: CryptoPrimitiveAlgorithmFamily=CRYPTO_ALGOFAM_ECCNIST, CryptoPrimitiveAlgorithmMode=CRYPTO_ALGOMODE_CUSTOM_P384R1, CryptoPrimitiveService=CRYPTO_SIGNATURE_GENERATE, CryptoPrimitiveAlgorithmSecondaryFamily=CRYPTO_ALGOFAM_NOT_SET, CryptoPrimitiveAlgorithmModeCustomRef=Crypto_30_LibCv_P384r1
        EccNistP384R1VerifyWithoutPreHashing: CryptoPrimitiveAlgorithmFamily=CRYPTO_ALGOFAM_ECCNIST, CryptoPrimitiveAlgorithmMode=CRYPTO_ALGOMODE_CUSTOM_P384R1, CryptoPrimitiveService=CRYPTO_SIGNATURE_VERIFY, CryptoPrimitiveAlgorithmSecondaryFamily=CRYPTO_ALGOFAM_NOT_SET, CryptoPrimitiveAlgorithmModeCustomRef=Crypto_30_LibCv_P384r1
        EccSecP384R1GenerateWithoutPreHashing: CryptoPrimitiveAlgorithmFamily=CRYPTO_ALGOFAM_CUSTOM_ECCSEC, CryptoPrimitiveAlgorithmMode=CRYPTO_ALGOMODE_CUSTOM_P384R1, CryptoPrimitiveService=CRYPTO_SIGNATURE_GENERATE, CryptoPrimitiveAlgorithmSecondaryFamily=CRYPTO_ALGOFAM_NOT_SET, CryptoPrimitiveAlgorithmModeCustomRef=Crypto_30_LibCv_P384r1, CryptoPrimitiveAlgorithmFamilyCustomRef=Crypto_30_LibCv_ECCSEC
        EccSecP384R1VerifyWithoutPreHashing: CryptoPrimitiveAlgorithmFamily=CRYPTO_ALGOFAM_CUSTOM_ECCSEC, CryptoPrimitiveAlgorithmMode=CRYPTO_ALGOMODE_CUSTOM_P384R1, CryptoPrimitiveService=CRYPTO_SIGNATURE_VERIFY, CryptoPrimitiveAlgorithmSecondaryFamily=CRYPTO_ALGOFAM_NOT_SET, CryptoPrimitiveAlgorithmModeCustomRef=Crypto_30_LibCv_P384r1, CryptoPrimitiveAlgorithmFamilyCustomRef=Crypto_30_LibCv_ECCSEC
        EccNistP384R1GenerateSha1: CryptoPrimitiveAlgorithmFamily=CRYPTO_ALGOFAM_ECCNIST, CryptoPrimitiveAlgorithmMode=CRYPTO_ALGOMODE_CUSTOM_P384R1, CryptoPrimitiveService=CRYPTO_SIGNATURE_GENERATE, CryptoPrimitiveAlgorithmSecondaryFamily=CRYPTO_ALGOFAM_SHA1, CryptoPrimitiveAlgorithmModeCustomRef=Crypto_30_LibCv_P384r1
        EccNistP384R1GenerateSha256: CryptoPrimitiveAlgorithmFamily=CRYPTO_ALGOFAM_ECCNIST, CryptoPrimitiveAlgorithmMode=CRYPTO_ALGOMODE_CUSTOM_P384R1, CryptoPrimitiveService=CRYPTO_SIGNATURE_GENERATE, CryptoPrimitiveAlgorithmSecondaryFamily=CRYPTO_ALGOFAM_SHA2_256, CryptoPrimitiveAlgorithmModeCustomRef=Crypto_30_LibCv_P384r1
        EccNistP384R1VerifySha1: CryptoPrimitiveAlgorithmFamily=CRYPTO_ALGOFAM_ECCNIST, CryptoPrimitiveAlgorithmMode=CRYPTO_ALGOMODE_CUSTOM_P384R1, CryptoPrimitiveService=CRYPTO_SIGNATURE_VERIFY, CryptoPrimitiveAlgorithmSecondaryFamily=CRYPTO_ALGOFAM_SHA1, CryptoPrimitiveAlgorithmModeCustomRef=Crypto_30_LibCv_P384r1
        EccNistP384R1VerifySha256: CryptoPrimitiveAlgorithmFamily=CRYPTO_ALGOFAM_ECCNIST, CryptoPrimitiveAlgorithmMode=CRYPTO_ALGOMODE_CUSTOM_P384R1, CryptoPrimitiveService=CRYPTO_SIGNATURE_VERIFY, CryptoPrimitiveAlgorithmSecondaryFamily=CRYPTO_ALGOFAM_SHA2_256, CryptoPrimitiveAlgorithmModeCustomRef=Crypto_30_LibCv_P384r1
        EccSecP384R1GenerateSha1: CryptoPrimitiveAlgorithmFamily=CRYPTO_ALGOFAM_CUSTOM_ECCSEC, CryptoPrimitiveAlgorithmMode=CRYPTO_ALGOMODE_CUSTOM_P384R1, CryptoPrimitiveService=CRYPTO_SIGNATURE_GENERATE, CryptoPrimitiveAlgorithmSecondaryFamily=CRYPTO_ALGOFAM_SHA1, CryptoPrimitiveAlgorithmFamilyCustomRef=Crypto_30_LibCv_ECCSEC, CryptoPrimitiveAlgorithmModeCustomRef=Crypto_30_LibCv_P384r1
        EccSecP384R1GenerateSha256: CryptoPrimitiveAlgorithmFamily=CRYPTO_ALGOFAM_CUSTOM_ECCSEC, CryptoPrimitiveAlgorithmMode=CRYPTO_ALGOMODE_CUSTOM_P384R1, CryptoPrimitiveService=CRYPTO_SIGNATURE_GENERATE, CryptoPrimitiveAlgorithmSecondaryFamily=CRYPTO_ALGOFAM_SHA2_256, CryptoPrimitiveAlgorithmFamilyCustomRef=Crypto_30_LibCv_ECCSEC, CryptoPrimitiveAlgorithmModeCustomRef=Crypto_30_LibCv_P384r1
        EccSecP384R1VerifySha1: CryptoPrimitiveAlgorithmFamily=CRYPTO_ALGOFAM_CUSTOM_ECCSEC, CryptoPrimitiveAlgorithmMode=CRYPTO_ALGOMODE_CUSTOM_P384R1, CryptoPrimitiveService=CRYPTO_SIGNATURE_VERIFY, CryptoPrimitiveAlgorithmSecondaryFamily=CRYPTO_ALGOFAM_SHA1, CryptoPrimitiveAlgorithmFamilyCustomRef=Crypto_30_LibCv_ECCSEC, CryptoPrimitiveAlgorithmModeCustomRef=Crypto_30_LibCv_P384r1
        EccSecP384R1VerifySha256: CryptoPrimitiveAlgorithmFamily=CRYPTO_ALGOFAM_CUSTOM_ECCSEC, CryptoPrimitiveAlgorithmMode=CRYPTO_ALGOMODE_CUSTOM_P384R1, CryptoPrimitiveService=CRYPTO_SIGNATURE_VERIFY, CryptoPrimitiveAlgorithmSecondaryFamily=CRYPTO_ALGOFAM_SHA2_256, CryptoPrimitiveAlgorithmFamilyCustomRef=Crypto_30_LibCv_ECCSEC, CryptoPrimitiveAlgorithmModeCustomRef=Crypto_30_LibCv_P384r1
        RsaOaepSha1Encrypt: CryptoPrimitiveAlgorithmFamily=CRYPTO_ALGOFAM_RSA, CryptoPrimitiveAlgorithmMode=CRYPTO_ALGOMODE_RSAES_OAEP, CryptoPrimitiveAlgorithmSecondaryFamily=CRYPTO_ALGOFAM_SHA1, CryptoPrimitiveService=CRYPTO_ENCRYPT
        RsaOaepSha1Decrypt: CryptoPrimitiveAlgorithmFamily=CRYPTO_ALGOFAM_RSA, CryptoPrimitiveAlgorithmMode=CRYPTO_ALGOMODE_RSAES_OAEP, CryptoPrimitiveAlgorithmSecondaryFamily=CRYPTO_ALGOFAM_SHA1, CryptoPrimitiveService=CRYPTO_DECRYPT
        RsaOaepSha256Encrypt: CryptoPrimitiveAlgorithmFamily=CRYPTO_ALGOFAM_RSA, CryptoPrimitiveAlgorithmMode=CRYPTO_ALGOMODE_RSAES_OAEP, CryptoPrimitiveAlgorithmSecondaryFamily=CRYPTO_ALGOFAM_SHA2_256, CryptoPrimitiveService=CRYPTO_ENCRYPT
        RsaOaepSha256Decrypt: CryptoPrimitiveAlgorithmFamily=CRYPTO_ALGOFAM_RSA, CryptoPrimitiveAlgorithmMode=CRYPTO_ALGOMODE_RSAES_OAEP, CryptoPrimitiveAlgorithmSecondaryFamily=CRYPTO_ALGOFAM_SHA2_256, CryptoPrimitiveService=CRYPTO_DECRYPT
        RsaOaepCrtSha1Decrypt: CryptoPrimitiveAlgorithmFamily=CRYPTO_ALGOFAM_RSA, CryptoPrimitiveAlgorithmMode=CRYPTO_ALGOMODE_CUSTOM_RSAES_OAEP_CRT, CryptoPrimitiveAlgorithmSecondaryFamily=CRYPTO_ALGOFAM_SHA1, CryptoPrimitiveService=CRYPTO_DECRYPT, CryptoPrimitiveAlgorithmModeCustomRef=Crypto_30_LibCv_RSAES_OAEP_CRT
        RsaOaepCrtSha256Decrypt: CryptoPrimitiveAlgorithmFamily=CRYPTO_ALGOFAM_RSA, CryptoPrimitiveAlgorithmMode=CRYPTO_ALGOMODE_CUSTOM_RSAES_OAEP_CRT, CryptoPrimitiveAlgorithmSecondaryFamily=CRYPTO_ALGOFAM_SHA2_256, CryptoPrimitiveService=CRYPTO_DECRYPT, CryptoPrimitiveAlgorithmModeCustomRef=Crypto_30_LibCv_RSAES_OAEP_CRT
        EccNistP256R1GenerateSha512: CryptoPrimitiveAlgorithmFamily=CRYPTO_ALGOFAM_ECCNIST, CryptoPrimitiveAlgorithmMode=CRYPTO_ALGOMODE_CUSTOM_P256R1, CryptoPrimitiveService=CRYPTO_SIGNATURE_GENERATE, CryptoPrimitiveAlgorithmSecondaryFamily=CRYPTO_ALGOFAM_SHA2_512, CryptoPrimitiveAlgorithmModeCustomRef=Crypto_30_LibCv_P256r1
        EccNistP256R1VerifySha512: CryptoPrimitiveAlgorithmFamily=CRYPTO_ALGOFAM_ECCNIST, CryptoPrimitiveAlgorithmMode=CRYPTO_ALGOMODE_CUSTOM_P256R1, CryptoPrimitiveService=CRYPTO_SIGNATURE_VERIFY, CryptoPrimitiveAlgorithmSecondaryFamily=CRYPTO_ALGOFAM_SHA2_512, CryptoPrimitiveAlgorithmModeCustomRef=Crypto_30_LibCv_P256r1
        EccAnsiP256R1GenerateSha512: CryptoPrimitiveAlgorithmFamily=CRYPTO_ALGOFAM_CUSTOM_ECCANSI, CryptoPrimitiveAlgorithmMode=CRYPTO_ALGOMODE_CUSTOM_P256R1, CryptoPrimitiveService=CRYPTO_SIGNATURE_GENERATE, CryptoPrimitiveAlgorithmSecondaryFamily=CRYPTO_ALGOFAM_SHA2_512, CryptoPrimitiveAlgorithmFamilyCustomRef=Crypto_30_LibCv_ECCANSI, CryptoPrimitiveAlgorithmModeCustomRef=Crypto_30_LibCv_P256r1
        EccAnsiP256R1VerifySha512: CryptoPrimitiveAlgorithmFamily=CRYPTO_ALGOFAM_CUSTOM_ECCANSI, CryptoPrimitiveAlgorithmMode=CRYPTO_ALGOMODE_CUSTOM_P256R1, CryptoPrimitiveService=CRYPTO_SIGNATURE_VERIFY, CryptoPrimitiveAlgorithmSecondaryFamily=CRYPTO_ALGOFAM_SHA2_512, CryptoPrimitiveAlgorithmFamilyCustomRef=Crypto_30_LibCv_ECCANSI, CryptoPrimitiveAlgorithmModeCustomRef=Crypto_30_LibCv_P256r1
        EccSecP256R1GenerateSha512: CryptoPrimitiveAlgorithmFamily=CRYPTO_ALGOFAM_CUSTOM_ECCSEC, CryptoPrimitiveAlgorithmMode=CRYPTO_ALGOMODE_CUSTOM_P256R1, CryptoPrimitiveService=CRYPTO_SIGNATURE_GENERATE, CryptoPrimitiveAlgorithmSecondaryFamily=CRYPTO_ALGOFAM_SHA2_512, CryptoPrimitiveAlgorithmFamilyCustomRef=Crypto_30_LibCv_ECCSEC, CryptoPrimitiveAlgorithmModeCustomRef=Crypto_30_LibCv_P256r1
        EccSecP256R1VerifySha512: CryptoPrimitiveAlgorithmFamily=CRYPTO_ALGOFAM_CUSTOM_ECCSEC, CryptoPrimitiveAlgorithmMode=CRYPTO_ALGOMODE_CUSTOM_P256R1, CryptoPrimitiveService=CRYPTO_SIGNATURE_VERIFY, CryptoPrimitiveAlgorithmSecondaryFamily=CRYPTO_ALGOFAM_SHA2_512, CryptoPrimitiveAlgorithmFamilyCustomRef=Crypto_30_LibCv_ECCSEC, CryptoPrimitiveAlgorithmModeCustomRef=Crypto_30_LibCv_P256r1
        EccNistP384R1GenerateSha512: CryptoPrimitiveAlgorithmFamily=CRYPTO_ALGOFAM_ECCNIST, CryptoPrimitiveAlgorithmMode=CRYPTO_ALGOMODE_CUSTOM_P384R1, CryptoPrimitiveService=CRYPTO_SIGNATURE_GENERATE, CryptoPrimitiveAlgorithmSecondaryFamily=CRYPTO_ALGOFAM_SHA2_512, CryptoPrimitiveAlgorithmModeCustomRef=Crypto_30_LibCv_P384r1
        EccNistP384R1VerifySha512: CryptoPrimitiveAlgorithmFamily=CRYPTO_ALGOFAM_ECCNIST, CryptoPrimitiveAlgorithmMode=CRYPTO_ALGOMODE_CUSTOM_P384R1, CryptoPrimitiveService=CRYPTO_SIGNATURE_VERIFY, CryptoPrimitiveAlgorithmSecondaryFamily=CRYPTO_ALGOFAM_SHA2_512, CryptoPrimitiveAlgorithmModeCustomRef=Crypto_30_LibCv_P384r1
        EccSecP384R1GenerateSha512: CryptoPrimitiveAlgorithmFamily=CRYPTO_ALGOFAM_CUSTOM_ECCSEC, CryptoPrimitiveAlgorithmMode=CRYPTO_ALGOMODE_CUSTOM_P384R1, CryptoPrimitiveService=CRYPTO_SIGNATURE_GENERATE, CryptoPrimitiveAlgorithmSecondaryFamily=CRYPTO_ALGOFAM_SHA2_512, CryptoPrimitiveAlgorithmFamilyCustomRef=Crypto_30_LibCv_ECCSEC, CryptoPrimitiveAlgorithmModeCustomRef=Crypto_30_LibCv_P384r1
        EccSecP384R1VerifySha512: CryptoPrimitiveAlgorithmFamily=CRYPTO_ALGOFAM_CUSTOM_ECCSEC, CryptoPrimitiveAlgorithmMode=CRYPTO_ALGOMODE_CUSTOM_P384R1, CryptoPrimitiveService=CRYPTO_SIGNATURE_VERIFY, CryptoPrimitiveAlgorithmSecondaryFamily=CRYPTO_ALGOFAM_SHA2_512, CryptoPrimitiveAlgorithmFamilyCustomRef=Crypto_30_LibCv_ECCSEC, CryptoPrimitiveAlgorithmModeCustomRef=Crypto_30_LibCv_P384r1
        SHA384: CryptoPrimitiveAlgorithmSecondaryFamily=CRYPTO_ALGOFAM_NOT_SET, CryptoPrimitiveAlgorithmMode=CRYPTO_ALGOMODE_NOT_SET, CryptoPrimitiveService=CRYPTO_HASH, CryptoPrimitiveAlgorithmFamily=CRYPTO_ALGOFAM_SHA2_384
        EccNistP256R1GenerateSha384: CryptoPrimitiveAlgorithmFamily=CRYPTO_ALGOFAM_ECCNIST, CryptoPrimitiveAlgorithmMode=CRYPTO_ALGOMODE_CUSTOM_P256R1, CryptoPrimitiveService=CRYPTO_SIGNATURE_GENERATE, CryptoPrimitiveAlgorithmSecondaryFamily=CRYPTO_ALGOFAM_SHA2_384, CryptoPrimitiveAlgorithmModeCustomRef=Crypto_30_LibCv_P256r1
        EccNistP256R1VerifySha384: CryptoPrimitiveAlgorithmFamily=CRYPTO_ALGOFAM_ECCNIST, CryptoPrimitiveAlgorithmMode=CRYPTO_ALGOMODE_CUSTOM_P256R1, CryptoPrimitiveService=CRYPTO_SIGNATURE_VERIFY, CryptoPrimitiveAlgorithmSecondaryFamily=CRYPTO_ALGOFAM_SHA2_384, CryptoPrimitiveAlgorithmModeCustomRef=Crypto_30_LibCv_P256r1
        EccAnsiP256R1GenerateSha384: CryptoPrimitiveAlgorithmFamily=CRYPTO_ALGOFAM_CUSTOM_ECCANSI, CryptoPrimitiveAlgorithmMode=CRYPTO_ALGOMODE_CUSTOM_P256R1, CryptoPrimitiveService=CRYPTO_SIGNATURE_GENERATE, CryptoPrimitiveAlgorithmSecondaryFamily=CRYPTO_ALGOFAM_SHA2_384, CryptoPrimitiveAlgorithmFamilyCustomRef=Crypto_30_LibCv_ECCANSI, CryptoPrimitiveAlgorithmModeCustomRef=Crypto_30_LibCv_P256r1
        EccAnsiP256R1VerifySha384: CryptoPrimitiveAlgorithmFamily=CRYPTO_ALGOFAM_CUSTOM_ECCANSI, CryptoPrimitiveAlgorithmMode=CRYPTO_ALGOMODE_CUSTOM_P256R1, CryptoPrimitiveService=CRYPTO_SIGNATURE_VERIFY, CryptoPrimitiveAlgorithmSecondaryFamily=CRYPTO_ALGOFAM_SHA2_384, CryptoPrimitiveAlgorithmFamilyCustomRef=Crypto_30_LibCv_ECCANSI, CryptoPrimitiveAlgorithmModeCustomRef=Crypto_30_LibCv_P256r1
        EccSecP256R1GenerateSha384: CryptoPrimitiveAlgorithmFamily=CRYPTO_ALGOFAM_CUSTOM_ECCSEC, CryptoPrimitiveAlgorithmMode=CRYPTO_ALGOMODE_CUSTOM_P256R1, CryptoPrimitiveService=CRYPTO_SIGNATURE_GENERATE, CryptoPrimitiveAlgorithmSecondaryFamily=CRYPTO_ALGOFAM_SHA2_384, CryptoPrimitiveAlgorithmFamilyCustomRef=Crypto_30_LibCv_ECCSEC, CryptoPrimitiveAlgorithmModeCustomRef=Crypto_30_LibCv_P256r1
        EccSecP256R1VerifySha384: CryptoPrimitiveAlgorithmFamily=CRYPTO_ALGOFAM_CUSTOM_ECCSEC, CryptoPrimitiveAlgorithmMode=CRYPTO_ALGOMODE_CUSTOM_P256R1, CryptoPrimitiveService=CRYPTO_SIGNATURE_VERIFY, CryptoPrimitiveAlgorithmSecondaryFamily=CRYPTO_ALGOFAM_SHA2_384, CryptoPrimitiveAlgorithmFamilyCustomRef=Crypto_30_LibCv_ECCSEC, CryptoPrimitiveAlgorithmModeCustomRef=Crypto_30_LibCv_P256r1
        EccNistP384R1GenerateSha384: CryptoPrimitiveAlgorithmFamily=CRYPTO_ALGOFAM_ECCNIST, CryptoPrimitiveAlgorithmMode=CRYPTO_ALGOMODE_CUSTOM_P384R1, CryptoPrimitiveService=CRYPTO_SIGNATURE_GENERATE, CryptoPrimitiveAlgorithmSecondaryFamily=CRYPTO_ALGOFAM_SHA2_384, CryptoPrimitiveAlgorithmModeCustomRef=Crypto_30_LibCv_P384r1
        EccNistP384R1VerifySha384: CryptoPrimitiveAlgorithmFamily=CRYPTO_ALGOFAM_ECCNIST, CryptoPrimitiveAlgorithmMode=CRYPTO_ALGOMODE_CUSTOM_P384R1, CryptoPrimitiveService=CRYPTO_SIGNATURE_VERIFY, CryptoPrimitiveAlgorithmSecondaryFamily=CRYPTO_ALGOFAM_SHA2_384, CryptoPrimitiveAlgorithmModeCustomRef=Crypto_30_LibCv_P384r1
        EccSecP384R1GenerateSha384: CryptoPrimitiveAlgorithmFamily=CRYPTO_ALGOFAM_CUSTOM_ECCSEC, CryptoPrimitiveAlgorithmMode=CRYPTO_ALGOMODE_CUSTOM_P384R1, CryptoPrimitiveService=CRYPTO_SIGNATURE_GENERATE, CryptoPrimitiveAlgorithmSecondaryFamily=CRYPTO_ALGOFAM_SHA2_384, CryptoPrimitiveAlgorithmFamilyCustomRef=Crypto_30_LibCv_ECCSEC, CryptoPrimitiveAlgorithmModeCustomRef=Crypto_30_LibCv_P384r1
        EccSecP384R1VerifySha384: CryptoPrimitiveAlgorithmFamily=CRYPTO_ALGOFAM_CUSTOM_ECCSEC, CryptoPrimitiveAlgorithmMode=CRYPTO_ALGOMODE_CUSTOM_P384R1, CryptoPrimitiveService=CRYPTO_SIGNATURE_VERIFY, CryptoPrimitiveAlgorithmSecondaryFamily=CRYPTO_ALGOFAM_SHA2_384, CryptoPrimitiveAlgorithmFamilyCustomRef=Crypto_30_LibCv_ECCSEC, CryptoPrimitiveAlgorithmModeCustomRef=Crypto_30_LibCv_P384r1
        GmacAesGenerate: CryptoPrimitiveAlgorithmSecondaryFamily=CRYPTO_ALGOFAM_NOT_SET, CryptoPrimitiveAlgorithmMode=CRYPTO_ALGOMODE_GMAC, CryptoPrimitiveService=CRYPTO_MAC_GENERATE, CryptoPrimitiveAlgorithmFamily=CRYPTO_ALGOFAM_AES
        GmacAesVerify: CryptoPrimitiveAlgorithmSecondaryFamily=CRYPTO_ALGOFAM_NOT_SET, CryptoPrimitiveAlgorithmMode=CRYPTO_ALGOMODE_GMAC, CryptoPrimitiveService=CRYPTO_MAC_VERIFY, CryptoPrimitiveAlgorithmFamily=CRYPTO_ALGOFAM_AES
        HmacSha384Generate: CryptoPrimitiveAlgorithmFamily=CRYPTO_ALGOFAM_SHA2_384, CryptoPrimitiveAlgorithmMode=CRYPTO_ALGOMODE_HMAC, CryptoPrimitiveAlgorithmSecondaryFamily=CRYPTO_ALGOFAM_NOT_SET, CryptoPrimitiveService=CRYPTO_MAC_GENERATE
        HmacSha384Verify: CryptoPrimitiveAlgorithmFamily=CRYPTO_ALGOFAM_SHA2_384, CryptoPrimitiveAlgorithmMode=CRYPTO_ALGOMODE_HMAC, CryptoPrimitiveAlgorithmSecondaryFamily=CRYPTO_ALGOFAM_NOT_SET, CryptoPrimitiveService=CRYPTO_MAC_VERIFY
        KeySetValid: CryptoPrimitiveService=CRYPTO_KEY_SET_VALID, CryptoPrimitiveAlgorithmFamily=CRYPTO_ALGOFAM_NOT_SET, CryptoPrimitiveAlgorithmMode=CRYPTO_ALGOMODE_NOT_SET, CryptoPrimitiveAlgorithmSecondaryFamily=CRYPTO_ALGOFAM_NOT_SET
        KeyDeriveX963SHA256: CryptoPrimitiveService=CRYPTO_KEY_DERIVE, CryptoPrimitiveAlgorithmFamily=CRYPTO_ALGOFAM_KDFX963, CryptoPrimitiveAlgorithmMode=CRYPTO_ALGOMODE_NOT_SET, CryptoPrimitiveAlgorithmSecondaryFamily=CRYPTO_ALGOFAM_SHA2_256
        KeyExchangeCalcPubValX25519: CryptoPrimitiveService=CRYPTO_KEY_EXCHANGE_CALC_PUBVAL, CryptoPrimitiveAlgorithmFamily=CRYPTO_ALGOFAM_CUSTOM_X25519, CryptoPrimitiveAlgorithmMode=CRYPTO_ALGOMODE_NOT_SET, CryptoPrimitiveAlgorithmSecondaryFamily=CRYPTO_ALGOFAM_NOT_SET, CryptoPrimitiveAlgorithmFamilyCustomRef=Crypto_30_LibCv_X25519
        KeyExchangeCalcSecretX25519: CryptoPrimitiveService=CRYPTO_KEY_EXCHANGE_CALC_SECRET, CryptoPrimitiveAlgorithmFamily=CRYPTO_ALGOFAM_CUSTOM_X25519, CryptoPrimitiveAlgorithmMode=CRYPTO_ALGOMODE_NOT_SET, CryptoPrimitiveAlgorithmSecondaryFamily=CRYPTO_ALGOFAM_NOT_SET, CryptoPrimitiveAlgorithmFamilyCustomRef=Crypto_30_LibCv_X25519
        KeyExchangeCalcPubValSecP256R1: CryptoPrimitiveService=CRYPTO_KEY_EXCHANGE_CALC_PUBVAL, CryptoPrimitiveAlgorithmFamily=CRYPTO_ALGOFAM_ECCSEC, CryptoPrimitiveAlgorithmMode=CRYPTO_ALGOMODE_CUSTOM_P256R1, CryptoPrimitiveAlgorithmSecondaryFamily=CRYPTO_ALGOFAM_NOT_SET, CryptoPrimitiveAlgorithmModeCustomRef=Crypto_30_LibCv_P256r1
        KeyExchangeCalcPubValSecP384R1: CryptoPrimitiveService=CRYPTO_KEY_EXCHANGE_CALC_PUBVAL, CryptoPrimitiveAlgorithmFamily=CRYPTO_ALGOFAM_ECCSEC, CryptoPrimitiveAlgorithmMode=CRYPTO_ALGOMODE_CUSTOM_P384R1, CryptoPrimitiveAlgorithmSecondaryFamily=CRYPTO_ALGOFAM_NOT_SET, CryptoPrimitiveAlgorithmModeCustomRef=Crypto_30_LibCv_P384r1
        KeyExchangeCalcSecretSecP256R1: CryptoPrimitiveService=CRYPTO_KEY_EXCHANGE_CALC_SECRET, CryptoPrimitiveAlgorithmFamily=CRYPTO_ALGOFAM_ECCSEC, CryptoPrimitiveAlgorithmMode=CRYPTO_ALGOMODE_CUSTOM_P256R1, CryptoPrimitiveAlgorithmSecondaryFamily=CRYPTO_ALGOFAM_NOT_SET, CryptoPrimitiveAlgorithmModeCustomRef=Crypto_30_LibCv_P256r1
        KeyExchangeCalcSecretSecP384R1: CryptoPrimitiveService=CRYPTO_KEY_EXCHANGE_CALC_SECRET, CryptoPrimitiveAlgorithmFamily=CRYPTO_ALGOFAM_ECCSEC, CryptoPrimitiveAlgorithmMode=CRYPTO_ALGOMODE_CUSTOM_P384R1, CryptoPrimitiveAlgorithmSecondaryFamily=CRYPTO_ALGOFAM_NOT_SET, CryptoPrimitiveAlgorithmModeCustomRef=Crypto_30_LibCv_P384r1
        KeyExchangeCalcPubValAnsiP256R1: CryptoPrimitiveService=CRYPTO_KEY_EXCHANGE_CALC_PUBVAL, CryptoPrimitiveAlgorithmFamily=CRYPTO_ALGOFAM_ECCANSI, CryptoPrimitiveAlgorithmMode=CRYPTO_ALGOMODE_CUSTOM_P256R1, CryptoPrimitiveAlgorithmSecondaryFamily=CRYPTO_ALGOFAM_NOT_SET, CryptoPrimitiveAlgorithmModeCustomRef=Crypto_30_LibCv_P256r1
        KeyExchangeCalcSecretAnsiP256R1: CryptoPrimitiveService=CRYPTO_KEY_EXCHANGE_CALC_SECRET, CryptoPrimitiveAlgorithmFamily=CRYPTO_ALGOFAM_ECCANSI, CryptoPrimitiveAlgorithmMode=CRYPTO_ALGOMODE_CUSTOM_P256R1, CryptoPrimitiveAlgorithmSecondaryFamily=CRYPTO_ALGOFAM_NOT_SET, CryptoPrimitiveAlgorithmModeCustomRef=Crypto_30_LibCv_P256r1
        KeyExchangeCalcPubValNistP256R1: CryptoPrimitiveService=CRYPTO_KEY_EXCHANGE_CALC_PUBVAL, CryptoPrimitiveAlgorithmFamily=CRYPTO_ALGOFAM_ECCNIST, CryptoPrimitiveAlgorithmMode=CRYPTO_ALGOMODE_CUSTOM_P256R1, CryptoPrimitiveAlgorithmSecondaryFamily=CRYPTO_ALGOFAM_NOT_SET, CryptoPrimitiveAlgorithmModeCustomRef=Crypto_30_LibCv_P256r1
        KeyExchangeCalcSecretNistP256R1: CryptoPrimitiveService=CRYPTO_KEY_EXCHANGE_CALC_SECRET, CryptoPrimitiveAlgorithmFamily=CRYPTO_ALGOFAM_ECCNIST, CryptoPrimitiveAlgorithmMode=CRYPTO_ALGOMODE_CUSTOM_P256R1, CryptoPrimitiveAlgorithmSecondaryFamily=CRYPTO_ALGOFAM_NOT_SET, CryptoPrimitiveAlgorithmModeCustomRef=Crypto_30_LibCv_P256r1
        KeyExchangeCalcPubValNistP384R1: CryptoPrimitiveService=CRYPTO_KEY_EXCHANGE_CALC_PUBVAL, CryptoPrimitiveAlgorithmFamily=CRYPTO_ALGOFAM_ECCNIST, CryptoPrimitiveAlgorithmMode=CRYPTO_ALGOMODE_CUSTOM_P384R1, CryptoPrimitiveAlgorithmSecondaryFamily=CRYPTO_ALGOFAM_NOT_SET, CryptoPrimitiveAlgorithmModeCustomRef=Crypto_30_LibCv_P384r1
        KeyExchangeCalcSecretNistP384R1: CryptoPrimitiveService=CRYPTO_KEY_EXCHANGE_CALC_SECRET, CryptoPrimitiveAlgorithmFamily=CRYPTO_ALGOFAM_ECCNIST, CryptoPrimitiveAlgorithmMode=CRYPTO_ALGOMODE_CUSTOM_P384R1, CryptoPrimitiveAlgorithmSecondaryFamily=CRYPTO_ALGOFAM_NOT_SET, CryptoPrimitiveAlgorithmModeCustomRef=Crypto_30_LibCv_P384r1
        RandomSeedRngFips186Sha1: CryptoPrimitiveAlgorithmMode=CRYPTO_ALGOMODE_NOT_SET, CryptoPrimitiveService=CRYPTO_RANDOM_SEED, CryptoPrimitiveAlgorithmFamily=CRYPTO_ALGOFAM_FIPS186, CryptoPrimitiveAlgorithmSecondaryFamily=CRYPTO_ALGOFAM_SHA1
        RandomSeedRngDrbgAes128: CryptoPrimitiveAlgorithmMode=CRYPTO_ALGOMODE_NOT_SET, CryptoPrimitiveService=CRYPTO_RANDOM_SEED, CryptoPrimitiveAlgorithmFamily=CRYPTO_ALGOFAM_DRBG, CryptoPrimitiveAlgorithmSecondaryFamily=CRYPTO_ALGOFAM_AES
        RandomSeedRngDrbgAes128Df: CryptoPrimitiveAlgorithmMode=CRYPTO_ALGOMODE_CUSTOM_USE_DF, CryptoPrimitiveService=CRYPTO_RANDOM_SEED, CryptoPrimitiveAlgorithmFamily=CRYPTO_ALGOFAM_DRBG, CryptoPrimitiveAlgorithmSecondaryFamily=CRYPTO_ALGOFAM_AES, CryptoPrimitiveAlgorithmModeCustomRef=Crypto_30_LibCv_UseDF
        KeyDeriveIso15118: CryptoPrimitiveService=CRYPTO_KEY_DERIVE, CryptoPrimitiveAlgorithmFamily=CRYPTO_ALGOFAM_CUSTOM_ISO15118, CryptoPrimitiveAlgorithmMode=CRYPTO_ALGOMODE_NOT_SET, CryptoPrimitiveAlgorithmSecondaryFamily=CRYPTO_ALGOFAM_NOT_SET, CryptoPrimitiveAlgorithmFamilyCustomRef=Crypto_30_LibCv_ISO15118
        KeyDeriveSymNist800108CntModeSha256: CryptoPrimitiveService=CRYPTO_KEY_DERIVE, CryptoPrimitiveAlgorithmFamily=CRYPTO_ALGOFAM_NOT_SET, CryptoPrimitiveAlgorithmMode=CRYPTO_ALGOMODE_CTR, CryptoPrimitiveAlgorithmSecondaryFamily=CRYPTO_ALGOFAM_SHA2_256
        KeyDeriveAsymNistFips1864Erb: CryptoPrimitiveService=CRYPTO_KEY_DERIVE, CryptoPrimitiveAlgorithmFamily=CRYPTO_ALGOFAM_FIPS186, CryptoPrimitiveAlgorithmMode=CRYPTO_ALGOMODE_NOT_SET, CryptoPrimitiveAlgorithmSecondaryFamily=CRYPTO_ALGOFAM_SHA2_256
        KeyDeriveNist80056AOnePassSha256: CryptoPrimitiveService=CRYPTO_KEY_DERIVE, CryptoPrimitiveAlgorithmFamily=CRYPTO_ALGOFAM_DH, CryptoPrimitiveAlgorithmMode=CRYPTO_ALGOMODE_CUSTOM_P256R1, CryptoPrimitiveAlgorithmSecondaryFamily=CRYPTO_ALGOFAM_SHA2_256, CryptoPrimitiveAlgorithmModeCustomRef=Crypto_30_LibCv_P256r1
        KeyGenerateSymmetricGeneric: CryptoPrimitiveService=CRYPTO_KEY_GENERATE, CryptoPrimitiveAlgorithmFamily=CRYPTO_ALGOFAM_NOT_SET, CryptoPrimitiveAlgorithmMode=CRYPTO_ALGOMODE_NOT_SET, CryptoPrimitiveAlgorithmSecondaryFamily=CRYPTO_ALGOFAM_NOT_SET
        KeyGenerateSecP256R1: CryptoPrimitiveService=CRYPTO_KEY_GENERATE, CryptoPrimitiveAlgorithmFamily=CRYPTO_ALGOFAM_ECCSEC, CryptoPrimitiveAlgorithmMode=CRYPTO_ALGOMODE_CUSTOM_P256R1, CryptoPrimitiveAlgorithmSecondaryFamily=CRYPTO_ALGOFAM_NOT_SET, CryptoPrimitiveAlgorithmModeCustomRef=Crypto_30_LibCv_P256r1
        KeyGenerateSecP384R1: CryptoPrimitiveService=CRYPTO_KEY_GENERATE, CryptoPrimitiveAlgorithmFamily=CRYPTO_ALGOFAM_ECCSEC, CryptoPrimitiveAlgorithmMode=CRYPTO_ALGOMODE_CUSTOM_P384R1, CryptoPrimitiveAlgorithmSecondaryFamily=CRYPTO_ALGOFAM_NOT_SET, CryptoPrimitiveAlgorithmModeCustomRef=Crypto_30_LibCv_P384r1
        KeyGenerateNistP256R1: CryptoPrimitiveService=CRYPTO_KEY_GENERATE, CryptoPrimitiveAlgorithmFamily=CRYPTO_ALGOFAM_ECCNIST, CryptoPrimitiveAlgorithmMode=CRYPTO_ALGOMODE_CUSTOM_P256R1, CryptoPrimitiveAlgorithmSecondaryFamily=CRYPTO_ALGOFAM_NOT_SET, CryptoPrimitiveAlgorithmModeCustomRef=Crypto_30_LibCv_P256r1
        KeyGenerateNistP384R1: CryptoPrimitiveService=CRYPTO_KEY_GENERATE, CryptoPrimitiveAlgorithmFamily=CRYPTO_ALGOFAM_ECCNIST, CryptoPrimitiveAlgorithmMode=CRYPTO_ALGOMODE_CUSTOM_P384R1, CryptoPrimitiveAlgorithmSecondaryFamily=CRYPTO_ALGOFAM_NOT_SET, CryptoPrimitiveAlgorithmModeCustomRef=Crypto_30_LibCv_P384r1
        KeyGenerateAnsiP256R1: CryptoPrimitiveService=CRYPTO_KEY_GENERATE, CryptoPrimitiveAlgorithmFamily=CRYPTO_ALGOFAM_ECCANSI, CryptoPrimitiveAlgorithmMode=CRYPTO_ALGOMODE_CUSTOM_P256R1, CryptoPrimitiveAlgorithmSecondaryFamily=CRYPTO_ALGOFAM_NOT_SET, CryptoPrimitiveAlgorithmModeCustomRef=Crypto_30_LibCv_P256r1
        HmacRipemd160Generate: CryptoPrimitiveService=CRYPTO_MAC_GENERATE, CryptoPrimitiveAlgorithmMode=CRYPTO_ALGOMODE_HMAC, CryptoPrimitiveAlgorithmFamily=CRYPTO_ALGOFAM_RIPEMD160, CryptoPrimitiveAlgorithmSecondaryFamily=CRYPTO_ALGOFAM_NOT_SET
        HmacRipemd160Verify: CryptoPrimitiveService=CRYPTO_MAC_VERIFY, CryptoPrimitiveAlgorithmMode=CRYPTO_ALGOMODE_HMAC, CryptoPrimitiveAlgorithmFamily=CRYPTO_ALGOFAM_RIPEMD160, CryptoPrimitiveAlgorithmSecondaryFamily=CRYPTO_ALGOFAM_NOT_SET
        vHsm_Signature_EccNistP256R1VerifySha25: CryptoPrimitiveAlgorithmMode=CRYPTO_ALGOMODE_CUSTOM_P256R1, CryptoPrimitiveService=CRYPTO_SIGNATURE_VERIFY, CryptoPrimitiveAlgorithmFamily=CRYPTO_ALGOFAM_ECCNIST, CryptoPrimitiveAlgorithmSecondaryFamily=CRYPTO_ALGOFAM_SHA2_256
        EccSecP160R1GenerateWithoutPreHashing: CryptoPrimitiveService=CRYPTO_SIGNATURE_GENERATE, CryptoPrimitiveAlgorithmMode=CRYPTO_ALGOMODE_CUSTOM_P160R1, CryptoPrimitiveAlgorithmFamily=CRYPTO_ALGOFAM_ECCSEC, CryptoPrimitiveAlgorithmSecondaryFamily=CRYPTO_ALGOFAM_NOT_SET, CryptoPrimitiveAlgorithmModeCustomRef=Crypto_30_LibCv_P160r1
        EccSecP160R1VerifyWithoutPreHashing: CryptoPrimitiveService=CRYPTO_SIGNATURE_VERIFY, CryptoPrimitiveAlgorithmMode=CRYPTO_ALGOMODE_CUSTOM_P160R1, CryptoPrimitiveAlgorithmFamily=CRYPTO_ALGOFAM_ECCSEC, CryptoPrimitiveAlgorithmSecondaryFamily=CRYPTO_ALGOFAM_NOT_SET, CryptoPrimitiveAlgorithmModeCustomRef=Crypto_30_LibCv_P160r1
        HashRipemd160: CryptoPrimitiveService=CRYPTO_HASH, CryptoPrimitiveAlgorithmMode=CRYPTO_ALGOMODE_NOT_SET, CryptoPrimitiveAlgorithmFamily=CRYPTO_ALGOFAM_RIPEMD160, CryptoPrimitiveAlgorithmSecondaryFamily=CRYPTO_ALGOFAM_NOT_SET
        KeyDerivePbkdf2HmacSha1: CryptoPrimitiveService=CRYPTO_KEY_DERIVE, CryptoPrimitiveAlgorithmFamily=CRYPTO_ALGOFAM_PBKDF2, CryptoPrimitiveAlgorithmMode=CRYPTO_ALGOMODE_HMAC, CryptoPrimitiveAlgorithmSecondaryFamily=CRYPTO_ALGOFAM_SHA1
        KeyDerivePbkdf2HmacSha256: CryptoPrimitiveService=CRYPTO_KEY_DERIVE, CryptoPrimitiveAlgorithmFamily=CRYPTO_ALGOFAM_PBKDF2, CryptoPrimitiveAlgorithmMode=CRYPTO_ALGOMODE_HMAC, CryptoPrimitiveAlgorithmSecondaryFamily=CRYPTO_ALGOFAM_SHA2_256
        KeyDeriveX963SHA512: CryptoPrimitiveService=CRYPTO_KEY_DERIVE, CryptoPrimitiveAlgorithmMode=CRYPTO_ALGOMODE_NOT_SET, CryptoPrimitiveAlgorithmFamily=CRYPTO_ALGOFAM_KDFX963, CryptoPrimitiveAlgorithmSecondaryFamily=CRYPTO_ALGOFAM_SHA2_512
        AeadChaCha20Poly1305Encrypt: CryptoPrimitiveService=CRYPTO_AEADENCRYPT, CryptoPrimitiveAlgorithmMode=CRYPTO_ALGOMODE_20ROUNDS, CryptoPrimitiveAlgorithmFamily=CRYPTO_ALGOFAM_CHACHA, CryptoPrimitiveAlgorithmSecondaryFamily=CRYPTO_ALGOFAM_CUSTOM_POLY_1305, CryptoPrimitiveAlgorithmSecondaryFamilyCustomRef=Crypto_30_LibCv_POLY1305
        AeadChaCha20Poly1305Decrypt: CryptoPrimitiveService=CRYPTO_AEADDECRYPT, CryptoPrimitiveAlgorithmMode=CRYPTO_ALGOMODE_20ROUNDS, CryptoPrimitiveAlgorithmFamily=CRYPTO_ALGOFAM_CHACHA, CryptoPrimitiveAlgorithmSecondaryFamily=CRYPTO_ALGOFAM_CUSTOM_POLY_1305, CryptoPrimitiveAlgorithmSecondaryFamilyCustomRef=Crypto_30_LibCv_POLY1305
        RngHashDrbgSha512: CryptoPrimitiveService=CRYPTO_RANDOM, CryptoPrimitiveAlgorithmMode=CRYPTO_ALGOMODE_NOT_SET, CryptoPrimitiveAlgorithmFamily=CRYPTO_ALGOFAM_DRBG, CryptoPrimitiveAlgorithmSecondaryFamily=CRYPTO_ALGOFAM_SHA2_512
        RandomSeedRngHashDrbgSha512: CryptoPrimitiveService=CRYPTO_RANDOM_SEED, CryptoPrimitiveAlgorithmMode=CRYPTO_ALGOMODE_NOT_SET, CryptoPrimitiveAlgorithmFamily=CRYPTO_ALGOFAM_DRBG, CryptoPrimitiveAlgorithmSecondaryFamily=CRYPTO_ALGOFAM_SHA2_512
        SHA3_256: CryptoPrimitiveService=CRYPTO_HASH, CryptoPrimitiveAlgorithmMode=CRYPTO_ALGOMODE_NOT_SET, CryptoPrimitiveAlgorithmFamily=CRYPTO_ALGOFAM_SHA3_256, CryptoPrimitiveAlgorithmSecondaryFamily=CRYPTO_ALGOFAM_NOT_SET
        RngDrbgAes256: CryptoPrimitiveService=CRYPTO_RANDOM, CryptoPrimitiveAlgorithmMode=CRYPTO_ALGOMODE_NOT_SET, CryptoPrimitiveAlgorithmFamily=CRYPTO_ALGOFAM_DRBG, CryptoPrimitiveAlgorithmSecondaryFamily=CRYPTO_ALGOFAM_AES
        RngDrbgAes256Df: CryptoPrimitiveService=CRYPTO_RANDOM, CryptoPrimitiveAlgorithmMode=CRYPTO_ALGOMODE_CUSTOM_USE_DF, CryptoPrimitiveAlgorithmFamily=CRYPTO_ALGOFAM_DRBG, CryptoPrimitiveAlgorithmSecondaryFamily=CRYPTO_ALGOFAM_AES, CryptoPrimitiveAlgorithmModeCustomRef=Crypto_30_LibCv_UseDF
        RandomSeedRngDrbgAes256: CryptoPrimitiveService=CRYPTO_RANDOM_SEED, CryptoPrimitiveAlgorithmMode=CRYPTO_ALGOMODE_NOT_SET, CryptoPrimitiveAlgorithmFamily=CRYPTO_ALGOFAM_DRBG, CryptoPrimitiveAlgorithmSecondaryFamily=CRYPTO_ALGOFAM_AES
        RandomSeedRngDrbgAes256Df: CryptoPrimitiveService=CRYPTO_RANDOM_SEED, CryptoPrimitiveAlgorithmMode=CRYPTO_ALGOMODE_CUSTOM_USE_DF, CryptoPrimitiveAlgorithmFamily=CRYPTO_ALGOFAM_DRBG, CryptoPrimitiveAlgorithmSecondaryFamily=CRYPTO_ALGOFAM_AES, CryptoPrimitiveAlgorithmModeCustomRef=Crypto_30_LibCv_UseDF
        SheCmdGetId: CryptoPrimitiveService=CRYPTO_MAC_GENERATE, CryptoPrimitiveAlgorithmMode=CRYPTO_ALGOMODE_CMAC, CryptoPrimitiveAlgorithmFamily=CRYPTO_ALGOFAM_AES, CryptoPrimitiveAlgorithmSecondaryFamily=CRYPTO_ALGOFAM_CUSTOM_CMD_GET_ID, CryptoPrimitiveAlgorithmSecondaryFamilyCustomRef=Crypto_30_LibCv_CmdGetId
        AesCCMEncrypt: CryptoPrimitiveAlgorithmSecondaryFamily=CRYPTO_ALGOFAM_NOT_SET, CryptoPrimitiveAlgorithmMode=CRYPTO_ALGOMODE_CUSTOM_CCM, CryptoPrimitiveService=CRYPTO_AEADENCRYPT, CryptoPrimitiveAlgorithmFamily=CRYPTO_ALGOFAM_AES, CryptoPrimitiveAlgorithmModeCustomRef=Crypto_30_LibCv_CCM
        AesCCMDecrypt: CryptoPrimitiveAlgorithmSecondaryFamily=CRYPTO_ALGOFAM_NOT_SET, CryptoPrimitiveAlgorithmMode=CRYPTO_ALGOMODE_CUSTOM_CCM, CryptoPrimitiveService=CRYPTO_AEADDECRYPT, CryptoPrimitiveAlgorithmFamily=CRYPTO_ALGOFAM_AES, CryptoPrimitiveAlgorithmModeCustomRef=Crypto_30_LibCv_CCM
        KeyDeriveHkdfHmacSHA256: CryptoPrimitiveService=CRYPTO_KEY_DERIVE, CryptoPrimitiveAlgorithmFamily=CRYPTO_ALGOFAM_CUSTOM_HKDF, CryptoPrimitiveAlgorithmMode=CRYPTO_ALGOMODE_HMAC, CryptoPrimitiveAlgorithmSecondaryFamily=CRYPTO_ALGOFAM_SHA2_256, CryptoPrimitiveAlgorithmFamilyCustomRef=Crypto_30_LibCv_HKDF
        KeyExchangeCalcPubValSpake2PlusCipherSuite8: CryptoPrimitiveService=CRYPTO_KEY_EXCHANGE_CALC_PUBVAL, CryptoPrimitiveAlgorithmFamily=CRYPTO_ALGOFAM_CUSTOM_SPAKE2_PLUS, CryptoPrimitiveAlgorithmMode=CRYPTO_ALGOMODE_CUSTOM_MODE_1, CryptoPrimitiveAlgorithmSecondaryFamily=CRYPTO_ALGOFAM_CUSTOM_CIPHER_SUITE_8, CryptoPrimitiveAlgorithmMode=CRYPTO_ALGOMODE_NOT_SET, CryptoPrimitiveAlgorithmSecondaryFamilyCustomRef=Crypto_30_LibCv_CipherSuite8, CryptoPrimitiveAlgorithmFamilyCustomRef=Crypto_30_LibCv_SPAKE2PLUS, CryptoPrimitiveAlgorithmModeCustomRef=Crypto_30_LibCv_Mode1
        KeyExchangeCalcSecretSpake2PlusCipherSuite8: CryptoPrimitiveService=CRYPTO_KEY_EXCHANGE_CALC_SECRET, CryptoPrimitiveAlgorithmFamily=CRYPTO_ALGOFAM_CUSTOM_SPAKE2_PLUS, CryptoPrimitiveAlgorithmMode=CRYPTO_ALGOMODE_CUSTOM_MODE_1, CryptoPrimitiveAlgorithmSecondaryFamily=CRYPTO_ALGOFAM_CUSTOM_CIPHER_SUITE_8, CryptoPrimitiveAlgorithmMode=CRYPTO_ALGOMODE_NOT_SET, CryptoPrimitiveAlgorithmSecondaryFamilyCustomRef=Crypto_30_LibCv_CipherSuite8, CryptoPrimitiveAlgorithmFamilyCustomRef=Crypto_30_LibCv_SPAKE2PLUS, CryptoPrimitiveAlgorithmModeCustomRef=Crypto_30_LibCv_Mode1
        KeyDeriveSpake2PlusP256R1: CryptoPrimitiveService=CRYPTO_KEY_DERIVE, CryptoPrimitiveAlgorithmFamily=CRYPTO_ALGOFAM_CUSTOM_SPAKE2_PLUS, CryptoPrimitiveAlgorithmMode=CRYPTO_ALGOMODE_CUSTOM_P256R1, CryptoPrimitiveAlgorithmSecondaryFamily=CRYPTO_ALGOFAM_NOT_SET, CryptoPrimitiveAlgorithmFamilyCustomRef=Crypto_30_LibCv_SPAKE2PLUS, CryptoPrimitiveAlgorithmModeCustomRef=Crypto_30_LibCv_P256r1
        HashMD5: CryptoPrimitiveService=CRYPTO_HASH, CryptoPrimitiveAlgorithmMode=CRYPTO_ALGOMODE_NOT_SET, CryptoPrimitiveAlgorithmFamily=CRYPTO_ALGOFAM_CUSTOM_MD5, CryptoPrimitiveAlgorithmSecondaryFamily=CRYPTO_ALGOFAM_NOT_SET, CryptoPrimitiveAlgorithmFamilyCustomRef=Crypto_30_LibCv_MD5
        KeyGenerateEd25519: CryptoPrimitiveService=CRYPTO_KEY_GENERATE, CryptoPrimitiveAlgorithmMode=CRYPTO_ALGOMODE_NOT_SET, CryptoPrimitiveAlgorithmFamily=CRYPTO_ALGOFAM_ED25519, CryptoPrimitiveAlgorithmSecondaryFamily=CRYPTO_ALGOFAM_NOT_SET
      13 x CryptoPrimitiveAlgorithmFamilyCustom:
        Crypto_30_LibCv_PaddingPKCS7: CryptoPrimitiveAlgorithmFamilyCustomId=133
        Crypto_30_LibCv_FIPS186: CryptoPrimitiveAlgorithmFamilyCustomId=132
        Crypto_30_LibCv_ECCANSI: CryptoPrimitiveAlgorithmFamilyCustomId=129
        Crypto_30_LibCv_ECCSEC: CryptoPrimitiveAlgorithmFamilyCustomId=130
        Crypto_30_LibCv_DRBG: CryptoPrimitiveAlgorithmFamilyCustomId=131
        Crypto_30_LibCv_X25519: CryptoPrimitiveAlgorithmFamilyCustomId=135
        Crypto_30_LibCv_ISO15118: CryptoPrimitiveAlgorithmFamilyCustomId=136
        Crypto_30_LibCv_POLY1305: CryptoPrimitiveAlgorithmFamilyCustomId=137
        Crypto_30_LibCv_CmdGetId: CryptoPrimitiveAlgorithmFamilyCustomId=140
        Crypto_30_LibCv_HKDF: CryptoPrimitiveAlgorithmFamilyCustomId=139
        Crypto_30_LibCv_SPAKE2PLUS: CryptoPrimitiveAlgorithmFamilyCustomId=138
        Crypto_30_LibCv_CipherSuite8: CryptoPrimitiveAlgorithmFamilyCustomId=157
        Crypto_30_LibCv_MD5: CryptoPrimitiveAlgorithmFamilyCustomId=191
      8 x CryptoPrimitiveAlgorithmModeCustom:
        Crypto_30_LibCv_CCM: CryptoPrimitiveAlgorithmModeCustomId=147
        Crypto_30_LibCv_Mode1: CryptoPrimitiveAlgorithmModeCustomId=150
        Crypto_30_LibCv_P160r1: CryptoPrimitiveAlgorithmModeCustomId=146
        Crypto_30_LibCv_P256r1: CryptoPrimitiveAlgorithmModeCustomId=128
        Crypto_30_LibCv_P384r1: CryptoPrimitiveAlgorithmModeCustomId=131
        Crypto_30_LibCv_RSAES_OAEP_CRT: CryptoPrimitiveAlgorithmModeCustomId=132
        Crypto_30_LibCv_RSASSA_PKCS1_v1_5_CRT: CryptoPrimitiveAlgorithmModeCustomId=129
        Crypto_30_LibCv_UseDF: CryptoPrimitiveAlgorithmModeCustomId=130
      KeyExchangeCalcPubValNistP224R1_BD (CryptoPrimitive):
        CryptoPrimitiveService = CRYPTO_KEY_EXCHANGE_CALC_PUBVAL
        CryptoPrimitiveAlgorithmFamily = CRYPTO_ALGOFAM_ECCNIST
        CryptoPrimitiveAlgorithmMode = CRYPTO_ALGOMODE_CUSTOM_P224R1
        CryptoPrimitiveAlgorithmSecondaryFamily = CRYPTO_ALGOFAM_CUSTOM_BD
        CryptoPrimitiveAlgorithmModeCustomRef = Crypto_30_LibCv_P224r1
        CryptoPrimitiveAlgorithmSecondaryFamilyCustomRef = Crypto_30_LibCv_BD
      KeyExchangeCalcSecretNistP224R1_BD (CryptoPrimitive):
        CryptoPrimitiveService = CRYPTO_KEY_EXCHANGE_CALC_SECRET
        CryptoPrimitiveAlgorithmFamily = CRYPTO_ALGOFAM_ECCNIST
        CryptoPrimitiveAlgorithmMode = CRYPTO_ALGOMODE_CUSTOM_P224R1
        CryptoPrimitiveAlgorithmSecondaryFamily = CRYPTO_ALGOFAM_CUSTOM_BD
        CryptoPrimitiveAlgorithmModeCustomRef = Crypto_30_LibCv_P224r1
        CryptoPrimitiveAlgorithmSecondaryFamilyCustomRef = Crypto_30_LibCv_BD
      Crypto_30_LibCv_P224r1 (CryptoPrimitiveAlgorithmModeCustom): CryptoPrimitiveAlgorithmModeCustomId=148
      Crypto_30_LibCv_BD (CryptoPrimitiveAlgorithmFamilyCustom): CryptoPrimitiveAlgorithmFamilyCustomId=141
      KeyDeriveHkdfOption1SHA256 (CryptoPrimitive):
        CryptoPrimitiveService = CRYPTO_KEY_DERIVE
        CryptoPrimitiveAlgorithmFamily = CRYPTO_ALGOFAM_CUSTOM_HKDF
        CryptoPrimitiveAlgorithmMode = CRYPTO_ALGOMODE_NOT_SET
        CryptoPrimitiveAlgorithmSecondaryFamily = CRYPTO_ALGOFAM_SHA2_256
        CryptoPrimitiveAlgorithmFamilyCustomRef = Crypto_30_LibCv_HKDF
    CryptoDriverObjects
      7 x CryptoDriverObject, all with CryptoDriverObjectQueueSize=1:
        vHsm_LibCv_vHsmUpd_Mac: CryptoDriverObjectId=5, CryptoPrimitiveRef=AesCmacGenerate
        vHsm_LibCv_vHsmUpd_Dec: CryptoDriverObjectId=3, CryptoPrimitiveRef=AesDecrypt
        vHsm_LibCv_vHsmUpd_Enc: CryptoDriverObjectId=4, CryptoPrimitiveRef=AesEncrypt
        vHsm_LibCv_vHsmUpd_Sig: CryptoDriverObjectId=6, CryptoPrimitiveRef=EccNistP256R1VerifySha256, CryptoPrimitiveRef=vHsm_Signature_EcDsaEd25519Verify
        vHsm_LibCv: CryptoDriverObjectId=0, CryptoPrimitiveRef=SHA256, CryptoPrimitiveRef=AesDecrypt, CryptoPrimitiveRef=AesEncrypt, CryptoPrimitiveRef=AesCmacGenerate, CryptoPrimitiveRef=AesCmacVerify, CryptoPrimitiveRef=RngDrbgAes128, CryptoPrimitiveRef=EccNistP256R1VerifySha256, CryptoPrimitiveRef=EcDsaEd25519Generate, CryptoPrimitiveRef=EcDsaEd25519Verify, CryptoPrimitiveRef=SHA512, CryptoPrimitiveRef=KeyGenerateEd25519
        vHsm_LibCv_HighPrio: CryptoDriverObjectId=1, CryptoPrimitiveRef=SHA256, CryptoPrimitiveRef=AesDecrypt, CryptoPrimitiveRef=AesEncrypt, CryptoPrimitiveRef=AesCmacGenerate, CryptoPrimitiveRef=AesCmacVerify, CryptoPrimitiveRef=RngDrbgAes128, CryptoPrimitiveRef=SHA512
        vHsm_LibCv_KeyM: CryptoDriverObjectId=2, CryptoPrimitiveRef=EccNistP256R1VerifySha256
    CryptoKeyElements
      170 x CryptoKeyElement, all with CryptoKeyElementFormat=CRYPTO_KE_FORMAT_BIN_OCTET, CryptoKeyElementWriteOnce=false:
        CryptoKeyElement_DummyWorkaround_RandomSeedSize: CryptoKeyElementId=999, CryptoKeyElementSize=209, CryptoKeyElementReadAccess=RA_ALLOWED, CryptoKeyElementAllowPartialAccess=false, CryptoKeyElementPersist=false, CryptoKeyElementWriteAccess=WA_ALLOWED
        Ssa_MacKey: CryptoKeyElementId=1, CryptoKeyElementSize=16, CryptoKeyElementReadAccess=RA_ALLOWED, CryptoKeyElementAllowPartialAccess=false, CryptoKeyElementPersist=true, CryptoKeyElementWriteAccess=WA_ALLOWED, CryptoKeyElementInitValue=0x23 0xe4 0xf5 0x35 0x25 0x93 0x1f 0xe5 0x01 0xc1 0xac 0x68 0x17 0x60 0x13 0x63
        Ssa_MacKey_Hash: CryptoKeyElementId=2, CryptoKeyElementSize=4, CryptoKeyElementReadAccess=RA_ALLOWED, CryptoKeyElementAllowPartialAccess=false, CryptoKeyElementPersist=true, CryptoKeyElementWriteAccess=WA_ALLOWED
        Ssa_SecurityAccesPublicKey: CryptoKeyElementId=1, CryptoKeyElementSize=32, CryptoKeyElementReadAccess=RA_ALLOWED, CryptoKeyElementAllowPartialAccess=false, CryptoKeyElementPersist=true, CryptoKeyElementWriteAccess=WA_ALLOWED, CryptoKeyElementInitValue=0xFB, 0xBB, 0xF0, 0x4F, 0x78, 0x6E, 0x35, 0x27, 0x6B, 0x93, 0x13, 0x58, 0xEB, 0xED, 0x03, 0x21, 0x6E, 0xE1, 0xF9, 0x3A, 0x95, 0x59, 0x85, 0xDD, 0xF7, 0xBC, 0x20, 0x88, 0xDB, 0x88, 0xC5, 0x87
        Ssa_Signature_Key_TrustModelEcu: CryptoKeyElementSize=32, CryptoKeyElementId=1, CryptoKeyElementReadAccess=RA_ALLOWED, CryptoKeyElementAllowPartialAccess=false, CryptoKeyElementPersist=false, CryptoKeyElementWriteAccess=WA_ALLOWED, CryptoKeyElementInitValue=0xF3 0x35 0xB4 0x95 0xED 0x83 0x91 0xE7 0xDF 0xB6 0x4A 0x2B 0xAE 0xE4 0xC1 0x78 0x3C 0xFE 0x8E 0xAF 0x56 0x7D 0xA7 0xA8 0x88 0xE7 0x5A 0xC3 0x2E 0x22 0x7D 0x87
        Ssa_EcuCert: CryptoKeyElementSize=600, CryptoKeyElementReadAccess=RA_ALLOWED, CryptoKeyElementAllowPartialAccess=false, CryptoKeyElementPersist=true, CryptoKeyElementWriteAccess=WA_ALLOWED, CryptoKeyElementId=0
        Ssa_BackendCert: CryptoKeyElementSize=600, CryptoKeyElementReadAccess=RA_ALLOWED, CryptoKeyElementAllowPartialAccess=true, CryptoKeyElementPersist=true, CryptoKeyElementWriteAccess=WA_ALLOWED, CryptoKeyElementId=0, CryptoKeyElementInitValue=0x30 0x82 0x01 0x8D 0x30 0x82 0x01 0x35 0xA0 0x03 0x02 0x01 0x02 0x02 0x01 0x02 0x30 0x0F 0x06 0x0D 0x2B 0x06 0x01 0x04 0x01 0x96 0x64 0x03 0x06 0x83 0x7D 0x05 0x6E 0x30 0x12 0x31 0x10 0x30 0x0E 0x06 0x03 0x55 0x04 0x03 0x0C 0x07 0x41 0x41 0x30 0x30 0x30 0x30 0x31 0x30 0x20 0x17 0x0D 0x31 0x38 0x30 0x36 0x31 0x35 0x31 0x33 0x32 0x36 0x32 0x31 0x5A 0x18 0x0F 0x39 0x39 0x39 0x39 0x31 0x32 0x33 0x31 0x32 0x32 0x35 0x39 0x35 0x39 0x5A 0x30 0x12 0x31 0x10 0x30 0x0E 0x06 0x03 0x55 0x04 0x03 0x0C 0x07 0x41 0x42 0x30 0x30 0x30 0x30 0x31 0x30 0x34 0x30 0x0F 0x06 0x0D 0x2B 0x06 0x01 0x04 0x01 0x96 0x64 0x03 0x06 0x83 0x7D 0x05 0x6E 0x03 0x21 0x00 0x1E 0xF1 0x32 0xE4 0xC5 0xB3 0x04 0x06 0xD1 0xF9 0xE8 0x54 0x7E 0x57 0xD2 0xA6 0x29 0x7F 0x30 0xAF 0xA2 0x3A 0xF1 0x68 0xE6 0x28 0x64 0xF1 0x32 0x32 0x05 0xC3 0xA3 0x81 0x99 0x30 0x81 0x96 0x30 0x17 0x06 0x0D 0x2B 0x06 0x01 0x04 0x01 0x96 0x64 0x03 0x06 0x83 0x7D 0x05 0x65 0x01 0x01 0xFF 0x04 0x03 0x04 0x01 0x02 0x30 0x17 0x06 0x0D 0x2B 0x06 0x01 0x04 0x01 0x96 0x64 0x03 0x06 0x83 0x7D 0x05 0x6B 0x01 0x01 0xFF 0x04 0x03 0x04 0x01 0x00 0x30 0x1D 0x06 0x03 0x55 0x1D 0x0E 0x04 0x16 0x04 0x14 0x80 0xDD 0x45 0x58 0xCC 0x84 0xCC 0x0A 0xC1 0x64 0xD5 0x18 0xEC 0xA6 0x45 0x06 0x5B 0x96 0x14 0x36 0x30 0x12 0x06 0x03 0x55 0x1D 0x13 0x01 0x01 0xFF 0x04 0x08 0x30 0x06 0x01 0x01 0xFF 0x02 0x01 0x00 0x30 0x0E 0x06 0x03 0x55 0x1D 0x0F 0x01 0x01 0xFF 0x04 0x04 0x03 0x02 0x02 0x04 0x30 0x1F 0x06 0x03 0x55 0x1D 0x23 0x04 0x18 0x30 0x16 0x80 0x14 0x5F 0x86 0x6B 0xAB 0x6B 0x87 0x12 0xED 0x2C 0xF5 0x47 0x70 0xDF 0xCD 0xA1 0x40 0x7B 0x96 0xB0 0xAB 0x30 0x0F 0x06 0x0D 0x2B 0x06 0x01 0x04 0x01 0x96 0x64 0x03 0x06 0x83 0x7D 0x05 0x6E 0x03 0x41 0x00 0x90 0xE2 0x55 0x3C 0x18 0x7B 0xAD 0xA4 0x1E 0x71 0xC6 0xCA 0xDB 0x7B 0x84 0xCA 0xE5 0x3E 0xD8 0x01 0x99 0x08 0x15 0x09 0x3C 0xCF 0x62 0xF4 0xCE 0x3C 0x81 0x15 0x9C 0x74 0x87 0xB4 0x76 0x79 0x69 0xFD 0x0B 0x88 0x05 0x69 0x9B 0x29 0x6D 0x28 0xDB 0xBA 0x14 0xCD 0x0F 0x58 0x33 0x1B 0x5A 0xA3 0x24 0x80 0x3E 0x8E 0x46 0x05
        Ssa_RootCert: CryptoKeyElementSize=600, CryptoKeyElementReadAccess=RA_ALLOWED, CryptoKeyElementAllowPartialAccess=true, CryptoKeyElementPersist=true, CryptoKeyElementWriteAccess=WA_ALLOWED, CryptoKeyElementId=0, CryptoKeyElementInitValue=0x30 0x82 0x01 0x6A 0x30 0x82 0x01 0x12 0xA0 0x03 0x02 0x01 0x02 0x02 0x01 0x01 0x30 0x0F 0x06 0x0D 0x2B 0x06 0x01 0x04 0x01 0x96 0x64 0x03 0x06 0x83 0x7D 0x05 0x6E 0x30 0x12 0x31 0x10 0x30 0x0E 0x06 0x03 0x55 0x04 0x03 0x0C 0x07 0x41 0x41 0x30 0x30 0x30 0x30 0x31 0x30 0x20 0x17 0x0D 0x31 0x38 0x30 0x36 0x31 0x35 0x31 0x33 0x30 0x36 0x34 0x33 0x5A 0x18 0x0F 0x39 0x39 0x39 0x39 0x31 0x32 0x33 0x31 0x32 0x32 0x35 0x39 0x35 0x39 0x5A 0x30 0x12 0x31 0x10 0x30 0x0E 0x06 0x03 0x55 0x04 0x03 0x0C 0x07 0x41 0x41 0x30 0x30 0x30 0x30 0x31 0x30 0x34 0x30 0x0F 0x06 0x0D 0x2B 0x06 0x01 0x04 0x01 0x96 0x64 0x03 0x06 0x83 0x7D 0x05 0x6E 0x03 0x21 0x00 0x3E 0x4B 0x5B 0x6E 0x49 0xFC 0x41 0xC1 0xE2 0x46 0xA4 0x05 0x95 0xDD 0x8D 0x92 0x2D 0x10 0xF3 0x14 0x87 0xD8 0xA9 0x10 0xF1 0xC0 0xF6 0x25 0x0A 0x09 0x4F 0xAD 0xA3 0x77 0x30 0x75 0x30 0x17 0x06 0x0D 0x2B 0x06 0x01 0x04 0x01 0x96 0x64 0x03 0x06 0x83 0x7D 0x05 0x65 0x01 0x01 0xFF 0x04 0x03 0x04 0x01 0x01 0x30 0x17 0x06 0x0D 0x2B 0x06 0x01 0x04 0x01 0x96 0x64 0x03 0x06 0x83 0x7D 0x05 0x6B 0x01 0x01 0xFF 0x04 0x03 0x04 0x01 0x00 0x30 0x1D 0x06 0x03 0x55 0x1D 0x0E 0x04 0x16 0x04 0x14 0x5F 0x86 0x6B 0xAB 0x6B 0x87 0x12 0xED 0x2C 0xF5 0x47 0x70 0xDF 0xCD 0xA1 0x40 0x7B 0x96 0xB0 0xAB 0x30 0x12 0x06 0x03 0x55 0x1D 0x13 0x01 0x01 0xFF 0x04 0x08 0x30 0x06 0x01 0x01 0xFF 0x02 0x01 0x01 0x30 0x0E 0x06 0x03 0x55 0x1D 0x0F 0x01 0x01 0xFF 0x04 0x04 0x03 0x02 0x02 0x04 0x30 0x0F 0x06 0x0D 0x2B 0x06 0x01 0x04 0x01 0x96 0x64 0x03 0x06 0x83 0x7D 0x05 0x6E 0x03 0x41 0x00 0x0B 0x34 0x62 0x99 0xEA 0xFF 0xBB 0x0A 0xDC 0xD5 0x3C 0x72 0x9A 0x28 0xE4 0x99 0x6E 0x3B 0x8E 0x50 0xEE 0xA1 0x3E 0x1F 0x1E 0x9F 0xE9 0x88 0xE8 0x66 0x2D 0x05 0x40 0xE0 0xF9 0xF2 0x1E 0xBA 0x1D 0x69 0xB6 0x71 0xC3 0x5B 0x5B 0x23 0x40 0x8B 0x35 0x6C 0xE5 0x22 0xC6 0x68 0xB7 0x98 0xC2 0x53 0x76 0x50 0xEB 0x69 0xC0 0x0D
        Ssa_PrivateEcuKey: CryptoKeyElementSize=32, CryptoKeyElementReadAccess=RA_ALLOWED, CryptoKeyElementAllowPartialAccess=false, CryptoKeyElementPersist=true, CryptoKeyElementWriteAccess=WA_ALLOWED, CryptoKeyElementId=1, CryptoKeyElementInitValue=0 1 2 3 4 5 6 7 8 9 10 11 12 13 14 15 16 17 18 19 20 21 22 23 24 25 26 27 28 29 30 31
        Ssa_SharedSecretHash: CryptoKeyElementSize=4, CryptoKeyElementReadAccess=RA_ALLOWED, CryptoKeyElementAllowPartialAccess=false, CryptoKeyElementPersist=true, CryptoKeyElementWriteAccess=WA_ALLOWED, CryptoKeyElementId=2
        Ssa_Mac_Proof: CryptoKeyElementSize=4, CryptoKeyElementReadAccess=RA_ALLOWED, CryptoKeyElementAllowPartialAccess=false, CryptoKeyElementPersist=true, CryptoKeyElementWriteAccess=WA_ALLOWED, CryptoKeyElementId=2, CryptoKeyElementInitValue=0 0 0 0
        Ssa_Mac_Key: CryptoKeyElementSize=16, CryptoKeyElementReadAccess=RA_ALLOWED, CryptoKeyElementAllowPartialAccess=false, CryptoKeyElementPersist=true, CryptoKeyElementWriteAccess=WA_ALLOWED, CryptoKeyElementId=1, CryptoKeyElementInitValue=0 0 0 0 0 0 0 0 0 0 0 0 0 0 0 0
        Ssa_Cipher_Key: CryptoKeyElementSize=16, CryptoKeyElementId=1, CryptoKeyElementReadAccess=RA_ALLOWED, CryptoKeyElementAllowPartialAccess=false, CryptoKeyElementPersist=false, CryptoKeyElementWriteAccess=WA_ALLOWED
        Ssa_Cipher_IV: CryptoKeyElementSize=16, CryptoKeyElementId=5, CryptoKeyElementReadAccess=RA_ALLOWED, CryptoKeyElementAllowPartialAccess=false, CryptoKeyElementPersist=false, CryptoKeyElementWriteAccess=WA_ALLOWED
        Ssa_Random_Nonce: CryptoKeyElementId=3017, CryptoKeyElementInitValue=0x00 0x00 0x00 0x00 0x00 0x00 0x00 0x00 0x00 0x00 0x00 0x00 0x00 0x00 0x00 0x01, CryptoKeyElementReadAccess=RA_ALLOWED, CryptoKeyElementSize=16, CryptoKeyElementWriteAccess=WA_ALLOWED, CryptoKeyElementAllowPartialAccess=false, CryptoKeyElementPersist=false
        Crypto_30_LibCv_Signature_Key: CryptoKeyElementSize=32, CryptoKeyElementId=1, CryptoKeyElementReadAccess=RA_ALLOWED, CryptoKeyElementAllowPartialAccess=false, CryptoKeyElementPersist=false, CryptoKeyElementWriteAccess=WA_ALLOWED
        Crypto_30_LibCv_Random_Seed: CryptoKeyElementSize=20, CryptoKeyElementId=3, CryptoKeyElementReadAccess=RA_ALLOWED, CryptoKeyElementAllowPartialAccess=false, CryptoKeyElementPersist=false, CryptoKeyElementWriteAccess=WA_ALLOWED
        Crypto_30_LibCv_Random_Data: CryptoKeyElementSize=20, CryptoKeyElementId=1, CryptoKeyElementReadAccess=RA_ALLOWED, CryptoKeyElementAllowPartialAccess=false, CryptoKeyElementPersist=false, CryptoKeyElementWriteAccess=WA_ALLOWED
        Crypto_30_LibCv_KeyGenerate_Seed: CryptoKeyElementSize=16, CryptoKeyElementId=16, CryptoKeyElementReadAccess=RA_ALLOWED, CryptoKeyElementAllowPartialAccess=false, CryptoKeyElementPersist=false, CryptoKeyElementWriteAccess=WA_ALLOWED
        Crypto_30_LibCv_KeyGenerate_Key: CryptoKeyElementSize=32, CryptoKeyElementId=1, CryptoKeyElementReadAccess=RA_ALLOWED, CryptoKeyElementAllowPartialAccess=false, CryptoKeyElementPersist=true, CryptoKeyElementWriteAccess=WA_ALLOWED
        Crypto_30_LibCv_KeyExchange_SharedValue: CryptoKeyElementSize=32, CryptoKeyElementId=1, CryptoKeyElementReadAccess=RA_ALLOWED, CryptoKeyElementAllowPartialAccess=false, CryptoKeyElementPersist=false, CryptoKeyElementWriteAccess=WA_ALLOWED
        Crypto_30_LibCv_KeyExchange_PrivKey: CryptoKeyElementSize=32, CryptoKeyElementId=9, CryptoKeyElementReadAccess=RA_ALLOWED, CryptoKeyElementAllowPartialAccess=false, CryptoKeyElementPersist=false, CryptoKeyElementWriteAccess=WA_ALLOWED
        Crypto_30_LibCv_Mac_Proof: CryptoKeyElementSize=48, CryptoKeyElementId=2, CryptoKeyElementReadAccess=RA_ALLOWED, CryptoKeyElementAllowPartialAccess=false, CryptoKeyElementPersist=false, CryptoKeyElementWriteAccess=WA_ALLOWED
        Crypto_30_LibCv_KeyDerivation_Salt: CryptoKeyElementSize=6, CryptoKeyElementId=13, CryptoKeyElementReadAccess=RA_ALLOWED, CryptoKeyElementAllowPartialAccess=false, CryptoKeyElementPersist=false, CryptoKeyElementWriteAccess=WA_ALLOWED
        Crypto_30_LibCv_KeyExchange_OwnPubKey: CryptoKeyElementSize=32, CryptoKeyElementReadAccess=RA_ALLOWED, CryptoKeyElementId=10, CryptoKeyElementAllowPartialAccess=false, CryptoKeyElementPersist=false, CryptoKeyElementWriteAccess=WA_ALLOWED
        Crypto_30_LibCv_KeyExchange_Base: CryptoKeyElementSize=16, CryptoKeyElementId=8, CryptoKeyElementReadAccess=RA_ALLOWED, CryptoKeyElementAllowPartialAccess=false, CryptoKeyElementPersist=false, CryptoKeyElementWriteAccess=WA_ALLOWED
        Crypto_30_LibCv_KeyDerivation_Password: CryptoKeyElementSize=32, CryptoKeyElementId=1, CryptoKeyElementReadAccess=RA_ALLOWED, CryptoKeyElementAllowPartialAccess=false, CryptoKeyElementPersist=false, CryptoKeyElementWriteAccess=WA_ALLOWED
        Crypto_30_LibCv_KeyDerivation_Label: CryptoKeyElementId=130, CryptoKeyElementSize=4, CryptoKeyElementReadAccess=RA_ALLOWED, CryptoKeyElementAllowPartialAccess=false, CryptoKeyElementPersist=false, CryptoKeyElementWriteAccess=WA_ALLOWED
        Crypto_30_LibCv_Cipher_Key: CryptoKeyElementSize=16, CryptoKeyElementId=1, CryptoKeyElementReadAccess=RA_ALLOWED, CryptoKeyElementAllowPartialAccess=false, CryptoKeyElementPersist=false, CryptoKeyElementWriteAccess=WA_ALLOWED
        Crypto_30_LibCv_Cipher_IV: CryptoKeyElementSize=16, CryptoKeyElementId=5, CryptoKeyElementReadAccess=RA_ALLOWED, CryptoKeyElementAllowPartialAccess=false, CryptoKeyElementPersist=false, CryptoKeyElementWriteAccess=WA_ALLOWED
        Crypto_30_LibCv_Cipher_Proof: CryptoKeyElementSize=48, CryptoKeyElementId=6, CryptoKeyElementReadAccess=RA_ALLOWED, CryptoKeyElementAllowPartialAccess=false, CryptoKeyElementPersist=false, CryptoKeyElementWriteAccess=WA_ALLOWED
        Crypto_30_LibCv_Mac_Key: CryptoKeyElementSize=16, CryptoKeyElementId=1, CryptoKeyElementReadAccess=RA_ALLOWED, CryptoKeyElementAllowPartialAccess=false, CryptoKeyElementPersist=false, CryptoKeyElementWriteAccess=WA_ALLOWED
        Crypto_30_LibCv_Hash_Result: CryptoKeyElementSize=20, CryptoKeyElementId=1, CryptoKeyElementReadAccess=RA_ALLOWED, CryptoKeyElementAllowPartialAccess=false, CryptoKeyElementPersist=false, CryptoKeyElementWriteAccess=WA_ALLOWED
        Crypto_30_LibCv_KeyDerive_Algorithm: CryptoKeyElementId=15, CryptoKeyElementInitValue=0x00, CryptoKeyElementSize=1, CryptoKeyElementReadAccess=RA_ALLOWED, CryptoKeyElementAllowPartialAccess=false, CryptoKeyElementPersist=false, CryptoKeyElementWriteAccess=WA_ALLOWED
        Crypto_30_LibCv_KeyGenerate_Algorithm: CryptoKeyElementId=17, CryptoKeyElementInitValue=0x00, CryptoKeyElementSize=1, CryptoKeyElementReadAccess=RA_ALLOWED, CryptoKeyElementAllowPartialAccess=false, CryptoKeyElementPersist=false, CryptoKeyElementWriteAccess=WA_ALLOWED
        Crypto_30_LibCv_KeyExchange_Algorithm_X25519: CryptoKeyElementId=12, CryptoKeyElementInitValue=0x00, CryptoKeyElementSize=1, CryptoKeyElementReadAccess=RA_ALLOWED, CryptoKeyElementAllowPartialAccess=false, CryptoKeyElementPersist=false, CryptoKeyElementWriteAccess=WA_ALLOWED
        Crypto_30_LibCv_Signature_Rsa_Modulus: CryptoKeyElementSize=128, CryptoKeyElementId=160, CryptoKeyElementReadAccess=RA_ALLOWED, CryptoKeyElementAllowPartialAccess=false, CryptoKeyElementPersist=false, CryptoKeyElementWriteAccess=WA_ALLOWED
        Crypto_30_LibCv_Signature_Rsa_Pub_Exponent: CryptoKeyElementSize=3, CryptoKeyElementId=161, CryptoKeyElementReadAccess=RA_ALLOWED, CryptoKeyElementAllowPartialAccess=false, CryptoKeyElementPersist=false, CryptoKeyElementWriteAccess=WA_ALLOWED
        Crypto_30_LibCv_Signature_Rsa_Priv_Exponent: CryptoKeyElementSize=128, CryptoKeyElementId=162, CryptoKeyElementReadAccess=RA_ALLOWED, CryptoKeyElementAllowPartialAccess=false, CryptoKeyElementPersist=false, CryptoKeyElementWriteAccess=WA_ALLOWED
        Crypto_30_LibCv_Signature_Rsa_Salt: CryptoKeyElementSize=32, CryptoKeyElementId=163, CryptoKeyElementReadAccess=RA_ALLOWED, CryptoKeyElementAllowPartialAccess=false, CryptoKeyElementPersist=false, CryptoKeyElementWriteAccess=WA_ALLOWED
        Crypto_30_LibCv_Signature_Rsa_SaltLength: CryptoKeyElementId=164, CryptoKeyElementSize=2, CryptoKeyElementReadAccess=RA_ALLOWED, CryptoKeyElementAllowPartialAccess=false, CryptoKeyElementPersist=false, CryptoKeyElementWriteAccess=WA_ALLOWED
        Crypto_30_LibCv_Mac_Acceleration_Aes: CryptoKeyElementId=129, CryptoKeyElementSize=256, CryptoKeyElementReadAccess=RA_DENIED, CryptoKeyElementWriteAccess=WA_DENIED, CryptoKeyElementAllowPartialAccess=false, CryptoKeyElementPersist=false
        Crypto_30_LibCv_KeyExchange_Algorithm_ANSIP256R1: CryptoKeyElementId=12, CryptoKeyElementInitValue=0x01, CryptoKeyElementSize=1, CryptoKeyElementReadAccess=RA_ALLOWED, CryptoKeyElementWriteAccess=WA_ALLOWED, CryptoKeyElementPersist=false, CryptoKeyElementAllowPartialAccess=false
        vHsm_Info_Uid: CryptoKeyElementId=3021, CryptoKeyElementSize=16, CryptoKeyElementReadAccess=RA_ALLOWED, CryptoKeyElementAllowPartialAccess=false, CryptoKeyElementPersist=true, CryptoKeyElementWriteAccess=WA_ALLOWED
        Crypto_30_LibCv_Random_Algorithm_Fips186_Sha1: CryptoKeyElementId=4, CryptoKeyElementInitValue=0x00, CryptoKeyElementSize=1, CryptoKeyElementAllowPartialAccess=false, CryptoKeyElementWriteAccess=WA_ALLOWED, CryptoKeyElementReadAccess=RA_ALLOWED, CryptoKeyElementPersist=false
        Crypto_30_LibCv_KeyExchange_PartnerPubKey: CryptoKeyElementId=3003, CryptoKeyElementWriteAccess=WA_ALLOWED, CryptoKeyElementSize=16, CryptoKeyElementReadAccess=RA_ALLOWED, CryptoKeyElementPersist=false, CryptoKeyElementAllowPartialAccess=false
        Crypto_30_LibCv_KeyDerivation_Algorithm_NIST80056A: CryptoKeyElementId=15, CryptoKeyElementInitValue=0x03, CryptoKeyElementSize=1, CryptoKeyElementReadAccess=RA_ALLOWED, CryptoKeyElementPersist=false, CryptoKeyElementAllowPartialAccess=false, CryptoKeyElementWriteAccess=WA_ALLOWED
        Crypto_30_LibCv_KeyDerivation_Algorithm_ISO15118: CryptoKeyElementId=15, CryptoKeyElementInitValue=0x04, CryptoKeyElementSize=1, CryptoKeyElementAllowPartialAccess=false, CryptoKeyElementPersist=false, CryptoKeyElementReadAccess=RA_ALLOWED, CryptoKeyElementWriteAccess=WA_ALLOWED
        Crypto_30_LibCv_KeyDerivation_Algorithm_SYM_NIST800108: CryptoKeyElementId=15, CryptoKeyElementInitValue=0x01, CryptoKeyElementSize=1, CryptoKeyElementPersist=false, CryptoKeyElementAllowPartialAccess=false, CryptoKeyElementReadAccess=RA_ALLOWED, CryptoKeyElementWriteAccess=WA_ALLOWED
        Crypto_30_LibCv_KeyDerivation_Algorithm_ASM_NISTFIPS1864: CryptoKeyElementId=15, CryptoKeyElementInitValue=0x02, CryptoKeyElementSize=1, CryptoKeyElementPersist=false, CryptoKeyElementReadAccess=RA_ALLOWED, CryptoKeyElementAllowPartialAccess=false, CryptoKeyElementWriteAccess=WA_ALLOWED
        Crypto_30_LibCv_KeyDerivation_AdditionalInfo: CryptoKeyElementId=131, CryptoKeyElementAllowPartialAccess=false, CryptoKeyElementPersist=false, CryptoKeyElementReadAccess=RA_ALLOWED, CryptoKeyElementWriteAccess=WA_ALLOWED, CryptoKeyElementSize=16
        Crypto_30_LibCv_SCC_Contract_PubKey: CryptoKeyElementId=3013, CryptoKeyElementAllowPartialAccess=false, CryptoKeyElementReadAccess=RA_ALLOWED, CryptoKeyElementWriteAccess=WA_ALLOWED, CryptoKeyElementSize=16, CryptoKeyElementPersist=false
        Crypto_30_LibCv_SCC_IV_And_Encrypted_PrivKey: CryptoKeyElementId=3014, CryptoKeyElementAllowPartialAccess=false, CryptoKeyElementReadAccess=RA_ALLOWED, CryptoKeyElementWriteAccess=WA_ALLOWED, CryptoKeyElementSize=16, CryptoKeyElementPersist=false
        Crypto_30_LibCv_Random_Algorithm: CryptoKeyElementId=4, CryptoKeyElementSize=1, CryptoKeyElementAllowPartialAccess=false, CryptoKeyElementReadAccess=RA_ALLOWED, CryptoKeyElementPersist=false, CryptoKeyElementWriteAccess=WA_ALLOWED
        Crypto_30_LibCv_Random_Algorithm_Nist_800_90A_DRBG_AES128: CryptoKeyElementId=4, CryptoKeyElementSize=1, CryptoKeyElementInitValue=0x01, CryptoKeyElementAllowPartialAccess=false, CryptoKeyElementReadAccess=RA_ALLOWED, CryptoKeyElementPersist=false, CryptoKeyElementWriteAccess=WA_ALLOWED
        Crypto_30_LibCv_Random_AdditinalInput: CryptoKeyElementId=3016, CryptoKeyElementWriteAccess=WA_ALLOWED, CryptoKeyElementSize=16, CryptoKeyElementReadAccess=RA_ALLOWED, CryptoKeyElementPersist=false, CryptoKeyElementAllowPartialAccess=false
        Crypto_30_LibCv_Random_PrivateString: CryptoKeyElementId=3015, CryptoKeyElementAllowPartialAccess=false, CryptoKeyElementReadAccess=RA_ALLOWED, CryptoKeyElementSize=16, CryptoKeyElementPersist=false, CryptoKeyElementWriteAccess=WA_ALLOWED
        Crypto_30_LibCv_Random_Nonce: CryptoKeyElementId=3017, CryptoKeyElementAllowPartialAccess=false, CryptoKeyElementReadAccess=RA_ALLOWED, CryptoKeyElementPersist=false, CryptoKeyElementSize=16, CryptoKeyElementWriteAccess=WA_ALLOWED
        Crypto_30_LibCv_Random_Reseed_Counter: CryptoKeyElementId=3018, CryptoKeyElementWriteAccess=WA_DENIED, CryptoKeyElementAllowPartialAccess=false, CryptoKeyElementSize=4, CryptoKeyElementInitValue=0 0 0 1, CryptoKeyElementPersist=true, CryptoKeyElementReadAccess=RA_ALLOWED
        Crypto_30_LibCv_Signature_RsaCrt_PrimeP: CryptoKeyElementId=3051, CryptoKeyElementAllowPartialAccess=false, CryptoKeyElementReadAccess=RA_ALLOWED, CryptoKeyElementWriteAccess=WA_ALLOWED, CryptoKeyElementPersist=false, CryptoKeyElementSize=16
        Crypto_30_LibCv_Signature_RsaCrt_PrimeQ: CryptoKeyElementId=3052, CryptoKeyElementAllowPartialAccess=false, CryptoKeyElementReadAccess=RA_ALLOWED, CryptoKeyElementWriteAccess=WA_ALLOWED, CryptoKeyElementSize=16, CryptoKeyElementPersist=false
        Crypto_30_LibCv_Signature_RsaCrt_ExponentDp: CryptoKeyElementId=3053, CryptoKeyElementAllowPartialAccess=false, CryptoKeyElementReadAccess=RA_ALLOWED, CryptoKeyElementSize=16, CryptoKeyElementPersist=false, CryptoKeyElementWriteAccess=WA_ALLOWED
        Crypto_30_LibCv_Signature_RsaCrt_ExponentDq: CryptoKeyElementId=3054, CryptoKeyElementAllowPartialAccess=false, CryptoKeyElementReadAccess=RA_ALLOWED, CryptoKeyElementWriteAccess=WA_ALLOWED, CryptoKeyElementSize=16, CryptoKeyElementPersist=false
        Crypto_30_LibCv_Signature_RsaCrt_InverseQi: CryptoKeyElementId=3055, CryptoKeyElementAllowPartialAccess=false, CryptoKeyElementReadAccess=RA_ALLOWED, CryptoKeyElementWriteAccess=WA_ALLOWED, CryptoKeyElementPersist=false, CryptoKeyElementSize=16
        Crypto_30_LibCv_KeyExchange_Algorithm_SECP256R1: CryptoKeyElementId=12, CryptoKeyElementInitValue=0x02, CryptoKeyElementSize=1, CryptoKeyElementReadAccess=RA_ALLOWED, CryptoKeyElementWriteAccess=WA_ALLOWED, CryptoKeyElementAllowPartialAccess=false, CryptoKeyElementPersist=false
        vHsm_Info_ErrorLog: CryptoKeyElementId=3023, CryptoKeyElementSize=32, CryptoKeyElementReadAccess=RA_ALLOWED, CryptoKeyElementAllowPartialAccess=true, CryptoKeyElementPersist=true, CryptoKeyElementWriteAccess=WA_ALLOWED
        Crypto_30_LibCv_Signature_Rsa_PrimeP: CryptoKeyElementId=3051, CryptoKeyElementSize=16, CryptoKeyElementReadAccess=RA_ALLOWED, CryptoKeyElementPersist=false, CryptoKeyElementAllowPartialAccess=false, CryptoKeyElementWriteAccess=WA_ALLOWED
        Crypto_30_LibCv_Signature_Rsa_PrimeQ: CryptoKeyElementId=3052, CryptoKeyElementWriteAccess=WA_ALLOWED, CryptoKeyElementSize=16, CryptoKeyElementReadAccess=RA_ALLOWED, CryptoKeyElementPersist=false, CryptoKeyElementAllowPartialAccess=false
        Crypto_30_LibCv_Signature_Rsa_ExponentDp: CryptoKeyElementId=3053, CryptoKeyElementReadAccess=RA_ALLOWED, CryptoKeyElementWriteAccess=WA_ALLOWED, CryptoKeyElementPersist=false, CryptoKeyElementAllowPartialAccess=false, CryptoKeyElementSize=16
        Crypto_30_LibCv_Signature_Rsa_ExponentDq: CryptoKeyElementId=3054, CryptoKeyElementSize=16, CryptoKeyElementWriteAccess=WA_ALLOWED, CryptoKeyElementReadAccess=RA_ALLOWED, CryptoKeyElementPersist=false, CryptoKeyElementAllowPartialAccess=false
        Crypto_30_LibCv_Signature_Rsa_InverseQi: CryptoKeyElementId=3055, CryptoKeyElementAllowPartialAccess=false, CryptoKeyElementPersist=false, CryptoKeyElementReadAccess=RA_ALLOWED, CryptoKeyElementSize=16, CryptoKeyElementWriteAccess=WA_ALLOWED
        Crypto_30_LibCv_Random_Seed_Nist_800_90A_DRBG_AES128: CryptoKeyElementId=3, CryptoKeyElementAllowPartialAccess=false, CryptoKeyElementReadAccess=RA_DENIED, CryptoKeyElementSize=32, CryptoKeyElementPersist=true, CryptoKeyElementWriteAccess=WA_ALLOWED
        Crypto_30_LibCv_Random_AdditionalInput: CryptoKeyElementId=3016, CryptoKeyElementAllowPartialAccess=false, CryptoKeyElementPersist=false, CryptoKeyElementReadAccess=RA_ALLOWED, CryptoKeyElementSize=16, CryptoKeyElementWriteAccess=WA_ALLOWED
        Crypto_30_LibCv_Mac_Key_She: CryptoKeyElementId=1, CryptoKeyElementWriteAccess=WA_ENCRYPTED, CryptoKeyElementSize=16, CryptoKeyElementAllowPartialAccess=false, CryptoKeyElementPersist=true, CryptoKeyElementReadAccess=RA_DENIED
        Crypto_30_LibCv_Cipher_Key_She: CryptoKeyElementId=1, CryptoKeyElementWriteAccess=WA_ENCRYPTED, CryptoKeyElementSize=16, CryptoKeyElementReadAccess=RA_DENIED, CryptoKeyElementAllowPartialAccess=false, CryptoKeyElementPersist=true
        Crypto_30_LibCv_She_UId: CryptoKeyElementSize=15, CryptoKeyElementId=3021, CryptoKeyElementAllowPartialAccess=false, CryptoKeyElementPersist=false, CryptoKeyElementReadAccess=RA_ALLOWED, CryptoKeyElementWriteAccess=WA_DENIED, CryptoKeyElementInitValue=0 0 0 0 0 0 0 0 0 0 0 0 0 0 0
        Crypto_30_LibCv_She_Counter: CryptoKeyElementId=3019, CryptoKeyElementSize=4, CryptoKeyElementWriteAccess=WA_DENIED, CryptoKeyElementAllowPartialAccess=false, CryptoKeyElementPersist=false, CryptoKeyElementReadAccess=RA_ALLOWED, CryptoKeyElementInitValue=0 0 0 0
        Crypto_30_LibCv_She_BootProtection: CryptoKeyElementId=3056, CryptoKeyElementSize=1, CryptoKeyElementReadAccess=RA_ALLOWED, CryptoKeyElementAllowPartialAccess=false, CryptoKeyElementPersist=false, CryptoKeyElementWriteAccess=WA_ALLOWED
        Crypto_30_LibCv_She_DebuggerProtection: CryptoKeyElementId=3057, CryptoKeyElementSize=1, CryptoKeyElementReadAccess=RA_ALLOWED, CryptoKeyElementAllowPartialAccess=false, CryptoKeyElementPersist=false, CryptoKeyElementWriteAccess=WA_ALLOWED
        vHsm_LazyPersistKey: CryptoKeyElementSize=16, CryptoKeyElementId=1, CryptoKeyElementReadAccess=RA_ALLOWED, CryptoKeyElementAllowPartialAccess=false, CryptoKeyElementPersist=true, CryptoKeyElementWriteAccess=WA_ALLOWED
        Crypto_30_LibCv_Rsa_Modulus: CryptoKeyElementId=160, CryptoKeyElementAllowPartialAccess=false, CryptoKeyElementPersist=false, CryptoKeyElementReadAccess=RA_ALLOWED, CryptoKeyElementSize=16, CryptoKeyElementWriteAccess=WA_ALLOWED
        Crypto_30_LibCv_Rsa_Pub_Exponent: CryptoKeyElementId=161, CryptoKeyElementAllowPartialAccess=false, CryptoKeyElementPersist=false, CryptoKeyElementReadAccess=RA_ALLOWED, CryptoKeyElementSize=16, CryptoKeyElementWriteAccess=WA_ALLOWED
        Crypto_30_LibCv_Rsa_Priv_Exponent: CryptoKeyElementId=162, CryptoKeyElementAllowPartialAccess=false, CryptoKeyElementPersist=false, CryptoKeyElementReadAccess=RA_ALLOWED, CryptoKeyElementSize=16, CryptoKeyElementWriteAccess=WA_ALLOWED
        Crypto_30_LibCv_Rsa_Salt: CryptoKeyElementId=163, CryptoKeyElementAllowPartialAccess=false, CryptoKeyElementPersist=false, CryptoKeyElementReadAccess=RA_ALLOWED, CryptoKeyElementSize=16, CryptoKeyElementWriteAccess=WA_ALLOWED
        Crypto_30_LibCv_Rsa_SaltLength: CryptoKeyElementId=164, CryptoKeyElementSize=2, CryptoKeyElementAllowPartialAccess=false, CryptoKeyElementPersist=false, CryptoKeyElementReadAccess=RA_ALLOWED, CryptoKeyElementWriteAccess=WA_ALLOWED
        Crypto_30_LibCv_Rsa_PrimeP: CryptoKeyElementId=3051, CryptoKeyElementAllowPartialAccess=false, CryptoKeyElementPersist=false, CryptoKeyElementReadAccess=RA_ALLOWED, CryptoKeyElementSize=16, CryptoKeyElementWriteAccess=WA_ALLOWED
        Crypto_30_LibCv_Rsa_PrimeQ: CryptoKeyElementId=3052, CryptoKeyElementAllowPartialAccess=false, CryptoKeyElementPersist=false, CryptoKeyElementReadAccess=RA_ALLOWED, CryptoKeyElementSize=16, CryptoKeyElementWriteAccess=WA_ALLOWED
        Crypto_30_LibCv_Rsa_ExponentDp: CryptoKeyElementId=3053, CryptoKeyElementAllowPartialAccess=false, CryptoKeyElementPersist=false, CryptoKeyElementReadAccess=RA_ALLOWED, CryptoKeyElementSize=16, CryptoKeyElementWriteAccess=WA_ALLOWED
        Crypto_30_LibCv_Rsa_ExponentDq: CryptoKeyElementId=3054, CryptoKeyElementAllowPartialAccess=false, CryptoKeyElementPersist=false, CryptoKeyElementReadAccess=RA_ALLOWED, CryptoKeyElementSize=16, CryptoKeyElementWriteAccess=WA_ALLOWED
        Crypto_30_LibCv_Rsa_InverseQi: CryptoKeyElementId=3055, CryptoKeyElementAllowPartialAccess=false, CryptoKeyElementPersist=false, CryptoKeyElementReadAccess=RA_ALLOWED, CryptoKeyElementSize=16, CryptoKeyElementWriteAccess=WA_ALLOWED
        Crypto_30_LibCv_Label: CryptoKeyElementId=3058, CryptoKeyElementAllowPartialAccess=false, CryptoKeyElementPersist=false, CryptoKeyElementReadAccess=RA_ALLOWED, CryptoKeyElementSize=16, CryptoKeyElementWriteAccess=WA_ALLOWED
        Crypto_30_LibCv_KeyExchange_Algorithm_SECP384R1: CryptoKeyElementId=12, CryptoKeyElementInitValue=0x04, CryptoKeyElementSize=1, CryptoKeyElementAllowPartialAccess=false, CryptoKeyElementPersist=false, CryptoKeyElementReadAccess=RA_ALLOWED, CryptoKeyElementWriteAccess=WA_ALLOWED
        vHsm_SecureBoot_Mode: CryptoKeyElementId=3039, CryptoKeyElementSize=1, CryptoKeyElementAllowPartialAccess=false, CryptoKeyElementReadAccess=RA_DENIED, CryptoKeyElementWriteAccess=WA_DENIED, CryptoKeyElementPersist=true, CryptoKeyElementInitValue=0
        vHsm_SecureBoot_Result: CryptoKeyElementId=3037, CryptoKeyElementSize=1, CryptoKeyElementAllowPartialAccess=false, CryptoKeyElementReadAccess=RA_ALLOWED, CryptoKeyElementWriteAccess=WA_DENIED, CryptoKeyElementPersist=false, CryptoKeyElementInitValue=0
        vHsm_SecureBoot_Cmac: CryptoKeyElementId=3026, CryptoKeyElementSize=16, CryptoKeyElementPersist=true, CryptoKeyElementWriteAccess=WA_DENIED, CryptoKeyElementAllowPartialAccess=true, CryptoKeyElementReadAccess=RA_DENIED, CryptoKeyElementInitValue=0
        vHsm_SecureBoot_Address: CryptoKeyElementId=3024, CryptoKeyElementAllowPartialAccess=false, CryptoKeyElementSize=4, CryptoKeyElementWriteAccess=WA_DENIED, CryptoKeyElementPersist=true, CryptoKeyElementReadAccess=RA_DENIED, CryptoKeyElementInitValue=0 0 0 0
        vHsm_SecureBoot_Key: CryptoKeyElementId=1, CryptoKeyElementSize=16, CryptoKeyElementAllowPartialAccess=false, CryptoKeyElementReadAccess=RA_DENIED, CryptoKeyElementPersist=true, CryptoKeyElementWriteAccess=WA_DENIED, CryptoKeyElementInitValue=0 0 0 0 0 0 0 0 0 0 0 0 0 0 0 0
        vHsm_SecureBoot_Size: CryptoKeyElementId=3025, CryptoKeyElementSize=4, CryptoKeyElementAllowPartialAccess=false, CryptoKeyElementWriteAccess=WA_DENIED, CryptoKeyElementReadAccess=RA_DENIED, CryptoKeyElementPersist=true, CryptoKeyElementInitValue=0 0 0 0
        vHsm_SecureBoot_Sanction: CryptoKeyElementId=3027, CryptoKeyElementSize=1, CryptoKeyElementAllowPartialAccess=false, CryptoKeyElementReadAccess=RA_ALLOWED, CryptoKeyElementWriteAccess=WA_DENIED, CryptoKeyElementPersist=true, CryptoKeyElementInitValue=0
        Crypto_30_LibCv_She_Secret_Key: CryptoKeyElementSize=16, CryptoKeyElementId=1, CryptoKeyElementReadAccess=RA_DENIED, CryptoKeyElementAllowPartialAccess=false, CryptoKeyElementPersist=false, CryptoKeyElementWriteAccess=WA_DENIED, CryptoKeyElementInitValue=0 0 0 0 0 0 0 0 0 0 0 0 0 0 0 0
        Crypto_30_LibCv_KeyDerivation_Algorithm_KDF_X963_SHA256: CryptoKeyElementId=15, CryptoKeyElementInitValue=0x06, CryptoKeyElementSize=1, CryptoKeyElementAllowPartialAccess=false, CryptoKeyElementPersist=false, CryptoKeyElementReadAccess=RA_ALLOWED, CryptoKeyElementWriteAccess=WA_ALLOWED
        Crypto_30_LibCv_Mac_Key_She_Ram: CryptoKeyElementId=1, CryptoKeyElementWriteAccess=WA_ALLOWED, CryptoKeyElementSize=16, CryptoKeyElementReadAccess=RA_ENCRYPTED, CryptoKeyElementAllowPartialAccess=false, CryptoKeyElementPersist=false
        Crypto_30_LibCv_Cipher_Key_She_Ram: CryptoKeyElementId=1, CryptoKeyElementWriteAccess=WA_ALLOWED, CryptoKeyElementSize=16, CryptoKeyElementReadAccess=RA_ENCRYPTED, CryptoKeyElementPersist=false, CryptoKeyElementAllowPartialAccess=false
        Crypto_30_LibCv_Cipher_2NDKey: CryptoKeyElementId=7, CryptoKeyElementSize=16, CryptoKeyElementReadAccess=RA_ALLOWED, CryptoKeyElementAllowPartialAccess=false, CryptoKeyElementPersist=false, CryptoKeyElementWriteAccess=WA_ALLOWED
        Crypto_30_LibCv_KeyM_CertificateData: CryptoKeyElementId=0, CryptoKeyElementSize=1500, CryptoKeyElementReadAccess=RA_ALLOWED, CryptoKeyElementAllowPartialAccess=false, CryptoKeyElementPersist=false, CryptoKeyElementWriteAccess=WA_ALLOWED
        vHsm_KeyDerivation_Algorithm_NIST800108_CMAC: CryptoKeyElementId=15, CryptoKeyElementSize=1, CryptoKeyElementAllowPartialAccess=false, CryptoKeyElementWriteAccess=WA_DENIED, CryptoKeyElementInitValue=8, CryptoKeyElementPersist=false, CryptoKeyElementReadAccess=RA_ALLOWED
        vHsm_KeyDerivation_Label: CryptoKeyElementId=130, CryptoKeyElementPersist=false, CryptoKeyElementAllowPartialAccess=true, CryptoKeyElementReadAccess=RA_ALLOWED, CryptoKeyElementSize=16, CryptoKeyElementWriteAccess=WA_ALLOWED
        vHsm_KeyDerivation_Context: CryptoKeyElementId=132, CryptoKeyElementPersist=false, CryptoKeyElementAllowPartialAccess=true, CryptoKeyElementReadAccess=RA_ALLOWED, CryptoKeyElementSize=16, CryptoKeyElementWriteAccess=WA_ALLOWED
        vHsm_KeyDerivation_Password: CryptoKeyElementId=1, CryptoKeyElementSize=16, CryptoKeyElementPersist=false, CryptoKeyElementAllowPartialAccess=false, CryptoKeyElementReadAccess=RA_ALLOWED, CryptoKeyElementWriteAccess=WA_ALLOWED
        Crypto_30_LibCv_Cipher_ConstIV: CryptoKeyElementSize=16, CryptoKeyElementId=5, CryptoKeyElementReadAccess=RA_DENIED, CryptoKeyElementAllowPartialAccess=false, CryptoKeyElementPersist=false, CryptoKeyElementWriteAccess=WA_DENIED, CryptoKeyElementInitValue=0 0 0 0 0 0 0 0 0 0 0 0 0 0 0 0
        Crypto_30_LibCv_KeyGenerate_Algorithm_Symmetric_Generic: CryptoKeyElementId=17, CryptoKeyElementInitValue=0, CryptoKeyElementSize=1, CryptoKeyElementAllowPartialAccess=false, CryptoKeyElementPersist=false, CryptoKeyElementReadAccess=RA_ALLOWED, CryptoKeyElementWriteAccess=WA_ALLOWED
        Crypto_30_LibCv_KeyGenerate_Algorithm_Ansi_Nist_Sec_P256R1: CryptoKeyElementId=17, CryptoKeyElementInitValue=1, CryptoKeyElementSize=1, CryptoKeyElementAllowPartialAccess=false, CryptoKeyElementPersist=false, CryptoKeyElementReadAccess=RA_ALLOWED, CryptoKeyElementWriteAccess=WA_ALLOWED
        Crypto_30_LibCv_KeyGenerate_Algorithm_Nist_Sec_P384R1: CryptoKeyElementId=17, CryptoKeyElementInitValue=2, CryptoKeyElementSize=1, CryptoKeyElementAllowPartialAccess=false, CryptoKeyElementPersist=false, CryptoKeyElementReadAccess=RA_ALLOWED, CryptoKeyElementWriteAccess=WA_ALLOWED
        vHsm_FirmwareUpdate_Internal_Key: CryptoKeyElementSize=16, CryptoKeyElementId=1, CryptoKeyElementReadAccess=RA_DENIED, CryptoKeyElementAllowPartialAccess=false, CryptoKeyElementPersist=false, CryptoKeyElementWriteAccess=WA_DENIED, CryptoKeyElementInitValue=0 0 0 0 0 0 0 0 0 0 0 0 0 0 0 0
        vHsm_FirmwareUpdate_IV: CryptoKeyElementSize=16, CryptoKeyElementId=5, CryptoKeyElementReadAccess=RA_DENIED, CryptoKeyElementAllowPartialAccess=false, CryptoKeyElementPersist=false, CryptoKeyElementWriteAccess=WA_DENIED, CryptoKeyElementInitValue=0x53 0x70 0x65 0x7A 0x69 0x61 0x6C 0x45 0x69 0x57 0x6F 0x6D 0x69 0x73 0x61 0x75
        vHsm_FirmwareUpdate_Decrypt_Key: CryptoKeyElementSize=16, CryptoKeyElementId=1, CryptoKeyElementReadAccess=RA_DENIED, CryptoKeyElementAllowPartialAccess=false, CryptoKeyElementPersist=false, CryptoKeyElementWriteAccess=WA_DENIED, CryptoKeyElementInitValue=0x92 0x12 0x2a 0x4c 0x92 0x3b 0x39 0x21 0x7e 0x1b 0xb0 0x69 0x8d 0x69 0x1d 0x1b
        Crypto_30_LibCv_KeyDerivation_Iterations_PBKDF2: CryptoKeyElementId=14, CryptoKeyElementSize=4, CryptoKeyElementReadAccess=RA_ALLOWED, CryptoKeyElementAllowPartialAccess=false, CryptoKeyElementPersist=false, CryptoKeyElementWriteAccess=WA_ALLOWED
        Crypto_30_LibCv_KeyDerivation_Algorithm_PBKDF2_HMAC_SHA1: CryptoKeyElementId=15, CryptoKeyElementInitValue=0x09, CryptoKeyElementSize=1, CryptoKeyElementReadAccess=RA_ALLOWED, CryptoKeyElementAllowPartialAccess=false, CryptoKeyElementPersist=false, CryptoKeyElementWriteAccess=WA_ALLOWED
        Crypto_30_LibCv_KeyDerivation_Algorithm_PBKDF2_HMAC_SHA256: CryptoKeyElementId=15, CryptoKeyElementInitValue=0x0A, CryptoKeyElementSize=1, CryptoKeyElementReadAccess=RA_ALLOWED, CryptoKeyElementAllowPartialAccess=false, CryptoKeyElementPersist=false, CryptoKeyElementWriteAccess=WA_ALLOWED
        Crypto_30_LibCv_KeyDerivation_Algorithm_KDF_X963_SHA512: CryptoKeyElementId=15, CryptoKeyElementInitValue=0x07, CryptoKeyElementSize=1, CryptoKeyElementReadAccess=RA_ALLOWED, CryptoKeyElementAllowPartialAccess=false, CryptoKeyElementPersist=false, CryptoKeyElementWriteAccess=WA_ALLOWED
        Crypto_30_LibCv_Aead_ChaCha_Key: CryptoKeyElementId=1, CryptoKeyElementSize=32, CryptoKeyElementReadAccess=RA_ALLOWED, CryptoKeyElementAllowPartialAccess=false, CryptoKeyElementPersist=false, CryptoKeyElementWriteAccess=WA_ALLOWED
        Crypto_30_LibCv_Aead_ChaCha_Nonce: CryptoKeyElementId=5, CryptoKeyElementSize=12, CryptoKeyElementReadAccess=RA_ALLOWED, CryptoKeyElementAllowPartialAccess=false, CryptoKeyElementPersist=false, CryptoKeyElementWriteAccess=WA_ALLOWED
        Crypto_30_LibCv_Random_Algorithm_Nist_800_90A_DRBG_AES128_DF: CryptoKeyElementId=4, CryptoKeyElementSize=1, CryptoKeyElementInitValue=2, CryptoKeyElementReadAccess=RA_ALLOWED, CryptoKeyElementAllowPartialAccess=false, CryptoKeyElementPersist=false, CryptoKeyElementWriteAccess=WA_ALLOWED
        Crypto_30_LibCv_Random_Algorithm_Nist_800_90A_DRBG_HASH_SHA2_512: CryptoKeyElementId=4, CryptoKeyElementSize=1, CryptoKeyElementInitValue=3, CryptoKeyElementReadAccess=RA_ALLOWED, CryptoKeyElementAllowPartialAccess=false, CryptoKeyElementPersist=false, CryptoKeyElementWriteAccess=WA_ALLOWED
        Crypto_30_LibCv_Random_Seed_Nist_800_90A_DRBG_HASH_SHA2_512: CryptoKeyElementId=3, CryptoKeyElementAllowPartialAccess=false, CryptoKeyElementReadAccess=RA_DENIED, CryptoKeyElementSize=222, CryptoKeyElementPersist=false, CryptoKeyElementWriteAccess=WA_ALLOWED
        Diagnostic_Backend_Cert_Test: CryptoKeyElementId=1, CryptoKeyElementSize=401, CryptoKeyElementReadAccess=RA_ALLOWED, CryptoKeyElementAllowPartialAccess=false, CryptoKeyElementPersist=false, CryptoKeyElementWriteAccess=WA_ALLOWED, CryptoKeyElementInitValue=0x30 0x82 0x01 0x8D 0x30 0x82 0x01 0x35 0xA0 0x03 0x02 0x01 0x02 0x02 0x01 0x02 0x30 0x0F 0x06 0x0D 0x2B 0x06 0x01 0x04 0x01 0x96 0x64 0x03 0x06 0x83 0x7D 0x05 0x6E 0x30 0x12 0x31 0x10 0x30 0x0E 0x06 0x03 0x55 0x04 0x03 0x0C 0x07 0x41 0x41 0x30 0x30 0x30 0x30 0x31 0x30 0x20 0x17 0x0D 0x31 0x38 0x30 0x36 0x31 0x35 0x31 0x33 0x32 0x36 0x32 0x31 0x5A 0x18 0x0F 0x39 0x39 0x39 0x39 0x31 0x32 0x33 0x31 0x32 0x32 0x35 0x39 0x35 0x39 0x5A 0x30 0x12 0x31 0x10 0x30 0x0E 0x06 0x03 0x55 0x04 0x03 0x0C 0x07 0x41 0x42 0x30 0x30 0x30 0x30 0x31 0x30 0x34 0x30 0x0F 0x06 0x0D 0x2B 0x06 0x01 0x04 0x01 0x96 0x64 0x03 0x06 0x83 0x7D 0x05 0x6E 0x03 0x21 0x00 0x1E 0xF1 0x32 0xE4 0xC5 0xB3 0x04 0x06 0xD1 0xF9 0xE8 0x54 0x7E 0x57 0xD2 0xA6 0x29 0x7F 0x30 0xAF 0xA2 0x3A 0xF1 0x68 0xE6 0x28 0x64 0xF1 0x32 0x32 0x05 0xC3 0xA3 0x81 0x99 0x30 0x81 0x96 0x30 0x17 0x06 0x0D 0x2B 0x06 0x01 0x04 0x01 0x96 0x64 0x03 0x06 0x83 0x7D 0x05 0x65 0x01 0x01 0xFF 0x04 0x03 0x04 0x01 0x02 0x30 0x17 0x06 0x0D 0x2B 0x06 0x01 0x04 0x01 0x96 0x64 0x03 0x06 0x83 0x7D 0x05 0x6B 0x01 0x01 0xFF 0x04 0x03 0x04 0x01 0x00 0x30 0x1D 0x06 0x03 0x55 0x1D 0x0E 0x04 0x16 0x04 0x14 0x80 0xDD 0x45 0x58 0xCC 0x84 0xCC 0x0A 0xC1 0x64 0xD5 0x18 0xEC 0xA6 0x45 0x06 0x5B 0x96 0x14 0x36 0x30 0x12 0x06 0x03 0x55 0x1D 0x13 0x01 0x01 0xFF 0x04 0x08 0x30 0x06 0x01 0x01 0xFF 0x02 0x01 0x00 0x30 0x0E 0x06 0x03 0x55 0x1D 0x0F 0x01 0x01 0xFF 0x04 0x04 0x03 0x02 0x02 0x04 0x30 0x1F 0x06 0x03 0x55 0x1D 0x23 0x04 0x18 0x30 0x16 0x80 0x14 0x5F 0x86 0x6B 0xAB 0x6B 0x87 0x12 0xED 0x2C 0xF5 0x47 0x70 0xDF 0xCD 0xA1 0x40 0x7B 0x96 0xB0 0xAB 0x30 0x0F 0x06 0x0D 0x2B 0x06 0x01 0x04 0x01 0x96 0x64 0x03 0x06 0x83 0x7D 0x05 0x6E 0x03 0x41 0x00 0x90 0xE2 0x55 0x3C 0x18 0x7B 0xAD 0xA4 0x1E 0x71 0xC6 0xCA 0xDB 0x7B 0x84 0xCA 0xE5 0x3E 0xD8 0x01 0x99 0x08 0x15 0x09 0x3C 0xCF 0x62 0xF4 0xCE 0x3C 0x81 0x15 0x9C 0x74 0x87 0xB4 0x76 0x79 0x69 0xFD 0x0B 0x88 0x05 0x69 0x9B 0x29 0x6D 0x28 0xDB 0xBA 0x14 0xCD 0x0F 0x58 0x33 0x1B 0x5A 0xA3 0x24 0x80 0x3E 0x8E 0x46 0x05
        Diagnostic_Root_Cert_Test: CryptoKeyElementId=1, CryptoKeyElementSize=292, CryptoKeyElementReadAccess=RA_ALLOWED, CryptoKeyElementAllowPartialAccess=false, CryptoKeyElementPersist=false, CryptoKeyElementWriteAccess=WA_ALLOWED, CryptoKeyElementInitValue=0x30 0x82 0x01 0x20 0x30 0x81 0xD3 0xA0 0x03 0x02 0x01 0x02 0x02 0x08 0x69 0x43 0x9B 0x49 0x78 0x93 0x6D 0x4B 0x30 0x05 0x06 0x03 0x2B 0x65 0x70 0x30 0x12 0x31 0x10 0x30 0x0E 0x06 0x03 0x55 0x04 0x03 0x0C 0x07 0x45 0x41 0x30 0x30 0x30 0x30 0x31 0x30 0x20 0x17 0x0D 0x32 0x32 0x31 0x30 0x31 0x37 0x30 0x39 0x32 0x37 0x32 0x30 0x5A 0x18 0x0F 0x39 0x39 0x39 0x39 0x31 0x32 0x33 0x31 0x32 0x33 0x35 0x39 0x35 0x39 0x5A 0x30 0x12 0x31 0x10 0x30 0x0E 0x06 0x03 0x55 0x04 0x03 0x0C 0x07 0x45 0x41 0x30 0x30 0x30 0x30 0x31 0x30 0x2A 0x30 0x05 0x06 0x03 0x2B 0x65 0x70 0x03 0x21 0x00 0xE6 0x1F 0xA2 0x53 0x49 0xAF 0x0E 0x89 0xA4 0xFD 0x32 0x43 0x5B 0x21 0x3B 0x1F 0xCA 0x1A 0x02 0x06 0x3B 0x02 0xD5 0x50 0xBC 0x1D 0x1E 0x09 0x18 0xA7 0x2C 0xBA 0xA3 0x45 0x30 0x43 0x30 0x1D 0x06 0x03 0x55 0x1D 0x0E 0x04 0x16 0x04 0x14 0x68 0x35 0x0A 0x9E 0x2C 0xB7 0xE0 0x2A 0x6E 0x46 0xD4 0x29 0xD0 0x5D 0x47 0x84 0xA2 0x56 0x6E 0xF9 0x30 0x12 0x06 0x03 0x55 0x1D 0x13 0x01 0x01 0xFF 0x04 0x08 0x30 0x06 0x01 0x01 0xFF 0x02 0x01 0x02 0x30 0x0E 0x06 0x03 0x55 0x1D 0x0F 0x01 0x01 0xFF 0x04 0x04 0x03 0x02 0x02 0x04 0x30 0x05 0x06 0x03 0x2B 0x65 0x70 0x03 0x41 0x00 0x5A 0x4A 0x9D 0x20 0x50 0x6F 0xBC 0x00 0xF5 0xEB 0x16 0x81 0x9E 0xC1 0x0D 0x59 0x61 0xFD 0x03 0xB6 0xBD 0xC2 0x68 0x23 0x28 0xAE 0x74 0x7D 0x13 0x61 0x19 0x05 0xC8 0x1E 0xFD 0x4B 0xA2 0xF5 0x80 0x90 0x6E 0x74 0x33 0x96 0x43 0xDC 0x37 0x97 0xD7 0xB2 0xAD 0x1B 0x3E 0x14 0x5F 0xAD 0x08 0x51 0x70 0x95 0xF8 0x80 0x0F 0x0C
        Crypto_30_LibCv_Random_Algorithm_Nist_800_90A_DRBG_AES256: CryptoKeyElementId=4, CryptoKeyElementSize=1, CryptoKeyElementInitValue=4, CryptoKeyElementReadAccess=RA_ALLOWED, CryptoKeyElementAllowPartialAccess=false, CryptoKeyElementPersist=false, CryptoKeyElementWriteAccess=WA_ALLOWED
        Crypto_30_LibCv_Random_Algorithm_Nist_800_90A_DRBG_AES256Df: CryptoKeyElementId=4, CryptoKeyElementSize=1, CryptoKeyElementInitValue=5, CryptoKeyElementReadAccess=RA_ALLOWED, CryptoKeyElementAllowPartialAccess=false, CryptoKeyElementPersist=false, CryptoKeyElementWriteAccess=WA_ALLOWED
        Crypto_30_LibCv_Random_Seed_Nist_800_90A_DRBG_AES256: CryptoKeyElementId=3, CryptoKeyElementAllowPartialAccess=false, CryptoKeyElementReadAccess=RA_DENIED, CryptoKeyElementSize=48, CryptoKeyElementPersist=false, CryptoKeyElementWriteAccess=WA_ALLOWED
        Crypto_30_LibCv_KeyDerivation_Algorithm_HKDF_HMAC_SHA256: CryptoKeyElementId=15, CryptoKeyElementInitValue=0x0B, CryptoKeyElementSize=1, CryptoKeyElementReadAccess=RA_ALLOWED, CryptoKeyElementAllowPartialAccess=false, CryptoKeyElementPersist=false, CryptoKeyElementWriteAccess=WA_ALLOWED
        Crypto_30_LibCv_KeyDerivation_Iterations_HKDF: CryptoKeyElementId=14, CryptoKeyElementSize=1, CryptoKeyElementReadAccess=RA_ALLOWED, CryptoKeyElementAllowPartialAccess=false, CryptoKeyElementPersist=false, CryptoKeyElementWriteAccess=WA_ALLOWED
        Crypto_30_LibCv_KeyDerivation_Algorithm_Spake2Plus_P256R1: CryptoKeyElementId=15, CryptoKeyElementInitValue=0x0C, CryptoKeyElementSize=1, CryptoKeyElementReadAccess=RA_ALLOWED, CryptoKeyElementAllowPartialAccess=false, CryptoKeyElementPersist=false, CryptoKeyElementWriteAccess=WA_ALLOWED
        Crypto_30_LibCv_KeyExchange_Algorithm_Spake2Plus_Suite8: CryptoKeyElementId=12, CryptoKeyElementSize=1, CryptoKeyElementInitValue=5, CryptoKeyElementReadAccess=RA_ALLOWED, CryptoKeyElementAllowPartialAccess=false, CryptoKeyElementPersist=false, CryptoKeyElementWriteAccess=WA_ALLOWED
        Crypto_30_LibCv_KeyExchange_Algorithm_Spake2Plus_Suite8_1: CryptoKeyElementId=12, CryptoKeyElementSize=1, CryptoKeyElementInitValue=6, CryptoKeyElementReadAccess=RA_ALLOWED, CryptoKeyElementAllowPartialAccess=false, CryptoKeyElementPersist=false, CryptoKeyElementWriteAccess=WA_ALLOWED
        Crypto_30_LibCv_W0: CryptoKeyElementId=3084, CryptoKeyElementSize=16, CryptoKeyElementReadAccess=RA_ALLOWED, CryptoKeyElementAllowPartialAccess=false, CryptoKeyElementPersist=false, CryptoKeyElementWriteAccess=WA_ALLOWED
        Crypto_30_LibCv_W1: CryptoKeyElementId=3085, CryptoKeyElementSize=16, CryptoKeyElementReadAccess=RA_ALLOWED, CryptoKeyElementAllowPartialAccess=false, CryptoKeyElementPersist=false, CryptoKeyElementWriteAccess=WA_ALLOWED
        Crypto_30_LibCv_L: CryptoKeyElementId=3086, CryptoKeyElementSize=16, CryptoKeyElementReadAccess=RA_ALLOWED, CryptoKeyElementAllowPartialAccess=false, CryptoKeyElementPersist=false, CryptoKeyElementWriteAccess=WA_ALLOWED
        Crypto_30_LibCv_Verification_Result: CryptoKeyElementId=3088, CryptoKeyElementSize=1, CryptoKeyElementReadAccess=RA_ALLOWED, CryptoKeyElementAllowPartialAccess=false, CryptoKeyElementPersist=false, CryptoKeyElementWriteAccess=WA_ALLOWED
        Crypto_30_LibCv_AdditionalInfo: CryptoKeyElementId=131, CryptoKeyElementAllowPartialAccess=false, CryptoKeyElementSize=16, CryptoKeyElementReadAccess=RA_ALLOWED, CryptoKeyElementPersist=false, CryptoKeyElementWriteAccess=WA_ALLOWED
        Crypto_30_LibCv_Verification: CryptoKeyElementId=3087, CryptoKeyElementSize=16, CryptoKeyElementReadAccess=RA_ALLOWED, CryptoKeyElementAllowPartialAccess=false, CryptoKeyElementPersist=false, CryptoKeyElementWriteAccess=WA_ALLOWED
        Ssa_TrustModelEcuPrivateUniqueKey: CryptoKeyElementSize=32, CryptoKeyElementId=1, CryptoKeyElementReadAccess=RA_ALLOWED, CryptoKeyElementAllowPartialAccess=false, CryptoKeyElementPersist=true, CryptoKeyElementWriteAccess=WA_ALLOWED
        CryptoKeyElement_Cert: CryptoKeyElementId=0, CryptoKeyElementSize=1000, CryptoKeyElementReadAccess=RA_ALLOWED, CryptoKeyElementAllowPartialAccess=false, CryptoKeyElementPersist=false, CryptoKeyElementWriteAccess=WA_ALLOWED
        Crypto_30_LibCv_KeyExchange_OwnPubKey_ED25519: CryptoKeyElementSize=32, CryptoKeyElementReadAccess=RA_ALLOWED, CryptoKeyElementId=10, CryptoKeyElementAllowPartialAccess=false, CryptoKeyElementPersist=false, CryptoKeyElementWriteAccess=WA_ALLOWED
        Crypto_30_LibCv_KeyExchange_PrivKey_ED25519: CryptoKeyElementSize=32, CryptoKeyElementId=9, CryptoKeyElementReadAccess=RA_ALLOWED, CryptoKeyElementAllowPartialAccess=false, CryptoKeyElementPersist=false, CryptoKeyElementWriteAccess=WA_ALLOWED
        Crypto_30_LibCv_KeyExchange_SharedValue_ED25519: CryptoKeyElementSize=64, CryptoKeyElementId=1, CryptoKeyElementReadAccess=RA_INTERNAL_COPY, CryptoKeyElementAllowPartialAccess=false, CryptoKeyElementPersist=false, CryptoKeyElementWriteAccess=WA_INTERNAL_COPY
        Crypto_30_LibCv_KeyGenerate_Algorithm_Ed25519: CryptoKeyElementId=17, CryptoKeyElementSize=1, CryptoKeyElementInitValue=3, CryptoKeyElementWriteAccess=WA_ALLOWED, CryptoKeyElementReadAccess=RA_ALLOWED, CryptoKeyElementAllowPartialAccess=false, CryptoKeyElementPersist=false
        Crypto_30_LibCv_KeyExchange_PartnerPubKey_2: CryptoKeyElementId=3004, CryptoKeyElementSize=16, CryptoKeyElementReadAccess=RA_ALLOWED, CryptoKeyElementAllowPartialAccess=false, CryptoKeyElementPersist=false, CryptoKeyElementWriteAccess=WA_ALLOWED
        Crypto_30_LibCv_KeyExchange_Algorithm_NISTP224R1_BD: CryptoKeyElementId=12, CryptoKeyElementInitValue=3, CryptoKeyElementSize=1, CryptoKeyElementAllowPartialAccess=false, CryptoKeyElementReadAccess=RA_ALLOWED, CryptoKeyElementPersist=false, CryptoKeyElementWriteAccess=WA_ALLOWED
        Crypto_30_LibCv_KeyExchange_EcuId: CryptoKeyElementId=3007, CryptoKeyElementSize=1, CryptoKeyElementReadAccess=RA_ALLOWED, CryptoKeyElementAllowPartialAccess=false, CryptoKeyElementPersist=false, CryptoKeyElementWriteAccess=WA_ALLOWED
        Crypto_30_LibCv_KeyExchange_NumEcu: CryptoKeyElementId=3006, CryptoKeyElementSize=1, CryptoKeyElementReadAccess=RA_ALLOWED, CryptoKeyElementAllowPartialAccess=false, CryptoKeyElementPersist=false, CryptoKeyElementWriteAccess=WA_ALLOWED
        Crypto_30_LibCv_KeyExchange_Intermediate: CryptoKeyElementId=3005, CryptoKeyElementSize=16, CryptoKeyElementReadAccess=RA_ALLOWED, CryptoKeyElementAllowPartialAccess=false, CryptoKeyElementPersist=false, CryptoKeyElementWriteAccess=WA_ALLOWED
        Crypto_30_LibCv_Signature_Key_replacementAuthority: CryptoKeyElementSize=32, CryptoKeyElementId=1, CryptoKeyElementReadAccess=RA_ALLOWED, CryptoKeyElementAllowPartialAccess=false, CryptoKeyElementPersist=false, CryptoKeyElementWriteAccess=WA_DENIED, CryptoKeyElementInitValue=0x70 0x06 0x97 0x86 0xD8 0xE1 0x1B 0xFE 0x62 0xE7 0x91 0x3D 0x41 0xE1 0x32 0x78 0x6F 0x08 0xA9 0xEA 0x75 0xD9 0x60 0x70 0xA2 0x19 0xF8 0x60 0x09 0xF0 0xA6 0x2F
        Ssa_TrustModelEcuPublicCsr_StagingKey: CryptoKeyElementSize=32, CryptoKeyElementId=1, CryptoKeyElementReadAccess=RA_ALLOWED, CryptoKeyElementAllowPartialAccess=false, CryptoKeyElementPersist=true, CryptoKeyElementWriteAccess=WA_ALLOWED
        Ssa_TrustModelEcuPublic_LiveKey: CryptoKeyElementSize=32, CryptoKeyElementId=1, CryptoKeyElementReadAccess=RA_ALLOWED, CryptoKeyElementAllowPartialAccess=false, CryptoKeyElementPersist=true, CryptoKeyElementWriteAccess=WA_ALLOWED
        Ssa_TrustModelPrivateEcu_LiveKey: CryptoKeyElementSize=32, CryptoKeyElementId=1, CryptoKeyElementReadAccess=RA_DENIED, CryptoKeyElementAllowPartialAccess=false, CryptoKeyElementPersist=true, CryptoKeyElementWriteAccess=WA_ALLOWED, CryptoKeyElementInitValue=0x3F 0x7D 0xD9 0x5D 0x1B 0x51 0xA5 0xA2 0x42 0x36 0x3D 0x64 0x6C 0xC7 0x3D 0x13 0xCD 0x93 0xB4 0xAF 0x9C 0x0A 0x64 0xE7 0xE1 0x3B 0xEB 0x4A 0xC6 0xD3 0x69 0xD3
        Crypto_30_LibCv_KeyDerivation_Algorithm_HKDF_Option1_SHA256: CryptoKeyElementId=15, CryptoKeyElementInitValue=0x0D, CryptoKeyElementSize=1, CryptoKeyElementAllowPartialAccess=false, CryptoKeyElementPersist=false, CryptoKeyElementReadAccess=RA_ALLOWED, CryptoKeyElementWriteAccess=WA_ALLOWED
        CryptoKeyElement_Cert_wPersist: CryptoKeyElementId=0, CryptoKeyElementSize=1000, CryptoKeyElementReadAccess=RA_ALLOWED, CryptoKeyElementAllowPartialAccess=true, CryptoKeyElementPersist=true, CryptoKeyElementWriteAccess=WA_ALLOWED
        Crypto_30_LibCv_KeyExchange_Algorithm_X25519_TlsCon2: CryptoKeyElementId=12, CryptoKeyElementInitValue=0x00, CryptoKeyElementSize=1, CryptoKeyElementReadAccess=RA_ALLOWED, CryptoKeyElementAllowPartialAccess=false, CryptoKeyElementPersist=false, CryptoKeyElementWriteAccess=WA_ALLOWED
        Crypto_30_LibCv_KeyExchange_OwnPubKey_ED25519_001: CryptoKeyElementSize=32, CryptoKeyElementReadAccess=RA_ALLOWED, CryptoKeyElementId=10, CryptoKeyElementAllowPartialAccess=false, CryptoKeyElementPersist=false, CryptoKeyElementWriteAccess=WA_ALLOWED
        Crypto_30_LibCv_KeyExchange_PrivKey_ED25519_001: CryptoKeyElementSize=32, CryptoKeyElementId=9, CryptoKeyElementReadAccess=RA_ALLOWED, CryptoKeyElementAllowPartialAccess=false, CryptoKeyElementPersist=false, CryptoKeyElementWriteAccess=WA_ALLOWED
        Crypto_30_LibCv_KeyExchange_SharedValue_ED25519_001: CryptoKeyElementSize=64, CryptoKeyElementId=1, CryptoKeyElementReadAccess=RA_INTERNAL_COPY, CryptoKeyElementAllowPartialAccess=true, CryptoKeyElementPersist=false, CryptoKeyElementWriteAccess=WA_INTERNAL_COPY
        Ssa_MacKey_Hash_nonPersisting: CryptoKeyElementId=2, CryptoKeyElementSize=4, CryptoKeyElementReadAccess=RA_ALLOWED, CryptoKeyElementAllowPartialAccess=false, CryptoKeyElementPersist=false, CryptoKeyElementWriteAccess=WA_ALLOWED
        Ssa_MacKey_nonPersisting: CryptoKeyElementId=1, CryptoKeyElementSize=16, CryptoKeyElementReadAccess=RA_ALLOWED, CryptoKeyElementAllowPartialAccess=false, CryptoKeyElementPersist=false, CryptoKeyElementWriteAccess=WA_ALLOWED, CryptoKeyElementInitValue=0x23 0xe4 0xf5 0x35 0x25 0x93 0x1f 0xe5 0x01 0xc1 0xac 0x68 0x17 0x60 0x13 0x63
        Ssa_TrustModel_Csr_Key_NonPersisting_Element: CryptoKeyElementId=1, CryptoKeyElementSize=32, CryptoKeyElementReadAccess=RA_ALLOWED, CryptoKeyElementAllowPartialAccess=false, CryptoKeyElementPersist=false, CryptoKeyElementWriteAccess=WA_ALLOWED
        Crypto_30_LibCv_Fbl_Signature_Ed25519_Key: CryptoKeyElementId=1, CryptoKeyElementSize=32, CryptoKeyElementReadAccess=RA_ALLOWED, CryptoKeyElementAllowPartialAccess=false, CryptoKeyElementPersist=false, CryptoKeyElementWriteAccess=WA_ALLOWED, CryptoKeyElementInitValue=0xF0 0x2D 0x5C 0x15 0x10 0xD9 0x8F 0xCD 0x5C 0xF4 0xD9 0x44 0xD7 0xAC 0x57 0x92 0x13 0xAC 0xFD 0xE1 0x95 0x5A 0x57 0x12 0xDA 0x91 0x64 0x5D 0x94 0x25 0xAA 0x62
        Crypto_30_LibCv_Fbl_Decrypt_Aes128_Key: CryptoKeyElementId=1, CryptoKeyElementSize=16, CryptoKeyElementReadAccess=RA_ALLOWED, CryptoKeyElementAllowPartialAccess=false, CryptoKeyElementPersist=false, CryptoKeyElementWriteAccess=WA_ALLOWED, CryptoKeyElementInitValue=0x92 0x12 0x2a 0x4c 0x92 0x3b 0x39 0x21 0x7e 0x1b 0xb0 0x69 0x8d 0x69 0x1d 0x1b
        Crypto_30_LibCv_Fbl_Decrypt_Aes128_Iv: CryptoKeyElementId=5, CryptoKeyElementSize=16, CryptoKeyElementReadAccess=RA_ALLOWED, CryptoKeyElementAllowPartialAccess=false, CryptoKeyElementPersist=false, CryptoKeyElementWriteAccess=WA_ALLOWED, CryptoKeyElementInitValue=0xc6 0x9a 0x93 0xc2 0xe5 0xdf 0x11 0x42 0xf0 0xc1 0x79 0x10 0x16 0x10 0x33 0x61
        Crypto_30_LibCv_Fbl_SecurityAccess_Ed25519_Key: CryptoKeyElementId=1, CryptoKeyElementSize=32, CryptoKeyElementReadAccess=RA_ALLOWED, CryptoKeyElementAllowPartialAccess=false, CryptoKeyElementPersist=false, CryptoKeyElementWriteAccess=WA_ALLOWED, CryptoKeyElementInitValue=0xD7 0x3E 0xDA 0xAB 0x73 0x22 0x51 0x96 0xCA 0x0C 0x7F 0x27 0xE1 0xDB 0xE1 0x21 0x20 0x6E 0xCA 0x40 0x8D 0xBD 0x52 0x19 0xD7 0xB2 0xA1 0xEE 0x63 0xE9 0x36 0xF7
        vHsm_Version: CryptoKeyElementId=1, CryptoKeyElementSize=3, CryptoKeyElementReadAccess=RA_ALLOWED, CryptoKeyElementAllowPartialAccess=false, CryptoKeyElementPersist=false, CryptoKeyElementWriteAccess=WA_ALLOWED
    CryptoKeyTypes
      102 x CryptoKeyType:
        Ssa_MacKey: CryptoKeyElementRef=CryptoKeyElements/Ssa_MacKey, CryptoKeyElementRef=Ssa_MacKey_Hash
        Ssa_SecurityAccessPublicKey: CryptoKeyElementRef=Ssa_SecurityAccesPublicKey
        Ssa_EcuCert: CryptoKeyElementRef=CryptoKeyElements/Ssa_EcuCert
        Ssa_BackEndCert: CryptoKeyElementRef=CryptoKeyElements/Ssa_BackendCert
        Ssa_RootCert: CryptoKeyElementRef=CryptoKeyElements/Ssa_RootCert
        Ssa_PrivateEcuKey: CryptoKeyElementRef=CryptoKeyElements/Ssa_TrustModelEcuPrivateUniqueKey
        Ssa_SharedSecretHash: CryptoKeyElementRef=CryptoKeyElements/Ssa_SharedSecretHash
        Ssa_Mac: CryptoKeyElementRef=Ssa_Mac_Key, CryptoKeyElementRef=Ssa_Mac_Proof
        Ssa_Cipher: CryptoKeyElementRef=Ssa_Cipher_IV, CryptoKeyElementRef=Ssa_Cipher_Key
        Ssa_Random_Nist_800_90A_DRBG_AES_DF: CryptoKeyElementRef=Crypto_30_LibCv_Random_Algorithm_Nist_800_90A_DRBG_AES128_DF, CryptoKeyElementRef=Crypto_30_LibCv_Random_Reseed_Counter, CryptoKeyElementRef=Crypto_30_LibCv_Random_Seed, CryptoKeyElementRef=Ssa_Random_Nonce, CryptoKeyElementRef=CryptoKeyElement_DummyWorkaround_RandomSeedSize
        Ssa_TrustModelEcuPrivateKey: CryptoKeyElementRef=CryptoKeyElements/Ssa_TrustModelPrivateEcu_LiveKey
        Cipher: CryptoKeyElementRef=Crypto_30_LibCv_Cipher_Key, CryptoKeyElementRef=Crypto_30_LibCv_Cipher_IV, CryptoKeyElementRef=Crypto_30_LibCv_Cipher_Proof
        KeyExchange_X25519: CryptoKeyElementRef=Crypto_30_LibCv_KeyExchange_Algorithm_X25519, CryptoKeyElementRef=Crypto_30_LibCv_KeyExchange_OwnPubKey, CryptoKeyElementRef=Crypto_30_LibCv_KeyExchange_Base, CryptoKeyElementRef=Crypto_30_LibCv_KeyExchange_PrivKey, CryptoKeyElementRef=Crypto_30_LibCv_KeyExchange_SharedValue
        KeyGenerate: CryptoKeyElementRef=Crypto_30_LibCv_KeyGenerate_Algorithm, CryptoKeyElementRef=Crypto_30_LibCv_KeyGenerate_Seed, CryptoKeyElementRef=Crypto_30_LibCv_KeyGenerate_Key
        Signature: CryptoKeyElementRef=Crypto_30_LibCv_Signature_Key
        Mac: CryptoKeyElementRef=Crypto_30_LibCv_Mac_Key, CryptoKeyElementRef=Crypto_30_LibCv_Mac_Proof, CryptoKeyElementRef=Crypto_30_LibCv_Cipher_IV
        KeyDerive: CryptoKeyElementRef=Crypto_30_LibCv_KeyDerivation_Password, CryptoKeyElementRef=Crypto_30_LibCv_KeyDerive_Algorithm, CryptoKeyElementRef=Crypto_30_LibCv_KeyDerivation_Salt, CryptoKeyElementRef=Crypto_30_LibCv_KeyDerivation_Label, CryptoKeyElementRef=Crypto_30_LibCv_KeyDerivation_Iterations_PBKDF2
        Hash: CryptoKeyElementRef=Crypto_30_LibCv_Hash_Result
        Mac_Acceleration_Aes: CryptoKeyElementRef=Crypto_30_LibCv_Mac_Key, CryptoKeyElementRef=Crypto_30_LibCv_Mac_Proof, CryptoKeyElementRef=Crypto_30_LibCv_Mac_Acceleration_Aes
        vHsm_Hardware: CryptoKeyElementRef=vHsm_SecureBoot_Result
        vHsm_Info: CryptoKeyElementRef=vHsm_Info_Uid, CryptoKeyElementRef=vHsm_Info_ErrorLog
        Signature_Rsa_Pkcs1_and_Ed25519_VerGen: CryptoKeyElementRef=Crypto_30_LibCv_Signature_Rsa_Modulus, CryptoKeyElementRef=Crypto_30_LibCv_Signature_Rsa_Pub_Exponent, CryptoKeyElementRef=Crypto_30_LibCv_Signature_Rsa_Priv_Exponent, CryptoKeyElementRef=Crypto_30_LibCv_Signature_Key
        Signature_Rsa_Pkcs1_Verify: CryptoKeyElementRef=Crypto_30_LibCv_Rsa_Modulus, CryptoKeyElementRef=Crypto_30_LibCv_Rsa_Pub_Exponent
        Signature_Rsa_Pkcs1_Generate: CryptoKeyElementRef=Crypto_30_LibCv_Rsa_Modulus, CryptoKeyElementRef=Crypto_30_LibCv_Rsa_Priv_Exponent
        Signature_Rsa_Pss_Verify: CryptoKeyElementRef=Crypto_30_LibCv_Rsa_Modulus, CryptoKeyElementRef=Crypto_30_LibCv_Rsa_Pub_Exponent, CryptoKeyElementRef=Crypto_30_LibCv_Rsa_SaltLength
        Signature_Rsa_Pss_Generate: CryptoKeyElementRef=Crypto_30_LibCv_Rsa_Modulus, CryptoKeyElementRef=Crypto_30_LibCv_Rsa_Priv_Exponent, CryptoKeyElementRef=Crypto_30_LibCv_Rsa_Salt
        Signature_Rsa_Pss_Verify_AutoSalt: CryptoKeyElementRef=Crypto_30_LibCv_Rsa_Modulus, CryptoKeyElementRef=Crypto_30_LibCv_Rsa_Pub_Exponent
        KeyExchange_ANSIP256R1: CryptoKeyElementRef=Crypto_30_LibCv_KeyExchange_Algorithm_ANSIP256R1, CryptoKeyElementRef=Crypto_30_LibCv_KeyExchange_OwnPubKey, CryptoKeyElementRef=Crypto_30_LibCv_KeyExchange_Base, CryptoKeyElementRef=Crypto_30_LibCv_KeyExchange_PrivKey, CryptoKeyElementRef=Crypto_30_LibCv_KeyExchange_SharedValue
        Random_Fips186_Sha1: CryptoKeyElementRef=Crypto_30_LibCv_Random_Algorithm_Fips186_Sha1, CryptoKeyElementRef=Crypto_30_LibCv_Random_Seed
        KeyDerive_NIST80056A: CryptoKeyElementRef=Crypto_30_LibCv_KeyDerivation_Password, CryptoKeyElementRef=Crypto_30_LibCv_KeyDerivation_Algorithm_NIST80056A, CryptoKeyElementRef=Crypto_30_LibCv_KeyExchange_PartnerPubKey, CryptoKeyElementRef=Crypto_30_LibCv_KeyDerivation_AdditionalInfo
        KeyDerive_ISO15118_ProvCert: CryptoKeyElementRef=Crypto_30_LibCv_Signature_Key, CryptoKeyElementRef=Crypto_30_LibCv_KeyDerivation_Algorithm_ISO15118, CryptoKeyElementRef=Crypto_30_LibCv_KeyExchange_OwnPubKey, CryptoKeyElementRef=Crypto_30_LibCv_KeyExchange_PrivKey
        KeyDerive_SYM_NIST800108: CryptoKeyElementRef=Crypto_30_LibCv_KeyDerivation_Password, CryptoKeyElementRef=Crypto_30_LibCv_KeyDerivation_Algorithm_SYM_NIST800108, CryptoKeyElementRef=Crypto_30_LibCv_KeyDerivation_Salt, CryptoKeyElementRef=Crypto_30_LibCv_KeyDerivation_Label
        KeyDerive_ASM_NISTFIPS1864: CryptoKeyElementRef=Crypto_30_LibCv_KeyDerivation_Password, CryptoKeyElementRef=Crypto_30_LibCv_KeyDerivation_Algorithm_ASM_NISTFIPS1864, CryptoKeyElementRef=Crypto_30_LibCv_KeyDerivation_Salt, CryptoKeyElementRef=Crypto_30_LibCv_KeyDerivation_Label
        KeyDerive_ISO15118_ContrCert: CryptoKeyElementRef=Crypto_30_LibCv_Signature_Key, CryptoKeyElementRef=Crypto_30_LibCv_KeyDerivation_Algorithm_ISO15118, CryptoKeyElementRef=Crypto_30_LibCv_KeyExchange_PartnerPubKey, CryptoKeyElementRef=Crypto_30_LibCv_SCC_Contract_PubKey, CryptoKeyElementRef=Crypto_30_LibCv_SCC_IV_And_Encrypted_PrivKey
        CipherWithoutIv: CryptoKeyElementRef=Crypto_30_LibCv_Cipher_Key
        CipherShe: CryptoKeyElementRef=Crypto_30_LibCv_Cipher_IV, CryptoKeyElementRef=Crypto_30_LibCv_Cipher_Proof, CryptoKeyElementRef=Crypto_30_LibCv_Cipher_Key_She, CryptoKeyElementRef=Crypto_30_LibCv_She_Counter
        MacShe: CryptoKeyElementRef=Crypto_30_LibCv_Mac_Proof, CryptoKeyElementRef=Crypto_30_LibCv_Mac_Key_She, CryptoKeyElementRef=Crypto_30_LibCv_She_Counter
        Mac_Acceleration_Aes_She: CryptoKeyElementRef=Crypto_30_LibCv_Mac_Key, CryptoKeyElementRef=Crypto_30_LibCv_Mac_Proof, CryptoKeyElementRef=Crypto_30_LibCv_Mac_Acceleration_Aes
        Random_Nist_800_90A_DRBG_AES_DF: CryptoKeyElementRef=Crypto_30_LibCv_Random_PrivateString, CryptoKeyElementRef=Crypto_30_LibCv_Random_Reseed_Counter, CryptoKeyElementRef=Crypto_30_LibCv_Random_Nonce, CryptoKeyElementRef=Crypto_30_LibCv_Random_Seed_Nist_800_90A_DRBG_AES128, CryptoKeyElementRef=Crypto_30_LibCv_Random_AdditionalInput, CryptoKeyElementRef=Crypto_30_LibCv_Random_Algorithm_Nist_800_90A_DRBG_AES128_DF
        Random_Nist_800_90A_DRBG_AES_NoDF: CryptoKeyElementRef=Crypto_30_LibCv_Random_Algorithm_Nist_800_90A_DRBG_AES128, CryptoKeyElementRef=Crypto_30_LibCv_Random_PrivateString, CryptoKeyElementRef=Crypto_30_LibCv_Random_Reseed_Counter, CryptoKeyElementRef=Crypto_30_LibCv_Random_Seed_Nist_800_90A_DRBG_AES128, CryptoKeyElementRef=Crypto_30_LibCv_Random_AdditionalInput
        Signature_RsaCrt_Pkcs1_Generate: CryptoKeyElementRef=Crypto_30_LibCv_Rsa_PrimeP, CryptoKeyElementRef=Crypto_30_LibCv_Rsa_PrimeQ, CryptoKeyElementRef=Crypto_30_LibCv_Rsa_ExponentDp, CryptoKeyElementRef=Crypto_30_LibCv_Rsa_ExponentDq, CryptoKeyElementRef=Crypto_30_LibCv_Rsa_InverseQi
        KeyExchange_SECP256R1: CryptoKeyElementRef=Crypto_30_LibCv_KeyExchange_OwnPubKey, CryptoKeyElementRef=Crypto_30_LibCv_KeyExchange_Base, CryptoKeyElementRef=Crypto_30_LibCv_KeyExchange_PrivKey, CryptoKeyElementRef=Crypto_30_LibCv_KeyExchange_SharedValue, CryptoKeyElementRef=Crypto_30_LibCv_KeyExchange_Algorithm_SECP256R1
        LazyPersistKey: CryptoKeyElementRef=vHsm_LazyPersistKey
        SheInfoKey: CryptoKeyElementRef=Crypto_30_LibCv_She_UId, CryptoKeyElementRef=Crypto_30_LibCv_She_BootProtection, CryptoKeyElementRef=Crypto_30_LibCv_She_DebuggerProtection
        Cipher_Rsa_Oaep_Encrypt: CryptoKeyElementRef=Crypto_30_LibCv_Rsa_Modulus, CryptoKeyElementRef=Crypto_30_LibCv_Rsa_Pub_Exponent
        Cipher_Rsa_Oaep_Decrypt: CryptoKeyElementRef=Crypto_30_LibCv_Rsa_Modulus, CryptoKeyElementRef=Crypto_30_LibCv_Rsa_Priv_Exponent
        Cipher_RsaCrt_Oaep_Decrypt: CryptoKeyElementRef=Crypto_30_LibCv_Rsa_PrimeP, CryptoKeyElementRef=Crypto_30_LibCv_Rsa_PrimeQ, CryptoKeyElementRef=Crypto_30_LibCv_Rsa_ExponentDp, CryptoKeyElementRef=Crypto_30_LibCv_Rsa_ExponentDq, CryptoKeyElementRef=Crypto_30_LibCv_Rsa_InverseQi
        Cipher_Rsa_Pkcs1_Encrypt: CryptoKeyElementRef=Crypto_30_LibCv_Rsa_Modulus, CryptoKeyElementRef=Crypto_30_LibCv_Rsa_Pub_Exponent
        Cipher_Rsa_Pkcs1_Decrypt: CryptoKeyElementRef=Crypto_30_LibCv_Rsa_Modulus, CryptoKeyElementRef=Crypto_30_LibCv_Rsa_Priv_Exponent
        Cipher_Rsa_Oaep_Encrypt_With_Label: CryptoKeyElementRef=Crypto_30_LibCv_Rsa_Modulus, CryptoKeyElementRef=Crypto_30_LibCv_Rsa_Pub_Exponent, CryptoKeyElementRef=Crypto_30_LibCv_Label
        Cipher_Rsa_Oaep_Decrypt_With_Label: CryptoKeyElementRef=Crypto_30_LibCv_Rsa_Modulus, CryptoKeyElementRef=Crypto_30_LibCv_Rsa_Priv_Exponent, CryptoKeyElementRef=Crypto_30_LibCv_Label
        Cipher_RsaCrt_Oaep_Decrypt_With_Label: CryptoKeyElementRef=Crypto_30_LibCv_Rsa_PrimeP, CryptoKeyElementRef=Crypto_30_LibCv_Rsa_PrimeQ, CryptoKeyElementRef=Crypto_30_LibCv_Rsa_ExponentDp, CryptoKeyElementRef=Crypto_30_LibCv_Rsa_ExponentDq, CryptoKeyElementRef=Crypto_30_LibCv_Rsa_InverseQi, CryptoKeyElementRef=Crypto_30_LibCv_Label
        KeyExchange_SECP384R1: CryptoKeyElementRef=Crypto_30_LibCv_KeyExchange_Algorithm_SECP384R1, CryptoKeyElementRef=Crypto_30_LibCv_KeyExchange_OwnPubKey, CryptoKeyElementRef=Crypto_30_LibCv_KeyExchange_PrivKey, CryptoKeyElementRef=Crypto_30_LibCv_KeyExchange_SharedValue
        vHsm_SecureBootSegment: CryptoKeyElementRef=vHsm_SecureBoot_Cmac, CryptoKeyElementRef=vHsm_SecureBoot_Address, CryptoKeyElementRef=vHsm_SecureBoot_Mode, CryptoKeyElementRef=vHsm_SecureBoot_Sanction, CryptoKeyElementRef=vHsm_SecureBoot_Size, CryptoKeyElementRef=vHsm_KeyDerivation_Password
        vHsm_SecureBootGroup: CryptoKeyElementRef=vHsm_SecureBoot_Key
        Cipher_Rsa_Pkcs1_Decrypt_Pub: CryptoKeyElementRef=Crypto_30_LibCv_Rsa_Modulus, CryptoKeyElementRef=Crypto_30_LibCv_Rsa_Pub_Exponent
        KeyDerive_KDF_X963_SHA256: CryptoKeyElementRef=Crypto_30_LibCv_KeyDerivation_Password, CryptoKeyElementRef=Crypto_30_LibCv_KeyDerivation_Salt, CryptoKeyElementRef=Crypto_30_LibCv_KeyDerivation_Algorithm_KDF_X963_SHA256
        CipherSheRam: CryptoKeyElementRef=Crypto_30_LibCv_Cipher_Key_She_Ram, CryptoKeyElementRef=Crypto_30_LibCv_Cipher_IV, CryptoKeyElementRef=Crypto_30_LibCv_Cipher_Proof
        MacSheRam: CryptoKeyElementRef=Crypto_30_LibCv_Mac_Key_She_Ram, CryptoKeyElementRef=Crypto_30_LibCv_Mac_Proof
        MacGmac: CryptoKeyElementRef=Crypto_30_LibCv_Mac_Key, CryptoKeyElementRef=Crypto_30_LibCv_Cipher_IV
        KeyType_KeyM_CertificateData: CryptoKeyElementRef=Crypto_30_LibCv_KeyM_CertificateData
        KeyDerive_NIST800108_CMAC: CryptoKeyElementRef=vHsm_KeyDerivation_Algorithm_NIST800108_CMAC, CryptoKeyElementRef=vHsm_KeyDerivation_Label, CryptoKeyElementRef=vHsm_KeyDerivation_Context, CryptoKeyElementRef=vHsm_KeyDerivation_Password
        Cipher_OnlyIV: CryptoKeyElementRef=Crypto_30_LibCv_Cipher_ConstIV
        KeyGenerate_Symmetric_Generic: CryptoKeyElementRef=Crypto_30_LibCv_KeyGenerate_Key, CryptoKeyElementRef=Crypto_30_LibCv_KeyGenerate_Algorithm_Symmetric_Generic
        KeyGenerate_Ansi_Nist_Sec_P256R1: CryptoKeyElementRef=Crypto_30_LibCv_KeyGenerate_Key, CryptoKeyElementRef=Crypto_30_LibCv_KeyExchange_OwnPubKey, CryptoKeyElementRef=Crypto_30_LibCv_KeyGenerate_Algorithm_Ansi_Nist_Sec_P256R1
        KeyGenerate_Nist_Sec_P384R1: CryptoKeyElementRef=Crypto_30_LibCv_KeyGenerate_Key, CryptoKeyElementRef=Crypto_30_LibCv_KeyExchange_OwnPubKey, CryptoKeyElementRef=Crypto_30_LibCv_KeyGenerate_Algorithm_Nist_Sec_P384R1
        vhsm_FirmwareUpdate_Mac: CryptoKeyElementRef=vHsm_FirmwareUpdate_Internal_Key
        vhsm_FirmwareUpdate_Encrypt: CryptoKeyElementRef=vHsm_FirmwareUpdate_Internal_Key, CryptoKeyElementRef=vHsm_FirmwareUpdate_IV
        vhsm_FirmwareUpdate_Decrypt: CryptoKeyElementRef=vHsm_FirmwareUpdate_Decrypt_Key, CryptoKeyElementRef=vHsm_FirmwareUpdate_IV
        KeyDerive_PBKDF2_HMAC_SHA1: CryptoKeyElementRef=Crypto_30_LibCv_KeyDerivation_Password, CryptoKeyElementRef=Crypto_30_LibCv_KeyDerivation_Salt, CryptoKeyElementRef=Crypto_30_LibCv_KeyDerivation_Iterations_PBKDF2, CryptoKeyElementRef=Crypto_30_LibCv_KeyDerivation_Algorithm_PBKDF2_HMAC_SHA1
        KeyDerive_PBKDF2_HMAC_SHA256: CryptoKeyElementRef=Crypto_30_LibCv_KeyDerivation_Password, CryptoKeyElementRef=Crypto_30_LibCv_KeyDerivation_Salt, CryptoKeyElementRef=Crypto_30_LibCv_KeyDerivation_Iterations_PBKDF2, CryptoKeyElementRef=Crypto_30_LibCv_KeyDerivation_Algorithm_PBKDF2_HMAC_SHA256
        KeyDerive_KDF_X963_SHA512: CryptoKeyElementRef=Crypto_30_LibCv_KeyDerivation_Password, CryptoKeyElementRef=Crypto_30_LibCv_KeyDerivation_Salt, CryptoKeyElementRef=Crypto_30_LibCv_KeyDerivation_Algorithm_KDF_X963_SHA512
        AEAD_ChaCha20_Poly1305: CryptoKeyElementRef=Crypto_30_LibCv_Aead_ChaCha_Key, CryptoKeyElementRef=Crypto_30_LibCv_Aead_ChaCha_Nonce
        Random_Nist_800_90A_DRBG_HASH_SHA2_512: CryptoKeyElementRef=Crypto_30_LibCv_Random_Algorithm_Nist_800_90A_DRBG_HASH_SHA2_512, CryptoKeyElementRef=Crypto_30_LibCv_Random_Seed_Nist_800_90A_DRBG_HASH_SHA2_512, CryptoKeyElementRef=Crypto_30_LibCv_Random_PrivateString, CryptoKeyElementRef=Crypto_30_LibCv_Random_AdditionalInput, CryptoKeyElementRef=Crypto_30_LibCv_Random_Reseed_Counter, CryptoKeyElementRef=Crypto_30_LibCv_Random_Nonce
        Ssa_TrustModelEcuPublicKey: CryptoKeyElementRef=CryptoKeyElements/Ssa_TrustModelEcuPublic_LiveKey
        Signature_TrustModelEcu: CryptoKeyElementRef=Ssa_Signature_Key_TrustModelEcu
        Diagnostic_Backend_Cert_Test: CryptoKeyElementRef=CryptoKeyElements/Diagnostic_Backend_Cert_Test
        Diagnostic_Root_Cert_Test: CryptoKeyElementRef=CryptoKeyElements/Diagnostic_Root_Cert_Test
        Random_Nist_800_90A_DRBG_AES256_NoDF: CryptoKeyElementRef=Crypto_30_LibCv_Random_Algorithm_Nist_800_90A_DRBG_AES256, CryptoKeyElementRef=Crypto_30_LibCv_Random_Seed_Nist_800_90A_DRBG_AES256, CryptoKeyElementRef=Crypto_30_LibCv_Random_PrivateString, CryptoKeyElementRef=Crypto_30_LibCv_Random_AdditionalInput, CryptoKeyElementRef=Crypto_30_LibCv_Random_Reseed_Counter
        Random_Nist_800_90A_DRBG_AES256_DF: CryptoKeyElementRef=Crypto_30_LibCv_Random_Algorithm_Nist_800_90A_DRBG_AES256Df, CryptoKeyElementRef=Crypto_30_LibCv_Random_Seed_Nist_800_90A_DRBG_AES256, CryptoKeyElementRef=Crypto_30_LibCv_Random_PrivateString, CryptoKeyElementRef=Crypto_30_LibCv_Random_AdditionalInput, CryptoKeyElementRef=Crypto_30_LibCv_Random_Reseed_Counter, CryptoKeyElementRef=Crypto_30_LibCv_Random_Nonce
        KeyDerive_HKDF_HMAC_SHA256: CryptoKeyElementRef=Crypto_30_LibCv_KeyDerivation_Password, CryptoKeyElementRef=Crypto_30_LibCv_KeyDerivation_Salt, CryptoKeyElementRef=Crypto_30_LibCv_KeyDerivation_Iterations_HKDF, CryptoKeyElementRef=Crypto_30_LibCv_KeyDerivation_Algorithm_HKDF_HMAC_SHA256, CryptoKeyElementRef=Crypto_30_LibCv_KeyDerivation_AdditionalInfo
        KeyDerive_Spake2Plus_P256R1: CryptoKeyElementRef=Crypto_30_LibCv_KeyDerivation_Password, CryptoKeyElementRef=Crypto_30_LibCv_KeyDerivation_Algorithm_Spake2Plus_P256R1
        KeyExchange_Spake2Plus_A_Suite8_1: CryptoKeyElementRef=Crypto_30_LibCv_KeyExchange_Algorithm_Spake2Plus_Suite8_1, CryptoKeyElementRef=Crypto_30_LibCv_W0, CryptoKeyElementRef=Crypto_30_LibCv_W1, CryptoKeyElementRef=Crypto_30_LibCv_AdditionalInfo, CryptoKeyElementRef=Crypto_30_LibCv_KeyExchange_SharedValue, CryptoKeyElementRef=Crypto_30_LibCv_Verification_Result, CryptoKeyElementRef=Crypto_30_LibCv_Verification
        KeyExchange_Spake2Plus_B_Suite8_1: CryptoKeyElementRef=Crypto_30_LibCv_KeyExchange_Algorithm_Spake2Plus_Suite8_1, CryptoKeyElementRef=Crypto_30_LibCv_W0, CryptoKeyElementRef=Crypto_30_LibCv_L, CryptoKeyElementRef=Crypto_30_LibCv_AdditionalInfo, CryptoKeyElementRef=Crypto_30_LibCv_KeyExchange_SharedValue, CryptoKeyElementRef=Crypto_30_LibCv_Verification_Result, CryptoKeyElementRef=Crypto_30_LibCv_Verification
        KeyExchange_Spake2Plus_A_Suite8: CryptoKeyElementRef=Crypto_30_LibCv_KeyExchange_Algorithm_Spake2Plus_Suite8, CryptoKeyElementRef=Crypto_30_LibCv_W0, CryptoKeyElementRef=Crypto_30_LibCv_W1, CryptoKeyElementRef=Crypto_30_LibCv_AdditionalInfo, CryptoKeyElementRef=Crypto_30_LibCv_KeyExchange_SharedValue, CryptoKeyElementRef=Crypto_30_LibCv_Verification_Result, CryptoKeyElementRef=Crypto_30_LibCv_Verification
        KeyExchange_Spake2Plus_B_Suite8: CryptoKeyElementRef=Crypto_30_LibCv_KeyExchange_Algorithm_Spake2Plus_Suite8, CryptoKeyElementRef=Crypto_30_LibCv_W0, CryptoKeyElementRef=Crypto_30_LibCv_L, CryptoKeyElementRef=Crypto_30_LibCv_AdditionalInfo, CryptoKeyElementRef=Crypto_30_LibCv_KeyExchange_SharedValue, CryptoKeyElementRef=Crypto_30_LibCv_Verification_Result, CryptoKeyElementRef=Crypto_30_LibCv_Verification
        Ssa_TrustModelEcuPrivateUniqueKey: CryptoKeyElementRef=CryptoKeyElements/Ssa_TrustModelEcuPrivateUniqueKey
        Ssa_TrustModelEcuPublicKeyCsr: CryptoKeyElementRef=CryptoKeyElements/Ssa_TrustModelEcuPublicCsr_StagingKey
        Cert: CryptoKeyElementRef=CryptoKeyElement_Cert
        KeyExchange_X25519_001: CryptoKeyElementRef=Crypto_30_LibCv_KeyExchange_Algorithm_X25519, CryptoKeyElementRef=Crypto_30_LibCv_KeyExchange_SharedValue_ED25519, CryptoKeyElementRef=Crypto_30_LibCv_KeyExchange_PrivKey_ED25519, CryptoKeyElementRef=Crypto_30_LibCv_KeyExchange_OwnPubKey_ED25519
        KeyGenerate_ED25519: CryptoKeyElementRef=Crypto_30_LibCv_KeyGenerate_Key, CryptoKeyElementRef=Crypto_30_LibCv_KeyExchange_OwnPubKey, CryptoKeyElementRef=Crypto_30_LibCv_KeyGenerate_Algorithm_Ed25519
        KeyExchange_NISTP224R1_BD: CryptoKeyElementRef=Crypto_30_LibCv_KeyExchange_Algorithm_NISTP224R1_BD, CryptoKeyElementRef=Crypto_30_LibCv_KeyExchange_OwnPubKey, CryptoKeyElementRef=Crypto_30_LibCv_KeyExchange_PrivKey, CryptoKeyElementRef=Crypto_30_LibCv_KeyExchange_SharedValue, CryptoKeyElementRef=Crypto_30_LibCv_KeyExchange_NumEcu, CryptoKeyElementRef=Crypto_30_LibCv_KeyExchange_EcuId, CryptoKeyElementRef=Crypto_30_LibCv_KeyExchange_Intermediate, CryptoKeyElementRef=Crypto_30_LibCv_KeyExchange_PartnerPubKey, CryptoKeyElementRef=Crypto_30_LibCv_KeyExchange_PartnerPubKey_2
        Signature_replacementAuthority: CryptoKeyElementRef=Crypto_30_LibCv_Signature_Key_replacementAuthority
        KeyDerive_Hkdf_Option1_Sha256: CryptoKeyElementRef=Crypto_30_LibCv_KeyDerivation_Password, CryptoKeyElementRef=Crypto_30_LibCv_KeyDerivation_AdditionalInfo, CryptoKeyElementRef=Crypto_30_LibCv_KeyDerivation_Algorithm_HKDF_Option1_SHA256
        Cert_wPersist: CryptoKeyElementRef=CryptoKeyElement_Cert_wPersist
        KeyExchange_X25519_TlsCon2: CryptoKeyElementRef=Crypto_30_LibCv_KeyExchange_Algorithm_X25519_TlsCon2, CryptoKeyElementRef=Crypto_30_LibCv_KeyExchange_SharedValue_ED25519_001, CryptoKeyElementRef=Crypto_30_LibCv_KeyExchange_PrivKey_ED25519_001, CryptoKeyElementRef=Crypto_30_LibCv_KeyExchange_OwnPubKey_ED25519_001
        Ssa_MacKey_nonPersisting: CryptoKeyElementRef=Ssa_MacKey_Hash_nonPersisting, CryptoKeyElementRef=CryptoKeyElements/Ssa_MacKey_nonPersisting
        Ssa_TrustModel_Csr_Key_NonPersisting_Type: CryptoKeyElementRef=Ssa_TrustModel_Csr_Key_NonPersisting_Element, CryptoKeyElementRef=Crypto_30_LibCv_KeyGenerate_Algorithm_Ed25519, CryptoKeyElementRef=Crypto_30_LibCv_KeyExchange_OwnPubKey
        CryptoKeyType_Fbl_Signature_Ed25519: CryptoKeyElementRef=Crypto_30_LibCv_Fbl_Signature_Ed25519_Key
        CryptoKeyType_Fbl_Decrypt_Aes128: CryptoKeyElementRef=Crypto_30_LibCv_Fbl_Decrypt_Aes128_Iv, CryptoKeyElementRef=Crypto_30_LibCv_Fbl_Decrypt_Aes128_Key
        CryptoKeyType_Fbl_SecurityAccess_Ed25519: CryptoKeyElementRef=Crypto_30_LibCv_Fbl_SecurityAccess_Ed25519_Key
        vHSM_Custom_HSM_Version: CryptoKeyElementRef=vHsm_Version
    CryptoGeneral:
      CryptoDevErrorDetect = true
      CryptoVersionInfoApi = false
      CryptoMainFunctionPeriod = 0.01
      CryptoSafeBswChecks = true
      CryptoKeyElementDelete = true
      CryptoUseVStdLib = true
      CryptoAlignKeyStorage = true
      CryptoNvMEnableSetRamBlockStatus = true
      CryptoRedirection = false
      CryptoDefaultRandomMaxRetries = 10
      CryptoNumberOfLongTermPrimitiveWorkspace = 0
      CryptoKeyDerivePrimitives: CryptoKeyDeriveAlgorithm=CRYPTO_KDF_ALGO_SYM_NIST_800_108_CNT_MODE_SHA256
      CryptoMacPrimitives: CryptoCmacAesRoundkeyReuse=false
      CryptoCipherPrimitives: CryptoEnableAES256=false
      CryptoKeyExchangePrimitives: CryptoKeyExchangeAlgorithm=CRYPTO_KEY_EXCHANGE_ALGORITHM_X25519
      CryptoKeyGeneratePrimitives: CryptoKeyGenerateMaxLength=32, CryptoKeyGenerateAlgorithm=CRYPTO_KEY_GENERATE_ALGORITHM_ED25519
      CryptoConfigurableCallouts
    CryptoKeys
      54 x CryptoKey, all with CryptoKeyDeriveIterations=1:
        KeyM_SigVerifyKey_TrustModelIntermediatePeer: CryptoKeyId=5, CryptoKeyNvId=26, CryptoKeyTypeRef=Signature
        KeyM_SigVerifyKey_TrustModelEcuPeer: CryptoKeyId=7, CryptoKeyNvId=28, CryptoKeyTypeRef=Signature
        KeyM_SigVerifyKey_TrustModelBackendPeer: CryptoKeyId=3, CryptoKeyNvId=254, CryptoKeyTypeRef=Signature
        Ssa_PduKeysMac: CryptoKeyId=0, CryptoKeyNvId=42, CryptoKeyTypeRef=CryptoKeyTypes/Ssa_MacKey_nonPersisting
        Ssa_SecurityAccessPublicKey: CryptoKeyId=22, CryptoKeyNvId=41, CryptoKeyTypeRef=CryptoKeyTypes/Ssa_SecurityAccessPublicKey
        Ssa_SharedSecretExchangeKey: CryptoKeyId=30, CryptoKeyNvId=20, CryptoKeyTypeRef=KeyExchange_X25519
        Ssa_BackendCert: CryptoKeyId=13, CryptoKeyNvId=3, CryptoKeyTypeRef=Ssa_BackEndCert
        Ssa_RootCert: CryptoKeyId=26, CryptoKeyNvId=8, CryptoKeyTypeRef=CryptoKeyTypes/Ssa_RootCert
        Ssa_RandomSeed: CryptoKeyId=23, CryptoKeyNvId=6, CryptoKeyTypeRef=Ssa_Random_Nist_800_90A_DRBG_AES_DF
        Ssa_AesRamKey: CryptoKeyId=6, CryptoKeyNvId=253, CryptoKeyTypeRef=Ssa_Cipher
        Ssa_SharedSecretHash: CryptoKeyId=32, CryptoKeyNvId=10, CryptoKeyTypeRef=CryptoKeyTypes/Ssa_SharedSecretHash
        SSA_SecOC_Int_MacVerify_Ign_Stat: CryptoKeyId=41, CryptoKeyNvId=40, CryptoKeyTypeRef=Ssa_Mac
        SSA_SecOC_Int_MacVerify_PN14_Master_Stat1: CryptoKeyId=2, CryptoKeyNvId=29, CryptoKeyTypeRef=Ssa_Mac
        SSA_SecOC_Int_MacVerify_PT4_PTCoor4: CryptoKeyId=9, CryptoKeyNvId=30, CryptoKeyTypeRef=Ssa_Mac
        SSA_SecOC_Int_MacVerify_VehSpd_8: CryptoKeyId=11, CryptoKeyNvId=31, CryptoKeyTypeRef=Ssa_Mac
        SSA_SecOC_Int_MacVerify_DI_OdoSpeedometer: CryptoKeyId=15, CryptoKeyNvId=32, CryptoKeyTypeRef=Ssa_Mac
        SSA_SecOC_Int_MacVerify_COM_C0X_Pdu20_secured_3ef6961f_Rx: CryptoKeyId=18, CryptoKeyNvId=33, CryptoKeyTypeRef=Ssa_Mac
        SSA_SecOC_Int_MacVerify_COM_C0X_Pdu21_secured_298d825c_Rx: CryptoKeyId=20, CryptoKeyNvId=34, CryptoKeyTypeRef=Ssa_Mac
        SSA_SecOC_Int_MacGen_COM_C04_Pdu20_secured_393d7a18_Tx: CryptoKeyId=24, CryptoKeyNvId=35, CryptoKeyTypeRef=Ssa_Mac
        SSA_SecOC_Int_MacGen_COM_C04_Pdu03_secured_044596e0_Tx: CryptoKeyId=25, CryptoKeyNvId=36, CryptoKeyTypeRef=Ssa_Mac
        SSA_SecOC_Int_MacGen_COM_C04_Pdu21_secured_2e466e5b_Tx: CryptoKeyId=28, CryptoKeyNvId=37, CryptoKeyTypeRef=Ssa_Mac
        Ssa_Authentication: CryptoKeyId=36, CryptoKeyNvId=2, CryptoKeyTypeRef=Ssa_Mac
        Ssa_RealTime: CryptoKeyId=38, CryptoKeyNvId=7, CryptoKeyTypeRef=Ssa_Mac
        Ssa_SignatureRamKey: CryptoKeyId=40, CryptoKeyNvId=11, CryptoKeyTypeRef=Signature
        Ssa_TickCount: CryptoKeyId=39, CryptoKeyNvId=12, CryptoKeyTypeRef=Ssa_Mac
        Ssa_VIN: CryptoKeyId=37, CryptoKeyNvId=13, CryptoKeyTypeRef=Ssa_Mac
        vHsm_Info: CryptoKeyId=21, CryptoKeyNvId=18, CryptoKeyTypeRef=CryptoKeyTypes/vHsm_Info
        vHsm_TRNG: CryptoKeyId=1, CryptoKeyNvId=1, CryptoKeyTypeRef=Random_Nist_800_90A_DRBG_AES_NoDF
        vHsm_FirmwareUpdate_Signature: CryptoKeyId=16, CryptoKeyNvId=16, CryptoKeyTypeRef=Signature
        vHsm_Custom: CryptoKeyId=4, CryptoKeyNvId=230, CryptoKeyTypeRef=Cipher
        vHsm_FirmwareUpdate_Decrypt: CryptoKeyId=8, CryptoKeyNvId=234, CryptoKeyTypeRef=vhsm_FirmwareUpdate_Decrypt
        vHsm_FirmwareUpdate_Encrypt: CryptoKeyId=10, CryptoKeyNvId=14, CryptoKeyTypeRef=vhsm_FirmwareUpdate_Encrypt
        vHsm_FirmwareUpdate_Mac: CryptoKeyId=12, CryptoKeyNvId=15, CryptoKeyTypeRef=vhsm_FirmwareUpdate_Mac
        KeyM_Cert_Root: CryptoKeyId=27, CryptoKeyNvId=128, CryptoKeyTypeRef=KeyType_KeyM_CertificateData
        KeyM_ECC_Intermediate: CryptoKeyId=29, CryptoKeyNvId=131, CryptoKeyTypeRef=Signature
        KeyM_ECC_Root: CryptoKeyId=31, CryptoKeyNvId=132, CryptoKeyTypeRef=Signature
        KeyM_SigVerifyKey_TrustModelRoot: CryptoKeyId=14, CryptoKeyNvId=22, CryptoKeyTypeRef=Signature
        KeyM_SigVerifyKey_TrustModelBackend: CryptoKeyId=17, CryptoKeyNvId=23, CryptoKeyTypeRef=Signature
        KeyM_SigVerifyKey_TrustModelIntermediate: CryptoKeyId=19, CryptoKeyNvId=24, CryptoKeyTypeRef=Signature
        Ssa_SignatureRamKey_replacementAuthority: CryptoKeyId=42, CryptoKeyNvId=264, CryptoKeyTypeRef=Signature_replacementAuthority
        Ssa_TrustModelEcuPublicCsr_StagingKey: CryptoKeyId=35, CryptoKeyNvId=5, CryptoKeyTypeRef=Ssa_TrustModelEcuPublicKeyCsr
        Ssa_TrustModelEcuPublic_LiveKey: CryptoKeyId=34, CryptoKeyNvId=258, CryptoKeyTypeRef=Ssa_TrustModelEcuPublicKey
        Ssa_TrustModelPrivateEcuUnique_StagingKey: CryptoKeyId=43, CryptoKeyNvId=263, CryptoKeyTypeRef=KeyGenerate_ED25519
        Ssa_TrustModelPrivateEcu_LiveKey: CryptoKeyId=33, CryptoKeyNvId=255, CryptoKeyTypeRef=Ssa_TrustModelEcuPrivateKey
        Ssa_TrustModelBackendCert_inHSM: CryptoKeyId=44, CryptoKeyNvId=0, CryptoKeyTypeRef=Cert_wPersist
        Ssa_TrustModelEcuCert_inHSM: CryptoKeyId=47, CryptoKeyNvId=283, CryptoKeyTypeRef=Cert_wPersist
        Ssa_TrustModelIntermediateCert_inHSM: CryptoKeyId=46, CryptoKeyNvId=282, CryptoKeyTypeRef=Cert_wPersist
        Ssa_TrustModelRootCert_inHSM: CryptoKeyId=45, CryptoKeyNvId=281, CryptoKeyTypeRef=Cert_wPersist
        Ssa_TrustModel_Ecu_CsrPrivateKey: CryptoKeyId=48, CryptoKeyNvId=284, CryptoKeyTypeRef=Ssa_TrustModel_Csr_Key_NonPersisting_Type
        Ssa_TrustModel_Ecu_CsrPublicKey: CryptoKeyId=49, CryptoKeyNvId=285, CryptoKeyTypeRef=Ssa_TrustModel_Csr_Key_NonPersisting_Type
        CryptoKey_Fbl_Signature_Ed25519: CryptoKeyId=50, CryptoKeyNvId=286, CryptoKeyTypeRef=CryptoKeyType_Fbl_Signature_Ed25519
        CryptoKey_Fbl_Decrypt_Aes128: CryptoKeyId=52, CryptoKeyNvId=287, CryptoKeyTypeRef=CryptoKeyType_Fbl_Decrypt_Aes128
        CryptoKey_Fbl_SecurityAccess_Ed25519: CryptoKeyId=51, CryptoKeyNvId=288, CryptoKeyTypeRef=CryptoKeyType_Fbl_SecurityAccess_Ed25519
        vHSM_Custom_HSM_Version: CryptoKeyId=53, CryptoKeyNvId=289, CryptoKeyTypeRef=CryptoKeyTypes/vHSM_Custom_HSM_Version
    CryptoNvStorage: CryptoNvManagementDataPerKey=4, CryptoNvWriteBlockFctName=vHsm_NvM_WriteBlock
      8 x CryptoNvBlock, all with CryptoNvBlockConsistencyLevel=NV_CONSISTENCY_LEVEL_DETECT:
        CryptoNvBlock_Immediate: CryptoNvBlockId=5, CryptoNvBlockLength=280, CryptoNvBlockFillLevel=250, CryptoNvBlockProcessing=NV_PROCESSING_IMMEDIATE, CryptoNvBlockRevision=1, CryptoNvBlockCrcLayoutChecksum=153758587, CryptoNvBlockDescriptor=Keys_Immediate, CryptoNvBlockKeyRef=CryptoKeys/vHsm_Info, CryptoNvBlockKeyRef=CryptoKeys/Ssa_RandomSeed, CryptoNvBlockKeyRef=CryptoKeys/Ssa_SecurityAccessPublicKey, CryptoNvBlockKeyRef=Ssa_TrustModelPrivateEcuUnique_StagingKey, CryptoNvBlockKeyRef=CryptoKeys/Ssa_TrustModelEcuPublic_LiveKey, CryptoNvBlockKeyRef=CryptoKeys/Ssa_TrustModelEcuPublicCsr_StagingKey, CryptoNvBlockKeyRef=CryptoKeys/Ssa_TrustModelPrivateEcu_LiveKey
        CryptoNvBlock_Deferred: CryptoNvBlockId=0, CryptoNvBlockLength=70, CryptoNvBlockFillLevel=50, CryptoNvBlockProcessing=NV_PROCESSING_DEFERRED, CryptoNvBlockRevision=0, CryptoNvBlockCrcLayoutChecksum=516446441, CryptoNvBlockDescriptor=Keys_Deferred, CryptoNvBlockKeyRef=CryptoKeys/vHsm_TRNG
        CryptoNvBlock_Deferred_SecOC: CryptoNvBlockId=1, CryptoNvBlockLength=400, CryptoNvBlockFillLevel=398, CryptoNvBlockProcessing=NV_PROCESSING_DEFERRED, CryptoNvBlockRevision=0, CryptoNvBlockCrcLayoutChecksum=1109534023, CryptoNvBlockDescriptor=Keys_Deferred_SecOC, CryptoNvBlockKeyRef=CryptoKeys/SSA_SecOC_Int_MacGen_COM_C04_Pdu03_secured_044596e0_Tx, CryptoNvBlockKeyRef=CryptoKeys/SSA_SecOC_Int_MacGen_COM_C04_Pdu20_secured_393d7a18_Tx, CryptoNvBlockKeyRef=CryptoKeys/SSA_SecOC_Int_MacGen_COM_C04_Pdu21_secured_2e466e5b_Tx, CryptoNvBlockKeyRef=CryptoKeys/SSA_SecOC_Int_MacVerify_COM_C0X_Pdu20_secured_3ef6961f_Rx, CryptoNvBlockKeyRef=CryptoKeys/SSA_SecOC_Int_MacVerify_COM_C0X_Pdu21_secured_298d825c_Rx, CryptoNvBlockKeyRef=CryptoKeys/SSA_SecOC_Int_MacVerify_DI_OdoSpeedometer, CryptoNvBlockKeyRef=CryptoKeys/SSA_SecOC_Int_MacVerify_Ign_Stat, CryptoNvBlockKeyRef=CryptoKeys/SSA_SecOC_Int_MacVerify_PN14_Master_Stat1, CryptoNvBlockKeyRef=CryptoKeys/SSA_SecOC_Int_MacVerify_PT4_PTCoor4, CryptoNvBlockKeyRef=CryptoKeys/SSA_SecOC_Int_MacVerify_VehSpd_8, CryptoNvBlockKeyRef=CryptoKeys/Ssa_Authentication, CryptoNvBlockKeyRef=CryptoKeys/Ssa_RealTime, CryptoNvBlockKeyRef=CryptoKeys/Ssa_TickCount, CryptoNvBlockKeyRef=CryptoKeys/Ssa_VIN
        CryptoNvBlock_Deferred_SharedSecretHash: CryptoNvBlockId=2, CryptoNvBlockLength=16, CryptoNvBlockFillLevel=14, CryptoNvBlockProcessing=NV_PROCESSING_DEFERRED, CryptoNvBlockRevision=0, CryptoNvBlockCrcLayoutChecksum=736849078, CryptoNvBlockKeyRef=CryptoKeys/Ssa_SharedSecretHash, CryptoNvBlockDescriptor=Keys_Deferred_SharedSecretHash
        CryptoNvBlock_Deferred_TrustModel_NoRoot: CryptoNvBlockId=3, CryptoNvBlockLength=3018, CryptoNvBlockFillLevel=3018, CryptoNvBlockProcessing=NV_PROCESSING_DEFERRED, CryptoNvBlockRevision=0, CryptoNvBlockCrcLayoutChecksum=3016506465, CryptoNvBlockDescriptor=Keys_Deferred_TrustModel_NoRoot, CryptoNvBlockKeyRef=Ssa_TrustModelBackendCert_inHSM, CryptoNvBlockKeyRef=Ssa_TrustModelEcuCert_inHSM, CryptoNvBlockKeyRef=Ssa_TrustModelIntermediateCert_inHSM
        CryptoNvBlock_Deferred_TrustModel_Root: CryptoNvBlockId=4, CryptoNvBlockLength=1010, CryptoNvBlockFillLevel=1010, CryptoNvBlockProcessing=NV_PROCESSING_DEFERRED, CryptoNvBlockRevision=0, CryptoNvBlockCrcLayoutChecksum=3032412649, CryptoNvBlockDescriptor=Keys_Deferred_TrustModel_Root, CryptoNvBlockKeyRef=Ssa_TrustModelRootCert_inHSM
        CryptoNvBlock_Immediate_BackendCert: CryptoNvBlockId=6, CryptoNvBlockLength=922, CryptoNvBlockFillLevel=610, CryptoNvBlockProcessing=NV_PROCESSING_IMMEDIATE, CryptoNvBlockRevision=1, CryptoNvBlockCrcLayoutChecksum=1048999479, CryptoNvBlockDescriptor=Keys_Immediate_BackendCert, CryptoNvBlockKeyRef=CryptoKeys/Ssa_BackendCert
        CryptoNvBlock_Immediate_RootCert: CryptoNvBlockId=7, CryptoNvBlockLength=922, CryptoNvBlockFillLevel=610, CryptoNvBlockProcessing=NV_PROCESSING_IMMEDIATE, CryptoNvBlockRevision=1, CryptoNvBlockCrcLayoutChecksum=1326764601, CryptoNvBlockDescriptor=Keys_Immediate_RootCert, CryptoNvBlockKeyRef=CryptoKeys/Ssa_RootCert
