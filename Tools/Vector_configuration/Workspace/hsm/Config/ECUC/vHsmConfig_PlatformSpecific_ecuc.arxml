AUTOSAR XML (schema 4-3-0)
package /ActiveEcuC
  module config vBRS: implementation-config-variant=VARIANT-PRE-COMPILE, module-description=vBRS_Impl
    vBRSGeneral:
      vBRSEnableHSMSupport = true
      vBRSEnableSupportLEDs = false
      vBRSEnableSafeContextSupport = false
      vBRSEnableMultiCoreSupport = false
      vBRSEnableSupportToggleWdPin = false
      vBRSEnableSupportToggleCustomPin = false
      vBRSEnableEcuMStubGeneration = false
      vBRSDisableSetupSupport = false
      vBRSEnableSchmStubGeneration = false
      vBRSEnableSchmStubSupportDrvCanAN = false
      vBRSEnableCoreSpecificVLinkGenConfig = false
      vBRSExecutionInstance = HSM
      vBRSFblSupportEcuMInit = false
      vBRSFblSupportExceptionTableInRam = true
      vBRSFirstInstance = true
    vBRSHwConfig:
      vBRSOscClock = 20000000
      vBRSPeriphClock = 100000000
      vBRSTimebaseClock = 6250000
      vBRSCompilerInstructionSet = THUMB
      vBRSPeriphClockDescription = Initial value for Peripheral Clock: SPB (System Peripheral Bus) = 100MHz
      vBRSEnablePortHandling = false
      vBRSEnableWatchdogHandling = true
      vBRSEnablePLLClocksHandling = true
      vBRSMakefileUserCode = TARGET_DERIVATIVE = TC39x
      vBRSPreferPLLWatchdogInit = false
      vBRSEvalBoardInfo: vBRSEvalBoardDescription=, vBRSEvalBoard=
    vBRSMemoryInit: vBRSInitPatternBlocks=0, vBRSInitPatternHardResetBlocks=0, vBRSInitPatternAreas=0, vBRSInitPatternHardResetAreas=0
  module config vBaseEnv: implementation-config-variant=VARIANT-PRE-COMPILE, module-description=vBaseEnv_Impl
    vBaseEnvGeneral: vBaseEnvTestedDerivativeRef=TC3xx
      TC3xx (vBaseEnvDerivativeInformation):
        vBaseEnvCpuCore = CORTEX_M3
        vBaseEnvCpuCoreAmount = 1
        vBaseEnvCpuMaxFrequency = 6250000
        vBaseEnvTestedDerivative = TC3xx
        vBaseEnvTestedDerivativeDescription = Infineon Aurix TC3xx Family - HSM Core
        vBaseEnvAvailableChannels_Can = 0
        vBaseEnvAvailableChannels_Ethernet = 0
        vBaseEnvAvailableChannels_Flexray = 0
        vBaseEnvAvailableChannels_Lin = 0
        vBaseEnvAvailableChannels_Hyperbus = 0
        vBaseEnvAvailableChannels_I2c = 0
        vBaseEnvAvailableChannels_Spi = 0
        6 x vBaseEnvMemLayoutHwRegion:
          HSM_FLASH: vBaseEnvHwRegionSize=243452, vBaseEnvHwRegionStartAddress=2147517024, vBaseEnvHwRegionType=ROM
          HSM_RAM: vBaseEnvHwRegionSize=97904, vBaseEnvHwRegionStartAddress=536871296, vBaseEnvHwRegionType=RAM
          HSM_IPC: vBaseEnvHwRegionSize=65536, vBaseEnvHwRegionStartAddress=4026859520, vBaseEnvHwRegionType=RAM
          HSM_DATA_FLASH: vBaseEnvHwRegionSize=131072, vBaseEnvHwRegionStartAddress=2948595712, vBaseEnvHwRegionType=NVRAM
          HSM_INTVEC_FLASH: vBaseEnvHwRegionSize=256, vBaseEnvHwRegionStartAddress=2147516512, vBaseEnvHwRegionType=ROM
          HSM_ENTRY: vBaseEnvHwRegionStartAddress=2147516768, vBaseEnvHwRegionSize=256, vBaseEnvHwRegionType=ROM
      6 x vBaseEnvMemLayoutHwRegion:
        HSM_FLASH
        HSM_RAM
        HSM_IPC
        HSM_DATA_FLASH
        HSM_INTVEC_FLASH
        HSM_ENTRY
  module config Fls: implementation-config-variant=VARIANT-POST-BUILD-LOADABLE, module-description=Fls_Impl
    FlsConfigSet:
      FlsAcErase = 0
      FlsAcWrite = 0
      FlsCallCycle = 0.01
      FlsDefaultMode = MEMIF_MODE_FAST
      FlsMaxReadFastMode = 131072
      FlsMaxReadNormalMode = 131072
      FlsMaxWriteFastMode = 32
      FlsMaxWriteNormalMode = 32
      FlsProtection = 0
      FlsJobEndNotification = Fee_JobEndNotification
      FlsJobErrorNotification = Fee_JobErrorNotification
      FlsEraseVerifyErrNotif = Fee_17_JobEraseErrorNotification
      FlsSectorList
        FlsSector: FlsNumberOfSectors=2, FlsPageSize=8, FlsSectorSize=65536, FlsSectorStartaddress=0
    FlsGeneral:
      FlsAcLoadOnJobStart = false
      FlsBaseAddress = 4290772992
      FlsBlankCheckApi = false
      FlsInitCheckApi = false
      FlsCancelApi = false
      FlsCompareApi = false
      FlsDevErrorDetect = true
      FlsRunTimeErrorDetect = false
      FlsSafetyEnable = false
      FlsIfxFeeUse = true
      FlsDriverIndex = 0
      FlsGetJobResultApi = true
      FlsGetStatusApi = true
      FlsSetModeApi = true
      FlsTotalSize = 131072
      FlsUseInterrupts = false
      FlsVersionInfoApi = false
    FlsPublishedInformation:
      FlsAcLocationErase = 0
      FlsAcLocationWrite = 0
      FlsAcSizeErase = 0
      FlsAcSizeWrite = 0
      FlsEraseTime = 22500000
      FlsErasedValue = 0
      FlsExpectedHwId = 0
      FlsSpecifiedEraseCycles = 125000
      FlsWriteTime = 50140
    FlsIfxSpecificConfig: FlsStateVarStruct=FlsStateVar, FlsUseEraseSuspend=false, FlsEraseSuspendTimeout=12000, FlsIllegalStateNotification=Fee_17_IllegalStateNotification
    CommonPublishedInformation:
      ArMajorVersion = 4
      ArMinorVersion = 2
      ArPatchVersion = 2
      SwMajorVersion = 2
      SwMinorVersion = 0
      SwPatchVersion = 0
      ModuleId = 92
      VendorId = 17
      VendorApiInfix = Dmu
      Release = _TRICORE_TC322
  module config Fee: implementation-config-variant=VARIANT-POST-BUILD-LOADABLE, module-description=Fee_Impl
    Keys_Deferred_cons0 (FeeBlockConfiguration):
      FeeBlockNumber = 17
      FeeQsBlockInstances = 0
      FeeQsBlockAddress = 0
      FeeQuasiStaticManager = false
      FeeBlockSize = 74
      FeeImmediateData = false
      FeeNumberOfWriteCycles = 0
      FeeDeviceIndex = FlsGeneral
    FeeGeneral:
      FeeDevErrorDetect = true
      FeeSafetyEnable = false
      FeeInitCheckApi = false
      FeeMainFunctionPeriod = 0.01
      FeePollingMode = false
      FeeSetModeSupported = true
      FeeVersionInfoApi = false
      FeeVirtualPageSize = 8
      FeeBlockTypeConfigured = FEE_DOUBLE_SECTOR_DATA_ONLY
    FeePublishedInformation: FeeBlockOverhead=17, FeePageOverhead=1
    FeeIfxSpecificConfig:
      FeeThresholdValue = 200
      FeeMaxBlockCount = 1
      FeeUseEraseSuspend = false
      FeeStateVarStructure = Fee_StateVar
      FeeUnConfigBlock = FEE_UNCONFIG_BLOCK_IGNORE
      FeeUnConfigBlkOverflowHandle = FEE_CONTINUE
      FeeGcRestart = FEE_GC_RESTART_INIT
      FeeGetCycleCountApi = false
      FeeEraseAllEnable = true
      FeeGetPrevDataApi = false
      FeeCancelAllApi = false
      FeeMaxBytesPerCycle = FEE_MAX_BYTES_512
      FeeNvmIllegalStateNotification = NULL_PTR
      FeeQsIllegalStateNotification = NULL_PTR
      FeeQsHardenErrorNotification = NULL_PTR
      FeeVirginFlashIllegalState = true
    CommonPublishedInformation: ArMajorVersion=4, ArMinorVersion=2, ArPatchVersion=2, SwMajorVersion=2, SwMinorVersion=0, SwPatchVersion=0, ModuleId=21, VendorId=17, Release=_TRICORE_TC322
    17 x FeeBlockConfiguration, all with FeeQsBlockInstances=0, FeeQsBlockAddress=0, FeeQuasiStaticManager=false, FeeImmediateData=false, FeeNumberOfWriteCycles=0, FeeDeviceIndex=FlsGeneral:
      Keys_Deferred: FeeBlockNumber=16, FeeBlockSize=74
      Keys_Immediate: FeeBlockNumber=32, FeeBlockSize=284
      Keys_Immediate_cons0: FeeBlockNumber=33, FeeBlockSize=284
      NvMConfigBlock: FeeBlockNumber=64, FeeBlockSize=4
      NvMConfigBlock_cons0: FeeBlockNumber=65, FeeBlockSize=4
      FeeKeys_Deferred_TrustModel_NoRoot: FeeBlockNumber=256, FeeBlockSize=3022
      FeeKeys_Deferred_TrustModel_NoRoot_cons0: FeeBlockNumber=257, FeeBlockSize=3022
      FeeKeys_Deferred_TrustModel_Root: FeeBlockNumber=272, FeeBlockSize=1014
      FeeKeys_Deferred_TrustModel_Root_cons0: FeeBlockNumber=273, FeeBlockSize=1014
      Keys_Deferred_SecOC: FeeBlockNumber=192, FeeBlockSize=404
      Keys_Deferred_SecOC_cons0: FeeBlockNumber=193, FeeBlockSize=404
      Keys_Deferred_SharedSecretHash: FeeBlockNumber=208, FeeBlockSize=20
      Keys_Deferred_SharedSecretHash_cons0: FeeBlockNumber=209, FeeBlockSize=20
      Keys_Immediate_BackendCert: FeeBlockNumber=240, FeeBlockSize=926
      Keys_Immediate_BackendCert_cons0: FeeBlockNumber=241, FeeBlockSize=926
      Keys_Immediate_RootCert: FeeBlockNumber=224, FeeBlockSize=926
      Keys_Immediate_RootCert_cons0: FeeBlockNumber=225, FeeBlockSize=926
