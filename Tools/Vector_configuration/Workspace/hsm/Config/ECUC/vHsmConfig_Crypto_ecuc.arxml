AUTOSAR XML (schema 4-3-0)
package /ActiveEcuC
  module config Crypto_30_Hwa: definition=Crypto, implementation-config-variant=VARIANT-PRE-COMPILE, module-description=Crypto_Impl
    CryptoKeys
      4 x CryptoKey, all with CryptoKeyDeriveIterations=1:
        RomKey0: CryptoKeyId=30004, CryptoKeyTypeRef=Crypto_30_Hwa_RomKeyType
        vHsm_Hal_Hardware: CryptoKeyId=30005, CryptoKeyTypeRef=CryptoKeyTypes/vHsm_Hal_Hardware
        CryptoKey_Fbl_Fips186: CryptoKeyId=30001, CryptoKeyTypeRef=Random_Fips186_Sha1
        CryptoKey_Fbl_HashDummy: CryptoKeyId=30002, CryptoKeyTypeRef=Hash
    CryptoKeyTypes
      4 x CryptoKeyType:
        Crypto_30_Hwa_RomKeyType: CryptoKeyElementRef=Crypto_30_Hwa_RomKey
        vHsm_Hal_Hardware: CryptoKeyElementRef=vHsm_Hal_FlashOperation
        Random_Fips186_Sha1: CryptoKeyElementRef=Crypto_30_Hwa_Random_Algorithm_Fips186_Sha1, CryptoKeyElementRef=Crypto_30_Hwa_Random_Seed
        Hash: CryptoKeyElementRef=Crypto_30_Hwa_Hash_Result
    CryptoKeyElements
      5 x CryptoKeyElement, all with CryptoKeyElementAllowPartialAccess=false, CryptoKeyElementPersist=false:
        Crypto_30_Hwa_RomKey: CryptoKeyElementId=7, CryptoKeyElementSize=16, CryptoKeyElementInitValue=0, CryptoKeyElementReadAccess=RA_DENIED, CryptoKeyElementWriteAccess=WA_DENIED
        vHsm_Hal_FlashOperation: CryptoKeyElementId=3032, CryptoKeyElementSize=1, CryptoKeyElementReadAccess=RA_DENIED, CryptoKeyElementWriteAccess=WA_ALLOWED
        Crypto_30_Hwa_Random_Algorithm_Fips186_Sha1: CryptoKeyElementId=5, CryptoKeyElementSize=16, CryptoKeyElementReadAccess=RA_ALLOWED, CryptoKeyElementWriteAccess=WA_ALLOWED
        Crypto_30_Hwa_Random_Seed: CryptoKeyElementId=6, CryptoKeyElementSize=16, CryptoKeyElementReadAccess=RA_ALLOWED, CryptoKeyElementWriteAccess=WA_ALLOWED
        Crypto_30_Hwa_Hash_Result: CryptoKeyElementId=4, CryptoKeyElementSize=20, CryptoKeyElementReadAccess=RA_ALLOWED, CryptoKeyElementWriteAccess=WA_ALLOWED
    CryptoPrimitives
      4 x CryptoPrimitive, all with CryptoPrimitiveAlgorithmFamily=CRYPTO_ALGOFAM_AES, CryptoPrimitiveAlgorithmSecondaryFamily=CRYPTO_ALGOFAM_NOT_SET:
        AesGCMDecrypt: CryptoPrimitiveAlgorithmMode=CRYPTO_ALGOMODE_GCM, CryptoPrimitiveService=CRYPTO_AEADDECRYPT
        AesGCMEncrypt: CryptoPrimitiveAlgorithmMode=CRYPTO_ALGOMODE_GCM, CryptoPrimitiveService=CRYPTO_AEADENCRYPT
        AesGCMSIVDecrypt: CryptoPrimitiveService=CRYPTO_AEADDECRYPT, CryptoPrimitiveAlgorithmMode=CRYPTO_ALGOMODE_CUSTOM, CryptoPrimitiveAlgorithmModeCustomRef=Crypto_30_Hwa_Aes_Gcm_Siv
        AesGCMSIVEncrypt: CryptoPrimitiveService=CRYPTO_AEADENCRYPT, CryptoPrimitiveAlgorithmMode=CRYPTO_ALGOMODE_CUSTOM, CryptoPrimitiveAlgorithmModeCustomRef=Crypto_30_Hwa_Aes_Gcm_Siv
      Crypto_30_Hwa_Aes_Gcm_Siv (CryptoPrimitiveAlgorithmModeCustom): CryptoPrimitiveAlgorithmModeCustomId=173
      EccP256R1VerifyWithoutPrehashing (CryptoPrimitive):
        CryptoPrimitiveAlgorithmFamily = CRYPTO_ALGOFAM_ECCNIST
        CryptoPrimitiveAlgorithmMode = CRYPTO_ALGOMODE_NOT_SET
        CryptoPrimitiveService = CRYPTO_SIGNATURE_VERIFY
        CryptoPrimitiveAlgorithmSecondaryFamily = CRYPTO_ALGOFAM_NOT_SET
        CryptoPrimitiveAlgorithmFamilyCustomRef = Crypto_30_Hwa_ECCANSI
        CryptoPrimitiveAlgorithmFamilyCustomRef = Crypto_30_Hwa_ECCSEC
        CryptoPrimitiveAlgorithmModeCustomRef = Crypto_30_Hwa_P256r1
      Crypto_30_Hwa_ECCANSI (CryptoPrimitiveAlgorithmFamilyCustom): CryptoPrimitiveAlgorithmFamilyCustomId=129
      Crypto_30_Hwa_ECCSEC (CryptoPrimitiveAlgorithmFamilyCustom): CryptoPrimitiveAlgorithmFamilyCustomId=130
      Crypto_30_Hwa_P256r1 (CryptoPrimitiveAlgorithmModeCustom): CryptoPrimitiveAlgorithmModeCustomId=128
      6 x CryptoPrimitive, all with CryptoPrimitiveAlgorithmSecondaryFamily=CRYPTO_ALGOFAM_NOT_SET:
        SHA256: CryptoPrimitiveAlgorithmFamily=CRYPTO_ALGOFAM_SHA2_256, CryptoPrimitiveAlgorithmMode=CRYPTO_ALGOMODE_NOT_SET, CryptoPrimitiveService=CRYPTO_HASH
        AesCmacGenerate: CryptoPrimitiveAlgorithmFamily=CRYPTO_ALGOFAM_AES, CryptoPrimitiveAlgorithmMode=CRYPTO_ALGOMODE_CMAC, CryptoPrimitiveService=CRYPTO_MAC_GENERATE
        AesCmacVerify: CryptoPrimitiveAlgorithmFamily=CRYPTO_ALGOFAM_AES, CryptoPrimitiveAlgorithmMode=CRYPTO_ALGOMODE_CMAC, CryptoPrimitiveService=CRYPTO_MAC_VERIFY
        AesEncrypt: CryptoPrimitiveAlgorithmFamily=CRYPTO_ALGOFAM_AES, CryptoPrimitiveAlgorithmMode=CRYPTO_ALGOMODE_ECB, CryptoPrimitiveService=CRYPTO_ENCRYPT, CryptoPrimitiveAlgorithmMode=CRYPTO_ALGOMODE_CBC, CryptoPrimitiveAlgorithmMode=CRYPTO_ALGOMODE_CTR, CryptoPrimitiveAlgorithmSecondaryFamilyCustomRef=Crypto_30_Hwa_PaddingPKCS7
        AesDecrypt: CryptoPrimitiveAlgorithmFamily=CRYPTO_ALGOFAM_AES, CryptoPrimitiveAlgorithmMode=CRYPTO_ALGOMODE_ECB, CryptoPrimitiveAlgorithmMode=CRYPTO_ALGOMODE_CBC, CryptoPrimitiveAlgorithmMode=CRYPTO_ALGOMODE_CTR, CryptoPrimitiveService=CRYPTO_DECRYPT, CryptoPrimitiveAlgorithmSecondaryFamilyCustomRef=Crypto_30_Hwa_PaddingPKCS7
        Trng: CryptoPrimitiveAlgorithmFamily=CRYPTO_ALGOFAM_RNG, CryptoPrimitiveAlgorithmMode=CRYPTO_ALGOMODE_NOT_SET, CryptoPrimitiveService=CRYPTO_RANDOM
      Crypto_30_Hwa_PaddingPKCS7 (CryptoPrimitiveAlgorithmFamilyCustom): CryptoPrimitiveAlgorithmFamilyCustomId=133
      16 x CryptoPrimitive:
        EccP256R1VerifyRIPEMD160: CryptoPrimitiveService=CRYPTO_SIGNATURE_VERIFY, CryptoPrimitiveAlgorithmFamily=CRYPTO_ALGOFAM_ECCNIST, CryptoPrimitiveAlgorithmMode=CRYPTO_ALGOMODE_NOT_SET, CryptoPrimitiveAlgorithmSecondaryFamily=CRYPTO_ALGOFAM_RIPEMD160, CryptoPrimitiveAlgorithmFamilyCustomRef=Crypto_30_Hwa_ECCSEC, CryptoPrimitiveAlgorithmFamilyCustomRef=Crypto_30_Hwa_ECCANSI, CryptoPrimitiveAlgorithmModeCustomRef=Crypto_30_Hwa_P256r1
        EccP256R1VerifySHA1: CryptoPrimitiveService=CRYPTO_SIGNATURE_VERIFY, CryptoPrimitiveAlgorithmFamily=CRYPTO_ALGOFAM_ECCNIST, CryptoPrimitiveAlgorithmMode=CRYPTO_ALGOMODE_NOT_SET, CryptoPrimitiveAlgorithmSecondaryFamily=CRYPTO_ALGOFAM_SHA1, CryptoPrimitiveAlgorithmFamilyCustomRef=Crypto_30_Hwa_ECCSEC, CryptoPrimitiveAlgorithmFamilyCustomRef=Crypto_30_Hwa_ECCANSI, CryptoPrimitiveAlgorithmModeCustomRef=Crypto_30_Hwa_P256r1
        EccP256R1VerifySHA2_224: CryptoPrimitiveService=CRYPTO_SIGNATURE_VERIFY, CryptoPrimitiveAlgorithmFamily=CRYPTO_ALGOFAM_ECCNIST, CryptoPrimitiveAlgorithmMode=CRYPTO_ALGOMODE_NOT_SET, CryptoPrimitiveAlgorithmSecondaryFamily=CRYPTO_ALGOFAM_SHA2_224, CryptoPrimitiveAlgorithmFamilyCustomRef=Crypto_30_Hwa_ECCSEC, CryptoPrimitiveAlgorithmFamilyCustomRef=Crypto_30_Hwa_ECCANSI, CryptoPrimitiveAlgorithmModeCustomRef=Crypto_30_Hwa_P256r1
        EccP256R1VerifySHA2_256: CryptoPrimitiveService=CRYPTO_SIGNATURE_VERIFY, CryptoPrimitiveAlgorithmFamily=CRYPTO_ALGOFAM_ECCNIST, CryptoPrimitiveAlgorithmMode=CRYPTO_ALGOMODE_NOT_SET, CryptoPrimitiveAlgorithmSecondaryFamily=CRYPTO_ALGOFAM_SHA2_256, CryptoPrimitiveAlgorithmFamilyCustomRef=Crypto_30_Hwa_ECCSEC, CryptoPrimitiveAlgorithmFamilyCustomRef=Crypto_30_Hwa_ECCANSI, CryptoPrimitiveAlgorithmModeCustomRef=Crypto_30_Hwa_P256r1
        EccP256R1VerifySHA2_384: CryptoPrimitiveService=CRYPTO_SIGNATURE_VERIFY, CryptoPrimitiveAlgorithmFamily=CRYPTO_ALGOFAM_ECCNIST, CryptoPrimitiveAlgorithmMode=CRYPTO_ALGOMODE_NOT_SET, CryptoPrimitiveAlgorithmSecondaryFamily=CRYPTO_ALGOFAM_SHA2_384, CryptoPrimitiveAlgorithmFamilyCustomRef=Crypto_30_Hwa_ECCSEC, CryptoPrimitiveAlgorithmFamilyCustomRef=Crypto_30_Hwa_ECCANSI, CryptoPrimitiveAlgorithmModeCustomRef=Crypto_30_Hwa_P256r1
        EccP256R1VerifySHA2_512: CryptoPrimitiveService=CRYPTO_SIGNATURE_VERIFY, CryptoPrimitiveAlgorithmFamily=CRYPTO_ALGOFAM_ECCNIST, CryptoPrimitiveAlgorithmMode=CRYPTO_ALGOMODE_NOT_SET, CryptoPrimitiveAlgorithmSecondaryFamily=CRYPTO_ALGOFAM_SHA2_512, CryptoPrimitiveAlgorithmFamilyCustomRef=Crypto_30_Hwa_ECCSEC, CryptoPrimitiveAlgorithmFamilyCustomRef=Crypto_30_Hwa_ECCANSI, CryptoPrimitiveAlgorithmModeCustomRef=Crypto_30_Hwa_P256r1
        EccP256R1VerifySHA2_512_224: CryptoPrimitiveService=CRYPTO_SIGNATURE_VERIFY, CryptoPrimitiveAlgorithmFamily=CRYPTO_ALGOFAM_ECCNIST, CryptoPrimitiveAlgorithmMode=CRYPTO_ALGOMODE_NOT_SET, CryptoPrimitiveAlgorithmSecondaryFamily=CRYPTO_ALGOFAM_SHA2_512_224, CryptoPrimitiveAlgorithmFamilyCustomRef=Crypto_30_Hwa_ECCSEC, CryptoPrimitiveAlgorithmFamilyCustomRef=Crypto_30_Hwa_ECCANSI, CryptoPrimitiveAlgorithmModeCustomRef=Crypto_30_Hwa_P256r1
        EccP256R1VerifySHA2_512_256: CryptoPrimitiveService=CRYPTO_SIGNATURE_VERIFY, CryptoPrimitiveAlgorithmFamily=CRYPTO_ALGOFAM_ECCNIST, CryptoPrimitiveAlgorithmMode=CRYPTO_ALGOMODE_NOT_SET, CryptoPrimitiveAlgorithmSecondaryFamily=CRYPTO_ALGOFAM_SHA2_512_256, CryptoPrimitiveAlgorithmFamilyCustomRef=Crypto_30_Hwa_ECCSEC, CryptoPrimitiveAlgorithmFamilyCustomRef=Crypto_30_Hwa_ECCANSI, CryptoPrimitiveAlgorithmModeCustomRef=Crypto_30_Hwa_P256r1
        EccP256R1VerifySHA3_224: CryptoPrimitiveService=CRYPTO_SIGNATURE_VERIFY, CryptoPrimitiveAlgorithmFamily=CRYPTO_ALGOFAM_ECCNIST, CryptoPrimitiveAlgorithmMode=CRYPTO_ALGOMODE_NOT_SET, CryptoPrimitiveAlgorithmSecondaryFamily=CRYPTO_ALGOFAM_SHA3_224, CryptoPrimitiveAlgorithmFamilyCustomRef=Crypto_30_Hwa_ECCSEC, CryptoPrimitiveAlgorithmFamilyCustomRef=Crypto_30_Hwa_ECCANSI, CryptoPrimitiveAlgorithmModeCustomRef=Crypto_30_Hwa_P256r1
        EccP256R1VerifySHA3_256: CryptoPrimitiveService=CRYPTO_SIGNATURE_VERIFY, CryptoPrimitiveAlgorithmFamily=CRYPTO_ALGOFAM_ECCNIST, CryptoPrimitiveAlgorithmMode=CRYPTO_ALGOMODE_NOT_SET, CryptoPrimitiveAlgorithmSecondaryFamily=CRYPTO_ALGOFAM_SHA3_256, CryptoPrimitiveAlgorithmFamilyCustomRef=Crypto_30_Hwa_ECCSEC, CryptoPrimitiveAlgorithmFamilyCustomRef=Crypto_30_Hwa_ECCANSI, CryptoPrimitiveAlgorithmModeCustomRef=Crypto_30_Hwa_P256r1
        EccP256R1VerifySHA3_384: CryptoPrimitiveService=CRYPTO_SIGNATURE_VERIFY, CryptoPrimitiveAlgorithmFamily=CRYPTO_ALGOFAM_ECCNIST, CryptoPrimitiveAlgorithmMode=CRYPTO_ALGOMODE_NOT_SET, CryptoPrimitiveAlgorithmSecondaryFamily=CRYPTO_ALGOFAM_SHA3_384, CryptoPrimitiveAlgorithmFamilyCustomRef=Crypto_30_Hwa_ECCSEC, CryptoPrimitiveAlgorithmFamilyCustomRef=Crypto_30_Hwa_ECCANSI, CryptoPrimitiveAlgorithmModeCustomRef=Crypto_30_Hwa_P256r1
        EccP256R1VerifySHA3_512: CryptoPrimitiveService=CRYPTO_SIGNATURE_VERIFY, CryptoPrimitiveAlgorithmFamily=CRYPTO_ALGOFAM_ECCNIST, CryptoPrimitiveAlgorithmMode=CRYPTO_ALGOMODE_NOT_SET, CryptoPrimitiveAlgorithmSecondaryFamily=CRYPTO_ALGOFAM_SHA3_512, CryptoPrimitiveAlgorithmFamilyCustomRef=Crypto_30_Hwa_ECCSEC, CryptoPrimitiveAlgorithmFamilyCustomRef=Crypto_30_Hwa_ECCANSI, CryptoPrimitiveAlgorithmModeCustomRef=Crypto_30_Hwa_P256r1
        EccP256R1VerifySHAKE128: CryptoPrimitiveService=CRYPTO_SIGNATURE_VERIFY, CryptoPrimitiveAlgorithmFamily=CRYPTO_ALGOFAM_ECCNIST, CryptoPrimitiveAlgorithmMode=CRYPTO_ALGOMODE_NOT_SET, CryptoPrimitiveAlgorithmSecondaryFamily=CRYPTO_ALGOFAM_SHAKE128, CryptoPrimitiveAlgorithmFamilyCustomRef=Crypto_30_Hwa_ECCSEC, CryptoPrimitiveAlgorithmFamilyCustomRef=Crypto_30_Hwa_ECCANSI, CryptoPrimitiveAlgorithmModeCustomRef=Crypto_30_Hwa_P256r1
        EccP256R1VerifySHAKE256: CryptoPrimitiveService=CRYPTO_SIGNATURE_VERIFY, CryptoPrimitiveAlgorithmFamily=CRYPTO_ALGOFAM_ECCNIST, CryptoPrimitiveAlgorithmMode=CRYPTO_ALGOMODE_NOT_SET, CryptoPrimitiveAlgorithmSecondaryFamily=CRYPTO_ALGOFAM_SHAKE256, CryptoPrimitiveAlgorithmFamilyCustomRef=Crypto_30_Hwa_ECCSEC, CryptoPrimitiveAlgorithmFamilyCustomRef=Crypto_30_Hwa_ECCANSI, CryptoPrimitiveAlgorithmModeCustomRef=Crypto_30_Hwa_P256r1
        EccP256R1GenerateWithoutPrehashing: CryptoPrimitiveAlgorithmFamily=CRYPTO_ALGOFAM_ECCNIST, CryptoPrimitiveAlgorithmMode=CRYPTO_ALGOMODE_NOT_SET, CryptoPrimitiveService=CRYPTO_SIGNATURE_GENERATE, CryptoPrimitiveAlgorithmSecondaryFamily=CRYPTO_ALGOFAM_NOT_SET, CryptoPrimitiveAlgorithmFamilyCustomRef=Crypto_30_Hwa_ECCANSI, CryptoPrimitiveAlgorithmFamilyCustomRef=Crypto_30_Hwa_ECCSEC, CryptoPrimitiveAlgorithmModeCustomRef=Crypto_30_Hwa_P256r1
        Ed25519GenerateWithoutPrehashing: CryptoPrimitiveAlgorithmFamily=CRYPTO_ALGOFAM_ED25519, CryptoPrimitiveAlgorithmMode=CRYPTO_ALGOMODE_CUSTOM, CryptoPrimitiveService=CRYPTO_SIGNATURE_GENERATE, CryptoPrimitiveAlgorithmSecondaryFamily=CRYPTO_ALGOFAM_NOT_SET, CryptoPrimitiveAlgorithmModeCustomRef=Crypto_30_Hwa_Ed25519Pure, CryptoPrimitiveAlgorithmModeCustomRef=Crypto_30_Hwa_Ed25519Ctx, CryptoPrimitiveAlgorithmModeCustomRef=Crypto_30_Hwa_Ed25519Ph
      3 x CryptoPrimitiveAlgorithmModeCustom:
        Crypto_30_Hwa_Ed25519Pure: CryptoPrimitiveAlgorithmModeCustomId=174
        Crypto_30_Hwa_Ed25519Ctx: CryptoPrimitiveAlgorithmModeCustomId=175
        Crypto_30_Hwa_Ed25519Ph: CryptoPrimitiveAlgorithmModeCustomId=176
      43 x CryptoPrimitive:
        Ed25519VerifyWithoutPrehashing: CryptoPrimitiveAlgorithmFamily=CRYPTO_ALGOFAM_ED25519, CryptoPrimitiveAlgorithmMode=CRYPTO_ALGOMODE_CUSTOM, CryptoPrimitiveService=CRYPTO_SIGNATURE_VERIFY, CryptoPrimitiveAlgorithmSecondaryFamily=CRYPTO_ALGOFAM_NOT_SET, CryptoPrimitiveAlgorithmModeCustomRef=Crypto_30_Hwa_Ed25519Pure, CryptoPrimitiveAlgorithmModeCustomRef=Crypto_30_Hwa_Ed25519Ctx, CryptoPrimitiveAlgorithmModeCustomRef=Crypto_30_Hwa_Ed25519Ph
        Ed25519VerifySHA2_512_256: CryptoPrimitiveAlgorithmSecondaryFamily=CRYPTO_ALGOFAM_SHA2_512_256, CryptoPrimitiveService=CRYPTO_SIGNATURE_VERIFY, CryptoPrimitiveAlgorithmFamily=CRYPTO_ALGOFAM_ED25519, CryptoPrimitiveAlgorithmMode=CRYPTO_ALGOMODE_CUSTOM, CryptoPrimitiveAlgorithmModeCustomRef=Crypto_30_Hwa_Ed25519Pure, CryptoPrimitiveAlgorithmModeCustomRef=Crypto_30_Hwa_Ed25519Ctx, CryptoPrimitiveAlgorithmModeCustomRef=Crypto_30_Hwa_Ed25519Ph
        EccP256R1GenerateRIPEMD160: CryptoPrimitiveAlgorithmSecondaryFamily=CRYPTO_ALGOFAM_RIPEMD160, CryptoPrimitiveService=CRYPTO_SIGNATURE_GENERATE, CryptoPrimitiveAlgorithmFamily=CRYPTO_ALGOFAM_ECCNIST, CryptoPrimitiveAlgorithmMode=CRYPTO_ALGOMODE_NOT_SET, CryptoPrimitiveAlgorithmFamilyCustomRef=Crypto_30_Hwa_ECCANSI, CryptoPrimitiveAlgorithmFamilyCustomRef=Crypto_30_Hwa_ECCSEC, CryptoPrimitiveAlgorithmModeCustomRef=Crypto_30_Hwa_P256r1
        EccP256R1GenerateSHA1: CryptoPrimitiveAlgorithmSecondaryFamily=CRYPTO_ALGOFAM_SHA1, CryptoPrimitiveService=CRYPTO_SIGNATURE_GENERATE, CryptoPrimitiveAlgorithmFamily=CRYPTO_ALGOFAM_ECCNIST, CryptoPrimitiveAlgorithmMode=CRYPTO_ALGOMODE_NOT_SET, CryptoPrimitiveAlgorithmFamilyCustomRef=Crypto_30_Hwa_ECCANSI, CryptoPrimitiveAlgorithmFamilyCustomRef=Crypto_30_Hwa_ECCSEC, CryptoPrimitiveAlgorithmModeCustomRef=Crypto_30_Hwa_P256r1
        EccP256R1GenerateSHA2_224: CryptoPrimitiveAlgorithmSecondaryFamily=CRYPTO_ALGOFAM_SHA2_224, CryptoPrimitiveService=CRYPTO_SIGNATURE_GENERATE, CryptoPrimitiveAlgorithmFamily=CRYPTO_ALGOFAM_ECCNIST, CryptoPrimitiveAlgorithmMode=CRYPTO_ALGOMODE_NOT_SET, CryptoPrimitiveAlgorithmFamilyCustomRef=Crypto_30_Hwa_ECCANSI, CryptoPrimitiveAlgorithmFamilyCustomRef=Crypto_30_Hwa_ECCSEC, CryptoPrimitiveAlgorithmModeCustomRef=Crypto_30_Hwa_P256r1
        EccP256R1GenerateSHA2_256: CryptoPrimitiveAlgorithmSecondaryFamily=CRYPTO_ALGOFAM_SHA2_256, CryptoPrimitiveService=CRYPTO_SIGNATURE_GENERATE, CryptoPrimitiveAlgorithmFamily=CRYPTO_ALGOFAM_ECCNIST, CryptoPrimitiveAlgorithmMode=CRYPTO_ALGOMODE_NOT_SET, CryptoPrimitiveAlgorithmFamilyCustomRef=Crypto_30_Hwa_ECCANSI, CryptoPrimitiveAlgorithmFamilyCustomRef=Crypto_30_Hwa_ECCSEC, CryptoPrimitiveAlgorithmModeCustomRef=Crypto_30_Hwa_P256r1
        EccP256R1GenerateSHA2_384: CryptoPrimitiveAlgorithmSecondaryFamily=CRYPTO_ALGOFAM_SHA2_384, CryptoPrimitiveService=CRYPTO_SIGNATURE_GENERATE, CryptoPrimitiveAlgorithmFamily=CRYPTO_ALGOFAM_ECCNIST, CryptoPrimitiveAlgorithmMode=CRYPTO_ALGOMODE_NOT_SET, CryptoPrimitiveAlgorithmFamilyCustomRef=Crypto_30_Hwa_ECCANSI, CryptoPrimitiveAlgorithmFamilyCustomRef=Crypto_30_Hwa_ECCSEC, CryptoPrimitiveAlgorithmModeCustomRef=Crypto_30_Hwa_P256r1
        EccP256R1GenerateSHA2_512: CryptoPrimitiveAlgorithmSecondaryFamily=CRYPTO_ALGOFAM_SHA2_512, CryptoPrimitiveService=CRYPTO_SIGNATURE_GENERATE, CryptoPrimitiveAlgorithmFamily=CRYPTO_ALGOFAM_ECCNIST, CryptoPrimitiveAlgorithmMode=CRYPTO_ALGOMODE_NOT_SET, CryptoPrimitiveAlgorithmFamilyCustomRef=Crypto_30_Hwa_ECCANSI, CryptoPrimitiveAlgorithmFamilyCustomRef=Crypto_30_Hwa_ECCSEC, CryptoPrimitiveAlgorithmModeCustomRef=Crypto_30_Hwa_P256r1
        EccP256R1GenerateSHA2_512_224: CryptoPrimitiveAlgorithmSecondaryFamily=CRYPTO_ALGOFAM_SHA2_512_224, CryptoPrimitiveService=CRYPTO_SIGNATURE_GENERATE, CryptoPrimitiveAlgorithmFamily=CRYPTO_ALGOFAM_ECCNIST, CryptoPrimitiveAlgorithmMode=CRYPTO_ALGOMODE_NOT_SET, CryptoPrimitiveAlgorithmFamilyCustomRef=Crypto_30_Hwa_ECCANSI, CryptoPrimitiveAlgorithmFamilyCustomRef=Crypto_30_Hwa_ECCSEC, CryptoPrimitiveAlgorithmModeCustomRef=Crypto_30_Hwa_P256r1
        EccP256R1GenerateSHA2_512_256: CryptoPrimitiveAlgorithmSecondaryFamily=CRYPTO_ALGOFAM_SHA2_512_256, CryptoPrimitiveService=CRYPTO_SIGNATURE_GENERATE, CryptoPrimitiveAlgorithmFamily=CRYPTO_ALGOFAM_ECCNIST, CryptoPrimitiveAlgorithmMode=CRYPTO_ALGOMODE_NOT_SET, CryptoPrimitiveAlgorithmFamilyCustomRef=Crypto_30_Hwa_ECCANSI, CryptoPrimitiveAlgorithmFamilyCustomRef=Crypto_30_Hwa_ECCSEC, CryptoPrimitiveAlgorithmModeCustomRef=Crypto_30_Hwa_P256r1
        EccP256R1GenerateSHA3_224: CryptoPrimitiveAlgorithmSecondaryFamily=CRYPTO_ALGOFAM_SHA3_224, CryptoPrimitiveService=CRYPTO_SIGNATURE_GENERATE, CryptoPrimitiveAlgorithmFamily=CRYPTO_ALGOFAM_ECCNIST, CryptoPrimitiveAlgorithmMode=CRYPTO_ALGOMODE_NOT_SET, CryptoPrimitiveAlgorithmFamilyCustomRef=Crypto_30_Hwa_ECCANSI, CryptoPrimitiveAlgorithmFamilyCustomRef=Crypto_30_Hwa_ECCSEC, CryptoPrimitiveAlgorithmModeCustomRef=Crypto_30_Hwa_P256r1
        EccP256R1GenerateSHA3_256: CryptoPrimitiveAlgorithmSecondaryFamily=CRYPTO_ALGOFAM_SHA3_256, CryptoPrimitiveService=CRYPTO_SIGNATURE_GENERATE, CryptoPrimitiveAlgorithmFamily=CRYPTO_ALGOFAM_ECCNIST, CryptoPrimitiveAlgorithmMode=CRYPTO_ALGOMODE_NOT_SET, CryptoPrimitiveAlgorithmFamilyCustomRef=Crypto_30_Hwa_ECCANSI, CryptoPrimitiveAlgorithmFamilyCustomRef=Crypto_30_Hwa_ECCSEC, CryptoPrimitiveAlgorithmModeCustomRef=Crypto_30_Hwa_P256r1
        EccP256R1GenerateSHA3_384: CryptoPrimitiveAlgorithmSecondaryFamily=CRYPTO_ALGOFAM_SHA3_384, CryptoPrimitiveService=CRYPTO_SIGNATURE_GENERATE, CryptoPrimitiveAlgorithmFamily=CRYPTO_ALGOFAM_ECCNIST, CryptoPrimitiveAlgorithmMode=CRYPTO_ALGOMODE_NOT_SET, CryptoPrimitiveAlgorithmFamilyCustomRef=Crypto_30_Hwa_ECCANSI, CryptoPrimitiveAlgorithmFamilyCustomRef=Crypto_30_Hwa_ECCSEC, CryptoPrimitiveAlgorithmModeCustomRef=Crypto_30_Hwa_P256r1
        EccP256R1GenerateSHA3_512: CryptoPrimitiveAlgorithmSecondaryFamily=CRYPTO_ALGOFAM_SHA3_512, CryptoPrimitiveService=CRYPTO_SIGNATURE_GENERATE, CryptoPrimitiveAlgorithmFamily=CRYPTO_ALGOFAM_ECCNIST, CryptoPrimitiveAlgorithmMode=CRYPTO_ALGOMODE_NOT_SET, CryptoPrimitiveAlgorithmFamilyCustomRef=Crypto_30_Hwa_ECCANSI, CryptoPrimitiveAlgorithmFamilyCustomRef=Crypto_30_Hwa_ECCSEC, CryptoPrimitiveAlgorithmModeCustomRef=Crypto_30_Hwa_P256r1
        EccP256R1GenerateSHAKE128: CryptoPrimitiveAlgorithmSecondaryFamily=CRYPTO_ALGOFAM_SHAKE128, CryptoPrimitiveService=CRYPTO_SIGNATURE_GENERATE, CryptoPrimitiveAlgorithmFamily=CRYPTO_ALGOFAM_ECCNIST, CryptoPrimitiveAlgorithmMode=CRYPTO_ALGOMODE_NOT_SET, CryptoPrimitiveAlgorithmFamilyCustomRef=Crypto_30_Hwa_ECCANSI, CryptoPrimitiveAlgorithmFamilyCustomRef=Crypto_30_Hwa_ECCSEC, CryptoPrimitiveAlgorithmModeCustomRef=Crypto_30_Hwa_P256r1
        EccP256R1GenerateSHAKE256: CryptoPrimitiveAlgorithmSecondaryFamily=CRYPTO_ALGOFAM_SHAKE256, CryptoPrimitiveService=CRYPTO_SIGNATURE_GENERATE, CryptoPrimitiveAlgorithmFamily=CRYPTO_ALGOFAM_ECCNIST, CryptoPrimitiveAlgorithmMode=CRYPTO_ALGOMODE_NOT_SET, CryptoPrimitiveAlgorithmFamilyCustomRef=Crypto_30_Hwa_ECCANSI, CryptoPrimitiveAlgorithmFamilyCustomRef=Crypto_30_Hwa_ECCSEC, CryptoPrimitiveAlgorithmModeCustomRef=Crypto_30_Hwa_P256r1
        Ed25519GenerateRIPEMD160: CryptoPrimitiveAlgorithmSecondaryFamily=CRYPTO_ALGOFAM_RIPEMD160, CryptoPrimitiveService=CRYPTO_SIGNATURE_GENERATE, CryptoPrimitiveAlgorithmFamily=CRYPTO_ALGOFAM_ED25519, CryptoPrimitiveAlgorithmMode=CRYPTO_ALGOMODE_CUSTOM, CryptoPrimitiveAlgorithmModeCustomRef=Crypto_30_Hwa_Ed25519Pure, CryptoPrimitiveAlgorithmModeCustomRef=Crypto_30_Hwa_Ed25519Ctx, CryptoPrimitiveAlgorithmModeCustomRef=Crypto_30_Hwa_Ed25519Ph
        Ed25519GenerateSHA1: CryptoPrimitiveAlgorithmSecondaryFamily=CRYPTO_ALGOFAM_SHA1, CryptoPrimitiveService=CRYPTO_SIGNATURE_GENERATE, CryptoPrimitiveAlgorithmFamily=CRYPTO_ALGOFAM_ED25519, CryptoPrimitiveAlgorithmMode=CRYPTO_ALGOMODE_CUSTOM, CryptoPrimitiveAlgorithmModeCustomRef=Crypto_30_Hwa_Ed25519Pure, CryptoPrimitiveAlgorithmModeCustomRef=Crypto_30_Hwa_Ed25519Ctx, CryptoPrimitiveAlgorithmModeCustomRef=Crypto_30_Hwa_Ed25519Ph
        Ed25519GenerateSHA2_224: CryptoPrimitiveAlgorithmSecondaryFamily=CRYPTO_ALGOFAM_SHA2_224, CryptoPrimitiveService=CRYPTO_SIGNATURE_GENERATE, CryptoPrimitiveAlgorithmFamily=CRYPTO_ALGOFAM_ED25519, CryptoPrimitiveAlgorithmMode=CRYPTO_ALGOMODE_CUSTOM, CryptoPrimitiveAlgorithmModeCustomRef=Crypto_30_Hwa_Ed25519Pure, CryptoPrimitiveAlgorithmModeCustomRef=Crypto_30_Hwa_Ed25519Ctx, CryptoPrimitiveAlgorithmModeCustomRef=Crypto_30_Hwa_Ed25519Ph
        Ed25519GenerateSHA2_256: CryptoPrimitiveAlgorithmSecondaryFamily=CRYPTO_ALGOFAM_SHA2_256, CryptoPrimitiveService=CRYPTO_SIGNATURE_GENERATE, CryptoPrimitiveAlgorithmFamily=CRYPTO_ALGOFAM_ED25519, CryptoPrimitiveAlgorithmMode=CRYPTO_ALGOMODE_CUSTOM, CryptoPrimitiveAlgorithmModeCustomRef=Crypto_30_Hwa_Ed25519Pure, CryptoPrimitiveAlgorithmModeCustomRef=Crypto_30_Hwa_Ed25519Ctx, CryptoPrimitiveAlgorithmModeCustomRef=Crypto_30_Hwa_Ed25519Ph
        Ed25519GenerateSHA2_384: CryptoPrimitiveAlgorithmSecondaryFamily=CRYPTO_ALGOFAM_SHA2_384, CryptoPrimitiveService=CRYPTO_SIGNATURE_GENERATE, CryptoPrimitiveAlgorithmFamily=CRYPTO_ALGOFAM_ED25519, CryptoPrimitiveAlgorithmMode=CRYPTO_ALGOMODE_CUSTOM, CryptoPrimitiveAlgorithmModeCustomRef=Crypto_30_Hwa_Ed25519Pure, CryptoPrimitiveAlgorithmModeCustomRef=Crypto_30_Hwa_Ed25519Ctx, CryptoPrimitiveAlgorithmModeCustomRef=Crypto_30_Hwa_Ed25519Ph
        Ed25519GenerateSHA2_512: CryptoPrimitiveAlgorithmSecondaryFamily=CRYPTO_ALGOFAM_SHA2_512, CryptoPrimitiveService=CRYPTO_SIGNATURE_GENERATE, CryptoPrimitiveAlgorithmFamily=CRYPTO_ALGOFAM_ED25519, CryptoPrimitiveAlgorithmMode=CRYPTO_ALGOMODE_CUSTOM, CryptoPrimitiveAlgorithmModeCustomRef=Crypto_30_Hwa_Ed25519Pure, CryptoPrimitiveAlgorithmModeCustomRef=Crypto_30_Hwa_Ed25519Ctx, CryptoPrimitiveAlgorithmModeCustomRef=Crypto_30_Hwa_Ed25519Ph
        Ed25519GenerateSHA2_512_224: CryptoPrimitiveAlgorithmSecondaryFamily=CRYPTO_ALGOFAM_SHA2_512_224, CryptoPrimitiveService=CRYPTO_SIGNATURE_GENERATE, CryptoPrimitiveAlgorithmFamily=CRYPTO_ALGOFAM_ED25519, CryptoPrimitiveAlgorithmMode=CRYPTO_ALGOMODE_CUSTOM, CryptoPrimitiveAlgorithmModeCustomRef=Crypto_30_Hwa_Ed25519Pure, CryptoPrimitiveAlgorithmModeCustomRef=Crypto_30_Hwa_Ed25519Ctx, CryptoPrimitiveAlgorithmModeCustomRef=Crypto_30_Hwa_Ed25519Ph
        Ed25519GenerateSHA2_512_256: CryptoPrimitiveAlgorithmSecondaryFamily=CRYPTO_ALGOFAM_SHA2_512_256, CryptoPrimitiveService=CRYPTO_SIGNATURE_GENERATE, CryptoPrimitiveAlgorithmFamily=CRYPTO_ALGOFAM_ED25519, CryptoPrimitiveAlgorithmMode=CRYPTO_ALGOMODE_CUSTOM, CryptoPrimitiveAlgorithmModeCustomRef=Crypto_30_Hwa_Ed25519Pure, CryptoPrimitiveAlgorithmModeCustomRef=Crypto_30_Hwa_Ed25519Ctx, CryptoPrimitiveAlgorithmModeCustomRef=Crypto_30_Hwa_Ed25519Ph
        Ed25519GenerateSHA3_224: CryptoPrimitiveAlgorithmSecondaryFamily=CRYPTO_ALGOFAM_SHA3_224, CryptoPrimitiveService=CRYPTO_SIGNATURE_GENERATE, CryptoPrimitiveAlgorithmFamily=CRYPTO_ALGOFAM_ED25519, CryptoPrimitiveAlgorithmMode=CRYPTO_ALGOMODE_CUSTOM, CryptoPrimitiveAlgorithmModeCustomRef=Crypto_30_Hwa_Ed25519Pure, CryptoPrimitiveAlgorithmModeCustomRef=Crypto_30_Hwa_Ed25519Ctx, CryptoPrimitiveAlgorithmModeCustomRef=Crypto_30_Hwa_Ed25519Ph
        Ed25519GenerateSHA3_256: CryptoPrimitiveAlgorithmSecondaryFamily=CRYPTO_ALGOFAM_SHA3_256, CryptoPrimitiveService=CRYPTO_SIGNATURE_GENERATE, CryptoPrimitiveAlgorithmFamily=CRYPTO_ALGOFAM_ED25519, CryptoPrimitiveAlgorithmMode=CRYPTO_ALGOMODE_CUSTOM, CryptoPrimitiveAlgorithmModeCustomRef=Crypto_30_Hwa_Ed25519Pure, CryptoPrimitiveAlgorithmModeCustomRef=Crypto_30_Hwa_Ed25519Ctx, CryptoPrimitiveAlgorithmModeCustomRef=Crypto_30_Hwa_Ed25519Ph
        Ed25519GenerateSHA3_384: CryptoPrimitiveAlgorithmSecondaryFamily=CRYPTO_ALGOFAM_SHA3_384, CryptoPrimitiveService=CRYPTO_SIGNATURE_GENERATE, CryptoPrimitiveAlgorithmFamily=CRYPTO_ALGOFAM_ED25519, CryptoPrimitiveAlgorithmMode=CRYPTO_ALGOMODE_CUSTOM, CryptoPrimitiveAlgorithmModeCustomRef=Crypto_30_Hwa_Ed25519Pure, CryptoPrimitiveAlgorithmModeCustomRef=Crypto_30_Hwa_Ed25519Ctx, CryptoPrimitiveAlgorithmModeCustomRef=Crypto_30_Hwa_Ed25519Ph
        Ed25519GenerateSHA3_512: CryptoPrimitiveAlgorithmSecondaryFamily=CRYPTO_ALGOFAM_SHA3_512, CryptoPrimitiveService=CRYPTO_SIGNATURE_GENERATE, CryptoPrimitiveAlgorithmFamily=CRYPTO_ALGOFAM_ED25519, CryptoPrimitiveAlgorithmMode=CRYPTO_ALGOMODE_CUSTOM, CryptoPrimitiveAlgorithmModeCustomRef=Crypto_30_Hwa_Ed25519Pure, CryptoPrimitiveAlgorithmModeCustomRef=Crypto_30_Hwa_Ed25519Ctx, CryptoPrimitiveAlgorithmModeCustomRef=Crypto_30_Hwa_Ed25519Ph
        Ed25519GenerateSHAKE128: CryptoPrimitiveAlgorithmSecondaryFamily=CRYPTO_ALGOFAM_SHAKE128, CryptoPrimitiveService=CRYPTO_SIGNATURE_GENERATE, CryptoPrimitiveAlgorithmFamily=CRYPTO_ALGOFAM_ED25519, CryptoPrimitiveAlgorithmMode=CRYPTO_ALGOMODE_CUSTOM, CryptoPrimitiveAlgorithmModeCustomRef=Crypto_30_Hwa_Ed25519Pure, CryptoPrimitiveAlgorithmModeCustomRef=Crypto_30_Hwa_Ed25519Ctx, CryptoPrimitiveAlgorithmModeCustomRef=Crypto_30_Hwa_Ed25519Ph
        Ed25519GenerateSHAKE256: CryptoPrimitiveAlgorithmSecondaryFamily=CRYPTO_ALGOFAM_SHAKE256, CryptoPrimitiveService=CRYPTO_SIGNATURE_GENERATE, CryptoPrimitiveAlgorithmFamily=CRYPTO_ALGOFAM_ED25519, CryptoPrimitiveAlgorithmMode=CRYPTO_ALGOMODE_CUSTOM, CryptoPrimitiveAlgorithmModeCustomRef=Crypto_30_Hwa_Ed25519Pure, CryptoPrimitiveAlgorithmModeCustomRef=Crypto_30_Hwa_Ed25519Ctx, CryptoPrimitiveAlgorithmModeCustomRef=Crypto_30_Hwa_Ed25519Ph
        Ed25519VerifyRIPEMD160: CryptoPrimitiveAlgorithmSecondaryFamily=CRYPTO_ALGOFAM_RIPEMD160, CryptoPrimitiveService=CRYPTO_SIGNATURE_VERIFY, CryptoPrimitiveAlgorithmFamily=CRYPTO_ALGOFAM_ED25519, CryptoPrimitiveAlgorithmMode=CRYPTO_ALGOMODE_CUSTOM, CryptoPrimitiveAlgorithmModeCustomRef=Crypto_30_Hwa_Ed25519Pure, CryptoPrimitiveAlgorithmModeCustomRef=Crypto_30_Hwa_Ed25519Ctx, CryptoPrimitiveAlgorithmModeCustomRef=Crypto_30_Hwa_Ed25519Ph
        Ed25519VerifySHA1: CryptoPrimitiveAlgorithmSecondaryFamily=CRYPTO_ALGOFAM_SHA1, CryptoPrimitiveService=CRYPTO_SIGNATURE_VERIFY, CryptoPrimitiveAlgorithmFamily=CRYPTO_ALGOFAM_ED25519, CryptoPrimitiveAlgorithmMode=CRYPTO_ALGOMODE_CUSTOM, CryptoPrimitiveAlgorithmModeCustomRef=Crypto_30_Hwa_Ed25519Pure, CryptoPrimitiveAlgorithmModeCustomRef=Crypto_30_Hwa_Ed25519Ctx, CryptoPrimitiveAlgorithmModeCustomRef=Crypto_30_Hwa_Ed25519Ph
        Ed25519VerifySHA2_224: CryptoPrimitiveAlgorithmSecondaryFamily=CRYPTO_ALGOFAM_SHA2_224, CryptoPrimitiveService=CRYPTO_SIGNATURE_VERIFY, CryptoPrimitiveAlgorithmFamily=CRYPTO_ALGOFAM_ED25519, CryptoPrimitiveAlgorithmMode=CRYPTO_ALGOMODE_CUSTOM, CryptoPrimitiveAlgorithmModeCustomRef=Crypto_30_Hwa_Ed25519Pure, CryptoPrimitiveAlgorithmModeCustomRef=Crypto_30_Hwa_Ed25519Ctx, CryptoPrimitiveAlgorithmModeCustomRef=Crypto_30_Hwa_Ed25519Ph
        Ed25519VerifySHA2_256: CryptoPrimitiveAlgorithmSecondaryFamily=CRYPTO_ALGOFAM_SHA2_256, CryptoPrimitiveService=CRYPTO_SIGNATURE_VERIFY, CryptoPrimitiveAlgorithmFamily=CRYPTO_ALGOFAM_ED25519, CryptoPrimitiveAlgorithmMode=CRYPTO_ALGOMODE_CUSTOM, CryptoPrimitiveAlgorithmModeCustomRef=Crypto_30_Hwa_Ed25519Pure, CryptoPrimitiveAlgorithmModeCustomRef=Crypto_30_Hwa_Ed25519Ctx, CryptoPrimitiveAlgorithmModeCustomRef=Crypto_30_Hwa_Ed25519Ph
        Ed25519VerifySHA2_384: CryptoPrimitiveAlgorithmSecondaryFamily=CRYPTO_ALGOFAM_SHA2_384, CryptoPrimitiveService=CRYPTO_SIGNATURE_VERIFY, CryptoPrimitiveAlgorithmFamily=CRYPTO_ALGOFAM_ED25519, CryptoPrimitiveAlgorithmMode=CRYPTO_ALGOMODE_CUSTOM, CryptoPrimitiveAlgorithmModeCustomRef=Crypto_30_Hwa_Ed25519Pure, CryptoPrimitiveAlgorithmModeCustomRef=Crypto_30_Hwa_Ed25519Ctx, CryptoPrimitiveAlgorithmModeCustomRef=Crypto_30_Hwa_Ed25519Ph
        Ed25519VerifySHA2_512: CryptoPrimitiveAlgorithmSecondaryFamily=CRYPTO_ALGOFAM_SHA2_512, CryptoPrimitiveService=CRYPTO_SIGNATURE_VERIFY, CryptoPrimitiveAlgorithmFamily=CRYPTO_ALGOFAM_ED25519, CryptoPrimitiveAlgorithmMode=CRYPTO_ALGOMODE_CUSTOM, CryptoPrimitiveAlgorithmModeCustomRef=Crypto_30_Hwa_Ed25519Pure, CryptoPrimitiveAlgorithmModeCustomRef=Crypto_30_Hwa_Ed25519Ctx, CryptoPrimitiveAlgorithmModeCustomRef=Crypto_30_Hwa_Ed25519Ph
        Ed25519VerifySHA2_512_224: CryptoPrimitiveAlgorithmSecondaryFamily=CRYPTO_ALGOFAM_SHA2_512_224, CryptoPrimitiveService=CRYPTO_SIGNATURE_VERIFY, CryptoPrimitiveAlgorithmFamily=CRYPTO_ALGOFAM_ED25519, CryptoPrimitiveAlgorithmMode=CRYPTO_ALGOMODE_CUSTOM, CryptoPrimitiveAlgorithmModeCustomRef=Crypto_30_Hwa_Ed25519Pure, CryptoPrimitiveAlgorithmModeCustomRef=Crypto_30_Hwa_Ed25519Ctx, CryptoPrimitiveAlgorithmModeCustomRef=Crypto_30_Hwa_Ed25519Ph
        Ed25519VerifySHA3_224: CryptoPrimitiveAlgorithmSecondaryFamily=CRYPTO_ALGOFAM_SHA3_224, CryptoPrimitiveService=CRYPTO_SIGNATURE_VERIFY, CryptoPrimitiveAlgorithmFamily=CRYPTO_ALGOFAM_ED25519, CryptoPrimitiveAlgorithmMode=CRYPTO_ALGOMODE_CUSTOM, CryptoPrimitiveAlgorithmModeCustomRef=Crypto_30_Hwa_Ed25519Pure, CryptoPrimitiveAlgorithmModeCustomRef=Crypto_30_Hwa_Ed25519Ctx, CryptoPrimitiveAlgorithmModeCustomRef=Crypto_30_Hwa_Ed25519Ph
        Ed25519VerifySHA3_256: CryptoPrimitiveAlgorithmSecondaryFamily=CRYPTO_ALGOFAM_SHA3_256, CryptoPrimitiveService=CRYPTO_SIGNATURE_VERIFY, CryptoPrimitiveAlgorithmFamily=CRYPTO_ALGOFAM_ED25519, CryptoPrimitiveAlgorithmMode=CRYPTO_ALGOMODE_CUSTOM, CryptoPrimitiveAlgorithmModeCustomRef=Crypto_30_Hwa_Ed25519Pure, CryptoPrimitiveAlgorithmModeCustomRef=Crypto_30_Hwa_Ed25519Ctx, CryptoPrimitiveAlgorithmModeCustomRef=Crypto_30_Hwa_Ed25519Ph
        Ed25519VerifySHA3_384: CryptoPrimitiveAlgorithmSecondaryFamily=CRYPTO_ALGOFAM_SHA3_384, CryptoPrimitiveService=CRYPTO_SIGNATURE_VERIFY, CryptoPrimitiveAlgorithmFamily=CRYPTO_ALGOFAM_ED25519, CryptoPrimitiveAlgorithmMode=CRYPTO_ALGOMODE_CUSTOM, CryptoPrimitiveAlgorithmModeCustomRef=Crypto_30_Hwa_Ed25519Pure, CryptoPrimitiveAlgorithmModeCustomRef=Crypto_30_Hwa_Ed25519Ctx, CryptoPrimitiveAlgorithmModeCustomRef=Crypto_30_Hwa_Ed25519Ph
        Ed25519VerifySHA3_512: CryptoPrimitiveAlgorithmSecondaryFamily=CRYPTO_ALGOFAM_SHA3_512, CryptoPrimitiveService=CRYPTO_SIGNATURE_VERIFY, CryptoPrimitiveAlgorithmFamily=CRYPTO_ALGOFAM_ED25519, CryptoPrimitiveAlgorithmMode=CRYPTO_ALGOMODE_CUSTOM, CryptoPrimitiveAlgorithmModeCustomRef=Crypto_30_Hwa_Ed25519Pure, CryptoPrimitiveAlgorithmModeCustomRef=Crypto_30_Hwa_Ed25519Ctx, CryptoPrimitiveAlgorithmModeCustomRef=Crypto_30_Hwa_Ed25519Ph
        Ed25519VerifySHAKE128: CryptoPrimitiveAlgorithmSecondaryFamily=CRYPTO_ALGOFAM_SHAKE128, CryptoPrimitiveService=CRYPTO_SIGNATURE_VERIFY, CryptoPrimitiveAlgorithmFamily=CRYPTO_ALGOFAM_ED25519, CryptoPrimitiveAlgorithmMode=CRYPTO_ALGOMODE_CUSTOM, CryptoPrimitiveAlgorithmModeCustomRef=Crypto_30_Hwa_Ed25519Pure, CryptoPrimitiveAlgorithmModeCustomRef=Crypto_30_Hwa_Ed25519Ctx, CryptoPrimitiveAlgorithmModeCustomRef=Crypto_30_Hwa_Ed25519Ph
        Ed25519VerifySHAKE256: CryptoPrimitiveAlgorithmSecondaryFamily=CRYPTO_ALGOFAM_SHAKE256, CryptoPrimitiveService=CRYPTO_SIGNATURE_VERIFY, CryptoPrimitiveAlgorithmFamily=CRYPTO_ALGOFAM_ED25519, CryptoPrimitiveAlgorithmMode=CRYPTO_ALGOMODE_CUSTOM, CryptoPrimitiveAlgorithmModeCustomRef=Crypto_30_Hwa_Ed25519Pure, CryptoPrimitiveAlgorithmModeCustomRef=Crypto_30_Hwa_Ed25519Ctx, CryptoPrimitiveAlgorithmModeCustomRef=Crypto_30_Hwa_Ed25519Ph
    CryptoPublishedInformation
      TC3x (CryptoDerivativeInformation)
        4 x CryptoPeripheral:
          AES: CryptoPeripheralContexts=5
            AES (CryptoFeature)
              CryptoFeatureAES
            GCM (CryptoFeature)
              CryptoFeatureAEAD
            GCMContextLimitation (CryptoPeripheralContextLimitation): CryptoPeripheralContextLimitationContexts=1, CryptoPeripheralContextLimitationUsage=3, CryptoPeripheralContextLimitationFeature=GCM
          TRNG: CryptoPeripheralContexts=1
            TRNG (CryptoFeature)
              CryptoFeatureTRNG
          HASH: CryptoPeripheralContexts=1
            CryptoFeature
              CryptoFeatureHASH
          PKC: CryptoPeripheralContexts=1
            CryptoFeature
              CryptoFeaturePKC: CryptoEccP256R1Generate=true, CryptoEccP256R1Verify=true, CryptoEd25519Generate=true, CryptoEd25519Verify=true
    CryptoDriverObjects
      vHsm_Hwa (CryptoDriverObject):
        CryptoDriverObjectId = 1
        CryptoDriverObjectQueueSize = 1
        CryptoPrimitiveRef = Trng
        CryptoPrimitiveRef = AesDecrypt
        CryptoPrimitiveRef = AesEncrypt
        CryptoPrimitiveRef = AesCmacVerify
        CryptoPrimitiveRef = AesCmacGenerate
        CryptoPrimitiveRef = AesGCMDecrypt
        CryptoPrimitiveRef = AesGCMEncrypt
        CryptoPrimitiveRef = Ed25519VerifySHA2_512
        CryptoPrimitiveRef = Ed25519GenerateSHA2_512
      vHsm_Hwa_HighPrio (CryptoDriverObject): CryptoDriverObjectId=0, CryptoDriverObjectQueueSize=1, CryptoPrimitiveRef=AesCmacVerify, CryptoPrimitiveRef=AesCmacGenerate
    CryptoGeneral:
      CryptoDevErrorDetect = true
      CryptoClearWorkspaceBuffers = false
      CryptoTrngPrefetchCapacity = 32
      CryptoTrngPrefetchWithInterrupt = false
      CryptoNonPreemptiveChunkSize = 4096
