AUTOSAR XML (schema 4-3-0)
package /ActiveEcuC
  ecuc value collection ActiveEcuC: ecu-extract=SYSTEM
    ecuc-values:
      Det_Stub
      Dem_Stub
      EcuC
      Crypto_30_LibCv
      CryIf
      vHsm
      Crc
      vHsm_Core
      vHsm_Custom
      MemIf
      vSet
      Fee
      vSecPrim
      NvM
      Csm
      VKMS_Core
      VKMS
      Fls
      vMem
      Rte
      Os
      vBRS
      vBaseEnv
      KeyM
      Crypto_30_KeyM
      Crypto_30_Harman
      Resource
      Crypto_30_Hwa
      vLinkGen
      vHsm_Hal
      MemMap
      VTTMemMap
      VTTMemMap
