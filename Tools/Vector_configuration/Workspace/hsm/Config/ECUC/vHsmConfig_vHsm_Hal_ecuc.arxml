AUTOSAR XML (schema 4-3-0)
package /ActiveEcuC
  module config vHsm_Hal: implementation-config-variant=VARIANT-PRE-COMPILE, module-description=vHsm_Hal_Impl
    vHsm_HalGeneral: vHsm_HalApplicationGenerateNoise=false, vHsm_HalProvideISRs=true
