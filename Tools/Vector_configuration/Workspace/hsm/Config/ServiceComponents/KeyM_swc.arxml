AUTOSAR XML (schema 4-3-0)
package /MICROSAR/KeyM_swc/DataTypes
  11 x impl type:
    KeyM_CertElementIdType: implementation-data-type=uint16  # Certificate Element handle
    KeyM_CertificateIdType: implementation-data-type=uint16  # Certificate handle
    KeyM_const_CryptoKeyDataType: category=DATA_REFERENCE, sw-pointer-target-props={target-category=TYPE_REFERENCE, implementation-data-type=uint8, sw-impl-policy=CONST}  # Byte-pointer to the input or output data.
    KeyM_CryptoKeyDataType: category=DATA_REFERENCE, sw-pointer-target-props={target-category=TYPE_REFERENCE, implementation-data-type=uint8}  # Byte-pointer to the input or output data.
    KeyM_ServiceCertificateType: compu {1=KEYM_SERVICE_CERT_REQUEST_CSR, 2=KEYM_SERVICE_CERT_UPDATE_SIGNED_CSR, 3=KEYM_SERVICE_CERT_SET_ROOT, 4=KEYM_SERVICE_CERT_UPDATE_ROOT, 5=KEYM_SERVICE_CERT_SET_INTERMEDIATE, 6=KEYM_SERVICE_CERT_UPDATE_INTERMEDIATE, 7=KEYM_SERVICE_CERT_UPDATE_CRL}, range raw 1..7, implementation-data-type=uint8  # KeyM module service type.
    KeyM_CertificateStatusType:  # KeyM module specific return values for certificate status.
      compu {0=KEYM_CERTIFICATE_VALID, 1=KEYM_CERTIFICATE_INVALID, 2=KEYM_CERTIFICATE_NOT_PARSED, 3=KEYM_CERTIFICATE_PARSED_NOT_VALIDATED, 4=KEYM_CERTIFICATE_NOT_AVAILABLE, 5=KEYM_E_CERTIFICATE_VALIDITY_PERIOD_FAIL, 6=KEYM_E_CERTIFICATE_SIGNATURE_FAIL, 7=KEYM_E_CERTIFICATE_INVALID_CHAIN_OF_TRUST, 8=KEYM_E_CERTIFICATE_INVALID_TYPE, 9=KEYM_E_CERTIFICATE_INVALID_FORMAT, 10=KEYM_E_CERTIFICATE_INVALID_CONTENT, 11=KEYM_E_CERTIFICATE_REVOKED}
      range raw 0..11
      implementation-data-type=uint8
    KeyM_ResultType: compu {0=KEYM_RT_OK, 1=KEYM_RT_NOT_OK, 2=KEYM_RT_KEY_CERT_INVALID, 3=KEYM_RT_KEY_CERT_WRITE_FAIL, 4=KEYM_RT_KEY_CERT_UPDATE_FAIL, 5=KEYM_RT_CERT_INVALID_CHAIN_OF_TRUST}, range raw 0..5, implementation-data-type=uint8  # KeyM module specific return values for certificate status.
    KeyM_ConstDataPtrType: category=DATA_REFERENCE, sw-pointer-target-props={target-category=TYPE_REFERENCE, implementation-data-type=uint8, sw-impl-policy=CONST}  # Byte-pointer to the input or output data.
    KeyM_DataPtrType: category=DATA_REFERENCE, sw-pointer-target-props={target-category=TYPE_REFERENCE, implementation-data-type=uint8}  # Byte-pointer to the input or output data.
    KeyM_LengthPtrType: category=DATA_REFERENCE, sw-pointer-target-props={target-category=TYPE_REFERENCE, implementation-data-type=uint32}  # Byte-pointer to the input or output data.
    KeyM_CsrEncodingType: compu {0=KEYM_CSR_ENCODING_NONE, 1=KEYM_CSR_ENCODING_DER}, range raw 0..1, implementation-data-type=uint8  # KeyM CSR element encoding type.
package /MICROSAR/KeyM_swc/ComponentTypes
  service sw component type KeyM: category=SERVICE_COMPONENT
    behavior KeyMInternalBehavior: handle-termination-and-restart=NO-SUPPORT, included-data-type-set=data-type=[KeyM_CertElementIdType, KeyM_CertificateIdType, KeyM_const_CryptoKeyDataType, KeyM_CryptoKeyDataType, KeyM_ConstDataPtrType, KeyM_DataPtrType, KeyM_LengthPtrType, KeyM_CsrEncodingType, KeyM_ServiceCertificateType, KeyM_CertificateStatusType, KeyM_ResultType]
      timing event Timer_KeyM_MainFunction: start-on-event=KeyM_MainFunction, period=0.01
      runnable KeyM_MainFunction
  swc implementation KeyMImplementation: programming-language=C, behavior=KeyMInternalBehavior
