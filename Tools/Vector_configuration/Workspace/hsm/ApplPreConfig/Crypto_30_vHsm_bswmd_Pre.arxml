AUTOSAR XML (schema 4-0-3)
package /MICROSAR/Crypto_30_vHsm
  module config Crypto_Pre: definition=Crypto  # Software Crypto Driver pre-configuration
    CryptoKeys
      59 x CryptoKey, all with CryptoKeyDeriveIterations=1:
        vHsm_Hardware: CryptoKeyId=53, CryptoKeyTypeRef=Crypto_30_vHsm_Hwa_vHsm_Hal_Hardware
        vHsm_FirmwareUpdate_Signature: CryptoKeyId=61, CryptoKeyTypeRef=Crypto_30_vHsm_LibCv_Signature
        vHsm_Custom: CryptoKeyId=48, CryptoKeyTypeRef=Crypto_30_vHsm_LibCv_Cipher
        KeyM_Cert_Root: CryptoKeyId=16, CryptoKeyTypeRef=Crypto_30_vHsm_LibCv_KeyType_KeyM_CertificateData
        KeyM_ECC_Root: CryptoKeyId=18, CryptoKeyTypeRef=Crypto_30_vHsm_LibCv_Signature
        KeyM_ECC_Intermediate: CryptoKeyId=17, CryptoKeyTypeRef=Crypto_30_vHsm_LibCv_Signature
        vHsm_RomKey0: CryptoKeyId=57, CryptoKeyTypeRef=Crypto_30_vHsm_Hwa_RomKeyType
        vHsm_Log: CryptoKeyId=56, CryptoKeyTypeRef=Crypto_30_vHsm_vHsm_Core_vHsmLog_Type
        Ssa_RandomSeed: CryptoKeyId=39, CryptoKeyTypeRef=Crypto_30_vHsm_LibCv_Ssa_Random_Nist_800_90A_DRBG_AES_DF
        Ssa_SecurityAccessPublicKey: CryptoKeyId=42, CryptoKeyTypeRef=Crypto_30_vHsm_LibCv_Ssa_SecurityAccessPublicKey
        Ssa_SharedSecretExchangeKey: CryptoKeyId=43, CryptoKeyTypeRef=Crypto_30_vHsm_LibCv_KeyExchange_X25519
        Ssa_SharedSecretHash: CryptoKeyId=44, CryptoKeyTypeRef=CryptoKeyTypes/Crypto_30_vHsm_LibCv_Ssa_SharedSecretHash
        Ssa_BackendCert: CryptoKeyId=37, CryptoKeyTypeRef=Crypto_30_vHsm_LibCv_Ssa_BackEndCert
        Ssa_AesRamKey: CryptoKeyId=35, CryptoKeyTypeRef=Crypto_30_vHsm_LibCv_Ssa_Cipher
        Ssa_RootCert: CryptoKeyId=41, CryptoKeyTypeRef=CryptoKeyTypes/Crypto_30_vHsm_LibCv_Ssa_RootCert
        Ssa_RealTime: CryptoKeyId=40, CryptoKeyTypeRef=Crypto_30_vHsm_LibCv_Ssa_Mac
        SSA_SecOC_Int_MacVerify_Ign_Stat: CryptoKeyId=31, CryptoKeyTypeRef=Crypto_30_vHsm_LibCv_Ssa_Mac
        Ssa_SignatureRamKey: CryptoKeyId=45, CryptoKeyTypeRef=Crypto_30_vHsm_LibCv_Signature
        SSA_SecOC_Int_MacVerify_VehSpd_8: CryptoKeyId=34, CryptoKeyTypeRef=Crypto_30_vHsm_LibCv_Ssa_Mac
        SSA_SecOC_Int_MacVerify_PN14_Master_Stat1: CryptoKeyId=32, CryptoKeyTypeRef=Crypto_30_vHsm_LibCv_Ssa_Mac
        KeyM_SigVerifyKey_TrustModelRoot: CryptoKeyId=24, CryptoKeyTypeRef=Crypto_30_vHsm_LibCv_Signature
        SSA_SecOC_Int_MacVerify_DI_OdoSpeedometer: CryptoKeyId=30, CryptoKeyTypeRef=Crypto_30_vHsm_LibCv_Ssa_Mac
        KeyM_SigVerifyKey_TrustModelIntermediate: CryptoKeyId=22, CryptoKeyTypeRef=Crypto_30_vHsm_LibCv_Signature
        Ssa_VIN: CryptoKeyId=51, CryptoKeyTypeRef=Crypto_30_vHsm_LibCv_Ssa_Mac
        Ssa_Authentication: CryptoKeyId=36, CryptoKeyTypeRef=Crypto_30_vHsm_LibCv_Ssa_Mac
        KeyM_SigVerifyKey_TrustModelBackend: CryptoKeyId=19, CryptoKeyTypeRef=Crypto_30_vHsm_LibCv_Signature
        Ssa_TickCount: CryptoKeyId=46, CryptoKeyTypeRef=Crypto_30_vHsm_LibCv_Ssa_Mac
        SSA_SecOC_Int_MacVerify_PT4_PTCoor4: CryptoKeyId=33, CryptoKeyTypeRef=Crypto_30_vHsm_LibCv_Ssa_Mac
        vHsm_Info: CryptoKeyId=54, CryptoKeyTypeRef=Crypto_30_vHsm_vHsm_Core_vHsmInfo_Type
        Ssa_PduKeysMac: CryptoKeyId=38, CryptoKeyTypeRef=CryptoKeyTypes/Crypto_30_vHsm_LibCv_Ssa_MacKey_nonPersisting
        SSA_SecOC_Int_MacGen_COM_C04_Pdu03_secured_044596e0_Tx: CryptoKeyId=25, CryptoKeyTypeRef=Crypto_30_vHsm_LibCv_Ssa_Mac
        SSA_SecOC_Int_MacGen_COM_C04_Pdu20_secured_393d7a18_Tx: CryptoKeyId=26, CryptoKeyTypeRef=Crypto_30_vHsm_LibCv_Ssa_Mac
        SSA_SecOC_Int_MacGen_COM_C04_Pdu21_secured_2e466e5b_Tx: CryptoKeyId=27, CryptoKeyTypeRef=Crypto_30_vHsm_LibCv_Ssa_Mac
        SSA_SecOC_Int_MacVerify_COM_C0X_Pdu20_secured_3ef6961f_Rx: CryptoKeyId=28, CryptoKeyTypeRef=Crypto_30_vHsm_LibCv_Ssa_Mac
        SSA_SecOC_Int_MacVerify_COM_C0X_Pdu21_secured_298d825c_Rx: CryptoKeyId=29, CryptoKeyTypeRef=Crypto_30_vHsm_LibCv_Ssa_Mac
        KeyM_SigVerifyKey_TrustModelBackendPeer: CryptoKeyId=20, CryptoKeyTypeRef=Crypto_30_vHsm_LibCv_Signature
        KeyM_SigVerifyKey_TrustModelEcuPeer: CryptoKeyId=21, CryptoKeyTypeRef=Crypto_30_vHsm_LibCv_Signature
        KeyM_SigVerifyKey_TrustModelIntermediatePeer: CryptoKeyId=23, CryptoKeyTypeRef=Crypto_30_vHsm_LibCv_Signature
        vHsm_TRNG: CryptoKeyId=60, CryptoKeyTypeRef=Crypto_30_vHsm_LibCv_Random_Nist_800_90A_DRBG_AES_NoDF
        CryIfKey_Ssa_SignatureRamKey_replacementAuthority: CryptoKeyId=7, CryptoKeyTypeRef=Crypto_30_vHsm_LibCv_Signature_replacementAuthority
        CryIfKey_Ssa_TrustModelPrivateEcuUnique_StagingKey: CryptoKeyId=11, CryptoKeyTypeRef=Crypto_30_vHsm_LibCv_KeyGenerate_ED25519
        Ssa_TrustModelEcuPublicCsr_StagingKey: CryptoKeyId=47, CryptoKeyTypeRef=Crypto_30_vHsm_LibCv_Ssa_TrustModelEcuPublicKeyCsr
        Ssa_TrustModelEcuPublic_LiveKey: CryptoKeyId=49, CryptoKeyTypeRef=Crypto_30_vHsm_LibCv_Ssa_TrustModelEcuPublicKey
        Ssa_TrustModelPrivateEcu_LiveKey: CryptoKeyId=50, CryptoKeyTypeRef=Crypto_30_vHsm_LibCv_Ssa_TrustModelEcuPrivateKey
        CryIfKey_Ssa_TrustModelBackendCert_inHSM: CryptoKeyId=8, CryptoKeyTypeRef=Crypto_30_vHsm_LibCv_Cert_wPersist
        CryIfKey_Ssa_TrustModelEcuCert_inHSM: CryptoKeyId=9, CryptoKeyTypeRef=Crypto_30_vHsm_LibCv_Cert_wPersist
        CryIfKey_Ssa_TrustModelIntermediateCert_inHSM: CryptoKeyId=10, CryptoKeyTypeRef=Crypto_30_vHsm_LibCv_Cert_wPersist
        CryIfKey_Ssa_TrustModelRootCert_inHSM: CryptoKeyId=12, CryptoKeyTypeRef=Crypto_30_vHsm_LibCv_Cert_wPersist
        CryIfKey_Ssa_TrustModel_Ecu_CsrPrivateKey: CryptoKeyId=13, CryptoKeyTypeRef=Crypto_30_vHsm_LibCv_Ssa_TrustModel_Csr_Key_NonPersisting_Type
        CryIfKey_Ssa_TrustModel_Ecu_CsrPublicKey: CryptoKeyId=14, CryptoKeyTypeRef=Crypto_30_vHsm_LibCv_Ssa_TrustModel_Csr_Key_NonPersisting_Type
        CryIfKey_vHsm_Info: CryptoKeyId=15, CryptoKeyTypeRef=Crypto_30_vHsm_LibCv_vHsm_Info
        CryIfKey_KeyMCertificate_OSSL_X509_ECDSA_P384_CA: CryptoKeyId=5, CryptoKeyTypeRef=Crypto_30_vHsm_KeyM_KeyType_KeyM_Certificate
        CryIfKey_KeyMCertificate_OSSL_X509_ECDSA_P384_IA: CryptoKeyId=6, CryptoKeyTypeRef=Crypto_30_vHsm_KeyM_KeyType_KeyM_Certificate
        CryIfKey_Fbl_Decrypt_Aes128: CryptoKeyId=0, CryptoKeyTypeRef=Crypto_30_vHsm_LibCv_CryptoKeyType_Fbl_Decrypt_Aes128
        CryIfKey_Fbl_Rng_Fips186: CryptoKeyId=2, CryptoKeyTypeRef=Crypto_30_vHsm_Hwa_Random_Fips186_Sha1
        CryIfKey_Fbl_Signature_Ed25519: CryptoKeyId=4, CryptoKeyTypeRef=Crypto_30_vHsm_LibCv_CryptoKeyType_Fbl_Signature_Ed25519
        CryIfKey_Fbl_HashDummy: CryptoKeyId=1, CryptoKeyTypeRef=Crypto_30_vHsm_Hwa_Hash
        CryIfKey_Fbl_SecurityAccess_Ed25519: CryptoKeyId=3, CryptoKeyTypeRef=Crypto_30_vHsm_LibCv_CryptoKeyType_Fbl_SecurityAccess_Ed25519
        vHSM_Custom_HSM_Version: CryptoKeyId=52, CryptoKeyTypeRef=Crypto_30_vHsm_LibCv_vHSM_Custom_HSM_Version
    CryptoKeyTypes
      32 x CryptoKeyType:
        Crypto_30_vHsm_Hwa_vHsm_Hal_Hardware: CryptoKeyElementRef=Crypto_30_vHsm_Hwa_vHsm_Hal_FlashOperation
        Crypto_30_vHsm_LibCv_Signature: CryptoKeyElementRef=Crypto_30_vHsm_LibCv_Signature_Key
        Crypto_30_vHsm_LibCv_Cipher: CryptoKeyElementRef=Crypto_30_vHsm_LibCv_Cipher_Key, CryptoKeyElementRef=Crypto_30_vHsm_LibCv_Cipher_IV, CryptoKeyElementRef=Crypto_30_vHsm_LibCv_Cipher_Proof
        Crypto_30_vHsm_LibCv_KeyType_KeyM_CertificateData: CryptoKeyElementRef=Crypto_30_vHsm_LibCv_KeyM_CertificateData
        Crypto_30_vHsm_Hwa_RomKeyType: CryptoKeyElementRef=Crypto_30_vHsm_Hwa_RomKey
        Crypto_30_vHsm_vHsm_Core_vHsmLog_Type: CryptoKeyElementRef=Crypto_30_vHsm_vHsm_Core_vHsmLog_EventId
        Crypto_30_vHsm_LibCv_Ssa_Random_Nist_800_90A_DRBG_AES_DF: CryptoKeyElementRef=Crypto_30_vHsm_LibCv_Random_Algorithm_Nist_800_90A_DRBG_AES128_DF, CryptoKeyElementRef=Crypto_30_vHsm_LibCv_Random_Reseed_Counter, CryptoKeyElementRef=Crypto_30_vHsm_LibCv_Random_Seed, CryptoKeyElementRef=Crypto_30_vHsm_LibCv_Ssa_Random_Nonce, CryptoKeyElementRef=Crypto_30_vHsm_LibCv_CryptoKeyElement_DummyWorkaround_RandomSeedSize
        Crypto_30_vHsm_LibCv_Ssa_SecurityAccessPublicKey: CryptoKeyElementRef=Crypto_30_vHsm_LibCv_Ssa_SecurityAccesPublicKey
        Crypto_30_vHsm_LibCv_KeyExchange_X25519: CryptoKeyElementRef=Crypto_30_vHsm_LibCv_KeyExchange_Algorithm_X25519, CryptoKeyElementRef=Crypto_30_vHsm_LibCv_KeyExchange_OwnPubKey, CryptoKeyElementRef=Crypto_30_vHsm_LibCv_KeyExchange_Base, CryptoKeyElementRef=Crypto_30_vHsm_LibCv_KeyExchange_PrivKey, CryptoKeyElementRef=Crypto_30_vHsm_LibCv_KeyExchange_SharedValue
        Crypto_30_vHsm_LibCv_Ssa_SharedSecretHash: CryptoKeyElementRef=CryptoKeyElements/Crypto_30_vHsm_LibCv_Ssa_SharedSecretHash
        Crypto_30_vHsm_LibCv_Ssa_BackEndCert: CryptoKeyElementRef=Crypto_30_vHsm_LibCv_Ssa_BackendCert
        Crypto_30_vHsm_LibCv_Ssa_Cipher: CryptoKeyElementRef=Crypto_30_vHsm_LibCv_Ssa_Cipher_IV, CryptoKeyElementRef=Crypto_30_vHsm_LibCv_Ssa_Cipher_Key
        Crypto_30_vHsm_LibCv_Ssa_RootCert: CryptoKeyElementRef=CryptoKeyElements/Crypto_30_vHsm_LibCv_Ssa_RootCert
        Crypto_30_vHsm_LibCv_Ssa_Mac: CryptoKeyElementRef=Crypto_30_vHsm_LibCv_Ssa_Mac_Key, CryptoKeyElementRef=Crypto_30_vHsm_LibCv_Ssa_Mac_Proof
        Crypto_30_vHsm_vHsm_Core_vHsmInfo_Type: CryptoKeyElementRef=Crypto_30_vHsm_vHsm_Core_vHsmInfo_Version, CryptoKeyElementRef=Crypto_30_vHsm_vHsm_Core_vHsmInfo_PerformPersist, CryptoKeyElementRef=Crypto_30_vHsm_vHsm_Core_vHsmInfo_PerformRepersist, CryptoKeyElementRef=Crypto_30_vHsm_vHsm_Core_vHsmInfo_StartFirmwareUpdater, CryptoKeyElementRef=Crypto_30_vHsm_vHsm_Core_vHsmInfo_SecureBootEnd, CryptoKeyElementRef=Crypto_30_vHsm_vHsm_Core_vHsmInfo_SecureBootResult
        Crypto_30_vHsm_LibCv_Ssa_MacKey_nonPersisting: CryptoKeyElementRef=Crypto_30_vHsm_LibCv_Ssa_MacKey_Hash_nonPersisting, CryptoKeyElementRef=CryptoKeyElements/Crypto_30_vHsm_LibCv_Ssa_MacKey_nonPersisting
        Crypto_30_vHsm_LibCv_Random_Nist_800_90A_DRBG_AES_NoDF: CryptoKeyElementRef=Crypto_30_vHsm_LibCv_Random_Algorithm_Nist_800_90A_DRBG_AES128, CryptoKeyElementRef=Crypto_30_vHsm_LibCv_Random_PrivateString, CryptoKeyElementRef=Crypto_30_vHsm_LibCv_Random_Reseed_Counter, CryptoKeyElementRef=Crypto_30_vHsm_LibCv_Random_Seed_Nist_800_90A_DRBG_AES128, CryptoKeyElementRef=Crypto_30_vHsm_LibCv_Random_AdditionalInput
        Crypto_30_vHsm_LibCv_Signature_replacementAuthority: CryptoKeyElementRef=Crypto_30_vHsm_LibCv_Signature_Key_replacementAuthority
        Crypto_30_vHsm_LibCv_KeyGenerate_ED25519: CryptoKeyElementRef=Crypto_30_vHsm_LibCv_KeyGenerate_Key, CryptoKeyElementRef=Crypto_30_vHsm_LibCv_KeyExchange_OwnPubKey, CryptoKeyElementRef=Crypto_30_vHsm_LibCv_KeyGenerate_Algorithm_Ed25519
        Crypto_30_vHsm_LibCv_Ssa_TrustModelEcuPublicKeyCsr: CryptoKeyElementRef=Crypto_30_vHsm_LibCv_Ssa_TrustModelEcuPublicCsr_StagingKey
        Crypto_30_vHsm_LibCv_Ssa_TrustModelEcuPublicKey: CryptoKeyElementRef=Crypto_30_vHsm_LibCv_Ssa_TrustModelEcuPublic_LiveKey
        Crypto_30_vHsm_LibCv_Ssa_TrustModelEcuPrivateKey: CryptoKeyElementRef=Crypto_30_vHsm_LibCv_Ssa_TrustModelPrivateEcu_LiveKey
        Crypto_30_vHsm_LibCv_Cert_wPersist: CryptoKeyElementRef=Crypto_30_vHsm_LibCv_CryptoKeyElement_Cert_wPersist
        Crypto_30_vHsm_LibCv_Ssa_TrustModel_Csr_Key_NonPersisting_Type: CryptoKeyElementRef=Crypto_30_vHsm_LibCv_Ssa_TrustModel_Csr_Key_NonPersisting_Element, CryptoKeyElementRef=Crypto_30_vHsm_LibCv_KeyGenerate_Algorithm_Ed25519, CryptoKeyElementRef=Crypto_30_vHsm_LibCv_KeyExchange_OwnPubKey
        Crypto_30_vHsm_LibCv_vHsm_Info: CryptoKeyElementRef=Crypto_30_vHsm_LibCv_vHsm_Info_Uid, CryptoKeyElementRef=Crypto_30_vHsm_LibCv_vHsm_Info_ErrorLog
        Crypto_30_vHsm_KeyM_KeyType_KeyM_Certificate: CryptoKeyElementRef=Crypto_30_vHsm_KeyM_KeyM_Certificate, CryptoKeyElementRef=Crypto_30_vHsm_KeyM_KeyM_GetStatus, CryptoKeyElementRef=Crypto_30_vHsm_KeyM_KeyM_VerifyCertificate, CryptoKeyElementRef=Crypto_30_vHsm_KeyM_KeyM_VerifyCertificates
        Crypto_30_vHsm_LibCv_CryptoKeyType_Fbl_Decrypt_Aes128: CryptoKeyElementRef=Crypto_30_vHsm_LibCv_Fbl_Decrypt_Aes128_Iv, CryptoKeyElementRef=Crypto_30_vHsm_LibCv_Fbl_Decrypt_Aes128_Key
        Crypto_30_vHsm_Hwa_Random_Fips186_Sha1: CryptoKeyElementRef=Crypto_30_vHsm_Hwa_Random_Algorithm_Fips186_Sha1, CryptoKeyElementRef=Crypto_30_vHsm_Hwa_Random_Seed
        Crypto_30_vHsm_LibCv_CryptoKeyType_Fbl_Signature_Ed25519: CryptoKeyElementRef=Crypto_30_vHsm_LibCv_Fbl_Signature_Ed25519_Key
        Crypto_30_vHsm_Hwa_Hash: CryptoKeyElementRef=Crypto_30_vHsm_Hwa_Hash_Result
        Crypto_30_vHsm_LibCv_CryptoKeyType_Fbl_SecurityAccess_Ed25519: CryptoKeyElementRef=Crypto_30_vHsm_LibCv_Fbl_SecurityAccess_Ed25519_Key
        Crypto_30_vHsm_LibCv_vHSM_Custom_HSM_Version: CryptoKeyElementRef=Crypto_30_vHsm_LibCv_vHsm_Version
    CryptoKeyElements
      60 x CryptoKeyElement:
        Crypto_30_vHsm_Hwa_vHsm_Hal_FlashOperation: CryptoKeyElementAllowPartialAccess=FALSE, CryptoKeyElementPersist=FALSE, CryptoKeyElementId=3032, CryptoKeyElementSize=1, CryptoKeyElementReadAccess=RA_DENIED, CryptoKeyElementWriteAccess=WA_ALLOWED
        Crypto_30_vHsm_LibCv_Signature_Key: CryptoKeyElementAllowPartialAccess=FALSE, CryptoKeyElementPersist=FALSE, CryptoKeyElementId=1, CryptoKeyElementSize=32, CryptoKeyElementReadAccess=RA_ALLOWED, CryptoKeyElementWriteAccess=WA_ALLOWED
        Crypto_30_vHsm_LibCv_Cipher_Key: CryptoKeyElementAllowPartialAccess=FALSE, CryptoKeyElementPersist=FALSE, CryptoKeyElementId=1, CryptoKeyElementSize=16, CryptoKeyElementReadAccess=RA_ALLOWED, CryptoKeyElementWriteAccess=WA_ALLOWED
        Crypto_30_vHsm_LibCv_Cipher_IV: CryptoKeyElementAllowPartialAccess=FALSE, CryptoKeyElementPersist=FALSE, CryptoKeyElementId=5, CryptoKeyElementSize=16, CryptoKeyElementReadAccess=RA_ALLOWED, CryptoKeyElementWriteAccess=WA_ALLOWED
        Crypto_30_vHsm_LibCv_Cipher_Proof: CryptoKeyElementAllowPartialAccess=FALSE, CryptoKeyElementPersist=FALSE, CryptoKeyElementId=6, CryptoKeyElementSize=48, CryptoKeyElementReadAccess=RA_ALLOWED, CryptoKeyElementWriteAccess=WA_ALLOWED
        Crypto_30_vHsm_LibCv_KeyM_CertificateData: CryptoKeyElementAllowPartialAccess=FALSE, CryptoKeyElementPersist=FALSE, CryptoKeyElementId=0, CryptoKeyElementSize=1500, CryptoKeyElementReadAccess=RA_ALLOWED, CryptoKeyElementWriteAccess=WA_ALLOWED
        Crypto_30_vHsm_Hwa_RomKey: CryptoKeyElementAllowPartialAccess=FALSE, CryptoKeyElementPersist=FALSE, CryptoKeyElementId=7, CryptoKeyElementSize=16, CryptoKeyElementReadAccess=RA_DENIED, CryptoKeyElementWriteAccess=WA_DENIED
        Crypto_30_vHsm_vHsm_Core_vHsmLog_EventId: CryptoKeyElementAllowPartialAccess=FALSE, CryptoKeyElementPersist=FALSE, CryptoKeyElementId=0, CryptoKeyElementSize=1, CryptoKeyElementReadAccess=RA_ALLOWED, CryptoKeyElementWriteAccess=WA_DENIED
        Crypto_30_vHsm_LibCv_Random_Algorithm_Nist_800_90A_DRBG_AES128_DF: CryptoKeyElementAllowPartialAccess=FALSE, CryptoKeyElementPersist=FALSE, CryptoKeyElementId=4, CryptoKeyElementSize=1, CryptoKeyElementReadAccess=RA_ALLOWED, CryptoKeyElementWriteAccess=WA_ALLOWED
        Crypto_30_vHsm_LibCv_Random_Reseed_Counter: CryptoKeyElementAllowPartialAccess=FALSE, CryptoKeyElementPersist=TRUE, CryptoKeyElementId=3018, CryptoKeyElementSize=4, CryptoKeyElementReadAccess=RA_ALLOWED, CryptoKeyElementWriteAccess=WA_DENIED
        Crypto_30_vHsm_LibCv_Random_Seed: CryptoKeyElementAllowPartialAccess=FALSE, CryptoKeyElementPersist=FALSE, CryptoKeyElementId=3, CryptoKeyElementSize=20, CryptoKeyElementReadAccess=RA_ALLOWED, CryptoKeyElementWriteAccess=WA_ALLOWED
        Crypto_30_vHsm_LibCv_Ssa_Random_Nonce: CryptoKeyElementAllowPartialAccess=FALSE, CryptoKeyElementPersist=FALSE, CryptoKeyElementId=3017, CryptoKeyElementSize=16, CryptoKeyElementReadAccess=RA_ALLOWED, CryptoKeyElementWriteAccess=WA_ALLOWED
        Crypto_30_vHsm_LibCv_CryptoKeyElement_DummyWorkaround_RandomSeedSize: CryptoKeyElementAllowPartialAccess=FALSE, CryptoKeyElementPersist=FALSE, CryptoKeyElementId=999, CryptoKeyElementSize=209, CryptoKeyElementReadAccess=RA_ALLOWED, CryptoKeyElementWriteAccess=WA_ALLOWED
        Crypto_30_vHsm_LibCv_Ssa_SecurityAccesPublicKey: CryptoKeyElementAllowPartialAccess=FALSE, CryptoKeyElementPersist=TRUE, CryptoKeyElementId=1, CryptoKeyElementSize=32, CryptoKeyElementReadAccess=RA_ALLOWED, CryptoKeyElementWriteAccess=WA_ALLOWED
        Crypto_30_vHsm_LibCv_KeyExchange_Algorithm_X25519: CryptoKeyElementAllowPartialAccess=FALSE, CryptoKeyElementPersist=FALSE, CryptoKeyElementId=12, CryptoKeyElementSize=1, CryptoKeyElementReadAccess=RA_ALLOWED, CryptoKeyElementWriteAccess=WA_ALLOWED
        Crypto_30_vHsm_LibCv_KeyExchange_OwnPubKey: CryptoKeyElementAllowPartialAccess=FALSE, CryptoKeyElementPersist=FALSE, CryptoKeyElementId=10, CryptoKeyElementSize=32, CryptoKeyElementReadAccess=RA_ALLOWED, CryptoKeyElementWriteAccess=WA_ALLOWED
        Crypto_30_vHsm_LibCv_KeyExchange_Base: CryptoKeyElementAllowPartialAccess=FALSE, CryptoKeyElementPersist=FALSE, CryptoKeyElementId=8, CryptoKeyElementSize=16, CryptoKeyElementReadAccess=RA_ALLOWED, CryptoKeyElementWriteAccess=WA_ALLOWED
        Crypto_30_vHsm_LibCv_KeyExchange_PrivKey: CryptoKeyElementAllowPartialAccess=FALSE, CryptoKeyElementPersist=FALSE, CryptoKeyElementId=9, CryptoKeyElementSize=32, CryptoKeyElementReadAccess=RA_ALLOWED, CryptoKeyElementWriteAccess=WA_ALLOWED
        Crypto_30_vHsm_LibCv_KeyExchange_SharedValue: CryptoKeyElementAllowPartialAccess=FALSE, CryptoKeyElementPersist=FALSE, CryptoKeyElementId=1, CryptoKeyElementSize=32, CryptoKeyElementReadAccess=RA_ALLOWED, CryptoKeyElementWriteAccess=WA_ALLOWED
        Crypto_30_vHsm_LibCv_Ssa_SharedSecretHash: CryptoKeyElementAllowPartialAccess=FALSE, CryptoKeyElementPersist=TRUE, CryptoKeyElementId=2, CryptoKeyElementSize=4, CryptoKeyElementReadAccess=RA_ALLOWED, CryptoKeyElementWriteAccess=WA_ALLOWED
        Crypto_30_vHsm_LibCv_Ssa_BackendCert: CryptoKeyElementAllowPartialAccess=TRUE, CryptoKeyElementPersist=TRUE, CryptoKeyElementId=0, CryptoKeyElementSize=600, CryptoKeyElementReadAccess=RA_ALLOWED, CryptoKeyElementWriteAccess=WA_ALLOWED
        Crypto_30_vHsm_LibCv_Ssa_Cipher_IV: CryptoKeyElementAllowPartialAccess=FALSE, CryptoKeyElementPersist=FALSE, CryptoKeyElementId=5, CryptoKeyElementSize=16, CryptoKeyElementReadAccess=RA_ALLOWED, CryptoKeyElementWriteAccess=WA_ALLOWED
        Crypto_30_vHsm_LibCv_Ssa_Cipher_Key: CryptoKeyElementAllowPartialAccess=FALSE, CryptoKeyElementPersist=FALSE, CryptoKeyElementId=1, CryptoKeyElementSize=16, CryptoKeyElementReadAccess=RA_ALLOWED, CryptoKeyElementWriteAccess=WA_ALLOWED
        Crypto_30_vHsm_LibCv_Ssa_RootCert: CryptoKeyElementAllowPartialAccess=TRUE, CryptoKeyElementPersist=TRUE, CryptoKeyElementId=0, CryptoKeyElementSize=600, CryptoKeyElementReadAccess=RA_ALLOWED, CryptoKeyElementWriteAccess=WA_ALLOWED
        Crypto_30_vHsm_LibCv_Ssa_Mac_Key: CryptoKeyElementAllowPartialAccess=FALSE, CryptoKeyElementPersist=TRUE, CryptoKeyElementId=1, CryptoKeyElementSize=16, CryptoKeyElementReadAccess=RA_ALLOWED, CryptoKeyElementWriteAccess=WA_ALLOWED
        Crypto_30_vHsm_LibCv_Ssa_Mac_Proof: CryptoKeyElementAllowPartialAccess=FALSE, CryptoKeyElementPersist=TRUE, CryptoKeyElementId=2, CryptoKeyElementSize=4, CryptoKeyElementReadAccess=RA_ALLOWED, CryptoKeyElementWriteAccess=WA_ALLOWED
        Crypto_30_vHsm_vHsm_Core_vHsmInfo_Version: CryptoKeyElementAllowPartialAccess=FALSE, CryptoKeyElementPersist=FALSE, CryptoKeyElementId=3020, CryptoKeyElementSize=3, CryptoKeyElementReadAccess=RA_ALLOWED, CryptoKeyElementWriteAccess=WA_DENIED
        Crypto_30_vHsm_vHsm_Core_vHsmInfo_PerformPersist: CryptoKeyElementAllowPartialAccess=FALSE, CryptoKeyElementPersist=FALSE, CryptoKeyElementId=3022, CryptoKeyElementSize=1, CryptoKeyElementReadAccess=RA_ALLOWED, CryptoKeyElementWriteAccess=WA_DENIED
        Crypto_30_vHsm_vHsm_Core_vHsmInfo_PerformRepersist: CryptoKeyElementAllowPartialAccess=FALSE, CryptoKeyElementPersist=FALSE, CryptoKeyElementId=3036, CryptoKeyElementSize=1, CryptoKeyElementReadAccess=RA_DENIED, CryptoKeyElementWriteAccess=WA_ALLOWED
        Crypto_30_vHsm_vHsm_Core_vHsmInfo_StartFirmwareUpdater: CryptoKeyElementAllowPartialAccess=FALSE, CryptoKeyElementPersist=FALSE, CryptoKeyElementId=3038, CryptoKeyElementSize=1, CryptoKeyElementReadAccess=RA_DENIED, CryptoKeyElementWriteAccess=WA_ALLOWED
        Crypto_30_vHsm_vHsm_Core_vHsmInfo_SecureBootEnd: CryptoKeyElementAllowPartialAccess=FALSE, CryptoKeyElementPersist=FALSE, CryptoKeyElementId=3028, CryptoKeyElementSize=1, CryptoKeyElementReadAccess=RA_ALLOWED, CryptoKeyElementWriteAccess=WA_ALLOWED
        Crypto_30_vHsm_vHsm_Core_vHsmInfo_SecureBootResult: CryptoKeyElementAllowPartialAccess=FALSE, CryptoKeyElementPersist=FALSE, CryptoKeyElementId=3037, CryptoKeyElementSize=1, CryptoKeyElementReadAccess=RA_ALLOWED, CryptoKeyElementWriteAccess=WA_DENIED
        Crypto_30_vHsm_LibCv_Ssa_MacKey_Hash_nonPersisting: CryptoKeyElementAllowPartialAccess=FALSE, CryptoKeyElementPersist=FALSE, CryptoKeyElementId=2, CryptoKeyElementSize=4, CryptoKeyElementReadAccess=RA_ALLOWED, CryptoKeyElementWriteAccess=WA_ALLOWED
        Crypto_30_vHsm_LibCv_Ssa_MacKey_nonPersisting: CryptoKeyElementAllowPartialAccess=FALSE, CryptoKeyElementPersist=FALSE, CryptoKeyElementId=1, CryptoKeyElementSize=16, CryptoKeyElementReadAccess=RA_ALLOWED, CryptoKeyElementWriteAccess=WA_ALLOWED
        Crypto_30_vHsm_LibCv_Random_Algorithm_Nist_800_90A_DRBG_AES128: CryptoKeyElementAllowPartialAccess=FALSE, CryptoKeyElementPersist=FALSE, CryptoKeyElementId=4, CryptoKeyElementSize=1, CryptoKeyElementReadAccess=RA_ALLOWED, CryptoKeyElementWriteAccess=WA_ALLOWED
        Crypto_30_vHsm_LibCv_Random_PrivateString: CryptoKeyElementAllowPartialAccess=FALSE, CryptoKeyElementPersist=FALSE, CryptoKeyElementId=3015, CryptoKeyElementSize=16, CryptoKeyElementReadAccess=RA_ALLOWED, CryptoKeyElementWriteAccess=WA_ALLOWED
        Crypto_30_vHsm_LibCv_Random_Seed_Nist_800_90A_DRBG_AES128: CryptoKeyElementAllowPartialAccess=FALSE, CryptoKeyElementPersist=TRUE, CryptoKeyElementId=3, CryptoKeyElementSize=32, CryptoKeyElementReadAccess=RA_DENIED, CryptoKeyElementWriteAccess=WA_ALLOWED
        Crypto_30_vHsm_LibCv_Random_AdditionalInput: CryptoKeyElementAllowPartialAccess=FALSE, CryptoKeyElementPersist=FALSE, CryptoKeyElementId=3016, CryptoKeyElementSize=16, CryptoKeyElementReadAccess=RA_ALLOWED, CryptoKeyElementWriteAccess=WA_ALLOWED
        Crypto_30_vHsm_LibCv_Signature_Key_replacementAuthority: CryptoKeyElementAllowPartialAccess=FALSE, CryptoKeyElementPersist=FALSE, CryptoKeyElementId=1, CryptoKeyElementSize=32, CryptoKeyElementReadAccess=RA_ALLOWED, CryptoKeyElementWriteAccess=WA_DENIED
        Crypto_30_vHsm_LibCv_KeyGenerate_Key: CryptoKeyElementAllowPartialAccess=FALSE, CryptoKeyElementPersist=TRUE, CryptoKeyElementId=1, CryptoKeyElementSize=32, CryptoKeyElementReadAccess=RA_ALLOWED, CryptoKeyElementWriteAccess=WA_ALLOWED
        Crypto_30_vHsm_LibCv_KeyGenerate_Algorithm_Ed25519: CryptoKeyElementAllowPartialAccess=FALSE, CryptoKeyElementPersist=FALSE, CryptoKeyElementId=17, CryptoKeyElementSize=1, CryptoKeyElementReadAccess=RA_ALLOWED, CryptoKeyElementWriteAccess=WA_ALLOWED
        Crypto_30_vHsm_LibCv_Ssa_TrustModelEcuPublicCsr_StagingKey: CryptoKeyElementAllowPartialAccess=FALSE, CryptoKeyElementPersist=TRUE, CryptoKeyElementId=1, CryptoKeyElementSize=32, CryptoKeyElementReadAccess=RA_ALLOWED, CryptoKeyElementWriteAccess=WA_ALLOWED
        Crypto_30_vHsm_LibCv_Ssa_TrustModelEcuPublic_LiveKey: CryptoKeyElementAllowPartialAccess=FALSE, CryptoKeyElementPersist=TRUE, CryptoKeyElementId=1, CryptoKeyElementSize=32, CryptoKeyElementReadAccess=RA_ALLOWED, CryptoKeyElementWriteAccess=WA_ALLOWED
        Crypto_30_vHsm_LibCv_Ssa_TrustModelPrivateEcu_LiveKey: CryptoKeyElementAllowPartialAccess=FALSE, CryptoKeyElementPersist=TRUE, CryptoKeyElementId=1, CryptoKeyElementSize=32, CryptoKeyElementReadAccess=RA_DENIED, CryptoKeyElementWriteAccess=WA_ALLOWED
        Crypto_30_vHsm_LibCv_CryptoKeyElement_Cert_wPersist: CryptoKeyElementAllowPartialAccess=TRUE, CryptoKeyElementPersist=TRUE, CryptoKeyElementId=0, CryptoKeyElementSize=1000, CryptoKeyElementReadAccess=RA_ALLOWED, CryptoKeyElementWriteAccess=WA_ALLOWED
        Crypto_30_vHsm_LibCv_Ssa_TrustModel_Csr_Key_NonPersisting_Element: CryptoKeyElementAllowPartialAccess=FALSE, CryptoKeyElementPersist=FALSE, CryptoKeyElementId=1, CryptoKeyElementSize=32, CryptoKeyElementReadAccess=RA_ALLOWED, CryptoKeyElementWriteAccess=WA_ALLOWED
        Crypto_30_vHsm_LibCv_vHsm_Info_Uid: CryptoKeyElementAllowPartialAccess=FALSE, CryptoKeyElementPersist=TRUE, CryptoKeyElementId=3021, CryptoKeyElementSize=16, CryptoKeyElementReadAccess=RA_ALLOWED, CryptoKeyElementWriteAccess=WA_ALLOWED
        Crypto_30_vHsm_LibCv_vHsm_Info_ErrorLog: CryptoKeyElementAllowPartialAccess=TRUE, CryptoKeyElementPersist=TRUE, CryptoKeyElementId=3023, CryptoKeyElementSize=32, CryptoKeyElementReadAccess=RA_ALLOWED, CryptoKeyElementWriteAccess=WA_ALLOWED
        Crypto_30_vHsm_KeyM_KeyM_Certificate: CryptoKeyElementAllowPartialAccess=TRUE, CryptoKeyElementPersist=FALSE, CryptoKeyElementId=3080, CryptoKeyElementSize=600, CryptoKeyElementReadAccess=RA_ALLOWED, CryptoKeyElementWriteAccess=WA_ALLOWED
        Crypto_30_vHsm_KeyM_KeyM_GetStatus: CryptoKeyElementAllowPartialAccess=FALSE, CryptoKeyElementPersist=FALSE, CryptoKeyElementId=3081, CryptoKeyElementSize=1, CryptoKeyElementReadAccess=RA_ALLOWED, CryptoKeyElementWriteAccess=WA_DENIED
        Crypto_30_vHsm_KeyM_KeyM_VerifyCertificate: CryptoKeyElementAllowPartialAccess=TRUE, CryptoKeyElementPersist=FALSE, CryptoKeyElementId=3082, CryptoKeyElementSize=1, CryptoKeyElementReadAccess=RA_DENIED, CryptoKeyElementWriteAccess=WA_ALLOWED
        Crypto_30_vHsm_KeyM_KeyM_VerifyCertificates: CryptoKeyElementAllowPartialAccess=FALSE, CryptoKeyElementPersist=FALSE, CryptoKeyElementId=3083, CryptoKeyElementSize=2, CryptoKeyElementReadAccess=RA_DENIED, CryptoKeyElementWriteAccess=WA_ALLOWED
        Crypto_30_vHsm_LibCv_Fbl_Decrypt_Aes128_Iv: CryptoKeyElementAllowPartialAccess=FALSE, CryptoKeyElementPersist=FALSE, CryptoKeyElementId=5, CryptoKeyElementSize=16, CryptoKeyElementReadAccess=RA_ALLOWED, CryptoKeyElementWriteAccess=WA_ALLOWED
        Crypto_30_vHsm_LibCv_Fbl_Decrypt_Aes128_Key: CryptoKeyElementAllowPartialAccess=FALSE, CryptoKeyElementPersist=FALSE, CryptoKeyElementId=1, CryptoKeyElementSize=16, CryptoKeyElementReadAccess=RA_ALLOWED, CryptoKeyElementWriteAccess=WA_ALLOWED
        Crypto_30_vHsm_Hwa_Random_Algorithm_Fips186_Sha1: CryptoKeyElementAllowPartialAccess=FALSE, CryptoKeyElementPersist=FALSE, CryptoKeyElementId=5, CryptoKeyElementSize=16, CryptoKeyElementReadAccess=RA_ALLOWED, CryptoKeyElementWriteAccess=WA_ALLOWED
        Crypto_30_vHsm_Hwa_Random_Seed: CryptoKeyElementAllowPartialAccess=FALSE, CryptoKeyElementPersist=FALSE, CryptoKeyElementId=6, CryptoKeyElementSize=16, CryptoKeyElementReadAccess=RA_ALLOWED, CryptoKeyElementWriteAccess=WA_ALLOWED
        Crypto_30_vHsm_LibCv_Fbl_Signature_Ed25519_Key: CryptoKeyElementAllowPartialAccess=FALSE, CryptoKeyElementPersist=FALSE, CryptoKeyElementId=1, CryptoKeyElementSize=32, CryptoKeyElementReadAccess=RA_ALLOWED, CryptoKeyElementWriteAccess=WA_ALLOWED
        Crypto_30_vHsm_Hwa_Hash_Result: CryptoKeyElementAllowPartialAccess=FALSE, CryptoKeyElementPersist=FALSE, CryptoKeyElementId=4, CryptoKeyElementSize=20, CryptoKeyElementReadAccess=RA_ALLOWED, CryptoKeyElementWriteAccess=WA_ALLOWED
        Crypto_30_vHsm_LibCv_Fbl_SecurityAccess_Ed25519_Key: CryptoKeyElementAllowPartialAccess=FALSE, CryptoKeyElementPersist=FALSE, CryptoKeyElementId=1, CryptoKeyElementSize=32, CryptoKeyElementReadAccess=RA_ALLOWED, CryptoKeyElementWriteAccess=WA_ALLOWED
        Crypto_30_vHsm_LibCv_vHsm_Version: CryptoKeyElementAllowPartialAccess=FALSE, CryptoKeyElementPersist=FALSE, CryptoKeyElementId=1, CryptoKeyElementSize=3, CryptoKeyElementReadAccess=RA_ALLOWED, CryptoKeyElementWriteAccess=WA_ALLOWED
    CryptoDriverObjects
      7 x CryptoDriverObject, all with CryptoDriverObjectQueueSize=1:
        Crypto_30_vHsm_KeyManagement: CryptoDriverObjectId=5, CryptoPrimitiveRef=vHsmUsageForbidden
        Crypto_30_vHsm_LibCv_HighPrio: CryptoDriverObjectId=7, CryptoPrimitiveRef=Crypto_30_vHsm_LibCv_SHA256, CryptoPrimitiveRef=Crypto_30_vHsm_LibCv_AesDecrypt, CryptoPrimitiveRef=Crypto_30_vHsm_LibCv_AesEncrypt, CryptoPrimitiveRef=Crypto_30_vHsm_LibCv_AesCmacGenerate, CryptoPrimitiveRef=Crypto_30_vHsm_LibCv_AesCmacVerify, CryptoPrimitiveRef=Crypto_30_vHsm_LibCv_RngDrbgAes128, CryptoPrimitiveRef=Crypto_30_vHsm_LibCv_SHA512
        Crypto_30_vHsm_KeyM_LibCv: CryptoDriverObjectId=4, CryptoPrimitiveRef=Crypto_30_vHsm_LibCv_EccNistP256R1VerifySha256
        Crypto_30_vHsm_Core: CryptoDriverObjectId=0, CryptoPrimitiveRef=Crypto_30_vHsm_vHsm_Core_vHsmSecureBoot, CryptoPrimitiveRef=Crypto_30_vHsm_vHsm_Core_vHsmFirmwareUpdate, CryptoPrimitiveRef=Crypto_30_vHsm_vHsm_Core_vHsmSecureBootUpdate, CryptoPrimitiveRef=Crypto_30_vHsm_vHsm_Core_vHsmSecureSoftwareDownload, CryptoPrimitiveRef=Crypto_30_vHsm_vHsm_Core_vHsmSecureBootConfirmation, CryptoPrimitiveRef=Crypto_30_vHsm_vHsm_Core_vHsmPersistency
        Crypto_30_vHsm_LibCv: CryptoDriverObjectId=6, CryptoPrimitiveRef=Crypto_30_vHsm_LibCv_SHA256, CryptoPrimitiveRef=Crypto_30_vHsm_LibCv_AesDecrypt, CryptoPrimitiveRef=Crypto_30_vHsm_LibCv_AesEncrypt, CryptoPrimitiveRef=Crypto_30_vHsm_LibCv_AesCmacGenerate, CryptoPrimitiveRef=Crypto_30_vHsm_LibCv_AesCmacVerify, CryptoPrimitiveRef=Crypto_30_vHsm_LibCv_RngDrbgAes128, CryptoPrimitiveRef=Crypto_30_vHsm_LibCv_EccNistP256R1VerifySha256, CryptoPrimitiveRef=Crypto_30_vHsm_LibCv_EcDsaEd25519Generate, CryptoPrimitiveRef=Crypto_30_vHsm_LibCv_EcDsaEd25519Verify, CryptoPrimitiveRef=Crypto_30_vHsm_LibCv_SHA512, CryptoPrimitiveRef=Crypto_30_vHsm_LibCv_KeyGenerateEd25519
        Crypto_30_vHsm_Hwa_HighPrio: CryptoDriverObjectId=2, CryptoPrimitiveRef=Crypto_30_vHsm_Hwa_AesCmacVerify, CryptoPrimitiveRef=Crypto_30_vHsm_Hwa_AesCmacGenerate
        Crypto_30_vHsm_Hwa: CryptoDriverObjectId=1, CryptoPrimitiveRef=Crypto_30_vHsm_Hwa_Trng, CryptoPrimitiveRef=Crypto_30_vHsm_Hwa_AesDecrypt, CryptoPrimitiveRef=Crypto_30_vHsm_Hwa_AesEncrypt, CryptoPrimitiveRef=Crypto_30_vHsm_Hwa_AesCmacVerify, CryptoPrimitiveRef=Crypto_30_vHsm_Hwa_AesCmacGenerate, CryptoPrimitiveRef=Crypto_30_vHsm_Hwa_AesGCMDecrypt, CryptoPrimitiveRef=Crypto_30_vHsm_Hwa_AesGCMEncrypt, CryptoPrimitiveRef=Crypto_30_vHsm_Hwa_Ed25519VerifySHA2_512, CryptoPrimitiveRef=Crypto_30_vHsm_Hwa_Ed25519GenerateSHA2_512
    CryptoPrimitives
      27 x CryptoPrimitive:
        Crypto_30_vHsm_LibCv_SHA256: CryptoPrimitiveService=CRYPTO_HASH, CryptoPrimitiveAlgorithmFamily=CRYPTO_ALGOFAM_SHA2_256, CryptoPrimitiveAlgorithmMode=CRYPTO_ALGOMODE_NOT_SET, CryptoPrimitiveAlgorithmSecondaryFamily=CRYPTO_ALGOFAM_NOT_SET
        Crypto_30_vHsm_LibCv_AesDecrypt: CryptoPrimitiveService=CRYPTO_DECRYPT, CryptoPrimitiveAlgorithmFamily=CRYPTO_ALGOFAM_AES, CryptoPrimitiveAlgorithmMode=CRYPTO_ALGOMODE_ECB, CryptoPrimitiveAlgorithmMode=CRYPTO_ALGOMODE_CBC, CryptoPrimitiveAlgorithmMode=CRYPTO_ALGOMODE_CTR, CryptoPrimitiveAlgorithmSecondaryFamily=CRYPTO_ALGOFAM_NOT_SET, CryptoPrimitiveAlgorithmSecondaryFamily=CRYPTO_ALGOFAM_CUSTOM_PADDING_PKCS7, CryptoPrimitiveAlgorithmSecondaryFamily=CRYPTO_ALGOFAM_CUSTOM
        Crypto_30_vHsm_LibCv_AesEncrypt: CryptoPrimitiveService=CRYPTO_ENCRYPT, CryptoPrimitiveAlgorithmFamily=CRYPTO_ALGOFAM_AES, CryptoPrimitiveAlgorithmMode=CRYPTO_ALGOMODE_ECB, CryptoPrimitiveAlgorithmMode=CRYPTO_ALGOMODE_CBC, CryptoPrimitiveAlgorithmMode=CRYPTO_ALGOMODE_CTR, CryptoPrimitiveAlgorithmSecondaryFamily=CRYPTO_ALGOFAM_NOT_SET, CryptoPrimitiveAlgorithmSecondaryFamily=CRYPTO_ALGOFAM_CUSTOM_PADDING_PKCS7, CryptoPrimitiveAlgorithmSecondaryFamily=CRYPTO_ALGOFAM_CUSTOM
        Crypto_30_vHsm_LibCv_AesCmacGenerate: CryptoPrimitiveService=CRYPTO_MAC_GENERATE, CryptoPrimitiveAlgorithmFamily=CRYPTO_ALGOFAM_AES, CryptoPrimitiveAlgorithmMode=CRYPTO_ALGOMODE_CMAC, CryptoPrimitiveAlgorithmSecondaryFamily=CRYPTO_ALGOFAM_NOT_SET
        Crypto_30_vHsm_LibCv_AesCmacVerify: CryptoPrimitiveService=CRYPTO_MAC_VERIFY, CryptoPrimitiveAlgorithmFamily=CRYPTO_ALGOFAM_AES, CryptoPrimitiveAlgorithmMode=CRYPTO_ALGOMODE_CMAC, CryptoPrimitiveAlgorithmSecondaryFamily=CRYPTO_ALGOFAM_NOT_SET
        Crypto_30_vHsm_LibCv_RngDrbgAes128: CryptoPrimitiveService=CRYPTO_RANDOM, CryptoPrimitiveAlgorithmFamily=CRYPTO_ALGOFAM_CUSTOM_DRBG, CryptoPrimitiveAlgorithmMode=CRYPTO_ALGOMODE_NOT_SET, CryptoPrimitiveAlgorithmSecondaryFamily=CRYPTO_ALGOFAM_AES
        Crypto_30_vHsm_LibCv_SHA512: CryptoPrimitiveService=CRYPTO_HASH, CryptoPrimitiveAlgorithmFamily=CRYPTO_ALGOFAM_SHA2_512, CryptoPrimitiveAlgorithmMode=CRYPTO_ALGOMODE_NOT_SET, CryptoPrimitiveAlgorithmSecondaryFamily=CRYPTO_ALGOFAM_NOT_SET
        Crypto_30_vHsm_LibCv_EccNistP256R1VerifySha256: CryptoPrimitiveService=CRYPTO_SIGNATURE_VERIFY, CryptoPrimitiveAlgorithmFamily=CRYPTO_ALGOFAM_ECCNIST, CryptoPrimitiveAlgorithmMode=CRYPTO_ALGOMODE_CUSTOM_P256R1, CryptoPrimitiveAlgorithmSecondaryFamily=CRYPTO_ALGOFAM_SHA2_256
        Crypto_30_vHsm_vHsm_Core_vHsmSecureBoot: CryptoPrimitiveService=CRYPTO_MAC_VERIFY, CryptoPrimitiveAlgorithmFamily=CRYPTO_ALGOFAM_CUSTOM_VHSM_SECURE_BOOT, CryptoPrimitiveAlgorithmMode=CRYPTO_ALGOMODE_CMAC, CryptoPrimitiveAlgorithmMode=CRYPTO_ALGOMODE_NOT_SET, CryptoPrimitiveAlgorithmMode=CRYPTO_ALGOMODE_CUSTOM, CryptoPrimitiveAlgorithmSecondaryFamily=CRYPTO_ALGOFAM_NOT_SET
        Crypto_30_vHsm_vHsm_Core_vHsmFirmwareUpdate: CryptoPrimitiveService=CRYPTO_AEADENCRYPT, CryptoPrimitiveAlgorithmFamily=CRYPTO_ALGOFAM_CUSTOM_VHSM_FIRMWARE_UPDATE, CryptoPrimitiveAlgorithmMode=CRYPTO_ALGOMODE_GCM, CryptoPrimitiveAlgorithmMode=CRYPTO_ALGOMODE_NOT_SET, CryptoPrimitiveAlgorithmSecondaryFamily=CRYPTO_ALGOFAM_NOT_SET
        Crypto_30_vHsm_vHsm_Core_vHsmSecureBootUpdate: CryptoPrimitiveService=CRYPTO_SIGNATURE_VERIFY, CryptoPrimitiveAlgorithmFamily=CRYPTO_ALGOFAM_CUSTOM, CryptoPrimitiveAlgorithmMode=CRYPTO_ALGOMODE_NOT_SET, CryptoPrimitiveAlgorithmSecondaryFamily=CRYPTO_ALGOFAM_NOT_SET
        Crypto_30_vHsm_vHsm_Core_vHsmSecureSoftwareDownload: CryptoPrimitiveService=CRYPTO_SIGNATURE_VERIFY, CryptoPrimitiveAlgorithmFamily=CRYPTO_ALGOFAM_CUSTOM_VHSM_SOFTWARE_DOWNLOAD, CryptoPrimitiveAlgorithmMode=CRYPTO_ALGOMODE_NOT_SET, CryptoPrimitiveAlgorithmSecondaryFamily=CRYPTO_ALGOFAM_NOT_SET
        Crypto_30_vHsm_vHsm_Core_vHsmSecureBootConfirmation: CryptoPrimitiveService=CRYPTO_SIGNATURE_VERIFY, CryptoPrimitiveAlgorithmFamily=CRYPTO_ALGOFAM_CUSTOM, CryptoPrimitiveAlgorithmMode=CRYPTO_ALGOMODE_NOT_SET, CryptoPrimitiveAlgorithmSecondaryFamily=CRYPTO_ALGOFAM_NOT_SET
        Crypto_30_vHsm_vHsm_Core_vHsmPersistency: CryptoPrimitiveService=CRYPTO_RANDOM, CryptoPrimitiveAlgorithmFamily=CRYPTO_ALGOFAM_CUSTOM, CryptoPrimitiveAlgorithmMode=CRYPTO_ALGOMODE_CUSTOM, CryptoPrimitiveAlgorithmSecondaryFamily=CRYPTO_ALGOFAM_NOT_SET
        Crypto_30_vHsm_LibCv_EcDsaEd25519Generate: CryptoPrimitiveService=CRYPTO_SIGNATURE_GENERATE, CryptoPrimitiveAlgorithmFamily=CRYPTO_ALGOFAM_ED25519, CryptoPrimitiveAlgorithmMode=CRYPTO_ALGOMODE_NOT_SET, CryptoPrimitiveAlgorithmSecondaryFamily=CRYPTO_ALGOFAM_NOT_SET, CryptoPrimitiveAlgorithmSecondaryFamily=CRYPTO_ALGOFAM_SHA2_512
        Crypto_30_vHsm_LibCv_EcDsaEd25519Verify: CryptoPrimitiveService=CRYPTO_SIGNATURE_VERIFY, CryptoPrimitiveAlgorithmFamily=CRYPTO_ALGOFAM_ED25519, CryptoPrimitiveAlgorithmMode=CRYPTO_ALGOMODE_NOT_SET, CryptoPrimitiveAlgorithmSecondaryFamily=CRYPTO_ALGOFAM_NOT_SET, CryptoPrimitiveAlgorithmSecondaryFamily=CRYPTO_ALGOFAM_SHA2_512
        Crypto_30_vHsm_LibCv_KeyGenerateEd25519: CryptoPrimitiveService=CRYPTO_KEY_GENERATE, CryptoPrimitiveAlgorithmFamily=CRYPTO_ALGOFAM_ED25519, CryptoPrimitiveAlgorithmMode=CRYPTO_ALGOMODE_NOT_SET, CryptoPrimitiveAlgorithmSecondaryFamily=CRYPTO_ALGOFAM_NOT_SET
        Crypto_30_vHsm_Hwa_AesCmacVerify: CryptoPrimitiveService=CRYPTO_MAC_VERIFY, CryptoPrimitiveAlgorithmFamily=CRYPTO_ALGOFAM_AES, CryptoPrimitiveAlgorithmMode=CRYPTO_ALGOMODE_CMAC, CryptoPrimitiveAlgorithmSecondaryFamily=CRYPTO_ALGOFAM_NOT_SET
        Crypto_30_vHsm_Hwa_AesCmacGenerate: CryptoPrimitiveService=CRYPTO_MAC_GENERATE, CryptoPrimitiveAlgorithmFamily=CRYPTO_ALGOFAM_AES, CryptoPrimitiveAlgorithmMode=CRYPTO_ALGOMODE_CMAC, CryptoPrimitiveAlgorithmSecondaryFamily=CRYPTO_ALGOFAM_NOT_SET
        Crypto_30_vHsm_Hwa_Trng: CryptoPrimitiveService=CRYPTO_RANDOM, CryptoPrimitiveAlgorithmFamily=CRYPTO_ALGOFAM_RNG, CryptoPrimitiveAlgorithmMode=CRYPTO_ALGOMODE_NOT_SET, CryptoPrimitiveAlgorithmSecondaryFamily=CRYPTO_ALGOFAM_NOT_SET
        Crypto_30_vHsm_Hwa_AesDecrypt: CryptoPrimitiveService=CRYPTO_DECRYPT, CryptoPrimitiveAlgorithmFamily=CRYPTO_ALGOFAM_AES, CryptoPrimitiveAlgorithmMode=CRYPTO_ALGOMODE_ECB, CryptoPrimitiveAlgorithmMode=CRYPTO_ALGOMODE_CBC, CryptoPrimitiveAlgorithmMode=CRYPTO_ALGOMODE_CTR, CryptoPrimitiveAlgorithmSecondaryFamily=CRYPTO_ALGOFAM_NOT_SET
        Crypto_30_vHsm_Hwa_AesEncrypt: CryptoPrimitiveService=CRYPTO_ENCRYPT, CryptoPrimitiveAlgorithmFamily=CRYPTO_ALGOFAM_AES, CryptoPrimitiveAlgorithmMode=CRYPTO_ALGOMODE_ECB, CryptoPrimitiveAlgorithmMode=CRYPTO_ALGOMODE_CBC, CryptoPrimitiveAlgorithmMode=CRYPTO_ALGOMODE_CTR, CryptoPrimitiveAlgorithmSecondaryFamily=CRYPTO_ALGOFAM_NOT_SET
        Crypto_30_vHsm_Hwa_AesGCMDecrypt: CryptoPrimitiveService=CRYPTO_AEADDECRYPT, CryptoPrimitiveAlgorithmFamily=CRYPTO_ALGOFAM_AES, CryptoPrimitiveAlgorithmMode=CRYPTO_ALGOMODE_GCM, CryptoPrimitiveAlgorithmSecondaryFamily=CRYPTO_ALGOFAM_NOT_SET
        Crypto_30_vHsm_Hwa_AesGCMEncrypt: CryptoPrimitiveService=CRYPTO_AEADENCRYPT, CryptoPrimitiveAlgorithmFamily=CRYPTO_ALGOFAM_AES, CryptoPrimitiveAlgorithmMode=CRYPTO_ALGOMODE_GCM, CryptoPrimitiveAlgorithmSecondaryFamily=CRYPTO_ALGOFAM_NOT_SET
        Crypto_30_vHsm_Hwa_Ed25519VerifySHA2_512: CryptoPrimitiveService=CRYPTO_SIGNATURE_VERIFY, CryptoPrimitiveAlgorithmFamily=CRYPTO_ALGOFAM_ED25519, CryptoPrimitiveAlgorithmMode=CRYPTO_ALGOMODE_CUSTOM, CryptoPrimitiveAlgorithmSecondaryFamily=CRYPTO_ALGOFAM_SHA2_512
        Crypto_30_vHsm_Hwa_Ed25519GenerateSHA2_512: CryptoPrimitiveService=CRYPTO_SIGNATURE_GENERATE, CryptoPrimitiveAlgorithmFamily=CRYPTO_ALGOFAM_ED25519, CryptoPrimitiveAlgorithmMode=CRYPTO_ALGOMODE_CUSTOM, CryptoPrimitiveAlgorithmSecondaryFamily=CRYPTO_ALGOFAM_SHA2_512
        vHsmUsageForbidden: CryptoPrimitiveService=CRYPTO_RANDOM, CryptoPrimitiveAlgorithmFamily=CRYPTO_ALGOFAM_NOT_SET, CryptoPrimitiveAlgorithmMode=CRYPTO_ALGOMODE_NOT_SET, CryptoPrimitiveAlgorithmSecondaryFamily=CRYPTO_ALGOFAM_NOT_SET
    CryptovHsm: CryptoIpcChannels=2, CryptoIpcProtocolVersion=3, CryptoManagementDriverObject=Crypto_30_vHsm_KeyManagement
