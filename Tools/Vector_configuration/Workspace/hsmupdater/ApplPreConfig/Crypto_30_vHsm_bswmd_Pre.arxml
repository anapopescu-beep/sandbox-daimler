AUTOSAR XML (schema 4-0-3)
package /MICROSAR/Crypto_30_vHsm
  module config Crypto_Pre: definition=Crypto  # Software Crypto Driver pre-configuration
    CryptoKeys
      32 x CryptoKey, all with CryptoKeyDeriveIterations=1:
        vHsm_SecureBoot_Segment_BM_0: CryptoKeyId=29, CryptoKeyTypeRef=Crypto_30_LibCv_vHsm_SecureBootSegment_KeyType_BM_0
        vHsm_SecureBoot_Segment_APPL_2: CryptoKeyId=28, CryptoKeyTypeRef=Crypto_30_LibCv_vHsm_SecureBootSegment_KeyType_APPL_2
        vHsm_SecureBoot_Segment_APPL_0: CryptoKeyId=26, CryptoKeyTypeRef=Crypto_30_LibCv_vHsm_SecureBootSegment_KeyType_APPL_0
        vHsm_SecureBoot_Segment_APPL_1: CryptoKeyId=27, CryptoKeyTypeRef=Crypto_30_LibCv_vHsm_SecureBootSegment_KeyType_APPL_1
        vHsm_SecureBoot_Group_BM: CryptoKeyId=24, CryptoKeyTypeRef=Crypto_30_LibCv_vHsm_SecureBootGroup
        vHsm_SecureBoot_Group_FBL: CryptoKeyId=25, CryptoKeyTypeRef=Crypto_30_LibCv_vHsm_SecureBootGroup
        vHsm_SecureBoot_Group_APPL: CryptoKeyId=23, CryptoKeyTypeRef=Crypto_30_LibCv_vHsm_SecureBootGroup
        vHsm_SecureBoot_Segment_FBL_0: CryptoKeyId=30, CryptoKeyTypeRef=Crypto_30_LibCv_vHsm_SecureBootSegment_KeyType_FBL_0
        vHsm_Hardware: CryptoKeyId=19, CryptoKeyTypeRef=Crypto_30_LibCv_vHsm_Hardware
        vHsm_SecureBoot_Signature: CryptoKeyId=31, CryptoKeyTypeRef=Crypto_30_LibCv_Signature
        SymmetricKey: CryptoKeyId=12, CryptoKeyTypeRef=Crypto_30_LibCv_Cipher
        WriteOnceKey: CryptoKeyId=13, CryptoKeyTypeRef=Crypto_30_LibCv_WriteOnceKey
        SecureBootProtectedKey: CryptoKeyId=6, CryptoKeyTypeRef=Crypto_30_LibCv_SecureBootProtectedKey
        Random_Fips186: CryptoKeyId=5, CryptoKeyTypeRef=Crypto_30_LibCv_Random_Fips186
        LazyPersistKey: CryptoKeyId=4, CryptoKeyTypeRef=Crypto_30_LibCv_LazyPersistKey
        vHsm_FirmwareUpdate_Signature: CryptoKeyId=18, CryptoKeyTypeRef=Crypto_30_LibCv_Signature
        vHsm_Custom: CryptoKeyId=14, CryptoKeyTypeRef=Crypto_30_LibCv_Cipher
        vHsm_FirmwareUpdate_Decrypt: CryptoKeyId=15, CryptoKeyTypeRef=Crypto_30_LibCv_Cipher
        vHsm_FirmwareUpdate_Encrypt: CryptoKeyId=16, CryptoKeyTypeRef=Crypto_30_LibCv_Cipher
        vHsm_FirmwareUpdate_Mac: CryptoKeyId=17, CryptoKeyTypeRef=Crypto_30_LibCv_Mac
        She_Key1: CryptoKeyId=8, CryptoKeyTypeRef=Crypto_30_LibCv_MacShe
        She_Key2: CryptoKeyId=9, CryptoKeyTypeRef=Crypto_30_LibCv_CipherShe
        She_MasterEcuKey: CryptoKeyId=10, CryptoKeyTypeRef=Crypto_30_LibCv_MacShe
        She_SecretKey: CryptoKeyId=11, CryptoKeyTypeRef=Crypto_30_LibCv_MacShe
        She_Info: CryptoKeyId=7, CryptoKeyTypeRef=Crypto_30_LibCv_SheInfoKey
        vHsm_Info: CryptoKeyId=20, CryptoKeyTypeRef=vHsm_Core_vHsmInfo_Type
        vHsm_Info_SecureBoot: CryptoKeyId=21, CryptoKeyTypeRef=vHsm_Core_vHsmSecureBootGroupInfo_Type
        KeyM_Cert_Root: CryptoKeyId=1, CryptoKeyTypeRef=Crypto_30_LibCv_KeyType_KeyM_CertificateData
        KeyM_Cert_Intermediate: CryptoKeyId=0, CryptoKeyTypeRef=Crypto_30_LibCv_KeyType_KeyM_CertificateData
        KeyM_Cert_Working: CryptoKeyId=2, CryptoKeyTypeRef=Crypto_30_LibCv_KeyType_KeyM_CertificateData
        KeyM_ECC_Working: CryptoKeyId=3, CryptoKeyTypeRef=Crypto_30_LibCv_Signature
        vHsm_RomKey0: CryptoKeyId=22, CryptoKeyTypeRef=vHsm_Hal_RomKeyType
    CryptoKeyTypes
      21 x CryptoKeyType:
        Crypto_30_LibCv_vHsm_SecureBootSegment_KeyType_BM_0: CryptoKeyElementRef=Crypto_30_LibCv_vHsm_SecureBootSegment_BM_0_Sanction_Sync, CryptoKeyElementRef=Crypto_30_LibCv_vHsm_SecureBootSegment_BM_0_Mode_Sync, CryptoKeyElementRef=Crypto_30_LibCv_vHsm_SecureBootSegment_BM_0_Address_Sync, CryptoKeyElementRef=Crypto_30_LibCv_vHsm_SecureBootSegment_BM_0_Length_Sync, CryptoKeyElementRef=Crypto_30_LibCv_vHsm_SecureBootSegment_BM_0_CMAC_Sync
        Crypto_30_LibCv_vHsm_SecureBootSegment_KeyType_APPL_2: CryptoKeyElementRef=Crypto_30_LibCv_vHsm_SecureBootSegment_APPL_2_Sanction_Sync, CryptoKeyElementRef=Crypto_30_LibCv_vHsm_SecureBootSegment_APPL_2_Mode_Sync, CryptoKeyElementRef=Crypto_30_LibCv_vHsm_SecureBootSegment_APPL_2_Address_Sync, CryptoKeyElementRef=Crypto_30_LibCv_vHsm_SecureBootSegment_APPL_2_Length_Sync, CryptoKeyElementRef=Crypto_30_LibCv_vHsm_SecureBootSegment_APPL_2_CMAC_Sync
        Crypto_30_LibCv_vHsm_SecureBootSegment_KeyType_APPL_0: CryptoKeyElementRef=Crypto_30_LibCv_vHsm_SecureBootSegment_APPL_0_Sanction_Sync, CryptoKeyElementRef=Crypto_30_LibCv_vHsm_SecureBootSegment_APPL_0_Mode_Sync, CryptoKeyElementRef=Crypto_30_LibCv_vHsm_SecureBootSegment_APPL_0_Address_Sync, CryptoKeyElementRef=Crypto_30_LibCv_vHsm_SecureBootSegment_APPL_0_Length_Sync, CryptoKeyElementRef=Crypto_30_LibCv_vHsm_SecureBootSegment_APPL_0_CMAC_Sync
        Crypto_30_LibCv_vHsm_SecureBootSegment_KeyType_APPL_1: CryptoKeyElementRef=Crypto_30_LibCv_vHsm_SecureBootSegment_APPL_1_Sanction_Sync, CryptoKeyElementRef=Crypto_30_LibCv_vHsm_SecureBootSegment_APPL_1_Mode_Sync, CryptoKeyElementRef=Crypto_30_LibCv_vHsm_SecureBootSegment_APPL_1_Address_Sync, CryptoKeyElementRef=Crypto_30_LibCv_vHsm_SecureBootSegment_APPL_1_Length_Sync, CryptoKeyElementRef=Crypto_30_LibCv_vHsm_SecureBootSegment_APPL_1_CMAC_Sync
        Crypto_30_LibCv_vHsm_SecureBootGroup: CryptoKeyElementRef=Crypto_30_LibCv_vHsm_SecureBoot_Key_Sync
        Crypto_30_LibCv_vHsm_SecureBootSegment_KeyType_FBL_0: CryptoKeyElementRef=Crypto_30_LibCv_vHsm_SecureBootSegment_FBL_0_Sanction_Sync, CryptoKeyElementRef=Crypto_30_LibCv_vHsm_SecureBootSegment_FBL_0_Mode_Sync, CryptoKeyElementRef=Crypto_30_LibCv_vHsm_SecureBootSegment_FBL_0_Address_Sync, CryptoKeyElementRef=Crypto_30_LibCv_vHsm_SecureBootSegment_FBL_0_Length_Sync, CryptoKeyElementRef=Crypto_30_LibCv_vHsm_SecureBootSegment_FBL_0_CMAC_Sync
        Crypto_30_LibCv_vHsm_Hardware: CryptoKeyElementRef=Crypto_30_LibCv_vHsm_SecureBoot_Result_Sync
        Crypto_30_LibCv_Signature: CryptoKeyElementRef=Crypto_30_LibCv_Signature_Key_Sync
        Crypto_30_LibCv_Cipher: CryptoKeyElementRef=Crypto_30_LibCv_Cipher_Key_Sync, CryptoKeyElementRef=Crypto_30_LibCv_Cipher_IV_Sync, CryptoKeyElementRef=Crypto_30_LibCv_Cipher_Proof_Sync
        Crypto_30_LibCv_WriteOnceKey: CryptoKeyElementRef=Crypto_30_LibCv_Cipher_Key_Sync
        Crypto_30_LibCv_SecureBootProtectedKey: CryptoKeyElementRef=Crypto_30_LibCv_Cipher_IV_Sync, CryptoKeyElementRef=Crypto_30_LibCv_Cipher_Key_Sync
        Crypto_30_LibCv_Random_Fips186: CryptoKeyElementRef=Crypto_30_LibCv_Random_Algorithm_Fips186_Sync, CryptoKeyElementRef=Crypto_30_LibCv_Random_Seed_Sync, CryptoKeyElementRef=Crypto_30_LibCv_Random_Data_Sync
        Crypto_30_LibCv_LazyPersistKey: CryptoKeyElementRef=Crypto_30_LibCv_vHsm_LazyPersistKey_Sync
        Crypto_30_LibCv_Mac: CryptoKeyElementRef=Crypto_30_LibCv_Mac_Key_Sync, CryptoKeyElementRef=Crypto_30_LibCv_Mac_Proof_Sync, CryptoKeyElementRef=Crypto_30_LibCv_Cipher_IV_Sync
        Crypto_30_LibCv_MacShe: CryptoKeyElementRef=Crypto_30_LibCv_Mac_Proof_Sync, CryptoKeyElementRef=Crypto_30_LibCv_Mac_Key_She_Sync, CryptoKeyElementRef=Crypto_30_LibCv_She_Counter_Sync
        Crypto_30_LibCv_CipherShe: CryptoKeyElementRef=Crypto_30_LibCv_Cipher_IV_Sync, CryptoKeyElementRef=Crypto_30_LibCv_Cipher_Proof_Sync, CryptoKeyElementRef=Crypto_30_LibCv_Cipher_Key_She_Sync, CryptoKeyElementRef=Crypto_30_LibCv_She_Counter_Sync
        Crypto_30_LibCv_SheInfoKey: CryptoKeyElementRef=Crypto_30_LibCv_She_UId_Sync, CryptoKeyElementRef=Crypto_30_LibCv_She_BootProtection_Sync, CryptoKeyElementRef=Crypto_30_LibCv_She_DebuggerProtection_Sync
        vHsm_Core_vHsmInfo_Type: CryptoKeyElementRef=vHsm_Core_vHsmInfo_Version_Sync, CryptoKeyElementRef=vHsm_Core_vHsmInfo_PerformPersist_Sync, CryptoKeyElementRef=vHsm_Core_vHsmInfo_PerformRepersist_Sync, CryptoKeyElementRef=vHsm_Core_vHsmInfo_StartFirmwareUpdater_Sync, CryptoKeyElementRef=vHsm_Core_vHsmInfo_SecureBootEnd_Sync, CryptoKeyElementRef=vHsm_Core_vHsmInfo_SecureBootResult_Sync
        vHsm_Core_vHsmSecureBootGroupInfo_Type: CryptoKeyElementRef=vHsm_Core_vHsmSecureBootInfo_GroupState_Sync
        Crypto_30_LibCv_KeyType_KeyM_CertificateData: CryptoKeyElementRef=Crypto_30_LibCv_KeyM_CertificateData_Sync
        vHsm_Hal_RomKeyType: CryptoKeyElementRef=vHsm_Hal_RomKey_Sync
    CryptoKeyElements
      52 x CryptoKeyElement:
        Crypto_30_LibCv_vHsm_SecureBootSegment_BM_0_Sanction_Sync: CryptoKeyElementAllowPartialAccess=FALSE, CryptoKeyElementPersist=TRUE, CryptoKeyElementId=3027, CryptoKeyElementSize=1, CryptoKeyElementReadAccess=RA_DENIED, CryptoKeyElementWriteAccess=WA_DENIED
        Crypto_30_LibCv_vHsm_SecureBootSegment_BM_0_Mode_Sync: CryptoKeyElementAllowPartialAccess=FALSE, CryptoKeyElementPersist=TRUE, CryptoKeyElementId=3039, CryptoKeyElementSize=1, CryptoKeyElementReadAccess=RA_DENIED, CryptoKeyElementWriteAccess=WA_DENIED
        Crypto_30_LibCv_vHsm_SecureBootSegment_BM_0_Address_Sync: CryptoKeyElementAllowPartialAccess=FALSE, CryptoKeyElementPersist=TRUE, CryptoKeyElementId=3024, CryptoKeyElementSize=4, CryptoKeyElementReadAccess=RA_DENIED, CryptoKeyElementWriteAccess=WA_DENIED
        Crypto_30_LibCv_vHsm_SecureBootSegment_BM_0_Length_Sync: CryptoKeyElementAllowPartialAccess=FALSE, CryptoKeyElementPersist=TRUE, CryptoKeyElementId=3025, CryptoKeyElementSize=4, CryptoKeyElementReadAccess=RA_DENIED, CryptoKeyElementWriteAccess=WA_DENIED
        Crypto_30_LibCv_vHsm_SecureBootSegment_BM_0_CMAC_Sync: CryptoKeyElementAllowPartialAccess=TRUE, CryptoKeyElementPersist=TRUE, CryptoKeyElementId=3026, CryptoKeyElementSize=16, CryptoKeyElementReadAccess=RA_DENIED, CryptoKeyElementWriteAccess=WA_DENIED
        Crypto_30_LibCv_vHsm_SecureBootSegment_APPL_2_Sanction_Sync: CryptoKeyElementAllowPartialAccess=FALSE, CryptoKeyElementPersist=TRUE, CryptoKeyElementId=3027, CryptoKeyElementSize=1, CryptoKeyElementReadAccess=RA_DENIED, CryptoKeyElementWriteAccess=WA_DENIED
        Crypto_30_LibCv_vHsm_SecureBootSegment_APPL_2_Mode_Sync: CryptoKeyElementAllowPartialAccess=FALSE, CryptoKeyElementPersist=TRUE, CryptoKeyElementId=3039, CryptoKeyElementSize=1, CryptoKeyElementReadAccess=RA_DENIED, CryptoKeyElementWriteAccess=WA_DENIED
        Crypto_30_LibCv_vHsm_SecureBootSegment_APPL_2_Address_Sync: CryptoKeyElementAllowPartialAccess=FALSE, CryptoKeyElementPersist=TRUE, CryptoKeyElementId=3024, CryptoKeyElementSize=4, CryptoKeyElementReadAccess=RA_DENIED, CryptoKeyElementWriteAccess=WA_DENIED
        Crypto_30_LibCv_vHsm_SecureBootSegment_APPL_2_Length_Sync: CryptoKeyElementAllowPartialAccess=FALSE, CryptoKeyElementPersist=TRUE, CryptoKeyElementId=3025, CryptoKeyElementSize=4, CryptoKeyElementReadAccess=RA_DENIED, CryptoKeyElementWriteAccess=WA_DENIED
        Crypto_30_LibCv_vHsm_SecureBootSegment_APPL_2_CMAC_Sync: CryptoKeyElementAllowPartialAccess=TRUE, CryptoKeyElementPersist=TRUE, CryptoKeyElementId=3026, CryptoKeyElementSize=16, CryptoKeyElementReadAccess=RA_DENIED, CryptoKeyElementWriteAccess=WA_DENIED
        Crypto_30_LibCv_vHsm_SecureBootSegment_APPL_0_Sanction_Sync: CryptoKeyElementAllowPartialAccess=FALSE, CryptoKeyElementPersist=TRUE, CryptoKeyElementId=3027, CryptoKeyElementSize=1, CryptoKeyElementReadAccess=RA_DENIED, CryptoKeyElementWriteAccess=WA_DENIED
        Crypto_30_LibCv_vHsm_SecureBootSegment_APPL_0_Mode_Sync: CryptoKeyElementAllowPartialAccess=FALSE, CryptoKeyElementPersist=TRUE, CryptoKeyElementId=3039, CryptoKeyElementSize=1, CryptoKeyElementReadAccess=RA_DENIED, CryptoKeyElementWriteAccess=WA_DENIED
        Crypto_30_LibCv_vHsm_SecureBootSegment_APPL_0_Address_Sync: CryptoKeyElementAllowPartialAccess=FALSE, CryptoKeyElementPersist=TRUE, CryptoKeyElementId=3024, CryptoKeyElementSize=4, CryptoKeyElementReadAccess=RA_DENIED, CryptoKeyElementWriteAccess=WA_DENIED
        Crypto_30_LibCv_vHsm_SecureBootSegment_APPL_0_Length_Sync: CryptoKeyElementAllowPartialAccess=FALSE, CryptoKeyElementPersist=TRUE, CryptoKeyElementId=3025, CryptoKeyElementSize=4, CryptoKeyElementReadAccess=RA_DENIED, CryptoKeyElementWriteAccess=WA_DENIED
        Crypto_30_LibCv_vHsm_SecureBootSegment_APPL_0_CMAC_Sync: CryptoKeyElementAllowPartialAccess=TRUE, CryptoKeyElementPersist=TRUE, CryptoKeyElementId=3026, CryptoKeyElementSize=16, CryptoKeyElementReadAccess=RA_DENIED, CryptoKeyElementWriteAccess=WA_DENIED
        Crypto_30_LibCv_vHsm_SecureBootSegment_APPL_1_Sanction_Sync: CryptoKeyElementAllowPartialAccess=FALSE, CryptoKeyElementPersist=TRUE, CryptoKeyElementId=3027, CryptoKeyElementSize=1, CryptoKeyElementReadAccess=RA_DENIED, CryptoKeyElementWriteAccess=WA_DENIED
        Crypto_30_LibCv_vHsm_SecureBootSegment_APPL_1_Mode_Sync: CryptoKeyElementAllowPartialAccess=FALSE, CryptoKeyElementPersist=TRUE, CryptoKeyElementId=3039, CryptoKeyElementSize=1, CryptoKeyElementReadAccess=RA_DENIED, CryptoKeyElementWriteAccess=WA_DENIED
        Crypto_30_LibCv_vHsm_SecureBootSegment_APPL_1_Address_Sync: CryptoKeyElementAllowPartialAccess=FALSE, CryptoKeyElementPersist=TRUE, CryptoKeyElementId=3024, CryptoKeyElementSize=4, CryptoKeyElementReadAccess=RA_DENIED, CryptoKeyElementWriteAccess=WA_DENIED
        Crypto_30_LibCv_vHsm_SecureBootSegment_APPL_1_Length_Sync: CryptoKeyElementAllowPartialAccess=FALSE, CryptoKeyElementPersist=TRUE, CryptoKeyElementId=3025, CryptoKeyElementSize=4, CryptoKeyElementReadAccess=RA_DENIED, CryptoKeyElementWriteAccess=WA_DENIED
        Crypto_30_LibCv_vHsm_SecureBootSegment_APPL_1_CMAC_Sync: CryptoKeyElementAllowPartialAccess=TRUE, CryptoKeyElementPersist=TRUE, CryptoKeyElementId=3026, CryptoKeyElementSize=16, CryptoKeyElementReadAccess=RA_DENIED, CryptoKeyElementWriteAccess=WA_DENIED
        Crypto_30_LibCv_vHsm_SecureBoot_Key_Sync: CryptoKeyElementAllowPartialAccess=FALSE, CryptoKeyElementPersist=TRUE, CryptoKeyElementId=1, CryptoKeyElementSize=16, CryptoKeyElementReadAccess=RA_DENIED, CryptoKeyElementWriteAccess=WA_DENIED
        Crypto_30_LibCv_vHsm_SecureBootSegment_FBL_0_Sanction_Sync: CryptoKeyElementAllowPartialAccess=FALSE, CryptoKeyElementPersist=TRUE, CryptoKeyElementId=3027, CryptoKeyElementSize=1, CryptoKeyElementReadAccess=RA_DENIED, CryptoKeyElementWriteAccess=WA_DENIED
        Crypto_30_LibCv_vHsm_SecureBootSegment_FBL_0_Mode_Sync: CryptoKeyElementAllowPartialAccess=FALSE, CryptoKeyElementPersist=TRUE, CryptoKeyElementId=3039, CryptoKeyElementSize=1, CryptoKeyElementReadAccess=RA_DENIED, CryptoKeyElementWriteAccess=WA_DENIED
        Crypto_30_LibCv_vHsm_SecureBootSegment_FBL_0_Address_Sync: CryptoKeyElementAllowPartialAccess=FALSE, CryptoKeyElementPersist=TRUE, CryptoKeyElementId=3024, CryptoKeyElementSize=4, CryptoKeyElementReadAccess=RA_DENIED, CryptoKeyElementWriteAccess=WA_DENIED
        Crypto_30_LibCv_vHsm_SecureBootSegment_FBL_0_Length_Sync: CryptoKeyElementAllowPartialAccess=FALSE, CryptoKeyElementPersist=TRUE, CryptoKeyElementId=3025, CryptoKeyElementSize=4, CryptoKeyElementReadAccess=RA_DENIED, CryptoKeyElementWriteAccess=WA_DENIED
        Crypto_30_LibCv_vHsm_SecureBootSegment_FBL_0_CMAC_Sync: CryptoKeyElementAllowPartialAccess=TRUE, CryptoKeyElementPersist=TRUE, CryptoKeyElementId=3026, CryptoKeyElementSize=16, CryptoKeyElementReadAccess=RA_DENIED, CryptoKeyElementWriteAccess=WA_DENIED
        Crypto_30_LibCv_vHsm_SecureBoot_Result_Sync: CryptoKeyElementAllowPartialAccess=FALSE, CryptoKeyElementPersist=FALSE, CryptoKeyElementId=3037, CryptoKeyElementSize=1, CryptoKeyElementReadAccess=RA_ALLOWED, CryptoKeyElementWriteAccess=WA_DENIED
        Crypto_30_LibCv_Signature_Key_Sync: CryptoKeyElementAllowPartialAccess=FALSE, CryptoKeyElementPersist=FALSE, CryptoKeyElementId=1, CryptoKeyElementSize=32, CryptoKeyElementReadAccess=RA_ALLOWED, CryptoKeyElementWriteAccess=WA_ALLOWED
        Crypto_30_LibCv_Cipher_Key_Sync: CryptoKeyElementAllowPartialAccess=FALSE, CryptoKeyElementPersist=FALSE, CryptoKeyElementId=1, CryptoKeyElementSize=16, CryptoKeyElementReadAccess=RA_ALLOWED, CryptoKeyElementWriteAccess=WA_ALLOWED
        Crypto_30_LibCv_Cipher_IV_Sync: CryptoKeyElementAllowPartialAccess=FALSE, CryptoKeyElementPersist=FALSE, CryptoKeyElementId=5, CryptoKeyElementSize=16, CryptoKeyElementReadAccess=RA_ALLOWED, CryptoKeyElementWriteAccess=WA_ALLOWED
        Crypto_30_LibCv_Cipher_Proof_Sync: CryptoKeyElementAllowPartialAccess=FALSE, CryptoKeyElementPersist=FALSE, CryptoKeyElementId=6, CryptoKeyElementSize=48, CryptoKeyElementReadAccess=RA_ALLOWED, CryptoKeyElementWriteAccess=WA_ALLOWED
        Crypto_30_LibCv_Random_Algorithm_Fips186_Sync: CryptoKeyElementAllowPartialAccess=FALSE, CryptoKeyElementPersist=FALSE, CryptoKeyElementId=4, CryptoKeyElementSize=1, CryptoKeyElementReadAccess=RA_ALLOWED, CryptoKeyElementWriteAccess=WA_ALLOWED
        Crypto_30_LibCv_Random_Seed_Sync: CryptoKeyElementAllowPartialAccess=FALSE, CryptoKeyElementPersist=FALSE, CryptoKeyElementId=3, CryptoKeyElementSize=20, CryptoKeyElementReadAccess=RA_ALLOWED, CryptoKeyElementWriteAccess=WA_ALLOWED
        Crypto_30_LibCv_Random_Data_Sync: CryptoKeyElementAllowPartialAccess=FALSE, CryptoKeyElementPersist=FALSE, CryptoKeyElementId=1, CryptoKeyElementSize=20, CryptoKeyElementReadAccess=RA_ALLOWED, CryptoKeyElementWriteAccess=WA_ALLOWED
        Crypto_30_LibCv_vHsm_LazyPersistKey_Sync: CryptoKeyElementAllowPartialAccess=FALSE, CryptoKeyElementPersist=TRUE, CryptoKeyElementId=1, CryptoKeyElementSize=16, CryptoKeyElementReadAccess=RA_ALLOWED, CryptoKeyElementWriteAccess=WA_ALLOWED
        Crypto_30_LibCv_Mac_Key_Sync: CryptoKeyElementAllowPartialAccess=FALSE, CryptoKeyElementPersist=FALSE, CryptoKeyElementId=1, CryptoKeyElementSize=16, CryptoKeyElementReadAccess=RA_ALLOWED, CryptoKeyElementWriteAccess=WA_ALLOWED
        Crypto_30_LibCv_Mac_Proof_Sync: CryptoKeyElementAllowPartialAccess=FALSE, CryptoKeyElementPersist=FALSE, CryptoKeyElementId=2, CryptoKeyElementSize=48, CryptoKeyElementReadAccess=RA_ALLOWED, CryptoKeyElementWriteAccess=WA_ALLOWED
        Crypto_30_LibCv_Mac_Key_She_Sync: CryptoKeyElementAllowPartialAccess=FALSE, CryptoKeyElementPersist=TRUE, CryptoKeyElementId=1, CryptoKeyElementSize=16, CryptoKeyElementReadAccess=RA_DENIED, CryptoKeyElementWriteAccess=WA_ENCRYPTED
        Crypto_30_LibCv_She_Counter_Sync: CryptoKeyElementAllowPartialAccess=FALSE, CryptoKeyElementPersist=FALSE, CryptoKeyElementId=3019, CryptoKeyElementSize=4, CryptoKeyElementReadAccess=RA_ALLOWED, CryptoKeyElementWriteAccess=WA_DENIED
        Crypto_30_LibCv_Cipher_Key_She_Sync: CryptoKeyElementAllowPartialAccess=FALSE, CryptoKeyElementPersist=TRUE, CryptoKeyElementId=1, CryptoKeyElementSize=16, CryptoKeyElementReadAccess=RA_DENIED, CryptoKeyElementWriteAccess=WA_ENCRYPTED
        Crypto_30_LibCv_She_UId_Sync: CryptoKeyElementAllowPartialAccess=FALSE, CryptoKeyElementPersist=FALSE, CryptoKeyElementId=3021, CryptoKeyElementSize=15, CryptoKeyElementReadAccess=RA_ALLOWED, CryptoKeyElementWriteAccess=WA_DENIED
        Crypto_30_LibCv_She_BootProtection_Sync: CryptoKeyElementAllowPartialAccess=FALSE, CryptoKeyElementPersist=FALSE, CryptoKeyElementId=3056, CryptoKeyElementSize=1, CryptoKeyElementReadAccess=RA_ALLOWED, CryptoKeyElementWriteAccess=WA_ALLOWED
        Crypto_30_LibCv_She_DebuggerProtection_Sync: CryptoKeyElementAllowPartialAccess=FALSE, CryptoKeyElementPersist=FALSE, CryptoKeyElementId=3057, CryptoKeyElementSize=1, CryptoKeyElementReadAccess=RA_ALLOWED, CryptoKeyElementWriteAccess=WA_ALLOWED
        vHsm_Core_vHsmInfo_Version_Sync: CryptoKeyElementAllowPartialAccess=FALSE, CryptoKeyElementPersist=FALSE, CryptoKeyElementId=3020, CryptoKeyElementSize=3, CryptoKeyElementReadAccess=RA_ALLOWED, CryptoKeyElementWriteAccess=WA_DENIED
        vHsm_Core_vHsmInfo_PerformPersist_Sync: CryptoKeyElementAllowPartialAccess=FALSE, CryptoKeyElementPersist=FALSE, CryptoKeyElementId=3022, CryptoKeyElementSize=1, CryptoKeyElementReadAccess=RA_ALLOWED, CryptoKeyElementWriteAccess=WA_DENIED
        vHsm_Core_vHsmInfo_PerformRepersist_Sync: CryptoKeyElementAllowPartialAccess=FALSE, CryptoKeyElementPersist=FALSE, CryptoKeyElementId=3036, CryptoKeyElementSize=1, CryptoKeyElementReadAccess=RA_DENIED, CryptoKeyElementWriteAccess=WA_ALLOWED
        vHsm_Core_vHsmInfo_StartFirmwareUpdater_Sync: CryptoKeyElementAllowPartialAccess=FALSE, CryptoKeyElementPersist=FALSE, CryptoKeyElementId=3038, CryptoKeyElementSize=1, CryptoKeyElementReadAccess=RA_DENIED, CryptoKeyElementWriteAccess=WA_ALLOWED
        vHsm_Core_vHsmInfo_SecureBootEnd_Sync: CryptoKeyElementAllowPartialAccess=FALSE, CryptoKeyElementPersist=FALSE, CryptoKeyElementId=3028, CryptoKeyElementSize=1, CryptoKeyElementReadAccess=RA_ALLOWED, CryptoKeyElementWriteAccess=WA_ALLOWED
        vHsm_Core_vHsmInfo_SecureBootResult_Sync: CryptoKeyElementAllowPartialAccess=FALSE, CryptoKeyElementPersist=FALSE, CryptoKeyElementId=3037, CryptoKeyElementSize=1, CryptoKeyElementReadAccess=RA_ALLOWED, CryptoKeyElementWriteAccess=WA_DENIED
        vHsm_Core_vHsmSecureBootInfo_GroupState_Sync: CryptoKeyElementAllowPartialAccess=FALSE, CryptoKeyElementPersist=FALSE, CryptoKeyElementId=0, CryptoKeyElementSize=2, CryptoKeyElementReadAccess=RA_ALLOWED, CryptoKeyElementWriteAccess=WA_DENIED
        Crypto_30_LibCv_KeyM_CertificateData_Sync: CryptoKeyElementAllowPartialAccess=FALSE, CryptoKeyElementPersist=FALSE, CryptoKeyElementId=0, CryptoKeyElementSize=1500, CryptoKeyElementReadAccess=RA_ALLOWED, CryptoKeyElementWriteAccess=WA_ALLOWED
        vHsm_Hal_RomKey_Sync: CryptoKeyElementAllowPartialAccess=FALSE, CryptoKeyElementPersist=FALSE, CryptoKeyElementId=1, CryptoKeyElementSize=16, CryptoKeyElementReadAccess=RA_DENIED, CryptoKeyElementWriteAccess=WA_DENIED
    CryptoDriverObjects
      5 x CryptoDriverObject, all with CryptoDriverObjectQueueSize=1:
        Crypto_30_vHsm_Core: CryptoDriverObjectId=0, CryptoPrimitiveRef=vHsm_Core_vHsmSecureBoot, CryptoPrimitiveRef=vHsm_Core_vHsmFirmwareUpdate, CryptoPrimitiveRef=vHsm_Core_vHsmSecureBootUpdate, CryptoPrimitiveRef=vHsm_Core_vHsmSecureSoftwareDownload
        Crypto_30_vHsm_Hal: CryptoDriverObjectId=1, CryptoPrimitiveRef=vHsm_Hal_Trng, CryptoPrimitiveRef=vHsm_Hal_AesDecrypt, CryptoPrimitiveRef=vHsm_Hal_AesEncrypt, CryptoPrimitiveRef=vHsm_Hal_AesCmacVerify, CryptoPrimitiveRef=vHsm_Hal_AesCmacGenerate
        Crypto_30_vHsm_LibCv: CryptoDriverObjectId=4, CryptoPrimitiveRef=Crypto_30_LibCv_RngFips186, CryptoPrimitiveRef=Crypto_30_LibCv_SHA256, CryptoPrimitiveRef=Crypto_30_LibCv_EcDsaEd25519Generate, CryptoPrimitiveRef=Crypto_30_LibCv_EcDsaEd25519Verify, CryptoPrimitiveRef=Crypto_30_LibCv_AesDecrypt, CryptoPrimitiveRef=Crypto_30_LibCv_AesEncrypt, CryptoPrimitiveRef=Crypto_30_LibCv_AesCmacGenerate, CryptoPrimitiveRef=Crypto_30_LibCv_AesCmacVerify, CryptoPrimitiveRef=Crypto_30_LibCv_SHA512
        Crypto_30_vHsm_KeyManagement: CryptoDriverObjectId=3, CryptoPrimitiveRef=vHsmUsageForbidden
        Crypto_30_vHsm_LibCv_HighPrio: CryptoDriverObjectId=5, CryptoPrimitiveRef=Crypto_30_LibCv_RngFips186, CryptoPrimitiveRef=Crypto_30_LibCv_SHA256, CryptoPrimitiveRef=Crypto_30_LibCv_EcDsaEd25519Generate, CryptoPrimitiveRef=Crypto_30_LibCv_EcDsaEd25519Verify, CryptoPrimitiveRef=Crypto_30_LibCv_AesDecrypt, CryptoPrimitiveRef=Crypto_30_LibCv_AesEncrypt, CryptoPrimitiveRef=Crypto_30_LibCv_AesCmacGenerate, CryptoPrimitiveRef=Crypto_30_LibCv_AesCmacVerify, CryptoPrimitiveRef=Crypto_30_LibCv_SHA512
    CryptoPrimitives
      19 x CryptoPrimitive, all with CryptoPrimitiveAlgorithmSecondaryFamily=CRYPTO_ALGOFAM_NOT_SET:
        vHsm_Core_vHsmSecureBoot: CryptoPrimitiveService=CRYPTO_MAC_VERIFY, CryptoPrimitiveAlgorithmFamily=CRYPTO_ALGOFAM_CUSTOM_VHSM_SECURE_BOOT, CryptoPrimitiveAlgorithmMode=CRYPTO_ALGOMODE_CMAC, CryptoPrimitiveAlgorithmMode=CRYPTO_ALGOMODE_NOT_SET, CryptoPrimitiveAlgorithmMode=CRYPTO_ALGOMODE_CUSTOM
        vHsm_Core_vHsmFirmwareUpdate: CryptoPrimitiveService=CRYPTO_AEADENCRYPT, CryptoPrimitiveAlgorithmFamily=CRYPTO_ALGOFAM_CUSTOM_VHSM_FIRMWARE_UPDATE, CryptoPrimitiveAlgorithmMode=CRYPTO_ALGOMODE_GCM, CryptoPrimitiveAlgorithmMode=CRYPTO_ALGOMODE_CUSTOM, CryptoPrimitiveAlgorithmMode=CRYPTO_ALGOMODE_NOT_SET
        vHsm_Core_vHsmSecureBootUpdate: CryptoPrimitiveService=CRYPTO_SIGNATURE_VERIFY, CryptoPrimitiveAlgorithmFamily=CRYPTO_ALGOFAM_CUSTOM, CryptoPrimitiveAlgorithmMode=CRYPTO_ALGOMODE_NOT_SET
        vHsm_Core_vHsmSecureSoftwareDownload: CryptoPrimitiveService=CRYPTO_SIGNATURE_VERIFY, CryptoPrimitiveAlgorithmFamily=CRYPTO_ALGOFAM_CUSTOM_VHSM_SOFTWARE_DOWNLOAD, CryptoPrimitiveAlgorithmMode=CRYPTO_ALGOMODE_NOT_SET
        vHsm_Hal_Trng: CryptoPrimitiveService=CRYPTO_RANDOM, CryptoPrimitiveAlgorithmFamily=CRYPTO_ALGOFAM_RNG, CryptoPrimitiveAlgorithmMode=CRYPTO_ALGOMODE_NOT_SET
        vHsm_Hal_AesDecrypt: CryptoPrimitiveService=CRYPTO_DECRYPT, CryptoPrimitiveAlgorithmFamily=CRYPTO_ALGOFAM_AES, CryptoPrimitiveAlgorithmMode=CRYPTO_ALGOMODE_ECB, CryptoPrimitiveAlgorithmMode=CRYPTO_ALGOMODE_CBC, CryptoPrimitiveAlgorithmMode=CRYPTO_ALGOMODE_CTR, CryptoPrimitiveAlgorithmSecondaryFamily=CRYPTO_ALGOFAM_CUSTOM_PADDING_PKCS7
        vHsm_Hal_AesEncrypt: CryptoPrimitiveService=CRYPTO_ENCRYPT, CryptoPrimitiveAlgorithmFamily=CRYPTO_ALGOFAM_AES, CryptoPrimitiveAlgorithmMode=CRYPTO_ALGOMODE_ECB, CryptoPrimitiveAlgorithmMode=CRYPTO_ALGOMODE_CBC, CryptoPrimitiveAlgorithmMode=CRYPTO_ALGOMODE_CTR, CryptoPrimitiveAlgorithmSecondaryFamily=CRYPTO_ALGOFAM_CUSTOM_PADDING_PKCS7
        vHsm_Hal_AesCmacVerify: CryptoPrimitiveService=CRYPTO_MAC_VERIFY, CryptoPrimitiveAlgorithmFamily=CRYPTO_ALGOFAM_AES, CryptoPrimitiveAlgorithmMode=CRYPTO_ALGOMODE_CMAC
        vHsm_Hal_AesCmacGenerate: CryptoPrimitiveService=CRYPTO_MAC_GENERATE, CryptoPrimitiveAlgorithmFamily=CRYPTO_ALGOFAM_AES, CryptoPrimitiveAlgorithmMode=CRYPTO_ALGOMODE_CMAC
        Crypto_30_LibCv_RngFips186: CryptoPrimitiveService=CRYPTO_RANDOM, CryptoPrimitiveAlgorithmFamily=CRYPTO_ALGOFAM_RNG, CryptoPrimitiveAlgorithmMode=CRYPTO_ALGOMODE_NOT_SET
        Crypto_30_LibCv_SHA256: CryptoPrimitiveService=CRYPTO_HASH, CryptoPrimitiveAlgorithmFamily=CRYPTO_ALGOFAM_SHA2_256, CryptoPrimitiveAlgorithmMode=CRYPTO_ALGOMODE_NOT_SET
        Crypto_30_LibCv_EcDsaEd25519Generate: CryptoPrimitiveService=CRYPTO_SIGNATURE_GENERATE, CryptoPrimitiveAlgorithmFamily=CRYPTO_ALGOFAM_ED25519, CryptoPrimitiveAlgorithmMode=CRYPTO_ALGOMODE_NOT_SET, CryptoPrimitiveAlgorithmSecondaryFamily=CRYPTO_ALGOFAM_SHA2_512
        Crypto_30_LibCv_EcDsaEd25519Verify: CryptoPrimitiveService=CRYPTO_SIGNATURE_VERIFY, CryptoPrimitiveAlgorithmFamily=CRYPTO_ALGOFAM_ED25519, CryptoPrimitiveAlgorithmMode=CRYPTO_ALGOMODE_NOT_SET, CryptoPrimitiveAlgorithmSecondaryFamily=CRYPTO_ALGOFAM_SHA2_512
        Crypto_30_LibCv_AesDecrypt: CryptoPrimitiveService=CRYPTO_DECRYPT, CryptoPrimitiveAlgorithmFamily=CRYPTO_ALGOFAM_AES, CryptoPrimitiveAlgorithmMode=CRYPTO_ALGOMODE_ECB, CryptoPrimitiveAlgorithmMode=CRYPTO_ALGOMODE_CBC, CryptoPrimitiveAlgorithmSecondaryFamily=CRYPTO_ALGOFAM_CUSTOM_PADDING_PKCS7, CryptoPrimitiveAlgorithmSecondaryFamily=CRYPTO_ALGOFAM_CUSTOM
        Crypto_30_LibCv_AesEncrypt: CryptoPrimitiveService=CRYPTO_ENCRYPT, CryptoPrimitiveAlgorithmFamily=CRYPTO_ALGOFAM_AES, CryptoPrimitiveAlgorithmMode=CRYPTO_ALGOMODE_ECB, CryptoPrimitiveAlgorithmMode=CRYPTO_ALGOMODE_CBC, CryptoPrimitiveAlgorithmSecondaryFamily=CRYPTO_ALGOFAM_CUSTOM_PADDING_PKCS7, CryptoPrimitiveAlgorithmSecondaryFamily=CRYPTO_ALGOFAM_CUSTOM
        Crypto_30_LibCv_AesCmacGenerate: CryptoPrimitiveService=CRYPTO_MAC_GENERATE, CryptoPrimitiveAlgorithmFamily=CRYPTO_ALGOFAM_AES, CryptoPrimitiveAlgorithmMode=CRYPTO_ALGOMODE_CMAC
        Crypto_30_LibCv_AesCmacVerify: CryptoPrimitiveService=CRYPTO_MAC_VERIFY, CryptoPrimitiveAlgorithmFamily=CRYPTO_ALGOFAM_AES, CryptoPrimitiveAlgorithmMode=CRYPTO_ALGOMODE_CMAC
        Crypto_30_LibCv_SHA512: CryptoPrimitiveService=CRYPTO_HASH, CryptoPrimitiveAlgorithmFamily=CRYPTO_ALGOFAM_SHA2_512, CryptoPrimitiveAlgorithmMode=CRYPTO_ALGOMODE_NOT_SET
        vHsmUsageForbidden: CryptoPrimitiveService=CRYPTO_RANDOM, CryptoPrimitiveAlgorithmFamily=CRYPTO_ALGOFAM_NOT_SET, CryptoPrimitiveAlgorithmMode=CRYPTO_ALGOMODE_NOT_SET
    CryptovHsm: CryptoIpcChannels=2, CryptoIpcProtocolVersion=2, CryptoManagementDriverObject=Crypto_30_vHsm_KeyManagement
