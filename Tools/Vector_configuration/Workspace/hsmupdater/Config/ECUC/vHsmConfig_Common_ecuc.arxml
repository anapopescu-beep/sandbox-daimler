AUTOSAR XML (schema 4-3-0)
package /ActiveEcuC
  module config EcuC: implementation-config-variant=VARIANT-PRE-COMPILE, module-description=EcuC_Impl
    EcucGeneral:
      DummyFunction = false
      DummyStatement = true
      StructAlignment = Auto
      ArrayAlignment = Auto
      StructInArrayAlignment = Auto
      SizeOfEnum = Size32Bit
      SizeOfROMPointer = Size32Bit
      SizeOfRAMPointer = Size32Bit
      DummyStatementKind = VoidCast
      CPUType = CPU32Bit
      SizeOfInt = Size32Bit
      ByteOrder = LITTLE_ENDIAN
      BitOrder = LSB_to_MSB
      AtomicBitAccessInBitfield = false
      AtomicVariableAccess = Atomic32BitAccess
      BitFieldDataType = INT
      ConditionalGenerating = true
      EcucBswImplementationCodeType = EcuCSourceCode
      EcuCUseStdReturnTypeForRte = false
      BswInitialization
        7 x InitFunction:
          Brs_Init: Header=, InitPhase=NO_INIT, ModuleRef=vBRS  # /ActiveEcuC/vBRS PLAIN_TEXT Automatically generated by EcuCBswInitFctConfigurationService.
          vBaseEnv_Init: Header=, InitPhase=NO_INIT, ModuleRef=vBaseEnv  # /ActiveEcuC/vBaseEnv PLAIN_TEXT Created vBaseEnv_Init by Extended Init XML Service
          vMem_30_Tc3xxInf01_Init: Header=vMem_30_Tc3xxInf01.h, InitPhase=INIT_TWO_MCAL, ConfigType=vMem_30_Tc3xxInf01_ConfigType, ConfigPtrName=vMem_30_Tc3xxInf01_Config_Ptr, ConfigPtrClass=VMEM_30_TC3XXINF01_INIT_DATA, ModuleRef=vMem
          vMem_30_Tc3xxInf01_InitMemory: Header=vMem_30_Tc3xxInf01.h, InitPhase=INIT_MEMORY, ModuleRef=vMem
          vMemAccM_Init: Header=vMemAccM.h, InitPhase=INIT_TWO_DRV, ModuleRef=vMemAccM
          vMemAccM_InitMemory: Header=vMemAccM.h, InitPhase=INIT_MEMORY, ModuleRef=vMemAccM
          vLinkGen_Init: Header=vLinkGen_Lcfg.h, InitPhase=NO_INIT, ModuleRef=vLinkGen  # /ActiveEcuC/vLinkGen PLAIN_TEXT Dummy initialization of the vLinkGen
    EcucPduCollection: PduIdTypeEnum=UINT8, PduLengthTypeEnum=UINT8
    EcucHardware
      EcucCoreDefinition: EcucCoreId=0
  module config vSet: implementation-config-variant=VARIANT-PRE-COMPILE, module-description=vSet_Impl
    vSetGeneral: vSetDummyStatementKind=VoidCast
    vSetPlatform:
      vSetSizeOfInt = Size32Bit
      vSetSizeOfROMPointer = Size32Bit
      vSetCPUType = CPU32Bit
      vSetSizeOfRAMPointer = Size32Bit
      vSetBitOrder = LSB_to_MSB
      vSetByteOrder = LITTLE_ENDIAN
      vSetSizeOfEnum = Size32Bit
    vSetCalibration
  module config Crc: implementation-config-variant=VARIANT-PRE-COMPILE, module-description=Crc_Impl
    CrcGeneral:
      Crc16Mode = CRC_16_RUNTIME
      Crc32Mode = CRC_32_RUNTIME
      Crc8H2FMode = CRC_8H2F_RUNTIME
      Crc8Mode = CRC_8_RUNTIME
      CrcVersionInfoApi = false
      Crc32P4Mode = CRC_32P4_RUNTIME
      Crc64Mode = CRC_64_RUNTIME
  module config vSecPrim: implementation-config-variant=VARIANT-PRE-COMPILE, module-description=vSecPrim_Impl
    vSecPrimGeneral:
      vSecPrimClearWorkspaceEnabled = false
      vSecPrimRSAMaxKeySize = RSA_MAX_KEY_SIZE_2048
      vSecPrimECPMaxKeySize = ECP_MAX_KEY_SIZE_256
      vSecPrimSupportUInt64 = true
      vSecPrimWatchdogLevel = WD_LEVEL_0
      vSecPrimSizeOfEsltLength = SIZE_UINT32
      vSecPrimDrbgReseedInterval = 4294967295
      vSecPrimSPAKE2pMaxAADSize = 16
      vSecPrimSPAKE2pPreambleOKMLength = 64
      vSecPrimCTRDRBGAES128SecurityStrength = SECURITY_STRENGTH_128
      vSecPrimUseVstdLib = true
    vSecPrimBasicAlgorithms
      vSecPrimHash:
        vSecPrimSHA1Enabled = false
        vSecPrimRIPEMD160Enabled = false
        vSecPrimSHA2_256Enabled = false
        vSecPrimSHA2_512Enabled = false
        vSecPrimMD5Enabled = false
        vSecPrimSHA3Enabled = false
      vSecPrimRandomNumberGeneration: vSecPrimFIPS186Enabled=false, vSecPrimHashDrbgEnabled=false, vSecPrimCtrDrbgEnabled=false
    vSecPrimSymmetricAlgorithms
      vSecPrimCipher:
        vSecPrimAes128Enabled = true
        vSecPrimAes192Enabled = false
        vSecPrimAes256Enabled = false
        vSecPrimGcmEnabled = false
        vSecPrimDesEnabled = false
        vSecPrimRC2Enabled = false
        vSecPrimTDesEnabled = false
        vSecPrimAeadChaCha20Poly1305Enabled = false
        vSecPrimChaCha20Enabled = false
        vSecPrimAesCcmEnabled = false
      vSecPrimMac:
        vSecPrimSipHashEnabled = false
        vSecPrimCmacEnabled = true
        vSecPrimHMacSHA1Enabled = false
        vSecPrimHMacRMD160Enabled = false
        vSecPrimHMacSHA2_256Enabled = false
        vSecPrimGMacEnabled = false
        vSecPrimPoly1305Enabled = false
        vSecPrimHMacSHA2_384Enabled = false
    vSecPrimAsymmetricAlgorithms
      vSecPrimSignature:
        vSecPrimRSA_PSS_RIPEMD160Enabled = false
        vSecPrimRSA_PSS_SHA1Enabled = false
        vSecPrimRSA_PSS_SHA2_256Enabled = false
        vSecPrimRSA_V15_RIPEMD160Enabled = false
        vSecPrimRSA_V15_SHA1Enabled = false
        vSecPrimRSA_V15_SHA2_256Enabled = false
        vSecPrimECDSA_25519Enabled = false
        vSecPrimECDSA_GenericEnabled = false
      vSecPrimKeyExchange: vSecPrimECDH_25519Enabled=false, vSecPrimECDH_GenericEnabled=false, vSecPrimECBD_GenericEnabled=false, vSecPrimSPAKE2pEnabled=false
      vSecPrimCipher: vSecPrimRSA_OAEP_SHA1Enabled=false, vSecPrimRSA_OAEP_SHA2_256Enabled=false, vSecPrimRSA_V15Enabled=false
      vSecPrimKeyGeneration: vSecPrimECCEnabled=false
      vSecPrimKeyDerivation:
        vSecPrimPKCS5Enabled = false
        vSecPrimANSI_X963Enabled = false
        vSecPrimANSI_X963_SHA256Enabled = false
        vSecPrimPKCS5HMacSHA256Enabled = false
        vSecPrimANSI_X963_SHA512Enabled = false
        vSecPrimHKDF_HMAC_SHA256Enabled = false
    vSecPrimOptimization:
      vSecPrimAesSpeedUp = SPEED_UP_LEVEL_1
      vSecPrimSha1SpeedUp = SPEED_UP_LEVEL_0
      vSecPrimSha256SpeedUp = SPEED_UP_LEVEL_0
      vSecPrimSha512SpeedUp = SPEED_UP_LEVEL_0
      vSecPrimChaCha20SpeedUp = SPEED_UP_LEVEL_0
