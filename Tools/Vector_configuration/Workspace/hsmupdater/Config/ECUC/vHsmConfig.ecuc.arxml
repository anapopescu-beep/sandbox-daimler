AUTOSAR XML (schema 4-3-0)
package /ActiveEcuC
  ecuc value collection ActiveEcuC: ecu-extract=SYSTEM
    ecuc-values:
      EcuC
      Crc
      vSet
      vSecPrim
      VKMS_Core
      VKMS
      vMem
      vMemAccM
      Rte
      Os
      vLinkGen
      vBRS
      vBaseEnv
      KeyM
      Crypto_30_KeyM
      Crypto_30_Harman
      Resource
      vMem
      vHsmUpd
      vMemAccM
      vHsmUpd_Ext
      MemMap
      Os
