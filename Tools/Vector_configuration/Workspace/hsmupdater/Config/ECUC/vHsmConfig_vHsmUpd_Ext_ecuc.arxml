AUTOSAR XML (schema 4-3-0)
package /ActiveEcuC
  module config vHsmUpd_Ext: implementation-config-variant=VARIANT-PRE-COMPILE, module-description=vHsmUpd_Ext_Impl
    vHsmUpd_ExtGeneral:
      vHsmUpd_ExtRetryCounter = 0
      vHsmUpd_ExtEnableUserCompareMechanism = true
      vHsmUpd_ExtDecryptionRamBufferSize = 256
      vHsmUpd_ExtFwStart = vHsmUpd_FirmwareStart
      vHsmUpd_ExtPlatformPagesize = 32
      vHsmUpd_ExtCodeflashLayout
        Partition_MainActive (vHsmUpd_ExtPartitions): vHsmUpd_ExtPartitionId=0, vHsmUpd_ExtPartitionTypeRef=vHsmUpd_ExtMainActive, vHsmUpd_ExtAddressAreaRef=vMemAccMAddressAreaConfiguration
        vHsmUpd_ExtPartitionGroup: vHsmUpd_ExtPartitionRef=Partition_MainActive
        vHsmUpd_ExtModule_vHsmFw (vHsmUpd_ExtModules): vHsmUpd_ExtModuleId=0, vHsmUpd_ExtPartitionGroupRef=vHsmUpd_ExtPartitionGroup, vHsmUpd_ExtModuleTypeRef=vHsmUpd_ExtvHsmFirmware
        vHsmUpd_ExtRegion_vHsmFw (vHsmUpd_ExtRegion): vHsmUpd_ExtRegionId=0, vHsmUpd_ExtStartAddress=2147516416, vHsmUpd_ExtLength=180224, vHsmUpd_ExtModuleRef=vHsmUpd_ExtModule_vHsmFw
      vHsmUpd_ExtTypes
        vHsmUpd_ExtvHsmFirmware (vHsmUpd_ExtModuleType): vHsmUpd_ExtModuleTypeId=0
        vHsmUpd_ExtMainActive (vHsmUpd_ExtPartitionType): vHsmUpd_ExtPartitonTypeId=0
        vHsmUpd_ExtvHsmUpd (vHsmUpd_ExtModuleType): vHsmUpd_ExtModuleTypeId=1
        vHsmUpd_ExtAlternativeActive (vHsmUpd_ExtPartitionType): vHsmUpd_ExtPartitonTypeId=1
      vHsmUpd_ExtUpdateHeader
        vHsmUpd_ExtUpdateHeaderFixAddress: vHsmUpd_ExtHeaderLocation_A=2148351680, vHsmUpd_ExtHeaderLocation_B=2148351680
      vHsmUpd_ExtIpc: vHsmUpd_ExtIpcHsmToHost=4026794036, vHsmUpd_ExtIpcHostToHsm=4026794040, vHsmUpd_ExtIpcWaitMask=2147483648
