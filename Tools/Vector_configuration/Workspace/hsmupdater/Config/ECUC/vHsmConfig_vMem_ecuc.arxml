AUTOSAR XML (schema 4-3-0)
package /ActiveEcuC
  module config vMem: implementation-config-variant=VARIANT-PRE-COMPILE, module-description=vMem_Impl
    vMemInstance: vMemInstanceId=0
      vMemSectorList
        PF0_PF2_PS0_S0_S63 (vMemSector): vMemNumberOfSectors=11, vMemPageSize=32, vMemSectorSize=16384, vMemStartAddress=2147516416, vMemProgramFlashId=0, vMemPhysicalSectorId=0
          vMemBurstSettings: vMemEraseBurstSize=524288, vMemPageBurstRamAlignment=1, vMemWriteBurstSize=256
    vMemGeneral: vMemDevErrorDetect=false, vMemSafeBswChecks=false, vMemVersionInfoApi=false, vMemMainFunctionPeriod=0.005, vMemUsePeripheralAccessApi=false
