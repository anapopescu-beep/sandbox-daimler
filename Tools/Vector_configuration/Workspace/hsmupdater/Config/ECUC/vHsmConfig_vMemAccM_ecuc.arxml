AUTOSAR XML (schema 4-3-0)
package /ActiveEcuC
  module config vMemAccM: implementation-config-variant=VARIANT-PRE-COMPILE, module-description=vMemAccM_Impl
    vMemAccMGeneral:
      vMemAccMVersionInfoApi = false
      vMemAccMMainFunctionPeriod = 0.005
      vMemAccMMainFunctionTriggering = FixedCycleTime
      vMemAccMSafeBswChecks = false
      vMemAccMDevErrorDetect = false
      vMemAccMCompareApi = false
    vMemAccMAddressAreaConfiguration: vMemAccMAddressAreaId=0, vMemAccMAddressAreaPriority=0, vMemAccMReadRequestLength=64
      vMemAccMSubAddressAreaConfiguration:
        vMemAccMNumberOfSectors = 11
        vMemAccMVirtualStartAddress = 2147516416
        vMemAccMPhysicalStartAddress = 2147516416
        vMemAccMvMemFuncPtrTableSymbol = vMem_30_Tc3xxInf01_FunctionPointerTable
        vMemAccMUseEraseBurst = false
        vMemAccMUseWriteBurst = false
        vMemAccMSectorRef = PF0_PF2_PS0_S0_S63
