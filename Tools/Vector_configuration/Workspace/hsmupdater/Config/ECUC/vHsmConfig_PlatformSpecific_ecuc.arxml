AUTOSAR XML (schema 4-3-0)
package /ActiveEcuC
  module config vLinkGen: implementation-config-variant=VARIANT-PRE-COMPILE, module-description=vLinkGen_Impl
    vLinkGenMemLayout
      vLinkGenLinkerSections
        7 x vLinkGenLinkerCodeSection, all with vLinkGenLinkerCodeSectionFast=false, vLinkGenLinkerCodeSectionModule=Os:
          OS_CODE: vLinkGenLinkerCodeSectionName=OS_CODE, vLinkGenLinkerCodeSectionAlignment=0
          OS_OS_COREINITHOOK_CODE: vLinkGenLinkerCodeSectionName=OS_OS_COREINITHOOK_CODE, vLinkGenLinkerCodeSectionAlignment=0
          OS_INTVEC_CODE: vLinkGenLinkerCodeSectionName=OS_INTVEC_CODE, vLinkGenLinkerCodeSectionAlignment=2048
          OS_EXCVEC_CORE0_CODE: vLinkGenLinkerCodeSectionName=OS_EXCVEC_CORE0_CODE, vLinkGenLinkerCodeSectionAlignment=0
          OS_INTVEC_CORE0_CODE: vLinkGenLinkerCodeSectionName=OS_INTVEC_CORE0_CODE, vLinkGenLinkerCodeSectionAlignment=2048
          OS_ERRORHOOK_CODE: vLinkGenLinkerCodeSectionName=OS_ERRORHOOK_CODE, vLinkGenLinkerCodeSectionAlignment=0
          OS_vHsm_Hal_ExternalRequestIsr_CODE: vLinkGenLinkerCodeSectionName=OS_vHsm_Hal_ExternalRequestIsr_CODE, vLinkGenLinkerCodeSectionAlignment=0
        7 x vLinkGenLinkerConstSection, all with vLinkGenLinkerConstSectionFast=false, vLinkGenLinkerConstSectionModule=Os:
          OS_CONST: vLinkGenLinkerConstSectionName=OS_CONST, vLinkGenLinkerConstSectionAlignment=0
          OS_INTVEC_CONST: vLinkGenLinkerConstSectionName=OS_INTVEC_CONST, vLinkGenLinkerConstSectionAlignment=0
          OS_GLOBALSHARED_CONST: vLinkGenLinkerConstSectionName=OS_GLOBALSHARED_CONST, vLinkGenLinkerConstSectionAlignment=0
          OS_CORE0_CONST: vLinkGenLinkerConstSectionName=OS_CORE0_CONST, vLinkGenLinkerConstSectionAlignment=0
          OS_EXCVEC_CORE0_CONST: vLinkGenLinkerConstSectionName=OS_EXCVEC_CORE0_CONST, vLinkGenLinkerConstSectionAlignment=0
          OS_INTVEC_CORE0_CONST: vLinkGenLinkerConstSectionName=OS_INTVEC_CORE0_CONST, vLinkGenLinkerConstSectionAlignment=2048
          OS_SystemApplication_OsCore0_CONST: vLinkGenLinkerConstSectionName=OS_SystemApplication_OsCore0_CONST, vLinkGenLinkerConstSectionAlignment=0
        4 x vLinkGenLinkerStackSection, all with vLinkGenLinkerStackSectionAlignment=0, vLinkGenLinkerStackSectionModule=Os:
          OS_STACK_OSCORE0_KERNEL_VAR_NOINIT: vLinkGenLinkerStackSectionName=OS_STACK_OSCORE0_KERNEL_VAR_NOINIT
          OS_STACK_OSCORE0_INIT_VAR_NOINIT: vLinkGenLinkerStackSectionName=OS_STACK_OSCORE0_INIT_VAR_NOINIT
          OS_STACK_OSCORE0_ERROR_VAR_NOINIT: vLinkGenLinkerStackSectionName=OS_STACK_OSCORE0_ERROR_VAR_NOINIT
          OS_STACK_OSCORE0_ISR_CORE_VAR_NOINIT: vLinkGenLinkerStackSectionName=OS_STACK_OSCORE0_ISR_CORE_VAR_NOINIT
        25 x vLinkGenLinkerVarSection, all with vLinkGenLinkerVarSectionFast=false, vLinkGenLinkerVarSectionAlignment=0, vLinkGenLinkerVarSectionModule=Os:
          OS_VAR_NOCACHE: vLinkGenLinkerVarSectionName=OS_VAR_NOCACHE
          OS_VAR_NOCACHE_NOINIT: vLinkGenLinkerVarSectionName=OS_VAR_NOCACHE_NOINIT
          OS_GLOBALSHARED_VAR_NOINIT: vLinkGenLinkerVarSectionName=OS_GLOBALSHARED_VAR_NOINIT
          OS_GLOBALSHARED_VAR: vLinkGenLinkerVarSectionName=OS_GLOBALSHARED_VAR
          OS_GLOBALSHARED_VAR_ZERO_INIT: vLinkGenLinkerVarSectionName=OS_GLOBALSHARED_VAR_ZERO_INIT
          OS_GLOBALSHARED_VAR_NOCACHE_NOINIT: vLinkGenLinkerVarSectionName=OS_GLOBALSHARED_VAR_NOCACHE_NOINIT
          OS_GLOBALSHARED_VAR_NOCACHE: vLinkGenLinkerVarSectionName=OS_GLOBALSHARED_VAR_NOCACHE
          OS_GLOBALSHARED_VAR_NOCACHE_ZERO_INIT: vLinkGenLinkerVarSectionName=OS_GLOBALSHARED_VAR_NOCACHE_ZERO_INIT
          OS_GLOBALSHARED_VAR_ZERO_INIT_bss: vLinkGenLinkerVarSectionName=OS_GLOBALSHARED_VAR_ZERO_INIT_bss
          OS_GLOBALSHARED_VAR_NOCACHE_ZERO_INIT_bss: vLinkGenLinkerVarSectionName=OS_GLOBALSHARED_VAR_NOCACHE_ZERO_INIT_bss
          OS_CORESTATUS_CORE0_VAR_NOCACHE_NOINIT: vLinkGenLinkerVarSectionName=OS_CORESTATUS_CORE0_VAR_NOCACHE_NOINIT
          OS_CORE0_VAR: vLinkGenLinkerVarSectionName=OS_CORE0_VAR
          OS_CORE0_VAR_NOCACHE: vLinkGenLinkerVarSectionName=OS_CORE0_VAR_NOCACHE
          OS_CORE0_VAR_NOINIT: vLinkGenLinkerVarSectionName=OS_CORE0_VAR_NOINIT
          OS_CORE0_VAR_NOCACHE_NOINIT: vLinkGenLinkerVarSectionName=OS_CORE0_VAR_NOCACHE_NOINIT
          OS_PUBLIC_CORE0_VAR_NOINIT: vLinkGenLinkerVarSectionName=OS_PUBLIC_CORE0_VAR_NOINIT
          OS_BARRIER_CORE0_VAR_NOCACHE_NOINIT: vLinkGenLinkerVarSectionName=OS_BARRIER_CORE0_VAR_NOCACHE_NOINIT
          OS_SystemApplication_OsCore0_VAR_NOINIT: vLinkGenLinkerVarSectionName=OS_SystemApplication_OsCore0_VAR_NOINIT
          OS_SystemApplication_OsCore0_VAR: vLinkGenLinkerVarSectionName=OS_SystemApplication_OsCore0_VAR
          OS_SystemApplication_OsCore0_VAR_ZERO_INIT: vLinkGenLinkerVarSectionName=OS_SystemApplication_OsCore0_VAR_ZERO_INIT
          OS_SystemApplication_OsCore0_VAR_NOCACHE_NOINIT: vLinkGenLinkerVarSectionName=OS_SystemApplication_OsCore0_VAR_NOCACHE_NOINIT
          OS_SystemApplication_OsCore0_VAR_NOCACHE: vLinkGenLinkerVarSectionName=OS_SystemApplication_OsCore0_VAR_NOCACHE
          OS_SystemApplication_OsCore0_VAR_NOCACHE_ZERO_INIT: vLinkGenLinkerVarSectionName=OS_SystemApplication_OsCore0_VAR_NOCACHE_ZERO_INIT
          OS_SystemApplication_OsCore0_VAR_ZERO_INIT_bss: vLinkGenLinkerVarSectionName=OS_SystemApplication_OsCore0_VAR_ZERO_INIT_bss
          OS_SystemApplication_OsCore0_VAR_NOCACHE_ZERO_INIT_bss: vLinkGenLinkerVarSectionName=OS_SystemApplication_OsCore0_VAR_NOCACHE_ZERO_INIT_bss
        brsStartup (vLinkGenLinkerCodeSection): vLinkGenLinkerCodeSectionName=brsStartup, vLinkGenLinkerCodeSectionFast=false, vLinkGenLinkerCodeSectionAlignment=0
        4 x vLinkGenLinkerSpecSection, all with vLinkGenLinkerSpecSectionPad=0, vLinkGenLinkerSpecSectionAlignment=0:
          bss: vLinkGenLinkerSpecSectionValue=[.]bss*
          data: vLinkGenLinkerSpecSectionValue=[.]data*
          rodata: vLinkGenLinkerSpecSectionValue=[.]rodata*
          text: vLinkGenLinkerSpecSectionValue=[.]text*
        vHsmEntryPoint (vLinkGenLinkerCodeSection):
          vLinkGenLinkerCodeSectionName = vHsmEntryPoint
          vLinkGenLinkerCodeSectionAlignment = 0
          vLinkGenLinkerCodeSectionFast = false
          vLinkGenLinkerCodeSectionFlag = vLinkGenConstSectionFlags/KEEP
        vHsmRamCodeCode (vLinkGenLinkerCodeSection): vLinkGenLinkerCodeSectionName=vHsmRamCode, vLinkGenLinkerCodeSectionFast=false, vLinkGenLinkerCodeSectionAlignment=0
        vHsmRamCodeConst (vLinkGenLinkerConstSection): vLinkGenLinkerConstSectionName=vHsmRamCode, vLinkGenLinkerConstSectionFast=false, vLinkGenLinkerConstSectionAlignment=0
        3 x vLinkGenLinkerSpecSection, all with vLinkGenLinkerSpecSectionPad=0, vLinkGenLinkerSpecSectionAlignment=0:
          zbss: vLinkGenLinkerSpecSectionValue=[.]zbss*
          zdata: vLinkGenLinkerSpecSectionValue=[.]zdata*
          zrodata: vLinkGenLinkerSpecSectionValue=[.]zrodata*
      3 x vLinkGenMemoryRegion, all with vLinkGenMemoryRegionAddrOffset=0:
        MemRegion_HSM_FLASH: vLinkGenMemoryRegionSize=243452, vLinkGenMemoryRegionAddress=2147485956, vLinkGenMemoryRegionHwRegion=vBaseEnvGeneral/HSM_FLASH
          RegionBlock_HSM_FLASH (vLinkGenMemoryRegionBlock):
            vLinkGenMemoryRegionBlockAddress = 2147485956
            vLinkGenMemoryRegionBlockPosition = 0
            vLinkGenMemoryRegionBlockSize = 243452
            vLinkGenMemoryRegionBlockBoundary = LOWER
            vLinkGenMemoryRegionBlockInitStage = NONE
        MemRegion_HSM_RAM: vLinkGenMemoryRegionSize=97920, vLinkGenMemoryRegionAddress=536871296, vLinkGenMemoryRegionHwRegion=vBaseEnvGeneral/HSM_RAM
          RegionBlock_HSM_RAM (vLinkGenMemoryRegionBlock):
            vLinkGenMemoryRegionBlockAddress = 536871296
            vLinkGenMemoryRegionBlockPosition = 0
            vLinkGenMemoryRegionBlockSize = 97920
            vLinkGenMemoryRegionBlockBoundary = LOWER
            vLinkGenMemoryRegionBlockInitStage = NONE
        MemRegion_HSM_INTVEC_FLASH: vLinkGenMemoryRegionSize=2052, vLinkGenMemoryRegionAddress=2147483648, vLinkGenMemoryRegionHwRegion=vBaseEnvGeneral/HSM_INTVEC_FLASH
          RegionBlock_HSM_INTVEC_FLASH (vLinkGenMemoryRegionBlock):
            vLinkGenMemoryRegionBlockAddress = 2147483648
            vLinkGenMemoryRegionBlockPosition = 0
            vLinkGenMemoryRegionBlockSize = 2052
            vLinkGenMemoryRegionBlockBoundary = LOWER
            vLinkGenMemoryRegionBlockInitStage = NONE
      10 x vLinkGenLogicalConstGroup, all with vLinkGenConstGroupModule=Os:
        OS_CODE: vLinkGenConstGroupPosition=900, vLinkGenConstGroupRegion=RegionBlock_HSM_FLASH
          OS_CODE (vLinkGenConstSectionGroup):
            vLinkGenConstSectionGroupPosition = 0
            vLinkGenConstSectionGroupInit = NONE
            vLinkGenConstSectionGroupInitStage = ONE
            vLinkGenConstSectionGroupFlag = vLinkGenConstGroupFlags/CONTIGUOUS
            vLinkGenConstSectionGroupFlag = vLinkGenConstGroupFlags/FILL
            vLinkGenConstSectionGroupFlag = vLinkGenConstGroupFlags/EXECUTE
            vLinkGenConstSectionGroupFlag = vLinkGenConstGroupFlags/ORDERED
            vLinkGenConstSectionGroupFlag = vLinkGenConstGroupFlags/READ
            vLinkGenConstSectionGroupRef = vLinkGenLinkerSections/OS_CODE
            vLinkGenConstSectionGroupRef = OS_OS_COREINITHOOK_CODE
        OS_USER_CODE: vLinkGenConstGroupPosition=5, vLinkGenConstGroupRegion=RegionBlock_HSM_FLASH
          OS_USER_CODE (vLinkGenConstSectionGroup):
            vLinkGenConstSectionGroupPosition = 0
            vLinkGenConstSectionGroupInit = NONE
            vLinkGenConstSectionGroupInitStage = ONE
            vLinkGenConstSectionGroupFlag = vLinkGenConstGroupFlags/CONTIGUOUS
            vLinkGenConstSectionGroupFlag = vLinkGenConstGroupFlags/READ
            vLinkGenConstSectionGroupFlag = vLinkGenConstGroupFlags/EXECUTE
            vLinkGenConstSectionGroupFlag = vLinkGenConstGroupFlags/ORDERED
            vLinkGenConstSectionGroupFlag = vLinkGenConstGroupFlags/FILL
            vLinkGenConstSectionGroupRef = OS_vHsm_Hal_ExternalRequestIsr_CODE
            vLinkGenConstSectionGroupRef = OS_ERRORHOOK_CODE
        OS_EXCVEC_CORE0_CODE: vLinkGenConstGroupPosition=5, vLinkGenConstGroupRegion=RegionBlock_HSM_FLASH
          OS_EXCVEC_CORE0_CODE (vLinkGenConstSectionGroup):
            vLinkGenConstSectionGroupPosition = 0
            vLinkGenConstSectionGroupInit = NONE
            vLinkGenConstSectionGroupInitStage = ONE
            vLinkGenConstSectionGroupAlignment = 0
            vLinkGenConstSectionGroupFlag = vLinkGenConstGroupFlags/CONTIGUOUS
            vLinkGenConstSectionGroupFlag = vLinkGenConstGroupFlags/ORDERED
            vLinkGenConstSectionGroupFlag = vLinkGenConstGroupFlags/FILL
            vLinkGenConstSectionGroupFlag = vLinkGenConstGroupFlags/EXECUTE
            vLinkGenConstSectionGroupFlag = vLinkGenConstGroupFlags/READ
            vLinkGenConstSectionGroupRef = vLinkGenLinkerSections/OS_EXCVEC_CORE0_CODE
        OS_INTVEC_CORE0_CODE: vLinkGenConstGroupPosition=5, vLinkGenConstGroupRegion=RegionBlock_HSM_FLASH
          OS_INTVEC_CORE0_CODE (vLinkGenConstSectionGroup):
            vLinkGenConstSectionGroupPosition = 0
            vLinkGenConstSectionGroupInit = NONE
            vLinkGenConstSectionGroupInitStage = ONE
            vLinkGenConstSectionGroupAlignment = 2048
            vLinkGenConstSectionGroupFlag = vLinkGenConstGroupFlags/EXECUTE
            vLinkGenConstSectionGroupFlag = vLinkGenConstGroupFlags/FILL
            vLinkGenConstSectionGroupFlag = vLinkGenConstGroupFlags/ORDERED
            vLinkGenConstSectionGroupFlag = vLinkGenConstGroupFlags/READ
            vLinkGenConstSectionGroupFlag = vLinkGenConstGroupFlags/CONTIGUOUS
            vLinkGenConstSectionGroupRef = vLinkGenLinkerSections/OS_INTVEC_CORE0_CODE
        OS_INTVEC_CODE: vLinkGenConstGroupPosition=5, vLinkGenConstGroupRegion=RegionBlock_HSM_FLASH
          OS_INTVEC_CODE (vLinkGenConstSectionGroup):
            vLinkGenConstSectionGroupPosition = 0
            vLinkGenConstSectionGroupInit = NONE
            vLinkGenConstSectionGroupInitStage = ONE
            vLinkGenConstSectionGroupAlignment = 2048
            vLinkGenConstSectionGroupFlag = vLinkGenConstGroupFlags/FILL
            vLinkGenConstSectionGroupFlag = vLinkGenConstGroupFlags/EXECUTE
            vLinkGenConstSectionGroupFlag = vLinkGenConstGroupFlags/ORDERED
            vLinkGenConstSectionGroupFlag = vLinkGenConstGroupFlags/READ
            vLinkGenConstSectionGroupFlag = vLinkGenConstGroupFlags/CONTIGUOUS
            vLinkGenConstSectionGroupRef = vLinkGenLinkerSections/OS_INTVEC_CODE
        OS_CONST: vLinkGenConstGroupPosition=910, vLinkGenConstGroupRegion=RegionBlock_HSM_FLASH
          OS_CONST (vLinkGenConstSectionGroup):
            vLinkGenConstSectionGroupPosition = 0
            vLinkGenConstSectionGroupInit = NONE
            vLinkGenConstSectionGroupInitStage = ONE
            vLinkGenConstSectionGroupFlag = vLinkGenConstGroupFlags/READ
            vLinkGenConstSectionGroupFlag = vLinkGenConstGroupFlags/EXECUTE
            vLinkGenConstSectionGroupFlag = vLinkGenConstGroupFlags/CONTIGUOUS
            vLinkGenConstSectionGroupFlag = vLinkGenConstGroupFlags/FILL
            vLinkGenConstSectionGroupFlag = vLinkGenConstGroupFlags/ORDERED
            vLinkGenConstSectionGroupRef = vLinkGenLinkerSections/OS_CONST
            vLinkGenConstSectionGroupRef = OS_CORE0_CONST
            vLinkGenConstSectionGroupRef = OS_SystemApplication_OsCore0_CONST
        OS_GLOBALSHARED_CONST: vLinkGenConstGroupPosition=5, vLinkGenConstGroupRegion=RegionBlock_HSM_FLASH
          OS_GLOBALSHARED_CONST (vLinkGenConstSectionGroup):
            vLinkGenConstSectionGroupPosition = 0
            vLinkGenConstSectionGroupInit = NONE
            vLinkGenConstSectionGroupInitStage = ONE
            vLinkGenConstSectionGroupFlag = vLinkGenConstGroupFlags/READ
            vLinkGenConstSectionGroupFlag = vLinkGenConstGroupFlags/CONTIGUOUS
            vLinkGenConstSectionGroupFlag = vLinkGenConstGroupFlags/EXECUTE
            vLinkGenConstSectionGroupFlag = vLinkGenConstGroupFlags/FILL
            vLinkGenConstSectionGroupFlag = vLinkGenConstGroupFlags/ORDERED
            vLinkGenConstSectionGroupRef = vLinkGenLinkerSections/OS_GLOBALSHARED_CONST
        OS_INTVEC_CONST: vLinkGenConstGroupPosition=5, vLinkGenConstGroupRegion=RegionBlock_HSM_FLASH
          OS_INTVEC_CONST (vLinkGenConstSectionGroup):
            vLinkGenConstSectionGroupPosition = 0
            vLinkGenConstSectionGroupInit = NONE
            vLinkGenConstSectionGroupInitStage = ONE
            vLinkGenConstSectionGroupAlignment = 2048
            vLinkGenConstSectionGroupFlag = vLinkGenConstGroupFlags/ORDERED
            vLinkGenConstSectionGroupFlag = vLinkGenConstGroupFlags/CONTIGUOUS
            vLinkGenConstSectionGroupFlag = vLinkGenConstGroupFlags/READ
            vLinkGenConstSectionGroupFlag = vLinkGenConstGroupFlags/EXECUTE
            vLinkGenConstSectionGroupFlag = vLinkGenConstGroupFlags/FILL
            vLinkGenConstSectionGroupRef = vLinkGenLinkerSections/OS_INTVEC_CONST
        OS_EXCVEC_CORE0_CONST: vLinkGenConstGroupPosition=5, vLinkGenConstGroupRegion=RegionBlock_HSM_FLASH
          OS_EXCVEC_CORE0_CONST (vLinkGenConstSectionGroup):
            vLinkGenConstSectionGroupPosition = 0
            vLinkGenConstSectionGroupInit = NONE
            vLinkGenConstSectionGroupInitStage = ONE
            vLinkGenConstSectionGroupAlignment = 0
            vLinkGenConstSectionGroupFlag = vLinkGenConstGroupFlags/EXECUTE
            vLinkGenConstSectionGroupFlag = vLinkGenConstGroupFlags/FILL
            vLinkGenConstSectionGroupFlag = vLinkGenConstGroupFlags/CONTIGUOUS
            vLinkGenConstSectionGroupFlag = vLinkGenConstGroupFlags/ORDERED
            vLinkGenConstSectionGroupFlag = vLinkGenConstGroupFlags/READ
            vLinkGenConstSectionGroupRef = vLinkGenLinkerSections/OS_EXCVEC_CORE0_CONST
        OS_INTVEC_CORE0_CONST: vLinkGenConstGroupPosition=5, vLinkGenConstGroupRegion=RegionBlock_HSM_INTVEC_FLASH
          OS_INTVEC_CORE0_CONST (vLinkGenConstSectionGroup):
            vLinkGenConstSectionGroupPosition = 0
            vLinkGenConstSectionGroupInit = NONE
            vLinkGenConstSectionGroupInitStage = ONE
            vLinkGenConstSectionGroupAlignment = 2048
            vLinkGenConstSectionGroupFlag = vLinkGenConstGroupFlags/CONTIGUOUS
            vLinkGenConstSectionGroupFlag = vLinkGenConstGroupFlags/ORDERED
            vLinkGenConstSectionGroupFlag = vLinkGenConstGroupFlags/FILL
            vLinkGenConstSectionGroupFlag = vLinkGenConstGroupFlags/READ
            vLinkGenConstSectionGroupFlag = vLinkGenConstGroupFlags/EXECUTE
            vLinkGenConstSectionGroupRef = vLinkGenLinkerSections/OS_INTVEC_CORE0_CONST
      4 x vLinkGenLogicalVarGroup, all with vLinkGenVarGroupPosition=5, vLinkGenVarGroupModule=Os, vLinkGenVarGroupRegion=RegionBlock_HSM_RAM:
        OS_STACKS_CORE0_VAR
          OS_STACKS_CORE0_VAR_NOINIT (vLinkGenVarSectionGroup):
            vLinkGenVarSectionGroupPosition = 0
            vLinkGenVarSectionGroupInit = NONE
            vLinkGenVarSectionGroupInitStage = ONE
            vLinkGenVarSectionGroupFlag = vLinkGenVarGroupFlags/READ
            vLinkGenVarSectionGroupFlag = vLinkGenVarGroupFlags/ORDERED
            vLinkGenVarSectionGroupFlag = vLinkGenVarGroupFlags/CONTIGUOUS
            vLinkGenVarSectionGroupFlag = vLinkGenVarGroupFlags/WRITE
            vLinkGenVarSectionGroupFlag = vLinkGenVarGroupFlags/FILL
            vLinkGenVarSectionGroupRef = OS_STACK_OSCORE0_KERNEL_VAR_NOINIT
            vLinkGenVarSectionGroupRef = OS_STACK_OSCORE0_ERROR_VAR_NOINIT
            vLinkGenVarSectionGroupRef = OS_STACK_OSCORE0_INIT_VAR_NOINIT
            vLinkGenVarSectionGroupRef = OS_STACK_OSCORE0_ISR_CORE_VAR_NOINIT
        OS_DATA_CORE0_VAR: vLinkGenVarGroupInitCore=0, vLinkGenVarGroupRomRegion=RegionBlock_HSM_FLASH
          4 x vLinkGenVarSectionGroup, all with vLinkGenVarSectionGroupPosition=0, vLinkGenVarSectionGroupInitStage=ONE, vLinkGenVarSectionGroupFlag=vLinkGenVarGroupFlags/WRITE, vLinkGenVarSectionGroupFlag=vLinkGenVarGroupFlags/READ, vLinkGenVarSectionGroupFlag=vLinkGenVarGroupFlags/ORDERED, vLinkGenVarSectionGroupFlag=vLinkGenVarGroupFlags/CONTIGUOUS, vLinkGenVarSectionGroupFlag=vLinkGenVarGroupFlags/FILL:
            OS_DATA_CORE0_VAR_NOINIT: vLinkGenVarSectionGroupInit=NONE, vLinkGenVarSectionGroupRef=OS_SystemApplication_OsCore0_VAR_NOINIT, vLinkGenVarSectionGroupRef=OS_CORE0_VAR_NOCACHE_NOINIT, vLinkGenVarSectionGroupRef=OS_SystemApplication_OsCore0_VAR_NOCACHE_NOINIT, vLinkGenVarSectionGroupRef=OS_CORE0_VAR_NOINIT
            OS_DATA_CORE0_VAR_INIT: vLinkGenVarSectionGroupInit=INIT, vLinkGenVarSectionGroupAlignment=4, vLinkGenVarSectionGroupEndAlignment=4, vLinkGenVarSectionGroupRef=OS_SystemApplication_OsCore0_VAR_NOCACHE, vLinkGenVarSectionGroupRef=OS_SystemApplication_OsCore0_VAR, vLinkGenVarSectionGroupRef=OS_CORE0_VAR, vLinkGenVarSectionGroupRef=OS_CORE0_VAR_NOCACHE
            OS_DATA_CORE0_VAR_ZERO_INIT: vLinkGenVarSectionGroupInit=ZERO_INIT, vLinkGenVarSectionGroupAlignment=4, vLinkGenVarSectionGroupEndAlignment=4, vLinkGenVarSectionGroupRef=OS_SystemApplication_OsCore0_VAR_NOCACHE_ZERO_INIT, vLinkGenVarSectionGroupRef=OS_SystemApplication_OsCore0_VAR_ZERO_INIT
            OS_DATA_CORE0_VAR_ZERO_INIT_bss: vLinkGenVarSectionGroupInit=ZERO_INIT, vLinkGenVarSectionGroupAlignment=4, vLinkGenVarSectionGroupEndAlignment=4, vLinkGenVarSectionGroupRef=OS_SystemApplication_OsCore0_VAR_NOCACHE_ZERO_INIT_bss, vLinkGenVarSectionGroupRef=OS_SystemApplication_OsCore0_VAR_ZERO_INIT_bss
        OS_DATA_SHARED_VAR: vLinkGenVarGroupInitCore=0, vLinkGenVarGroupRomRegion=RegionBlock_HSM_FLASH
          OS_DATA_SHARED_VAR_NOINIT (vLinkGenVarSectionGroup):
            vLinkGenVarSectionGroupPosition = 0
            vLinkGenVarSectionGroupInit = NONE
            vLinkGenVarSectionGroupInitStage = ONE
            vLinkGenVarSectionGroupFlag = vLinkGenVarGroupFlags/READ
            vLinkGenVarSectionGroupFlag = vLinkGenVarGroupFlags/ORDERED
            vLinkGenVarSectionGroupFlag = vLinkGenVarGroupFlags/FILL
            vLinkGenVarSectionGroupFlag = vLinkGenVarGroupFlags/CONTIGUOUS
            vLinkGenVarSectionGroupFlag = vLinkGenVarGroupFlags/WRITE
            vLinkGenVarSectionGroupRef = OS_BARRIER_CORE0_VAR_NOCACHE_NOINIT
            vLinkGenVarSectionGroupRef = OS_CORESTATUS_CORE0_VAR_NOCACHE_NOINIT
            vLinkGenVarSectionGroupRef = OS_VAR_NOCACHE_NOINIT
            vLinkGenVarSectionGroupRef = OS_PUBLIC_CORE0_VAR_NOINIT
          OS_DATA_SHARED_VAR_INIT (vLinkGenVarSectionGroup):
            vLinkGenVarSectionGroupPosition = 0
            vLinkGenVarSectionGroupInit = INIT
            vLinkGenVarSectionGroupInitStage = ONE
            vLinkGenVarSectionGroupAlignment = 4
            vLinkGenVarSectionGroupEndAlignment = 4
            vLinkGenVarSectionGroupFlag = vLinkGenVarGroupFlags/ORDERED
            vLinkGenVarSectionGroupFlag = vLinkGenVarGroupFlags/READ
            vLinkGenVarSectionGroupFlag = vLinkGenVarGroupFlags/WRITE
            vLinkGenVarSectionGroupFlag = vLinkGenVarGroupFlags/FILL
            vLinkGenVarSectionGroupFlag = vLinkGenVarGroupFlags/CONTIGUOUS
            vLinkGenVarSectionGroupRef = OS_VAR_NOCACHE
        OS_GLOBALSHARED_VAR: vLinkGenVarGroupInitCore=0, vLinkGenVarGroupRomRegion=RegionBlock_HSM_FLASH
          4 x vLinkGenVarSectionGroup, all with vLinkGenVarSectionGroupPosition=0, vLinkGenVarSectionGroupInitStage=ONE, vLinkGenVarSectionGroupFlag=vLinkGenVarGroupFlags/FILL, vLinkGenVarSectionGroupFlag=vLinkGenVarGroupFlags/WRITE, vLinkGenVarSectionGroupFlag=vLinkGenVarGroupFlags/ORDERED, vLinkGenVarSectionGroupFlag=vLinkGenVarGroupFlags/READ, vLinkGenVarSectionGroupFlag=vLinkGenVarGroupFlags/CONTIGUOUS:
            OS_GLOBALSHARED_VAR_NOINIT: vLinkGenVarSectionGroupInit=NONE, vLinkGenVarSectionGroupRef=OS_GLOBALSHARED_VAR_NOCACHE_NOINIT, vLinkGenVarSectionGroupRef=vLinkGenLinkerSections/OS_GLOBALSHARED_VAR_NOINIT
            OS_GLOBALSHARED_VAR_INIT: vLinkGenVarSectionGroupInit=INIT, vLinkGenVarSectionGroupAlignment=4, vLinkGenVarSectionGroupEndAlignment=4, vLinkGenVarSectionGroupRef=OS_GLOBALSHARED_VAR_NOCACHE, vLinkGenVarSectionGroupRef=vLinkGenLinkerSections/OS_GLOBALSHARED_VAR
            OS_GLOBALSHARED_VAR_ZERO_INIT: vLinkGenVarSectionGroupInit=ZERO_INIT, vLinkGenVarSectionGroupAlignment=4, vLinkGenVarSectionGroupEndAlignment=4, vLinkGenVarSectionGroupRef=OS_GLOBALSHARED_VAR_NOCACHE_ZERO_INIT, vLinkGenVarSectionGroupRef=vLinkGenLinkerSections/OS_GLOBALSHARED_VAR_ZERO_INIT
            OS_GLOBALSHARED_VAR_ZERO_INIT_bss: vLinkGenVarSectionGroupInit=ZERO_INIT, vLinkGenVarSectionGroupAlignment=4, vLinkGenVarSectionGroupEndAlignment=4, vLinkGenVarSectionGroupRef=OS_GLOBALSHARED_VAR_NOCACHE_ZERO_INIT_bss, vLinkGenVarSectionGroupRef=vLinkGenLinkerSections/OS_GLOBALSHARED_VAR_ZERO_INIT_bss
      Const_Default (vLinkGenLogicalConstGroup): vLinkGenConstGroupPosition=1000, vLinkGenConstGroupRegion=RegionBlock_HSM_FLASH
        3 x vLinkGenConstSectionGroup, all with vLinkGenConstSectionGroupPosition=0, vLinkGenConstSectionGroupInit=NONE, vLinkGenConstSectionGroupInitStage=ONE, vLinkGenConstSectionGroupFlag=vLinkGenConstGroupFlags/ORDERED, vLinkGenConstSectionGroupFlag=vLinkGenConstGroupFlags/CONTIGUOUS, vLinkGenConstSectionGroupFlag=vLinkGenConstGroupFlags/FILL, vLinkGenConstSectionGroupFlag=vLinkGenConstGroupFlags/READ, vLinkGenConstSectionGroupFlag=vLinkGenConstGroupFlags/EXECUTE:
          text: vLinkGenConstSectionGroupRef=vLinkGenLinkerSections/text
          rodata: vLinkGenConstSectionGroupRef=vLinkGenLinkerSections/rodata
          zrodata: vLinkGenConstSectionGroupRef=vLinkGenLinkerSections/zrodata
      Data_Default (vLinkGenLogicalVarGroup):
        vLinkGenVarGroupInitCore = 0
        vLinkGenVarGroupPosition = 1000
        vLinkGenVarGroupRegion = RegionBlock_HSM_RAM
        vLinkGenVarGroupRomRegion = RegionBlock_HSM_FLASH
        4 x vLinkGenVarSectionGroup, all with vLinkGenVarSectionGroupPosition=0, vLinkGenVarSectionGroupInitStage=ONE, vLinkGenVarSectionGroupAlignment=4, vLinkGenVarSectionGroupEndAlignment=4, vLinkGenVarSectionGroupFlag=vLinkGenVarGroupFlags/ORDERED, vLinkGenVarSectionGroupFlag=vLinkGenVarGroupFlags/CONTIGUOUS, vLinkGenVarSectionGroupFlag=vLinkGenVarGroupFlags/FILL, vLinkGenVarSectionGroupFlag=vLinkGenVarGroupFlags/READ, vLinkGenVarSectionGroupFlag=vLinkGenVarGroupFlags/WRITE:
          data: vLinkGenVarSectionGroupInit=INIT, vLinkGenVarSectionGroupRef=vLinkGenLinkerSections/data
          zdata: vLinkGenVarSectionGroupInit=INIT, vLinkGenVarSectionGroupRef=vLinkGenLinkerSections/zdata
          bss: vLinkGenVarSectionGroupInit=ZERO_INIT, vLinkGenVarSectionGroupRef=vLinkGenLinkerSections/bss
          zbss: vLinkGenVarSectionGroupInit=ZERO_INIT, vLinkGenVarSectionGroupRef=vLinkGenLinkerSections/zbss
      MemRegion_HSM_FLASH_vHsmUpdEntryPoint (vLinkGenMemoryRegion):
        vLinkGenMemoryRegionAddrOffset = 0
        vLinkGenMemoryRegionSize = 256
        vLinkGenMemoryRegionAddress = 2147485700
        vLinkGenMemoryRegionHwRegion = vBaseEnvGeneral/HSM_FLASH_vHsmUpdEntryPoint
        RegionBlock_HSM_FLASH_vHsmUpdEntryPoint (vLinkGenMemoryRegionBlock):
          vLinkGenMemoryRegionBlockPosition = 0
          vLinkGenMemoryRegionBlockSize = 256
          vLinkGenMemoryRegionBlockAddress = 2147485700
          vLinkGenMemoryRegionBlockBoundary = LOWER
          vLinkGenMemoryRegionBlockInitStage = NONE
      OS_USER_CONST (vLinkGenLogicalConstGroup): vLinkGenConstGroupPosition=5, vLinkGenConstGroupRegion=RegionBlock_HSM_FLASH
      STACK_C0 (vLinkGenLogicalVarGroup): vLinkGenVarGroupInitCore=0, vLinkGenVarGroupPosition=5, vLinkGenVarGroupRegion=RegionBlock_HSM_RAM
        STACK_C0 (vLinkGenVarSectionGroup):
          vLinkGenVarSectionGroupAlignment = 4
          vLinkGenVarSectionGroupEndAlignment = 4
          vLinkGenVarSectionGroupSize = 4024
          vLinkGenVarSectionGroupInit = ZERO_INIT
          vLinkGenVarSectionGroupInitStage = EARLY
          vLinkGenVarSectionGroupPosition = 0
          vLinkGenVarSectionGroupFlag = vLinkGenVarGroupFlags/ORDERED
          vLinkGenVarSectionGroupFlag = vLinkGenVarGroupFlags/CONTIGUOUS
          vLinkGenVarSectionGroupFlag = vLinkGenVarGroupFlags/FILL
          vLinkGenVarSectionGroupFlag = vLinkGenVarGroupFlags/READ
          vLinkGenVarSectionGroupFlag = vLinkGenVarGroupFlags/WRITE
      Startup_Code (vLinkGenLogicalConstGroup): vLinkGenConstGroupPosition=5, vLinkGenConstGroupRegion=RegionBlock_HSM_FLASH
        Startup_Code (vLinkGenConstSectionGroup):
          vLinkGenConstSectionGroupAlignment = 4
          vLinkGenConstSectionGroupPosition = 0
          vLinkGenConstSectionGroupInit = NONE
          vLinkGenConstSectionGroupInitStage = ONE
          vLinkGenConstSectionGroupFlag = vLinkGenConstGroupFlags/ORDERED
          vLinkGenConstSectionGroupFlag = vLinkGenConstGroupFlags/CONTIGUOUS
          vLinkGenConstSectionGroupFlag = vLinkGenConstGroupFlags/FILL
          vLinkGenConstSectionGroupFlag = vLinkGenConstGroupFlags/READ
          vLinkGenConstSectionGroupFlag = vLinkGenConstGroupFlags/EXECUTE
          vLinkGenConstSectionGroupRef = brsStartup
      Startup_Labels (vLinkGenLogicalSymbolGroup): vLinkGenSymbolGroupPosition=5
        6 x vLinkGenLinkerSymbol, all with vLinkGenLinkerSymbolPosition=0:
          Startup_Labels1: vLinkGenLinkerSymbolName=_RESET, vLinkGenLinkerSymbolValue=brsStartupEntry
          Startup_Labels2: vLinkGenLinkerSymbolName=_start, vLinkGenLinkerSymbolValue=brsStartupEntry
          Startup_Labels3: vLinkGenLinkerSymbolName=StartupEntry, vLinkGenLinkerSymbolValue=brsStartupEntry
          Startup_Labels4: vLinkGenLinkerSymbolName=_StartupEntry, vLinkGenLinkerSymbolValue=brsStartupEntry
          Startup_Labels5: vLinkGenLinkerSymbolName=Reset_Handler, vLinkGenLinkerSymbolValue=brsStartupEntry
          vHsmUpd_FirmwareStartLabel: vLinkGenLinkerSymbolName=vHsmUpd_FirmwareStart, vLinkGenLinkerSymbolValue=0x80008161
      Startup_Stack (vLinkGenLogicalSymbolGroup): vLinkGenSymbolGroupPosition=5
        Startup_Stack_c0 (vLinkGenLinkerSymbol): vLinkGenLinkerSymbolName=__section_stack_c0_end, vLinkGenLinkerSymbolValue=_STACK_C0_LIMIT, vLinkGenLinkerSymbolPosition=0
      vHsmEntryPoint (vLinkGenLogicalConstGroup): vLinkGenConstGroupPosition=0, vLinkGenConstGroupRegion=RegionBlock_HSM_FLASH_vHsmUpdEntryPoint
        vHsmEntryPoint (vLinkGenConstSectionGroup):
          vLinkGenConstSectionGroupInit = NONE
          vLinkGenConstSectionGroupInitStage = NONE
          vLinkGenConstSectionGroupPosition = 0
          vLinkGenConstSectionGroupRef = vLinkGenLinkerSections/vHsmEntryPoint
          vLinkGenConstSectionGroupFlag = vLinkGenConstGroupFlags/CONTIGUOUS
          vLinkGenConstSectionGroupFlag = vLinkGenConstGroupFlags/EXECUTE
          vLinkGenConstSectionGroupFlag = vLinkGenConstGroupFlags/FILL
          vLinkGenConstSectionGroupFlag = vLinkGenConstGroupFlags/ORDERED
          vLinkGenConstSectionGroupFlag = vLinkGenConstGroupFlags/READ
      vHsmRamCode (vLinkGenLogicalConstGroup):
        vLinkGenConstGroupPosition = 5
        vLinkGenConstGroupInitCore = 0
        vLinkGenConstGroupRegion = RegionBlock_HSM_FLASH
        vLinkGenConstGroupRamRegion = RegionBlock_HSM_RAM
        vHsmRamCode (vLinkGenConstSectionGroup):
          vLinkGenConstSectionGroupPosition = 0
          vLinkGenConstSectionGroupInit = COPY_TO_RAM
          vLinkGenConstSectionGroupInitStage = ONE
          vLinkGenConstSectionGroupAlignment = 4
          vLinkGenConstSectionGroupEndAlignment = 4
          vLinkGenConstSectionGroupFlag = vLinkGenConstGroupFlags/ORDERED
          vLinkGenConstSectionGroupFlag = vLinkGenConstGroupFlags/CONTIGUOUS
          vLinkGenConstSectionGroupFlag = vLinkGenConstGroupFlags/FILL
          vLinkGenConstSectionGroupFlag = vLinkGenConstGroupFlags/READ
          vLinkGenConstSectionGroupFlag = vLinkGenConstGroupFlags/EXECUTE
          vLinkGenConstSectionGroupRef = vHsmRamCodeConst
          vLinkGenConstSectionGroupRef = vHsmRamCodeCode
    vLinkGenGeneral: vLinkGenFileGeneration=STANDARD, vLinkGenEntrySymbol=brsStartupEntry
    vLinkGenPublishedInformation: vLinkGenGeneration=2, vLinkGenDuplicatedLabels=false
      vLinkGenRegionBlockFlags
        RESERVED (vLinkGenRegionBlockFlag)
      vLinkGenConstGroupFlags
        7 x vLinkGenConstGroupFlag:
          ORDERED
          CONTIGUOUS
          FILL
          NOCOPY
          EXECUTE
          READ
          WRITE
      vLinkGenConstSectionFlags
        KEEP (vLinkGenConstSectionFlag)
      vLinkGenVarGroupFlags
        7 x vLinkGenVarGroupFlag:
          ORDERED
          CONTIGUOUS
          FILL
          NOCOPY
          EXECUTE
          READ
          WRITE
      vLinkGenVarSectionFlags
        KEEP (vLinkGenVarSectionFlag)
  module config vBRS: implementation-config-variant=VARIANT-PRE-COMPILE, module-description=vBRS_Impl
    vBRSGeneral:
      vBRSEnableHSMSupport = true
      vBRSEnableSupportLEDs = false
      vBRSEnableSafeContextSupport = false
      vBRSEnableMultiCoreSupport = false
      vBRSEnableSupportToggleWdPin = false
      vBRSEnableSupportToggleCustomPin = false
      vBRSEnableEcuMStubGeneration = false
      vBRSDisableSetupSupport = false
      vBRSEnableSchmStubGeneration = true
      vBRSEnableSchmStubSupportDrvCanAN = false
      vBRSFblSupport = Disabled
      vBRSEnableCoreSpecificVLinkGenConfig = false
    vBRSHwConfig:
      vBRSOscClock = 20000000
      vBRSPeriphClock = 100000000
      vBRSTimebaseClock = 6250000
      vBRSCompilerInstructionSet = THUMB
      vBRSPeriphClockDescription = Initial value for Peripheral Clock: SPB (System Peripheral Bus) = 100MHz
      vBRSEnablePortHandling = false
      vBRSEnableWatchdogHandling = true
      vBRSEnablePLLClocksHandling = true
      vBRSMakefileUserCode = TARGET_DERIVATIVE = TC39x
      vBRSPreferPLLWatchdogInit = false
      vBRSEvalBoardInfo: vBRSEvalBoardDescription=, vBRSEvalBoard=
    vBRSMemoryInit: vBRSInitPatternBlocks=0, vBRSInitPatternHardResetBlocks=0, vBRSInitPatternAreas=0, vBRSInitPatternHardResetAreas=0
  module config vBaseEnv: implementation-config-variant=VARIANT-PRE-COMPILE, module-description=vBaseEnv_Impl
    vBaseEnvGeneral: vBaseEnvTestedDerivativeRef=TC3xx
      TC3xx (vBaseEnvDerivativeInformation):
        vBaseEnvCpuCore = CORTEX_M3
        vBaseEnvCpuCoreAmount = 1
        vBaseEnvCpuMaxFrequency = 6250000
        vBaseEnvTestedDerivative = TC3xx
        vBaseEnvTestedDerivativeDescription = Infineon Aurix TC3xx Family - HSM Core
        vBaseEnvAvailableChannels_Can = 0
        vBaseEnvAvailableChannels_Ethernet = 0
        vBaseEnvAvailableChannels_Flexray = 0
        vBaseEnvAvailableChannels_Lin = 0
        vBaseEnvAvailableChannels_Hyperbus = 0
        vBaseEnvAvailableChannels_I2c = 0
        vBaseEnvAvailableChannels_Spi = 0
        6 x vBaseEnvMemLayoutHwRegion:
          HSM_FLASH: vBaseEnvHwRegionSize=243452, vBaseEnvHwRegionStartAddress=2147485956, vBaseEnvHwRegionType=ROM
          HSM_RAM: vBaseEnvHwRegionSize=97920, vBaseEnvHwRegionStartAddress=536871296, vBaseEnvHwRegionType=RAM
          HSM_IPC: vBaseEnvHwRegionSize=65536, vBaseEnvHwRegionStartAddress=4026859520, vBaseEnvHwRegionType=RAM
          HSM_DATA_FLASH: vBaseEnvHwRegionSize=131072, vBaseEnvHwRegionStartAddress=2948595712, vBaseEnvHwRegionType=NVRAM
          HSM_INTVEC_FLASH: vBaseEnvHwRegionSize=2052, vBaseEnvHwRegionStartAddress=2147483648, vBaseEnvHwRegionType=ROM
          HSM_FLASH_vHsmUpdEntryPoint: vBaseEnvHwRegionSize=256, vBaseEnvHwRegionStartAddress=2147485700, vBaseEnvHwRegionType=ROM
      6 x vBaseEnvMemLayoutHwRegion:
        HSM_FLASH
        HSM_RAM
        HSM_IPC
        HSM_DATA_FLASH
        HSM_INTVEC_FLASH
        HSM_FLASH_vHsmUpdEntryPoint
