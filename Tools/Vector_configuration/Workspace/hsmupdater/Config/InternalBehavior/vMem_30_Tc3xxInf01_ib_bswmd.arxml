AUTOSAR XML (schema 4-0-3)
package /MICROSAR/vMem_30_Tc3xxInf01_ib_bswmd/BswModuleDescriptions
  bsw module description vMem: provided-entrys=vMem_30_Tc3xxInf01_MainFunction
    bsw internal behavior vMemBehavior
      exclusive area VMEM_30_TC3XXINF01_EXCLUSIVE_AREA_0
      bsw schedulable entity vMem_30_Tc3xxInf01_MainFunction: implemented-entry=vMem_30_Tc3xxInf01_MainFunction
      bsw timing event vMem_30_Tc3xxInf01_MainFunctionTimingEvent0: starts-on-event=vMem_30_Tc3xxInf01_MainFunction, period=0.005
  bsw module entry vMem_30_Tc3xxInf01_MainFunction: call-type=SCHEDULED, execution-context=TASK
