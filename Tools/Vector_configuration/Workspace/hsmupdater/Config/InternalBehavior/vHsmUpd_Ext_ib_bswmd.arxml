AUTOSAR XML (schema 4-0-3)
package /MICROSAR/vHsmUpd_Ext_ib_bswmd/BswModuleDescriptions
  bsw module description vHsmUpd_Ext
    bsw internal behavior vHsmUpd_ExtBehavior
