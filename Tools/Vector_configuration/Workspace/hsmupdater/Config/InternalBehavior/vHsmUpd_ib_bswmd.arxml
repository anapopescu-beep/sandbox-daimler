AUTOSAR XML (schema 4-0-3)
package /MICROSAR/vHsmUpd_ib_bswmd/BswModuleDescriptions
  bsw module description vHsmUpd
    bsw internal behavior vHsmUpdBehavior
