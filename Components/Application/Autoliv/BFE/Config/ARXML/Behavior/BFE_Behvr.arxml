AUTOSAR XML (schema 4-2-2)
package /AUTOLIV/SoftwareComponents/BFE
  application sw component type BFE_AC_BeltFunctionExecution: category=SWC
    behavior BFE_IB_BeltFunctionExecution: constant-value-mapping=ConstantsMappingSet_PP4G, data-type-mapping=DataTypeMappingSet_PP4G, handle-termination-and-restart=NO-SUPPORT
      exclusive area BFE_EXCLUSIVE_AREA
      operation invoked event BFE_evExecuteEmergencyBrakingSequence: start-on-event=BFE_runExecuteEmergencyBrakingSequence, operation=pseSynchronousMotorControl.ExecuteEmergencyBrakingSequence
      operation invoked event BFE_evExecuteHighPowerSteps: start-on-event=BFE_runExecuteHighPowerStep, operation=pseSynchronousMotorControl.ExecuteHighPowerStep
      timing event BFE_evExecuteStandardSteps: start-on-event=BFE_runExecuteStandardSteps, period=0.002
      operation invoked event BFE_evResetMotorStageStatus: start-on-event=BFE_runResetMotorStageStatus, operation=pseSynchronousMotorControl.ResetMotorStageStatus
      timing event BFE_evScheduleStep: start-on-event=BFE_runScheduleStep, period=0.01
      explicit-inter-runnable-variables:
        6 x data, all with step-size=0.0, sw-calibration-access=READ-ONLY:
          s16MotorPowerOrder: type=s16MotorPowerOrderType_Appl, init-value=constant-reference=APPLINIT_KS16_MOTOR_POWER_ORDER_ZERO
          s32FirstOrderValue: type=s32OrderValueType_Appl, init-value=constant-reference=APPLINIT_KS32_ORDER_VALUE_ZERO
          s32OrderIncrementValue: type=s32OrderValueType_Appl, init-value=constant-reference=APPLINIT_KS32_ORDER_VALUE_ZERO
          u16StepDuration: type=u16StepDurationType_Appl, init-value=constant-reference=APPLINIT_KU16_STEP_DURATION_ZERO  # HP step need to know how long does the hp step last.
          u8MotorStageStatus: type=u8MotorStageStatusType_Appl, init-value=constant-reference={short-label=ConstantValue4, constant=APPLINIT_KU8_MOTOR_STAGE_STATUS_ACTIVATION}  # To know if the motor stage is activated or not
          u8OrderType: type=u8OrdersListType_Appl, init-value=constant-reference=APPLINIT_KU8_ORDERS_LIST_ZERO
      port-api-options:
        enable-take-address=false, indirect-api=false, port=pseSynchronousMotorControl
        enable-take-address=false, indirect-api=false, port=psrExecutedCycle
        enable-take-address=false, indirect-api=false, port=psrExecutedStep
        enable-take-address=false, indirect-api=false, port=prrSelectedCycle
      5 x runnable, all with sw-addr-method=CODE:
        BFE_runExecuteEmergencyBrakingSequence: can-be-invoked-concurrently=true
          read-local-variables:
            access rd_s16MotorPowerOrder: accessed-variable=s16MotorPowerOrder
            access rd_u8MotorStageStatus: accessed-variable=u8MotorStageStatus
          sync call SSCP_pclMotor_I_Get_mA: operation=pclMotor_I.Get_mA, timeout=0.0
          sync call SSCP_pclMotor_P_SetPowerOrder: operation=pclMotor_P.SetPowerOrder, timeout=0.0
          written-local-variables:
            access wr_s16MotorPowerOrder: accessed-variable=s16MotorPowerOrder
            access wr_u8MotorStageStatus: accessed-variable=u8MotorStageStatus
        BFE_runExecuteHighPowerStep: can-be-invoked-concurrently=true
          read-local-variables:
            5 x access:
              s32FirstOrderValue: accessed-variable=s32FirstOrderValue
              u16StepDuration: accessed-variable=u16StepDuration
              u8MotorStageStatus: accessed-variable=u8MotorStageStatus
              u8OrderType: accessed-variable=u8OrderType
              rd_s16MotorPowerOrder: accessed-variable=s16MotorPowerOrder
          sync call SSCP_pclKL30_V_Get: operation=pclKL30_V.Get, timeout=0.0
          sync call SSCP_pclMotor_I_Get_mA: operation=pclMotor_I.Get_mA, timeout=0.0
          sync call SSCP_pclMotor_P_SetPowerOrder: operation=pclMotor_P.SetPowerOrder, timeout=0.0
          written-local-variables:
            access wr_s16MotorPowerOrder: accessed-variable=s16MotorPowerOrder
        BFE_runExecuteStandardSteps: can-enter-exclusive-area=BFE_EXCLUSIVE_AREA
          data-receive-point-by-arguments:
            access DRP_prrCarAcceleration_b8IsCarAccelerationLow: accessed-variable=prrCarAcceleration.b8IsCarAccelerationLow
          read-local-variables:
            5 x access:
              s32FirstOrderValue: accessed-variable=s32FirstOrderValue
              u8OrderType: accessed-variable=u8OrderType
              rd_s16MotorPowerOrder: accessed-variable=s16MotorPowerOrder
              u8MotorStageStatus: accessed-variable=u8MotorStageStatus
              s32OrderIncrementValue: accessed-variable=s32OrderIncrementValue
          5 x sync call, all with timeout=0.0:
            SSCP_pclMotor_I_Get_A: operation=pclMotor_I.Get_A
            SSCP_pclMotor_I_Get_mA: operation=pclMotor_I.Get_mA
            SSCP_pclKL30_V_Get_2ms: operation=pclKL30_V.Get_2ms
            SSCP_pclMotor_P_SetPowerOrder: operation=pclMotor_P.SetPowerOrder
            SSCP_pclKL30_V_Get: operation=pclKL30_V.Get
          written-local-variables:
            access wr_s16MotorPowerOrder: accessed-variable=s16MotorPowerOrder
        BFE_runResetMotorStageStatus: can-enter-exclusive-area=BFE_EXCLUSIVE_AREA, can-be-invoked-concurrently=true
          written-local-variables:
            access u8MotorStageStatus: accessed-variable=u8MotorStageStatus
        BFE_runScheduleStep
          data-receive-point-by-arguments:
            access DRP_prrCarAcceleration_b8IsCarAccelerationLow: accessed-variable=prrCarAcceleration.b8IsCarAccelerationLow
            access DRP_prrSelect_u8CycleNumber: accessed-variable=prrSelectedCycle.u8CycleNumber
          data-send-points:
            access DSP_psrExecut_u8StepNumber: accessed-variable=psrExecutedStep.u8StepNumber
            access DSP_psrExecut_u8CycleNumber: accessed-variable=psrExecutedCycle.u8CycleNumber
          read-local-variables:
            access u8MotorStageStatus: accessed-variable=u8MotorStageStatus
            access s16MotorPowerOrder: accessed-variable=s16MotorPowerOrder
            access rd_u8OrderType: accessed-variable=u8OrderType
          9 x sync call, all with timeout=0.0:
            SSCP_pclECU_T_GetFiltered: operation=pclECU_T.GetFiltered
            SSCP_pclKL30_V_Get: operation=pclKL30_V.Get
            SSCP_pclECU_R_Get: operation=pclECU_R.Get
            SSCP_pclMotor_R_Get: operation=pclMotor_R.Get
            SSCP_pclKL30_V_Get_10ms: operation=pclKL30_V.Get_10ms
            SSCP_pclMotor_I_Get_mA: operation=pclMotor_I.Get_mA
            SSCP_pclBelt_D_GetFromMinPos_mm: operation=pclBelt_D.GetFromMinPos_mm
            SSCP_pseBelt_S_GetSpeed_mm_s: operation=pseBelt_S.GetSpeed_mm_s
            SSCP_pclBelt_D_GetFromT0_mm: operation=pclBelt_D.GetFromT0_mm
          written-local-variables:
            4 x access:
              s32FirstOrderValue: accessed-variable=s32FirstOrderValue
              u16StepDuration: accessed-variable=u16StepDuration
              s32OrderIncrementValue: accessed-variable=s32OrderIncrementValue
              wr_u8OrderType: accessed-variable=u8OrderType
  swc implementation BFE_impBeltFunctionExecution: programming-language=C, sw-version=1.0.0, vendor-id=0, behavior=BFE_IB_BeltFunctionExecution
    code-descriptors:
      code BFE_Impl_Code: artifact-descriptors=autosar-engineering-object={short-label=BFE_Impl_Code_CodeDesc, category=SWSRC}
    resource consumption BFE_Impl_ResCons
      memory section CODE: size=0, sw-addrmethod=CODE
      memory section VAR_INIT_UNSPECIFIED: alignment=UNSPECIFIED, size=0, sw-addrmethod=VAR_INIT
      memory section VAR_UNSPECIFIED: alignment=UNSPECIFIED, size=0, sw-addrmethod=VAR_ALV
