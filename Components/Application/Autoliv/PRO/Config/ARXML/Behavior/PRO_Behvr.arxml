AUTOSAR XML (schema 4-2-2)
package /AUTOLIV/SoftwareComponents/PRO
  application sw component type PRO_AC_ProductionCycles: category=SWC
    behavior PRO_IB_ProductionCycles: constant-value-mapping=ConstantsMappingSet_PP4G, data-type-mapping=DataTypeMappingSet_PP4G, handle-termination-and-restart=NO-SUPPORT
      timing event PRO_evProductionCycles: start-on-event=PRO_runProductionCycles, period=0.01
      runnable PRO_runProductionCycles: sw-addr-method=CODE
        data-receive-point-by-arguments:
          access DRP_prrExecutedCycle_u8CycleNumber: accessed-variable=prrExecutedCycle.u8CycleNumber
        data-send-points:
          10 x access:
            DSP_psrAlgo_Flags_PRO1_u8TriggeringSource: accessed-variable=psrAlgo_Flags_PRO1.u8TriggeringSource
            DSP_psrAlgo_Flags_PRO1_b8InterruptFlag: accessed-variable=psrAlgo_Flags_PRO1.b8InterruptFlag
            DSP_psrAlgo_Flags_PRO2_b8TriggerFlag: accessed-variable=psrAlgo_Flags_PRO2.b8TriggerFlag
            DSP_psrAlgo_Flags_PRO2_b8InterruptFlag: accessed-variable=psrAlgo_Flags_PRO2.b8InterruptFlag
            DSP_psrAlgo_Flags_PRO2_u8TriggeringSource: accessed-variable=psrAlgo_Flags_PRO2.u8TriggeringSource
            DSP_psrAlgo_Flags_PRO2_b8PreActivationFlag: accessed-variable=psrAlgo_Flags_PRO2.b8PreActivationFlag
            DSP_psrAlgo_Flags_PRO1_b8PreConditionsFlag: accessed-variable=psrAlgo_Flags_PRO1.b8PreConditionsFlag
            DSP_psrAlgo_Flags_PRO1_b8TriggerFlag: accessed-variable=psrAlgo_Flags_PRO1.b8TriggerFlag
            DSP_psrAlgo_Flags_PRO1_b8PreActivationFlag: accessed-variable=psrAlgo_Flags_PRO1.b8PreActivationFlag
            DSP_psrAlgo_Flags_PRO2_b8PreConditionsFlag: accessed-variable=psrAlgo_Flags_PRO2.b8PreConditionsFlag
        6 x sync call, all with timeout=0.0:
          SSCP_pclDiagRequestCycle_GetDiagRequestCycle: operation=pclDiagRequestCycle.GetDiagRequestCycle
          SSCP_pclTestResult_GetTestResult: operation=pclAutotestServices.GetTestResult
          SSCP_pclModeManagement_CheckModeStatus: operation=pclModeManagement.CheckModeStatus
          SSCP_pclDiagRequestCycle_ClearDiagRequestCycle: operation=pclDiagRequestCycle.ClearDiagRequestCycle
          scp_GetEventStatus: operation=pclEvtInfoBatPwrUnderVoltageDuringTens.GetEventStatus
          scp_GetEventStatus1: operation=pclEvtInfoBatPwrOverVoltage.GetEventStatus
  swc implementation PRO_impProductionCycles: programming-language=C, sw-version=1.0.0, vendor-id=0, behavior=PRO_IB_ProductionCycles
    code-descriptors:
      code PRO_Impl_Code: artifact-descriptors=autosar-engineering-object={short-label=PRO_Impl_Code_CodeDesc, category=SWSRC}
    resource consumption PRO_Impl_ResCons
      5 x memory section, all with size=0:
        CODE: sw-addrmethod=CODE
        CONST_8: alignment=8, sw-addrmethod=CONST
        VAR_INIT_8: alignment=8, sw-addrmethod=VAR_INIT
        VAR_INIT_UNSPECIFIED: alignment=UNSPECIFIED, sw-addrmethod=VAR_INIT
        VAR_UNSPECIFIED: alignment=UNSPECIFIED, sw-addrmethod=VAR_ALV
