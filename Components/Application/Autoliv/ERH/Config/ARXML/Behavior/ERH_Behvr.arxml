AUTOSAR XML (schema 4-2-2)
package /AUTOLIV/SoftwareComponents/ERH
  application sw component type ERH_AC_ErrorHandler: category=SWC
    behavior ERH_IB_ErrorHandler: constant-value-mapping=ConstantsMappingSet_PP4G, data-type-mapping=DataTypeMappingSet_PP4G, handle-termination-and-restart=NO-SUPPORT
      6 x operation invoked event:
        ERH_evGetAecDeskillThrs: start-on-event=ERH_runGetAecDeskillThrs, operation=pseAecStatus.GetAecDeskillThrs
        ERH_evGetAecGroupsStatus: start-on-event=ERH_runGetAecGroupsStatus, operation=pseAecStatus.GetAecGroupsStatus
        ERH_evGetAecNvpBlockRecordingStatus: start-on-event=ERH_runGetAecNvpBlockRecordingStatus, operation=pseAecStatus.GetAecNvpBlockRecordingStatus
        ERH_evGetAecStatus: start-on-event=ERH_runGetAecStatus, operation=pseAecStatus.GetAecStatus
        ERH_evGetNumberOfImplementedAec: start-on-event=ERH_runGetNumberOfImplementedAec, operation=pseAecStatus.GetNumberOfImplementedAec
        ERH_evSetAecEvent: start-on-event=ERH_runSetAecEvent, operation=pseAecStatus.SetAecEvent
      timing event ERH_evStoreEverQualifiedAECsToNVP: start-on-event=ERH_runStoreEverQualifiedAECsToNVP, period=0.01
      8 x runnable:
        ERH_Init: sw-addr-method=CODE
        ERH_runGetAecDeskillThrs: can-be-invoked-concurrently=true
        ERH_runGetAecGroupsStatus: sw-addr-method=CODE, can-be-invoked-concurrently=true
        ERH_runGetAecNvpBlockRecordingStatus: can-be-invoked-concurrently=true
        ERH_runGetAecStatus: sw-addr-method=CODE, can-be-invoked-concurrently=true
          sync call SSCP_pclTimInternalCounter_GetInternalCounter: operation=pclTimInternalCounter.GetInternalCounter, timeout=0.0
        ERH_runGetNumberOfImplementedAec: can-be-invoked-concurrently=true
        ERH_runSetAecEvent: sw-addr-method=CODE, can-be-invoked-concurrently=true
          sync call scp_NotifyBlockStatusChanged: operation=pclNvpServices.NotifyBlockStatusChanged, timeout=0.0
        ERH_runStoreEverQualifiedAECsToNVP: sw-addr-method=CODE
          sync call scp_WriteBlock: operation=pclNvpServices.WriteBlock, timeout=0.0
          sync call scp_GetLastJobBlockResult: operation=pclNvpServices.GetLastJobBlockResult, timeout=0.0
          sync call scp_GetBlockStatus: operation=pclNvpServices.GetBlockStatus, timeout=0.0
  swc implementation ERH_impErrorHandler: programming-language=C, sw-version=1.0.0, vendor-id=0, behavior=ERH_IB_ErrorHandler
    code-descriptors:
      code ERH_Impl_Code_CodeDesc: artifact-descriptors=autosar-engineering-object={short-label=ERH_Impl_Code_CodeDesc, category=SWSRC}
    resource consumption ERH_Impl_ResCons
      4 x memory section, all with size=0:
        ERH_CODE: sw-addrmethod=CODE
        ERH_CONST_UNSPECIFIED: alignment=UNSPECIFIED, sw-addrmethod=CONST
        ERH_VAR_16: alignment=16, sw-addrmethod=VAR
        ERH_VAR_8: alignment=8, sw-addrmethod=VAR
