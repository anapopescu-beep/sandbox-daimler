AUTOSAR XML (schema 4-2-2)
package /AUTOLIV/SoftwareComponents/SFR
  application sw component type SFR_AC_StandardFunctionRecovery: category=SWC
    behavior SFR_IB_StandardFunctionRecovery: constant-value-mapping=ConstantsMappingSet_PP4G, data-type-mapping=DataTypeMappingSet_PP4G, handle-termination-and-restart=NO-SUPPORT
      timing event SFR_evReleasingAlgorithm: start-on-event=SFR_runStandardFunctionRecovery, period=0.01
      runnable SFR_runStandardFunctionRecovery: sw-addr-method=CODE
        data-receive-point-by-arguments:
          access DRP_prrExecutedCycle_u8CycleNumber: accessed-variable=prrExecutedCycle.u8CycleNumber
          access DRP_prrCarAcceleration_b8IsCarAccelerationLow: accessed-variable=prrCarAcceleration.b8IsCarAccelerationLow
          access DRP_prrCustomerSpecific_b8IsCarCrashDetected: accessed-variable=prrCustomerSpecific.b8IsCarCrashDetected
        data-send-points:
          20 x access:
            DSP_psrAlgo_Flags_PAT_b8InterruptFlag: accessed-variable=psrAlgo_Flags_PAT.b8InterruptFlag
            DSP_psrAlgo_Flags_PAT_u8TriggeringSource: accessed-variable=psrAlgo_Flags_PAT.u8TriggeringSource
            DSP_psrAlgo_Flags_BCK_b8InterruptFlag: accessed-variable=psrAlgo_Flags_BCK.b8InterruptFlag
            DSP_psrAlgo_Flags_BCK_b8TriggerFlag: accessed-variable=psrAlgo_Flags_BCK.b8TriggerFlag
            DSP_psrAlgo_Flags_PAT_b8PreConditionsFlag: accessed-variable=psrAlgo_Flags_PAT.b8PreConditionsFlag
            DSP_psrAlgo_Flags_SMO_b8TriggerFlag: accessed-variable=psrAlgo_Flags_SMO.b8TriggerFlag
            DSP_psrAlgo_Flags_HRD_b8TriggerFlag: accessed-variable=psrAlgo_Flags_HRD.b8TriggerFlag
            DSP_psrAlgo_Flags_SMO_u8TriggeringSource: accessed-variable=psrAlgo_Flags_SMO.u8TriggeringSource
            DSP_psrAlgo_Flags_BCK_u8TriggeringSource: accessed-variable=psrAlgo_Flags_BCK.u8TriggeringSource
            DSP_psrAlgo_Flags_HRD_b8InterruptFlag: accessed-variable=psrAlgo_Flags_HRD.b8InterruptFlag
            DSP_psrAlgo_Flags_HRD_b8PreActivationFlag: accessed-variable=psrAlgo_Flags_HRD.b8PreActivationFlag
            DSP_psrAlgo_Flags_PAT_b8PreActivationFlag: accessed-variable=psrAlgo_Flags_PAT.b8PreActivationFlag
            DSP_psrAlgo_Flags_SMO_b8PreConditionsFlag: accessed-variable=psrAlgo_Flags_SMO.b8PreConditionsFlag
            DSP_psrAlgo_Flags_HRD_u8TriggeringSource: accessed-variable=psrAlgo_Flags_HRD.u8TriggeringSource
            DSP_psrAlgo_Flags_PAT_b8TriggerFlag: accessed-variable=psrAlgo_Flags_PAT.b8TriggerFlag
            DSP_psrAlgo_Flags_HRD_b8PreConditionsFlag: accessed-variable=psrAlgo_Flags_HRD.b8PreConditionsFlag
            DSP_psrAlgo_Flags_BCK_b8PreActivationFlag: accessed-variable=psrAlgo_Flags_BCK.b8PreActivationFlag
            DSP_psrAlgo_Flags_SMO_b8PreActivationFlag: accessed-variable=psrAlgo_Flags_SMO.b8PreActivationFlag
            DSP_psrAlgo_Flags_SMO_b8InterruptFlag: accessed-variable=psrAlgo_Flags_SMO.b8InterruptFlag
            DSP_psrAlgo_Flags_BCK_b8PreConditionsFlag: accessed-variable=psrAlgo_Flags_BCK.b8PreConditionsFlag
        6 x sync call, all with timeout=0.0:
          SSCP_pclTestResult_GetTestResult: operation=pclAutotestServices.GetTestResult
          SSCP_pclDiagRequestCycle_GetDiagRequestCycle: operation=pclDiagRequestCycle.GetDiagRequestCycle
          SSCP_pclModeManagement_CheckModeStatus: operation=pclModeManagement.CheckModeStatus
          SSCP_pclSystemContextManagement_GetLastTensionningState: operation=pclSystemContextManagement.GetLastTensionningState
          SSCP_pclDiagRequestCycle_ClearDiagRequestCycle: operation=pclDiagRequestCycle.ClearDiagRequestCycle
          scp_GetEventStatus: operation=pclEvtInfoHallSensor.GetEventStatus
  swc implementation SFR_impStandardFunctionRecovery: programming-language=C, sw-version=1.0.0, vendor-id=0, behavior=SFR_IB_StandardFunctionRecovery
    code-descriptors:
      code SFR_Impl_Code: artifact-descriptors=autosar-engineering-object={short-label=SFR_Impl_Code_CodeDesc, category=SWSRC}
    resource consumption SFR_Impl_ResCons
      memory section CODE: size=0, sw-addrmethod=CODE
      memory section VAR_INIT_UNSPECIFIED: alignment=UNSPECIFIED, size=0, sw-addrmethod=VAR_INIT
      memory section VAR_UNSPECIFIED: alignment=UNSPECIFIED, size=0, sw-addrmethod=VAR_ALV
