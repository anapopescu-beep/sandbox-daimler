AUTOSAR XML (schema 4-2-2)
package /AUTOLIV/SoftwareComponents/BFS
  application sw component type BFS_AC_BeltFunctionSelection: category=SWC
    behavior BFS_IB_BeltFunctionSelection: constant-value-mapping=ConstantsMappingSet_PP4G, data-type-mapping=DataTypeMappingSet_PP4G, handle-termination-and-restart=NO-SUPPORT
      timing event BFS_evBeltFunctionSelection: start-on-event=BFS_runBeltFunctionSelection, period=0.01
      runnable BFS_runBeltFunctionSelection
        data-read-access:
          access DRA_prrExecut_u8CycleNumber: accessed-variable=prrExecutedCycle.u8CycleNumber  # ARCH_SW_BFS_0090
        data-receive-point-by-arguments:
          50 x access:
            DRP_prrAlgo13_InterruptFlag: accessed-variable=prrAlgo13_Flags.b8InterruptFlag  # ARCH_SW_BFS_0056
            DRP_prrAlgo22_b8TriggerFlag: accessed-variable=prrAlgo22_Flags.b8TriggerFlag
            DRP_prrAlgo23_InterruptFlag: accessed-variable=prrAlgo23_Flags.b8InterruptFlag
            DRP_prrAlgo21_b8TriggerFlag: accessed-variable=prrAlgo21_Flags.b8TriggerFlag  # ARCH_SW_BFS_0082
            DRP_prrAlgo05_InterruptFlag: accessed-variable=prrAlgo05_Flags.b8InterruptFlag  # ARCH_SW_BFS_0035
            DRP_prrAlgo07_b8TriggerFlag: accessed-variable=prrAlgo07_Flags.b8TriggerFlag  # ARCH_SW_BFS_0027
            DRP_prrAlgo25_b8TriggerFlag: accessed-variable=prrAlgo25_Flags.b8TriggerFlag
            DRP_prrAlgo23_b8TriggerFlag: accessed-variable=prrAlgo23_Flags.b8TriggerFlag
            DRP_prrAlgo10_b8TriggerFlag: accessed-variable=prrAlgo10_Flags.b8TriggerFlag
            DRP_prrAlgo12_b8TriggerFlag: accessed-variable=prrAlgo12_Flags.b8TriggerFlag  # ARCH_SW_BFS_0052
            DRP_prrAlgo20_b8TriggerFlag: accessed-variable=prrAlgo20_Flags.b8TriggerFlag  # ARCH_SW_BFS_0081
            DRP_prrAlgo15_b8TriggerFlag: accessed-variable=prrAlgo15_Flags.b8TriggerFlag  # ARCH_SW_BFS_0062
            DRP_prrAlgo01_InterruptFlag: accessed-variable=prrAlgo01_Flags.b8InterruptFlag  # ARCH_SW_BFS_0031
            DRP_prrAlgo01_b8TriggerFlag: accessed-variable=prrAlgo01_Flags.b8TriggerFlag  # ARCH_SW_BFS_0021
            DRP_prrAlgo19_InterruptFlag: accessed-variable=prrAlgo19_Flags.b8InterruptFlag  # ARCH_SW_BFS_0078
            DRP_prrAlgo17_b8TriggerFlag: accessed-variable=prrAlgo17_Flags.b8TriggerFlag  # ARCH_SW_BFS_0072
            DRP_prrAlgo07_InterruptFlag: accessed-variable=prrAlgo07_Flags.b8InterruptFlag  # ARCH_SW_BFS_0037
            DRP_prrAlgo03_InterruptFlag: accessed-variable=prrAlgo03_Flags.b8InterruptFlag  # ARCH_SW_BFS_0033
            DRP_prrAlgo19_b8TriggerFlag: accessed-variable=prrAlgo19_Flags.b8TriggerFlag  # ARCH_SW_BFS_0074
            DRP_prrAlgo06_b8TriggerFlag: accessed-variable=prrAlgo06_Flags.b8TriggerFlag  # ARCH_SW_BFS_0026
            DRP_prrAlgo11_b8TriggerFlag: accessed-variable=prrAlgo11_Flags.b8TriggerFlag  # ARCH_SW_BFS_0051
            DRP_prrAlgo06_InterruptFlag: accessed-variable=prrAlgo06_Flags.b8InterruptFlag  # ARCH_SW_BFS_0036
            DRP_prrAlgo12_InterruptFlag: accessed-variable=prrAlgo12_Flags.b8InterruptFlag  # ARCH_SW_BFS_0055
            DRP_prrAlgo11_InterruptFlag: accessed-variable=prrAlgo11_Flags.b8InterruptFlag  # ARCH_SW_BFS_0054
            DRP_prrAlgo10_InterruptFlag: accessed-variable=prrAlgo10_Flags.b8InterruptFlag
            DRP_prrAlgo17_InterruptFlag: accessed-variable=prrAlgo17_Flags.b8InterruptFlag  # ARCH_SW_BFS_0076
            DRP_prrAlgo13_b8TriggerFlag: accessed-variable=prrAlgo13_Flags.b8TriggerFlag  # ARCH_SW_BFS_0053
            DRP_prrAlgo09_InterruptFlag: accessed-variable=prrAlgo09_Flags.b8InterruptFlag  # ARCH_SW_BFS_0042
            DRP_prrAlgo02_b8TriggerFlag: accessed-variable=prrAlgo02_Flags.b8TriggerFlag  # ARCH_SW_BFS_0022
            DRP_prrAlgo24_b8TriggerFlag: accessed-variable=prrAlgo24_Flags.b8TriggerFlag
            DRP_prrAlgo25_InterruptFlag: accessed-variable=prrAlgo25_Flags.b8InterruptFlag
            DRP_prrAlgo20_InterruptFlag: accessed-variable=prrAlgo20_Flags.b8InterruptFlag  # ARCH_SW_BFS_0084
            DRP_prrAlgo24_InterruptFlag: accessed-variable=prrAlgo24_Flags.b8InterruptFlag
            DRP_prrAlgo21_InterruptFlag: accessed-variable=prrAlgo21_Flags.b8InterruptFlag  # ARCH_SW_BFS_0085
            DRP_prrAlgo15_InterruptFlag: accessed-variable=prrAlgo15_Flags.b8InterruptFlag  # ARCH_SW_BFS_0065
            DRP_prrAlgo02_InterruptFlag: accessed-variable=prrAlgo02_Flags.b8InterruptFlag  # ARCH_SW_BFS_0032
            DRP_prrAlgo05_b8TriggerFlag: accessed-variable=prrAlgo05_Flags.b8TriggerFlag  # ARCH_SW_BFS_0025
            DRP_prrAlgo04_InterruptFlag: accessed-variable=prrAlgo04_Flags.b8InterruptFlag  # ARCH_SW_BFS_0034
            DRP_prrAlgo14_InterruptFlag: accessed-variable=prrAlgo14_Flags.b8InterruptFlag  # ARCH_SW_BFS_0064
            DRP_prrAlgo04_b8TriggerFlag: accessed-variable=prrAlgo04_Flags.b8TriggerFlag  # ARCH_SW_BFS_0024
            DRP_prrAlgo18_InterruptFlag: accessed-variable=prrAlgo18_Flags.b8InterruptFlag  # ARCH_SW_BFS_0077
            DRP_prrAlgo14_b8TriggerFlag: accessed-variable=prrAlgo14_Flags.b8TriggerFlag  # ARCH_SW_BFS_0061
            DRP_prrAlgo16_b8TriggerFlag: accessed-variable=prrAlgo16_Flags.b8TriggerFlag  # ARCH_SW_BFS_0071
            DRP_prrAlgo09_b8TriggerFlag: accessed-variable=prrAlgo09_Flags.b8TriggerFlag  # ARCH_SW_BFS_0041
            DRP_prrAlgo08_b8TriggerFlag: accessed-variable=prrAlgo08_Flags.b8TriggerFlag  # ARCH_SW_BFS_0028
            DRP_prrAlgo18_b8TriggerFlag: accessed-variable=prrAlgo18_Flags.b8TriggerFlag  # ARCH_SW_BFS_0073
            DRP_prrAlgo22_InterruptFlag: accessed-variable=prrAlgo22_Flags.b8InterruptFlag
            DRP_prrAlgo03_b8TriggerFlag: accessed-variable=prrAlgo03_Flags.b8TriggerFlag  # ARCH_SW_BFS_0023
            DRP_prrAlgo16_InterruptFlag: accessed-variable=prrAlgo16_Flags.b8InterruptFlag  # ARCH_SW_BFS_0075
            DRP_prrAlgo08_InterruptFlag: accessed-variable=prrAlgo08_Flags.b8InterruptFlag  # ARCH_SW_BFS_0038
        data-send-points:
          access DSP_psrSelect_u8CycleNumber: accessed-variable=psrSelectedCycle.u8CycleNumber  # ARCH_SW_BFS_0091
  swc implementation BFS_impBeltFunctionSelection: programming-language=C, sw-version=1.0.0, vendor-id=0, behavior=BFS_IB_BeltFunctionSelection
    code-descriptors:
      code BFS_Impl_Code: artifact-descriptors=autosar-engineering-object={short-label=BFS_Impl_Code_CodeDesc, category=SWSRC}
    resource consumption BFS_Impl_ResCons
      memory section CODE: size=0, sw-addrmethod=CODE
      memory section VAR_INIT_UNSPECIFIED: alignment=UNSPECIFIED, size=0, sw-addrmethod=VAR_INIT
      memory section VAR_UNSPECIFIED: alignment=UNSPECIFIED, size=0, sw-addrmethod=VAR_ALV
