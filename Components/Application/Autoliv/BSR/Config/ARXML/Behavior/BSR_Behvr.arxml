AUTOSAR XML (schema 4-2-2)
package /AUTOLIV/SoftwareComponents/BSR
  application sw component type BSR_AC_BeltSlackReduction: category=SWC
    behavior BSR_IB_BeltSlackReduction: constant-value-mapping=ConstantsMappingSet_PP4G, data-type-mapping=DataTypeMappingSet_PP4G, handle-termination-and-restart=NO-SUPPORT
      timing event BSR_evBeltSlackReductionAlgo: start-on-event=BSR_runBeltSlackReductionAlgo, period=0.01  # Periodical event to trig BSR runnable
      runnable BSR_runBeltSlackReductionAlgo
        data-receive-point-by-arguments:
          5 x access:
            DRP_prrBuckleDoorSwitch_u8BuckleSwitch: accessed-variable=prrBuckleDoorSwitch.u8BuckleSwitch
            DRP_prrCustomerSpecific_b8IsCarCrashDetected: accessed-variable=prrCustomerSpecific.b8IsCarCrashDetected
            DRP_prrCustomerSpecific_u8BeltSlackStatus: accessed-variable=prrCustomerSpecific.u8BeltSlackStatus
            DRP_prrDriverControls_u16VehicleSpeed: accessed-variable=prrDriverControls.u16VehicleSpeed
            DRP_prrExecutedCycle_u8CycleNumber: accessed-variable=prrExecutedCycle.u8CycleNumber
        data-send-points:
          5 x access:
            DSP_psrAlgo_Flags_BSR_b8InterruptFlag: accessed-variable=psrAlgo_Flags_BSR.b8InterruptFlag
            DSP_psrAlgo_Flags_BSR_b8PreActivationFlag: accessed-variable=psrAlgo_Flags_BSR.b8PreActivationFlag
            DSP_psrAlgo_Flags_BSR_b8PreConditionsFlag: accessed-variable=psrAlgo_Flags_BSR.b8PreConditionsFlag
            DSP_psrAlgo_Flags_BSR_b8TriggerFlag: accessed-variable=psrAlgo_Flags_BSR.b8TriggerFlag
            DSP_psrAlgo_Flags_BSR_u8TriggeringSource: accessed-variable=psrAlgo_Flags_BSR.u8TriggeringSource
        8 x sync call, all with timeout=0.0:
          SSCP_pclBelt_D_GetFromT0_deg: operation=pclBelt_D.GetFromT0_deg
          SSCP_pclDiagRequestCycle_ClearDiagRequestCycle: operation=pclDiagRequestCycle.ClearDiagRequestCycle
          SSCP_pclDiagRequestCycle_GetDiagRequestCycle: operation=pclDiagRequestCycle.GetDiagRequestCycle
          SSCP_pclModeManagement_CheckModeStatus: operation=pclModeManagement.CheckModeStatus
          SSCP_pclTestResult_GetTestResult: operation=pclAutotestServices.GetTestResult
          scp_GetEventStatus: operation=pclEvtInfoComfortEndOfLife.GetEventStatus
          scp_GetEventStatus1: operation=pclEvtInfoBatPwrOverVoltage.GetEventStatus
          scp_GetEventStatus2: operation=pclEvtInfoBatPwrUnderVoltageDuringTens.GetEventStatus
  swc implementation BSR_impBeltSlackReduction: programming-language=C, sw-version=1.0.0, vendor-id=0, behavior=BSR_IB_BeltSlackReduction
    code-descriptors:
      code BSR_Impl_Code: artifact-descriptors=autosar-engineering-object={short-label=BSR_Impl_Code_CodeDesc, category=SWSRC}
    resource consumption BSR_Impl_ResCons
      memory section CODE: size=0, sw-addrmethod=CODE
      memory section VAR_INIT_UNSPECIFIED: alignment=UNSPECIFIED, size=0, sw-addrmethod=VAR_INIT
      memory section VAR_UNSPECIFIED: alignment=UNSPECIFIED, size=0, sw-addrmethod=VAR_ALV
