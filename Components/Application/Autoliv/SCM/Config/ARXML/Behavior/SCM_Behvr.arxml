AUTOSAR XML (schema 4-2-2)
package /AUTOLIV/SoftwareComponents/SCM
  application sw component type SCM_AC_SystemContextManagement: category=SWC
    behavior SCM_IB_SystemContextManagement: constant-value-mapping=ConstantsMappingSet_PP4G, data-type-mapping=DataTypeMappingSet_PP4G, handle-termination-and-restart=NO-SUPPORT
      operation invoked event SCM_evGetKL30LostStatus: start-on-event=SCM_runGetLastKL30LostStatus, operation=pseSystemContextManagement.GetLastKL30LostStatus
      operation invoked event SCM_evGetLastTensioningState: start-on-event=SCM_runGetLastTensioningState, operation=pseSystemContextManagement.GetLastTensionningState
      operation invoked event SCM_evManageSystemContextStorage: start-on-event=SCM_runManageSystemContextStorage, operation=pseSystemContextManagement.ManageSystemContextStorage
      timing event SCM_evMonitoreExecutedCycle: start-on-event=SCM_runMonitoreExecutedCycle, period=0.01
      timing event SCM_evPeriodicEvent: start-on-event=SCM_runManageSystemContext, period=0.002
      operation invoked event SCM_evRestoreSystemContext: start-on-event=SCM_runRestoreSystemContext, operation=pseSystemContextManagement.RestoreSystemContext
      operation invoked event SCM_evSuperviseKL30bg: start-on-event=SCM_runKL30bgSupervision, operation=pseSystemContextManagement.SuperviseKL30bg
      explicit-inter-runnable-variables:
        data b8WasKL30Lost: step-size=0.0, sw-calibration-access=READ-ONLY, type=b8BooleanType_Appl, init-value=constant-reference=APPLINIT_KB8_BOOLEAN_FALSE
        data u8CurrentTensioningState: step-size=0.0, sw-calibration-access=READ-ONLY, type=u8CycleNumberType_Appl, init-value=constant-reference=APPLINIT_KU8_CYCLE_NUMBER_NONE
        data u8LastTensioningSituation: step-size=0.0, sw-calibration-access=READ-ONLY, type=u8CycleNumberType_Appl, init-value=constant-reference=APPLINIT_KU8_CYCLE_NUMBER_NONE
      7 x runnable:
        SCM_runGetLastKL30LostStatus: sw-addr-method=CODE, can-be-invoked-concurrently=true
          read-local-variables:
            access b8WasKL30Lost: accessed-variable=b8WasKL30Lost
        SCM_runGetLastTensioningState: sw-addr-method=CODE, can-be-invoked-concurrently=true
          read-local-variables:
            access u8LastTensioningSituation: accessed-variable=u8LastTensioningSituation
        SCM_runKL30bgSupervision: sw-addr-method=CODE, can-be-invoked-concurrently=true
        SCM_runManageSystemContext: sw-addr-method=CODE, can-be-invoked-concurrently=true
          data-receive-point-by-arguments:
            22 x access:
              DRP_prrAlgo{01..21}_Flags_b8InterruptFlag: accessed-variable=prrAlgo{01..21}_Flags.b8InterruptFlag
              DRP_prrExecutedCycle_u8CycleNumber: accessed-variable=prrExecutedCycle.u8CycleNumber
          read-local-variables:
            access rd_u8CurrentTensioningState: accessed-variable=u8CurrentTensioningState
          10 x sync call, all with timeout=0.0:
            SSCP_pclMoto_T_GetDeficiencyLevel: operation=pclMoto_T.GetDeficiencyLevel
            SSCP_pclSystemTime_ReadAbsoluteSystemTime: operation=pclSystemTime.ReadAbsoluteSystemTime
            scp_EraseBlock: operation=pclNvmServicesSystemContext0.EraseBlock
            scp_EraseBlock1: operation=pclNvmServicesSystemContext1.EraseBlock
            scp_EraseBlock2: operation=pclNvmServicesSystemContext2.EraseBlock
            scp_GetBlockStatus: operation=pclNvmIfServices.GetNvmBlockStatus
            scp_GetEventStatus: operation=pclEvtInfoSwSelfProtection.GetEventStatus
            scp_WriteBlock: operation=pclNvmServicesSystemContext0.WriteBlock
            scp_WriteBlock1: operation=pclNvmServicesSystemContext1.WriteBlock
            scp_WriteBlock2: operation=pclNvmServicesSystemContext2.WriteBlock
          written-local-variables:
            access wr_u8CurrentTensioningState: accessed-variable=u8CurrentTensioningState
        SCM_runManageSystemContextStorage: sw-addr-method=CODE, can-be-invoked-concurrently=true
          sync call scp_WriteBlock: operation=pclNvmServicesSystemContext0.WriteBlock, timeout=0.0
          sync call scp_WriteBlock1: operation=pclNvmServicesSystemContext1.WriteBlock, timeout=0.0
          sync call scp_WriteBlock2: operation=pclNvmServicesSystemContext2.WriteBlock, timeout=0.0
        SCM_runMonitoreExecutedCycle
        SCM_runRestoreSystemContext: sw-addr-method=CODE, can-be-invoked-concurrently=true
          14 x sync call, all with timeout=0.0:
            SSCP_pclMoto_T_InitializeDeficiencyLevel: operation=pclMoto_T.InitializeDeficiencyLevel
            SSCP_pclResetCauseNotification_NotifyResetCause: operation=pclResetCauseNotification.NotifyResetCause
            SSCP_pclResetCause_GetResetCause: operation=pclResetCause.GetResetCause
            SSCP_pclSystemTime_WriteAbsoluteSystemTime: operation=pclSystemTime.WriteAbsoluteSystemTime
            SSCP_pclSystemTime_WriteRelativeSystemTime: operation=pclSystemTime.WriteRelativeSystemTime
            scp_EraseBlock: operation=pclNvmServicesSystemContext0.EraseBlock
            scp_EraseBlock1: operation=pclNvmServicesSystemContext1.EraseBlock
            scp_EraseBlock2: operation=pclNvmServicesSystemContext2.EraseBlock
            scp_GetBlockStatus: operation=pclNvmIfServices.GetNvmBlockStatus
            scp_ReadBlock: operation=pclNvmServicesSystemContext0.ReadBlock
            scp_ReadBlock1: operation=pclNvmServicesSystemContext1.ReadBlock
            scp_ReadBlock2: operation=pclNvmServicesSystemContext2.ReadBlock
            scp_SetEventStatus: operation=pclEvtSwSelfProtection.SetEventStatus
            scp_SynchronousRecord: operation=pclNvmIfServices.SynchronousRecord
          written-local-variables:
            access b8WasKL30Lost: accessed-variable=b8WasKL30Lost
            access u8LastTensioningSituation: accessed-variable=u8LastTensioningSituation
  swc implementation SCM_impSystemContextManagement: programming-language=C, sw-version=1.0.0, vendor-id=0, behavior=SCM_IB_SystemContextManagement
    code-descriptors:
      code SCM_Impl_Code: artifact-descriptors=autosar-engineering-object={short-label=SCM_Impl_Code_CodeDesc, category=SWSRC}
    resource consumption SCM_Impl_ResCons
      9 x memory section, all with size=0:
        CODE: sw-addrmethod=CODE
        CONST_8: alignment=8, sw-addrmethod=CONST
        CONST_UNSPECIFIED: alignment=UNSPECIFIED, sw-addrmethod=CONST
        VAR_8: alignment=8, sw-addrmethod=VAR_ALV
        VAR_INIT_16: alignment=16, sw-addrmethod=VAR_INIT
        VAR_INIT_32: alignment=32, sw-addrmethod=VAR_INIT
        VAR_INIT_8: alignment=8, sw-addrmethod=VAR_INIT
        VAR_NO_INIT_8: alignment=8, sw-addrmethod=VAR_NO_INIT
        VAR_UNSPECIFIED: alignment=UNSPECIFIED, sw-addrmethod=VAR_ALV
