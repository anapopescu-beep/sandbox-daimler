AUTOSAR XML (schema 4-2-2)
package /AUTOLIV/SoftwareComponents/RCM
  complex device driver sw component type RCM_AC_ResetCauseManagement: category=MCAL
    behavior RCM_IB_ResetCauseManagement: constant-value-mapping=ConstantsMappingSet_PP4G, data-type-mapping=DataTypeMappingSet_PP4G, handle-termination-and-restart=NO-SUPPORT, port-api-option{enable-take-address=false, indirect-api=false, port=pseResetCause}
      5 x operation invoked event:
        RCM_evConfirmResetCause: start-on-event=RCM_runConfirmResetCause, operation=pseResetCause.ConfirmResetCause
        RCM_evDetermineResetCause: start-on-event=RCM_runDetermineResetCause, operation=pseResetCause.DetermineResetCause
        RCM_evGetResetCause: start-on-event=RCM_runGetResetCause, operation=pseResetCause.GetResetCause
        RCM_evNotifyResetCause: start-on-event=RCM_runNotifyResetCause, operation=pseResetCauseNotification.NotifyResetCause
        oie_pseRunresetCause_AutotestCallback: start-on-event=RCM_Autotest_RunResetCause, operation=pseRunResetCause.AutotestCallback
      explicit-inter-runnable-variables:
        data u8ResetCause: step-size=0.0, sw-calibration-access=READ-ONLY, type=u32ResetCauseType_Appl, init-value=constant-reference=APPLINIT_KU32_RESET_CAUSE_UNKNOWN  # Reset cause computed by the RCM component
      5 x runnable, all with sw-addr-method=CODE, can-be-invoked-concurrently=true:
        RCM_Autotest_RunResetCause
        RCM_runConfirmResetCause  # To confirm the computed reset cause based on some restored information
          read-local-variables:
            access rd_u8ResetCause: accessed-variable=u8ResetCause
          sync call SSCP_pclStartupSystemContext_GetLastKL30LostStatus: operation=pclStartupSystemContext.GetLastKL30LostStatus, timeout=0.0
          sync call scp_SetRamBlockStatus: operation=pclNvmServicesWarmReset.SetRamBlockStatus, timeout=0.0
          written-local-variables:
            access wr_u8ResetCause: accessed-variable=u8ResetCause
        RCM_runDetermineResetCause  # To determine the reset cause
        RCM_runGetResetCause
          read-local-variables:
            access u8ResetCause: accessed-variable=u8ResetCause
        RCM_runNotifyResetCause  # this function give sthe possibility to the rest of the SW application to store in protected memory section that a reset will be performed
  swc implementation RCM_impResetCauseManagement: programming-language=C, sw-version=1.0.0, vendor-id=0, behavior=RCM_IB_ResetCauseManagement
    code-descriptors:
      code RCM_Impl_Code: artifact-descriptors=autosar-engineering-object={short-label=RCM_Impl_Code_CodeDesc, category=SWSRC}
    resource consumption RCM_Impl_ResCons
      4 x memory section, all with size=0:
        CODE: sw-addrmethod=CODE
        VAR_INIT_32: alignment=32, sw-addrmethod=VAR_INIT
        VAR_INIT_8: alignment=8, sw-addrmethod=VAR_INIT
        VAR_NO_INIT_8: alignment=8, sw-addrmethod=VAR_NO_INIT
