AUTOSAR XML (schema 4-2-2)
package /AUTOLIV/SoftwareComponents/HWA
  application sw component type HWA_AC_HapticWarning: category=SWC
    behavior HWA_IB_HapticWarning: constant-value-mapping=ConstantsMappingSet_PP4G, data-type-mapping=DataTypeMappingSet_PP4G, handle-termination-and-restart=NO-SUPPORT
      timing event HWA_evMainFunction: start-on-event=HWA_runMainFunction, period=0.01
      runnable HWA_runMainFunction
        data-receive-point-by-arguments:
          5 x access:
            DRP_prrCustomerSpecific_u8HapticRequest: accessed-variable=prrCustomerSpecific.u8HapticRequest
            DRP_prrBuckleDoorSwitch_u8BuckleSwitch: accessed-variable=prrBuckleDoorSwitch.u8BuckleSwitch
            DRP_prrCustomerSpecific_b8IsCarCrashDetected: accessed-variable=prrCustomerSpecific.b8IsCarCrashDetected
            DRP_prrExecutedCycle_u8CycleNumber: accessed-variable=prrExecutedCycle.u8CycleNumber
            DRP_prrCustomerSpecific_b8IsCarCrankingActive: accessed-variable=prrCustomerSpecific.b8IsCarCrankingActive
        data-send-points:
          10 x access:
            DSP_psrAlgo_Flags_HWA1_b8PreConditionsFlag: accessed-variable=psrAlgo_Flags_HWA1.b8PreConditionsFlag
            DSP_psrAlgo_Flags_HWA1_b8InterruptFlag: accessed-variable=psrAlgo_Flags_HWA1.b8InterruptFlag
            DSP_psrAlgo_Flags_HWA1_b8TriggerFlag: accessed-variable=psrAlgo_Flags_HWA1.b8TriggerFlag
            DSP_psrAlgo_Flags_HWA0_b8PreActivationFlag: accessed-variable=psrAlgo_Flags_HWA0.b8PreActivationFlag
            DSP_psrAlgo_Flags_HWA1_u8TriggeringSource: accessed-variable=psrAlgo_Flags_HWA1.u8TriggeringSource
            DSP_psrAlgo_Flags_HWA0_b8TriggerFlag: accessed-variable=psrAlgo_Flags_HWA0.b8TriggerFlag
            DSP_psrAlgo_Flags_HWA1_b8PreActivationFlag: accessed-variable=psrAlgo_Flags_HWA1.b8PreActivationFlag
            DSP_psrAlgo_Flags_HWA0_b8InterruptFlag: accessed-variable=psrAlgo_Flags_HWA0.b8InterruptFlag
            DSP_psrAlgo_Flags_HWA0_u8TriggeringSource: accessed-variable=psrAlgo_Flags_HWA0.u8TriggeringSource
            DSP_psrAlgo_Flags_HWA0_b8PreConditionsFlag: accessed-variable=psrAlgo_Flags_HWA0.b8PreConditionsFlag
        7 x sync call, all with timeout=0.0:
          SSCP_pclDiagRequestCycle_GetDiagRequestCycle: operation=pclDiagRequestCycle.GetDiagRequestCycle
          SSCP_pclModeManagement_CheckModeStatus: operation=pclModeManagement.CheckModeStatus
          SSCP_pclDiagRequestCycle_ClearDiagRequestCycle: operation=pclDiagRequestCycle.ClearDiagRequestCycle
          SSCP_pclTestResult_GetTestResult: operation=pclAutotestServices.GetTestResult
          scp_GetEventStatus: operation=pclEvtInfoBatPwrOverVoltage.GetEventStatus
          scp_GetEventStatus1: operation=pclEvtInfoBatPwrUnderVoltageDuringTens.GetEventStatus
          scp_GetEventStatus2: operation=pclEvtInfoHapticWarningEndOfLife.GetEventStatus
  swc implementation HWA_impHapticWarning: programming-language=C, sw-version=1.0.0, vendor-id=0, behavior=HWA_IB_HapticWarning
    code-descriptors:
      code HWA_Impl_Code: artifact-descriptors=autosar-engineering-object={short-label=HWA_Impl_Code_CodeDesc, category=SWSRC}
    resource consumption HWA_Impl_ResCons
      memory section CODE: size=0, sw-addrmethod=CODE
      memory section VAR_INIT_UNSPECIFIED: alignment=UNSPECIFIED, size=0, sw-addrmethod=VAR_INIT
      memory section VAR_UNSPECIFIED: alignment=UNSPECIFIED, size=0, sw-addrmethod=VAR_ALV
