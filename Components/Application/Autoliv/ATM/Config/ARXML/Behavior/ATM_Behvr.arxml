AUTOSAR XML (schema 4-2-2)
package /AUTOLIV/SoftwareComponents/ATM
  application sw component type ATM_AC_AutoTestManager: category=SWC
    behavior ATM_IB_AutoTestManager: constant-value-mapping=ConstantsMappingSet_PP4G, data-type-mapping=DataTypeMappingSet_PP4G, handle-termination-and-restart=NO-SUPPORT
      operation invoked event ATM_evGetLastCriticalAutotestId: start-on-event=ATM_runGetLastCriticalAutotestId, operation=pseAutotestServices.GetLastCriticalAutotestID
      operation invoked event ATM_evGetTestResult: start-on-event=ATM_runGetTestResult, operation=pseAutotestServices.GetTestResult
      timing event ATM_evMainFunction: start-on-event=ATM_runMainFunction, period=0.002
      4 x runnable, all with sw-addr-method=CODE:
        ATM_Init
        ATM_runGetLastCriticalAutotestId: can-be-invoked-concurrently=true
        ATM_runGetTestResult: can-be-invoked-concurrently=true
        ATM_runMainFunction
          73 x sync call, all with timeout=0.0:
            SSCP_pclAcknowledgeEccError_AcknowledgeEccError: operation=pclAcknowledgeEccError.AcknowledgeEccError
            SSCP_pclGetEccErrorStatus_GetEccError: operation=pclGetEccErrorStatus.GetEccError
            SSCP_pclModeManagement_CheckModeStatus: operation=pclModeManagement.CheckModeStatus
            scp_AutotestCallback: operation=pclCheckAdc.AutotestCallback
            scp_AutotestCallback1: operation=pclRunResetCause.AutotestCallback
            scp_AutotestCallback10: operation=pclCheckPreliminaryBoost.AutotestCallback
            scp_AutotestCallback11: operation=pclCheckVBoost.AutotestCallback
            scp_AutotestCallback12: operation=pclCheckMotorCurrent.AutotestCallback
            scp_AutotestCallback13: operation=pclCheckMotorDisengagement.AutotestCallback
            scp_AutotestCallback14: operation=pclCheckMotorThermalProctection.AutotestCallback
            scp_AutotestCallback15: operation=pclCheckMotorSC.AutotestCallback
            scp_AutotestCallback16: operation=pclCheckMotorPowerOrder.AutotestCallback
            scp_AutotestCallback17: operation=pclCheckBatterySurvey.AutotestCallback
            scp_AutotestCallback18: operation=pclCheckMotorConnection.AutotestCallback
            scp_AutotestCallback19: operation=pclRunPFlashMemoryCorruption.AutotestCallback
            scp_AutotestCallback2: operation=pclRunEepromMemoryCorruption.AutotestCallback
            scp_AutotestCallback20: operation=pclRunRamMemoryCorruption.AutotestCallback
            scp_AutotestCallback21: operation=pclRunTFlashMemoryCorruption.AutotestCallback
            scp_AutotestCallback22: operation=pclCheckHallEffectSensor.AutotestCallback
            scp_AutotestCallback23: operation=pclCheckTemperatureSensor.AutotestCallback
            scp_AutotestCallback24: operation=pclCheckPowerSupplyUV.AutotestCallback
            scp_AutotestCallback25: operation=pclCheckPowerSupplyUVDuringActivation.AutotestCallback
            scp_AutotestCallback26: operation=pclCheckLogicalSupplyOV.AutotestCallback
            scp_AutotestCallback27: operation=pclCheckLogicalSupplyUV.AutotestCallback
            scp_AutotestCallback28: operation=pclCheckLogicalSupplyImplausible.AutotestCallback
            scp_AutotestCallback29: operation=pclCheckProductEndOfLifeLowForce.AutotestCallback
            scp_AutotestCallback3: operation=pclRunEepromMemoryNotProgrammed.AutotestCallback
            scp_AutotestCallback30: operation=pclCheckProductEndOfLifeHighForce.AutotestCallback
            scp_AutotestCallback31: operation=pclCheckProductEndOfLifeComfort.AutotestCallback
            scp_AutotestCallback32: operation=pclCheckProductEndOfLifeHapticWarning.AutotestCallback
            scp_AutotestCallback33: operation=pclCheckPowerSupplyOV.AutotestCallback
            scp_AutotestCallback34: operation=pclCheckAdcCalib.AutotestCallback
            scp_AutotestCallback4: operation=pclCheckHighSideSwRegulation.AutotestCallback
            scp_AutotestCallback5: operation=pclCheckCommandConsistency.AutotestCallback
            scp_AutotestCallback6: operation=pclCheckMosfetHighSC.AutotestCallback
            scp_AutotestCallback7: operation=pclCheckMosfetLowSC.AutotestCallback
            scp_AutotestCallback8: operation=pclCheckHWSelfProtection.AutotestCallback
            scp_AutotestCallback9: operation=pclCheckMosfetOCAT.AutotestCallback
            scp_SetEventStatus: operation=pclEvtAdcOutOfOrder.SetEventStatus
            scp_SetEventStatus1: operation=pclEvtHighSideSwitch.SetEventStatus
            scp_SetEventStatus10: operation=pclEvtHallSensor.SetEventStatus
            scp_SetEventStatus11: operation=pclEvtMotorCurrent.SetEventStatus
            scp_SetEventStatus12: operation=pclEvtMotorBlocked.SetEventStatus
            scp_SetEventStatus13: operation=pclEvtSwSelfProtection.SetEventStatus
            scp_SetEventStatus14: operation=pclEvtTemperatureSensorFailure.SetEventStatus
            scp_SetEventStatus15: operation=pclEvtMotorInSc.SetEventStatus
            scp_SetEventStatus16: operation=pclEvtBatPwrOverVoltage.SetEventStatus
            scp_SetEventStatus17: operation=pclEvtBatPwrUnderVoltage.SetEventStatus
            scp_SetEventStatus18: operation=pclEvtBatPwrUnderVoltageDuringTens.SetEventStatus
            scp_SetEventStatus19: operation=pclEvtBatLogOverVoltage.SetEventStatus
            scp_SetEventStatus2: operation=pclEvtEnableOutOfOrder.SetEventStatus
            scp_SetEventStatus20: operation=pclEvtBatLogUnderVoltage.SetEventStatus
            scp_SetEventStatus21: operation=pclEvtBatLogImplausible.SetEventStatus
            scp_SetEventStatus22: operation=pclEvtNvmNotPrg.SetEventStatus
            scp_SetEventStatus23: operation=pclEvtExtWdgOutOfOrder.SetEventStatus
            scp_SetEventStatus24: operation=pclEvtWarmReset.SetEventStatus
            scp_SetEventStatus25: operation=pclEvtLowForceEndOfLife.SetEventStatus
            scp_SetEventStatus26: operation=pclEvtComfortEndOfLife.SetEventStatus
            scp_SetEventStatus27: operation=pclEvtHapticWarningEndOfLife.SetEventStatus
            scp_SetEventStatus28: operation=pclEvtAdcCalibration.SetEventStatus
            scp_SetEventStatus29: operation=pclEvtBatterySurvey.SetEventStatus
            scp_SetEventStatus3: operation=pclEvtMosfetHighSc.SetEventStatus
            scp_SetEventStatus30: operation=pclEvtHighForceEndOfLife.SetEventStatus
            scp_SetEventStatus31: operation=pclEvtRamEcc.SetEventStatus
            scp_SetEventStatus32: operation=pclEvtNvmEcc.SetEventStatus
            scp_SetEventStatus33: operation=pclEvtFlsEcc.SetEventStatus
            scp_SetEventStatus34: operation=pclEvtMotorOrder.SetEventStatus
            scp_SetEventStatus4: operation=pclEvtMosfetLowSc.SetEventStatus
            scp_SetEventStatus5: operation=pclEvtMotorDisconnected.SetEventStatus
            scp_SetEventStatus6: operation=pclEvtHwSelfProtection.SetEventStatus
            scp_SetEventStatus7: operation=pclEvtMosfetOc.SetEventStatus
            scp_SetEventStatus8: operation=pclEvtPreliminaryBooster.SetEventStatus
            scp_SetEventStatus9: operation=pclEvtPowerBooster.SetEventStatus
  swc implementation ATM_impAutoTestManager: programming-language=C, sw-version=1.0.0, vendor-id=0, behavior=ATM_IB_AutoTestManager
    code-descriptors:
      code ATM_Impl_Code: artifact-descriptors=autosar-engineering-object={short-label=ATM_Impl_Code_CodeDesc, category=SWSRC}
    resource consumption ATM_Impl_ResCons
      5 x memory section, all with size=0:
        CODE: sw-addrmethod=CODE
        CONST_UNSPECIFIED: alignment=UNSPECIFIED, sw-addrmethod=CONST
        VAR_16: alignment=16, sw-addrmethod=VAR_ALV
        VAR_8: alignment=8, sw-addrmethod=VAR_ALV
        VAR_INIT_16: alignment=16, sw-addrmethod=VAR_INIT
