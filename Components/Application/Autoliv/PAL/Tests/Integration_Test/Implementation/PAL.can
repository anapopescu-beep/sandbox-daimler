/*@!Encoding:1252*/
includes
{
  #include "S:\Tools\CANoe\Config\DAIMLER_MMA_INTEGRATION\Includes\WinIdea_Includes\Project_functions.cin"
  #include "S:\Tools\CANoe\Config\DAIMLER_MMA_INTEGRATION\Includes\WinIdea_Includes\Debugger_Functions.cin"
  #include "S:\Tools\CANoe\Config\DAIMLER_MMA_INTEGRATION\Includes\WinIdea_Includes\Debugger_Defines.cin"
}


variables
{
  byte bWriteStepsLibraryRequest[3] = {0x2E, 0xFD, 0x2A};
}


testcase InitTestModule()
{
  ConfigureTestModuleInformation();
  
  strncpy(cLogPathAndName, "S:\\Tools\\CANoe\\Config\\DAIMLER_MMA_INTEGRATION\\Logs\\PAL\\",  elcount(cLogPathAndName));
}


testcase SW_Int_PAL_ComponentInit_01()
{
  //***********************************Test report header*********************************
  testReportAddMiscInfoBlock("AUTOLIV ELECTRONICS document");
  TestReportAddMiscInfo("Nightly test", "No");
  TestReportAddMiscInfo("Test type", "Requirement-Based test");
  TestReportAddMiscInfo("Regression Test", "Yes");
  TestReportAddMiscInfo("Fault injection method used", "No");
  TestReportAddMiscInfo("Resource usage evaluation", "No");
  TestReportAddMiscInfo("Priority", "No");
  TestReportAddMiscInfo("Safety relevant", "No");
  
  AddRequirementInfo("Requirement under test", "ARCH_SW_PAL_0010");
  AddRequirementInfo("ARCH_SW_PAL_0010", "Check if the component is initialized.");
  //***************************************************************************************

  testCaseComment("Preconditions");
  testStep("STEP", "Bench Initialization");
  
  testStep("", "Delete all breakpoint from debugger.");
  debugger_deleteAllBreakpoints();
  
  testStep("STEP", "Reset the debugger.");
  debugger_reset();
  
  testStep("STEP", "Run the debugger.");
  debugger_run();
  
  RunPreTs();
  //====================================================
  
    /*********************  STEP 1  **************************/
    testStep("STEP", "Set a breakpoint in function PAL_Init().");
    debugger_setRelativeFunctionBpAtLine("PAL_Init", "8");
    /*********************************************************/
    
    testStep("", "Reset the debugger.");
    debugger_reset();
  
    testStep("", "Run the debugger.");
    debugger_run();
    testWaitForTimeout(500);
    
    /*********************  STEP 2  **************************/
    testCaseComment("Action: ARCH_SW_PAL_0010");
    testStep("STEP", "Check if CPU has stopped in function PAL_Init(). -->  BP reached");
    debugger_getCPUStatus();
    ExpectedTestResult(debugger_result, "CPU is Stopped", "CPU is Stopped.");
    /*********************************************************/
  
  //====================================================
  testCaseComment("Postcondition");
  testStep("STEP", "Return ECU to default values");
  RunPostTs();
}

testcase SW_Int_PAL_runMainFunction_01()
{
  //***********************************Test report header*********************************
  testReportAddMiscInfoBlock("AUTOLIV ELECTRONICS document");
  TestReportAddMiscInfo("Nightly test", "No");
  TestReportAddMiscInfo("Test type", "Requirement-Based test");
  TestReportAddMiscInfo("Regression Test", "Yes");
  TestReportAddMiscInfo("Fault injection method used", "No");
  TestReportAddMiscInfo("Resource usage evaluation", "No");
  TestReportAddMiscInfo("Priority", "No");
  TestReportAddMiscInfo("Safety relevant", "No");
  
  AddRequirementInfo("Requirement under test", "ARCH_SW_PAL_0450, ARCH_SW_PAL_0456, ARCH_SW_PAL_0457");
  AddRequirementInfo("ARCH_SW_PAL_0450", "The component shall have a main function.");
  AddRequirementInfo("ARCH_SW_PAL_0456", "The PAL_runMainFunction function shall allow the application to switch to the OFF_MODE if a Shut Down is requested or if a critical autotest has failed during startup.");
  AddRequirementInfo("ARCH_SW_PAL_0457", "The PAL_runMainFunction function shall allow the application to enable control for autotest for motor command.");
  //***************************************************************************************

  testCaseComment("Preconditions");
  testStep("STEP", "Bench Initialization");
    
  testStep("", "Delete all breakpoints from debugger.");
  debugger_deleteAllBreakpoints();
  
  testStep("STEP", "Reset the debugger.");
  debugger_reset();
  
  testStep("STEP", "Run the debugger.");
  debugger_run();
  
  RunPreTs();
  //====================================================

    /*********************  STEP 1  **************************/
    testStep("STEP", "Set a breakpoint in function PAL_runMainFunction().");
    debugger_setRelativeFunctionBpAtLine("PAL_runMainFunction", "0");
    /*********************************************************/
    
    testStep("", "Reset the debugger.");
    debugger_reset();
  
    testStep("", "Run the debugger.");
    debugger_run();
    
    /*********************  STEP 2  **************************/
    testCaseComment("Action: ARCH_SW_PAL_0450, ARCH_SW_PAL_0456, ARCH_SW_PAL_0457");
    testStep("STEP", "Check if CPU has stopped in function PAL_runMainFunction(). --> True");
    debugger_getCPUStatus();
    ExpectedTestResult(debugger_result, "CPU is Stopped", "CPU is Stopped.");
    /*********************************************************/
    
  //====================================================
  testCaseComment("Postcondition");
  testStep("STEP", "Return ECU to default values");
  RunPostTs();
}

testcase SW_Int_PAL_checkPowerSupply_01()
{ 
  //***********************************Test report header*********************************
  testReportAddMiscInfoBlock("AUTOLIV ELECTRONICS document");
  TestReportAddMiscInfo("Nightly test", "No");
  TestReportAddMiscInfo("Test type", "Requirement-Based test");
  TestReportAddMiscInfo("Regression Test", "Yes");
  TestReportAddMiscInfo("Fault injection method used", "No");
  TestReportAddMiscInfo("Resource usage evaluation", "No");
  TestReportAddMiscInfo("Priority", "No");
  TestReportAddMiscInfo("Safety relevant", "No");

  AddRequirementInfo("Requirement under test", "ARCH_SW_PAL_0070, ARCH_SW_PAL_0075, ARCH_SW_PAL_0076");
  AddRequirementInfo("ARCH_SW_PAL_0070", "The component shall be able to set the power state to IDLE.");
  AddRequirementInfo("ARCH_SW_PAL_0075", "The component shall be able to deactivate the half bridge connected to the Vp pin of the motor.");
  AddRequirementInfo("ARCH_SW_PAL_0076", "The component shall be able to deactivate the half bridge connected to the Vn pin of the motor.");
  //***************************************************************************************

  testCaseComment("Preconditions");
  testStep("STEP", "Bench Initialization");
  
  testStep("", "Delete all breakpoints from debugger.");
  debugger_deleteAllBreakpoints();
  
  testStep("", "Reset the debugger.");
  debugger_reset();
  
  testStep("STEP", "Run the debugger.");
  debugger_run();

  RunPreTs();
  //====================================================

    /*********************  STEP 1  **************************/
    testStep("STEP", "Set a breakpoint in function ATM_runMainFunction() at line atm_PlayCyclicTests(castStartupCyclicList);.");
    debugger_setRelativeFunctionBpAtLine("ATM_runMainFunction", "19");

    testStep("", "Run the debugger.");
    debugger_run();

    testStep("STEP", "Step in atm_PlayCyclicTests().");
    debugger_stepIn();
    /*********************************************************/


    /*********************  STEP 2  **************************/
    debugger_deleteAllBreakpoints();
    testStep("STEP", "Set a breakpoint in function atm_PlayCyclicTests() at line if (B_TRUE == isAutoTestEnabled(u8AutotestID)).");
    debugger_setRelativeFunctionBpAtLine("atm_PlayCyclicTests", "9");
    
    testStep("", "Run the debugger.");
    debugger_run();
    /*********************************************************/
    
    
    /*********************  STEP 3  **************************/
    testStep("STEP", "Set u8AutotestID variable to 1.");
    debugger_writeLocalVariable("u8AutotestID", "1");
    /*********************************************************/


    /*********************  STEP 4  **************************/ 
    debugger_deleteAllBreakpoints();
    testStep("STEP", "Set a breakpoint in function executeAutoTest() at line u8InhibModesIndex = castATMConfig[cu8AutotestID].u8InhibIndex;.");
    debugger_setRelativeFunctionBpAtLine("atm_executeAutoTest", "0");
//    debugger_setBreakPointAtLine(198, "s:\\Components\\Application\\Autoliv\\ATM\\Implementation\\src\\ATM.c");    
    
    debugger_waitUntilBPisReached("1000");
    debugger_run();
    /*********************************************************/
    
    
    /*********************  STEP 5  **************************/ 
    debugger_deleteAllBreakpoints();
    testStep("STEP", "Set a breakpoint in function PAL_cbk_CheckHighSideSwRegulation().");
    debugger_setRelativeFunctionBpAtLine("PAL_cbk_CheckHighSideSwRegulation", "4");
    
    debugger_run();
    testWaitForTimeout(500);

    testStep("", "Step in PAL_Autotest_CheckHighSideSwRegulation().");
    debugger_stepIn();
    /*********************************************************/
    
    
    /*********************  STEP 6  **************************/    
    debugger_deleteAllBreakpoints();
    testStep("STEP", "Set a breakpoint in function PAL_Autotest_CheckHighSideSwRegulation().");
    debugger_setRelativeFunctionBpAtLine("PAL_Autotest_CheckHighSideSwRegulation", "23"); // 51 15

    debugger_run();
    
    testCaseComment("Action: ARCH_SW_PAL_0070");
    testStep("STEP", "Check if CPU stopped in function PAL_Autotest_CheckHighSideSwRegulation() at line case PAL_KU8_HIGH_SIDE_SW_REG_INIT:. --> True");
    debugger_getCPUStatus();
ExpectedTestResult(debugger_result, IS_CPU_STOP_AT_BP_SUCCESFUL, "CPU is Stopped.");
    /*********************************************************/
    
    
    /*********************  STEP 7  **************************/
    debugger_deleteAllBreakpoints();
    testStep("STEP", "Set a breakpoint in function PAL_DisablePowerStage().");
    debugger_setRelativeFunctionBpAtLine("PAL_DisablePowerStage", "0");

    testStep("", "Reset the debugger.");
    debugger_reset();
  
    testStep("", "Run the debugger.");
    debugger_run();
    testWaitForTimeout(500);

    PowerOff();
  
    testCaseComment("Action: ARCH_SW_PAL_0075, ARCH_SW_PAL_0076"); 
    testStep("STEP", "Check if CPU stopped in function PAL_DisablePowerStage at line Dio_WriteChannel (PAL_kstHardWareTopology.astHBridgeDef[PAL_CFG_KU8_HB_P_ID].u16DriveEnableDioId,(uint8)STD_LOW).  --> True");
    debugger_waitUntilBPisReached("5000");
    ExpectedTestResult(debugger_result, IS_CPU_STOP_AT_BP_SUCCESFUL, "Breakpoint was reached.");
    /*********************************************************/
  
  //====================================================
  testCaseComment("Postcondition");
  testStep("STEP", "Return ECU to default values");
  RunPostTs();
}

testcase SW_Int_PAL_HardwareInit_02()
{
  //***********************************Test report header*********************************
  testReportAddMiscInfoBlock("AUTOLIV ELECTRONICS document");
  TestReportAddMiscInfo("Nightly test", "No");
  TestReportAddMiscInfo("Test type", "Requirement-Based test");
  TestReportAddMiscInfo("Regression Test", "Yes");
  TestReportAddMiscInfo("Fault injection method used", "No");
  TestReportAddMiscInfo("Resource usage evaluation", "No");
  TestReportAddMiscInfo("Priority", "No");
  TestReportAddMiscInfo("Safety relevant", "No");
  
  AddRequirementInfo("Requirement under test", "ARCH_SW_PAL_0090, ARCH_SW_PAL_0095, ARCH_SW_PAL_0110");
  AddRequirementInfo("ARCH_SW_PAL_0090", "The component shall be able to init the hardware.");
  AddRequirementInfo("ARCH_SW_PAL_0095", "The component shall be able to disable the H-bridge at startup.");
  AddRequirementInfo("ARCH_SW_PAL_0110", "The component shall initialize the auto tests data.");
  //***************************************************************************************

  testCaseComment("Preconditions");
  testStep("STEP", "Bench Initialization");
      
  testStep("", "Delete all breakpoint from debugger.");
  debugger_deleteAllBreakpoints();
  
  testStep("STEP", "Reset the debugger.");
  debugger_reset();
  
  testStep("STEP", "Run the debugger.");
  debugger_run();

  RunPreTs();
  //====================================================

    /*********************  STEP 1  **************************/
    testStep("STEP", "Set a breakpoint in function PAL_Init at line pal_Cfg_Init (); .");
    debugger_setRelativeFunctionBpAtLine("PAL_Init", "8");
    debugger_waitUntilBPisReached("1000");
    /*********************************************************/
  
    testStep("", "Reset the debugger.");
    debugger_reset();
    
    testStep("", "Run the debugger.");
    debugger_run();
    testWaitForTimeout(500);

    /*********************  STEP 2  **************************/ 
    testCaseComment("Action: ARCH_SW_PAL_0090");
    testStep("STEP", "Check if CPU stopped in function PAL_Init at line pal_Cfg_Init ();. --> BP reached.");
    debugger_getCPUStatus();
    ExpectedTestResult(debugger_result, "CPU is Stopped", "CPU is Stopped.");
    /*********************************************************/
    
    testStep("", "Run the debugger.");
    debugger_run();
    
    /*********************  STEP 3  **************************/
    debugger_deleteAllBreakpoints();
    testStep("STEP", "Set a breakpoint in function pal_Cfg_Init at line PAL_Cfg_InternalData.s16AdaptedDutyCycleCommand = KS16_ZERO.");
    debugger_setRelativeFunctionBpAtLine("pal_Cfg_Init", "0");
    /*********************************************************/
    
    testStep("STEP", "Reset the debugger.");
    debugger_reset();
  
    testStep("", "Run the debugger.");
    debugger_run();
    testWaitForTimeout(500);

    /*********************  STEP 4  **************************/
    testCaseComment("Action: ARCH_SW_PAL_0095");
    testStep("STEP", "Check if CPU stopped in function pal_Cfg_Init at line PAL_Cfg_InternalData.s16AdaptedDutyCycleCommand = KS16_ZERO.");
    debugger_getCPUStatus();
    ExpectedTestResult(debugger_result, "CPU is Stopped", "CPU is Stopped.");
    /*********************************************************/
    
    testStep("", "Run the debugger.");
    debugger_run();
    
    /*********************  STEP 5  **************************/
    debugger_deleteAllBreakpoints();
    testStep("STEP", "Set a breakpoint in function pal_Cfg_Init at line pal_AT_Init().");
    debugger_setRelativeFunctionBpAtLine("pal_Cfg_Init", "36");
    /*********************************************************/
    
    testStep("", "Reset the debugger.");
    debugger_reset();
  
    testStep("", "Run the debugger.");
    debugger_run();
    testWaitForTimeout(500);
    
    /*********************  STEP 6  **************************/
    testCaseComment("Action: ARCH_SW_PAL_0110");
    testStep("STEP", "Check if CPU stopped in function pal_Cfg_Init at line pal_AT_Init ()  --> BP reached.");
    debugger_getCPUStatus();
    ExpectedTestResult(debugger_result, "CPU is Stopped", "CPU is Stopped.");
    /*********************************************************/
  
  //====================================================
  testCaseComment("Postcondition");
  testStep("STEP", "Return ECU to default values");
  RunPostTs();
}

testcase SW_Int_PAL_Autotest_CheckCommandConsistency_01()
{ 
  //***********************************Test report header*********************************
  testReportAddMiscInfoBlock("AUTOLIV ELECTRONICS document");
  TestReportAddMiscInfo("Nightly test", "No");
  TestReportAddMiscInfo("Test type", "Requirement-Based test");
  TestReportAddMiscInfo("Regression Test", "Yes");
  TestReportAddMiscInfo("Fault injection method used", "No");
  TestReportAddMiscInfo("Resource usage evaluation", "No");
  TestReportAddMiscInfo("Priority", "No");
  TestReportAddMiscInfo("Safety relevant", "No");

  AddRequirementInfo("Requirement under test", "ARCH_SW_PAL_0369");
  AddRequirementInfo("ARCH_SW_PAL_0369", "The component shall check if the power stage activation state is consistent with the order.");
  //***************************************************************************************

  testCaseComment("Preconditions");
  testStep("STEP", "Bench Initialization");
  
  testStep("", "Delete all breakpoints from debugger.");
  debugger_deleteAllBreakpoints();
  
  testStep("", "Reset the debugger.");
  debugger_reset();
  
  testStep("STEP", "Run the debugger.");
  debugger_run();

  RunPreTs();
  //====================================================

    /*********************  STEP 1  **************************/
    testStep("STEP", "Set a breakpoint in function PAL_cbk_CheckCommandConsistency at the RTE Call for CheckCommandConsistency autotest --> BP reached.");
    debugger_setRelativeFunctionBpAtLine("PAL_cbk_CheckCommandConsistency", "4");
    debugger_reset();
    debugger_run();
    debugger_waitUntilBPisReached("5000");
    ExpectedTestResult(debugger_result, IS_CPU_STOP_AT_BP_SUCCESFUL, "CPU is stopped at BP");
    
    testStep("", "Step In");
    debugger_stepIn();
  
    /*********************  STEP 2  **************************/
    debugger_deleteRelativeFunctionBpAtLine("PAL_cbk_CheckCommandConsistency", "4");
    testStep("STEP", "Set a breakpoint in function PAL_Autotest_CheckCommandConsistency at the return of autotest result  --> BP reached.");
    debugger_setRelativeFunctionBpAtLine("PAL_Autotest_CheckCommandConsistency", "26");
    debugger_run();
    debugger_waitUntilBPisReached("5000");
    ExpectedTestResult(debugger_result, IS_CPU_STOP_AT_BP_SUCCESFUL, "CPU is stopped at BP");
    
    /*********************  STEP 3  **************************/
    testStep("STEP", "Overwrite autotest result with KU8_ATM_TEST_OK --> Variable is set to 0x1 .");
    debugger_writeLocalVariable("*pu8TestResult", "1");
    ExpectedTestResult(debugger_result, "1", "Variable is set to 0x1");
    /*********************************************************/

   testCaseComment("Action: ARCH_SW_PAL_0369");
    /*********************  STEP 4  **************************/ 
    debugger_deleteRelativeFunctionBpAtLine("PAL_Autotest_CheckCommandConsistency", "26");
    testStep("STEP", "Set a breakpoint in function PAL_cbk_CheckCommandConsistency after the return of the autotest result  --> BP reached.");
    debugger_setRelativeFunctionBpAtLine("PAL_cbk_CheckCommandConsistency", "7");
    debugger_run();
    debugger_waitUntilBPisReached("5000");
    ExpectedTestResult(debugger_result, IS_CPU_STOP_AT_BP_SUCCESFUL, "CPU is stopped at BP");
    /*********************************************************/
  
  /*********************  STEP 5  **************************/ 
    testStep("STEP", "Read autotest result transmited from ATM --> Variable is equal to 0x1 .");
    debugger_readLocalVariable("u8TestResult");
    ExpectedTestResult(debugger_result, "1", "Variable is equal to 0x1");
  /*********************************************************/
  
  //====================================================
  testCaseComment("Postcondition");
  testStep("STEP", "Return ECU to default values");
  RunPostTs();
}

testcase SW_Int_PAL_Autotest_CheckHighSideSwRegulation_01()
{ 
  //***********************************Test report header*********************************
  testReportAddMiscInfoBlock("AUTOLIV ELECTRONICS document");
  TestReportAddMiscInfo("Nightly test", "No");
  TestReportAddMiscInfo("Test type", "Requirement-Based test");
  TestReportAddMiscInfo("Regression Test", "Yes");
  TestReportAddMiscInfo("Fault injection method used", "No");
  TestReportAddMiscInfo("Resource usage evaluation", "No");
  TestReportAddMiscInfo("Priority", "No");
  TestReportAddMiscInfo("Safety relevant", "No");

  AddRequirementInfo("Requirement under test", "ARCH_SW_PAL_0368");
  AddRequirementInfo("ARCH_SW_PAL_0368", "The component shall check if high switch regulation works well.");
  //***************************************************************************************

  testCaseComment("Preconditions");
  testStep("STEP", "Bench Initialization");
  
  testStep("", "Delete all breakpoints from debugger.");
  debugger_deleteAllBreakpoints();
  
  testStep("", "Reset the debugger.");
  debugger_reset();
  
  testStep("STEP", "Run the debugger.");
  debugger_run();

  RunPreTs();
  //====================================================

    /*********************  STEP 1  **************************/
    testStep("STEP", "Set a breakpoint in function PAL_cbk_CheckHighSideSwRegulation at the RTE Call for CheckHighSideSwRegulation autotest --> BP reached.");
    debugger_setRelativeFunctionBpAtLine("PAL_cbk_CheckHighSideSwRegulation", "4");
    debugger_reset();
    debugger_run();
    debugger_waitUntilBPisReached("5000");
    ExpectedTestResult(debugger_result, IS_CPU_STOP_AT_BP_SUCCESFUL, "CPU is stopped at BP");
  
    testStep("", "Step In");
    debugger_stepIn();
  
    /*********************  STEP 2  **************************/
    debugger_deleteRelativeFunctionBpAtLine("PAL_cbk_CheckHighSideSwRegulation", "4");
    testStep("STEP", "Set a breakpoint in function PAL_Autotest_CheckHighSideSwRegulation at the return of autotest result --> BP reached.");
    debugger_setRelativeFunctionBpAtLine("PAL_Autotest_CheckHighSideSwRegulation", "102");
    debugger_run();
    debugger_waitUntilBPisReached("5000");
    ExpectedTestResult(debugger_result, IS_CPU_STOP_AT_BP_SUCCESFUL, "CPU is stopped at BP");
    
    /*********************  STEP 3  **************************/
    testStep("STEP", "Overwrite autotest result with KU8_ATM_TEST_OK --> Variable is set to 0x1.");
    debugger_writeLocalVariable("*pu8TestResult", "1");
ExpectedTestResult(debugger_result, "1", "Variable is set to 0x1");
    /*********************************************************/

  testCaseComment("Action: ARCH_SW_PAL_0368");
    /*********************  STEP 4  **************************/ 
    debugger_deleteRelativeFunctionBpAtLine("PAL_Autotest_CheckHighSideSwRegulation", "102");
    testStep("STEP", "Set a breakpoint in function PAL_cbk_CheckHighSideSwRegulation after the return of the autotest result --> BP reached.");
    debugger_setRelativeFunctionBpAtLine("PAL_cbk_CheckHighSideSwRegulation", "7");
    debugger_run();
    debugger_waitUntilBPisReached("5000");
    ExpectedTestResult(debugger_result, IS_CPU_STOP_AT_BP_SUCCESFUL, "CPU is stopped at BP");
    /*********************************************************/
  
  /*********************  STEP 5  **************************/ 
    testStep("STEP", "Read autotest result transmited from ATM --> Variable is equal to 0x1.");
    debugger_readLocalVariable("u8TestResult");
ExpectedTestResult(debugger_result, "1", "Variable is equal to 0x1");
  /*********************************************************/
  
  //====================================================
  testCaseComment("Postcondition");
  testStep("STEP", "Return ECU to default values");
  RunPostTs();
}

testcase SW_Int_PAL_Autotest_CheckHWSelfProtection_01()
{ 
  //***********************************Test report header*********************************
  testReportAddMiscInfoBlock("AUTOLIV ELECTRONICS document");
  TestReportAddMiscInfo("Nightly test", "No");
  TestReportAddMiscInfo("Test type", "Requirement-Based test");
  TestReportAddMiscInfo("Regression Test", "Yes");
  TestReportAddMiscInfo("Fault injection method used", "No");
  TestReportAddMiscInfo("Resource usage evaluation", "No");
  TestReportAddMiscInfo("Priority", "No");
  TestReportAddMiscInfo("Safety relevant", "No");

  AddRequirementInfo("Requirement under test", "ARCH_SW_PAL_0140, ARCH_SW_PAL_0147");
  AddRequirementInfo("ARCH_SW_PAL_0140", "The component shall check for HW thermanl protection.");
  AddRequirementInfo("ARCH_SW_PAL_0147", "ATM_runGetTestResult shall be called to get the status ot specific tests (inhibiting the execution of the present one if failed).");
  //***************************************************************************************

  testCaseComment("Preconditions");
  testStep("STEP", "Bench Initialization");
  
  testStep("", "Delete all breakpoints from debugger.");
  debugger_deleteAllBreakpoints();
  
  testStep("", "Reset the debugger.");
  debugger_reset();
  
  testStep("STEP", "Run the debugger.");
  debugger_run();

  RunPreTs();
  //====================================================

  testCaseComment("Action: ARCH_SW_PAL_0140");
    /*********************  STEP 1  **************************/
    testStep("STEP", "Set a breakpoint in function PAL_cbk_CheckHWSelfProtection at the RTE Call for CheckHWSelfProtection autotest --> BP reached.");
    debugger_setRelativeFunctionBpAtLine("PAL_cbk_CheckHWSelfProtection", "4");
    debugger_reset();
    debugger_run();
    debugger_waitUntilBPisReached("5000");
    ExpectedTestResult(debugger_result, IS_CPU_STOP_AT_BP_SUCCESFUL, "CPU is stopped at BP");
    
    testStep("", "Step in.");
    debugger_stepIn();
  
    /*********************  STEP 2  **************************/
    debugger_deleteRelativeFunctionBpAtLine("PAL_cbk_CheckHWSelfProtection", "4");
    testStep("STEP", "Set a breakpoint in function PAL_Autotest_CheckHWSelfProtection at the RTE call for GetTestResult --> BP reached..");
    debugger_setRelativeFunctionBpAtLine("PAL_Autotest_CheckHWSelfProtection", "11");
    debugger_run();
    debugger_waitUntilBPisReached("5000");
    ExpectedTestResult(debugger_result, IS_CPU_STOP_AT_BP_SUCCESFUL, "CPU is stopped at BP");
    
    /*********************  STEP 3  **************************/
    testStep("", "Step in.");
    debugger_stepIn();
    /*********************************************************/

    /*********************  STEP 4  **************************/ 
    debugger_deleteRelativeFunctionBpAtLine("PAL_Autotest_CheckHWSelfProtection", "11");
    testStep("STEP", "Run until return in function ATM_runGetTestResult.");
    debugger_runUntilReturn("10");
    /*********************************************************/
  
  /*********************  STEP 5  **************************/ 
    testStep("STEP", "Write autotest result with KU8_ATM_TEST_OK --> Variable overwritten with 0x1");
    debugger_writeLocalVariable("*u8TestResult", "1");
    ExpectedTestResult(debugger_result, "0x1", "Variable overwritten with 0x1");
  /*********************************************************/
  
  /*********************  STEP 6  **************************/ 
    testStep("STEP", "Set a breakpoint in function PAL_Autotest_CheckHWSelfProtection at the test result --> BP reached.");
    debugger_setRelativeFunctionBpAtLine("PAL_Autotest_CheckHWSelfProtection", "36");
    debugger_run();
    debugger_waitUntilBPisReached("5000");
    ExpectedTestResult(debugger_result, IS_CPU_STOP_AT_BP_SUCCESFUL, "CPU is stopped at BP");
  
      /*********************  STEP 7  **************************/
    testStep("STEP", "Overwrite autotest result with KU8_ATM_TEST_OK --> Variable is set to 0x1.");
    debugger_writeLocalVariable("*pu8TestResult", "1");
ExpectedTestResult(debugger_result, "1", "Variable is set to 0x1");
    /*********************************************************/
  
  testCaseComment("Action: ARCH_SW_PAL_0147");
  /*********************  STEP 8  **************************/ 
    debugger_deleteRelativeFunctionBpAtLine("PAL_Autotest_CheckHWSelfProtection", "36");
    testStep("STEP", "Set a breakpoint in function PAL_cbk_CheckHWSelfProtection after the return of the autotest result --> BP reached.");
    debugger_setRelativeFunctionBpAtLine("PAL_cbk_CheckHWSelfProtection", "7");
    debugger_run();
    debugger_waitUntilBPisReached("5000");
    ExpectedTestResult(debugger_result, IS_CPU_STOP_AT_BP_SUCCESFUL, "CPU is stopped at BP");
    /*********************************************************/
  
  /*********************  STEP 9  **************************/ 
    testStep("STEP", "Read autotest result transmited from ATM --> Variable is equal to 0x1.");
    debugger_readLocalVariable("u8TestResult");
    ExpectedTestResult(debugger_result, "1", "Variable is equal to 0x1");
  /*********************************************************/
  //====================================================
  testCaseComment("Postcondition");
  testStep("STEP", "Return ECU to default values");
  RunPostTs();
}

testcase SW_Int_PAL_Autotest_CheckMosfetLowSC_01()
{ 
  //***********************************Test report header*********************************
  testReportAddMiscInfoBlock("AUTOLIV ELECTRONICS document");
  TestReportAddMiscInfo("Nightly test", "No");
  TestReportAddMiscInfo("Test type", "Requirement-Based test");
  TestReportAddMiscInfo("Regression Test", "Yes");
  TestReportAddMiscInfo("Fault injection method used", "No");
  TestReportAddMiscInfo("Resource usage evaluation", "No");
  TestReportAddMiscInfo("Priority", "No");
  TestReportAddMiscInfo("Safety relevant", "No");

  AddRequirementInfo("Requirement under test", "ARCH_SW_PAL_0370, ARCH_SW_PAL_0390, ARCH_SW_PAL_0391");
  AddRequirementInfo("ARCH_SW_PAL_0370", "The component shall check the Short Circuit failure for Low Mosfets and set the result of autotest.");
  AddRequirementInfo("ARCH_SW_PAL_0390", "ATM_runGetTestResult shall be called to get the status of specific tests (inhibiting the execution of the present one if failed).");
  AddRequirementInfo("ARCH_SW_PAL_0391", "PMP_runGetMotorVp_100ms and PMP_runGetMotorVn_100ms shall be called to check battery voltage.");

  //***************************************************************************************

  testCaseComment("Preconditions");
  testStep("STEP", "Bench Initialization");
  
  testStep("", "Delete all breakpoints from debugger.");
  debugger_deleteAllBreakpoints();
  
  testStep("", "Reset the debugger.");
  debugger_reset();
  
  testStep("STEP", "Run the debugger.");
  debugger_run();

  RunPreTs();
  //====================================================

  testCaseComment("Action: ARCH_SW_PAL_0370");
    /*********************  STEP 1  **************************/
    testStep("STEP", "Set a breakpoint in function PAL_cbk_CheckMosfetLowSC at the RTE Call for CheckMosfetLowSC autotest --> BP reached.");
    debugger_setRelativeFunctionBpAtLine("PAL_cbk_CheckMosfetLowSC", "4");
    debugger_reset();
    debugger_run();
    debugger_waitUntilBPisReached("5000");
    ExpectedTestResult(debugger_result, IS_CPU_STOP_AT_BP_SUCCESFUL, "CPU is stopped at BP");
    
    testStep("STEP", "Step in.");
    debugger_stepIn();
  
    /*********************  STEP 2  **************************/
    debugger_deleteRelativeFunctionBpAtLine("PAL_cbk_CheckMosfetLowSC", "4");
    testStep("STEP", "Set a breakpoint in function PAL_Autotest_CheckMosfetLowSC at the RTE call for GetTestResult --> BP reached.");
    debugger_setRelativeFunctionBpAtLine("PAL_Autotest_CheckMosfetLowSC", "35");
    debugger_run();
    debugger_waitUntilBPisReached("5000");
    ExpectedTestResult(debugger_result, IS_CPU_STOP_AT_BP_SUCCESFUL, "CPU is stopped at BP");
    
    /*********************  STEP 3  **************************/
    testStep("", "Step in.");
    debugger_stepIn();
    /*********************************************************/

    /*********************  STEP 4  **************************/ 
    testStep("", "Run until return in function ATM_runGetTestResult.");
    debugger_runUntilReturn("10");
    /*********************************************************/
  
  /*********************  STEP 5  **************************/ 
    testStep("STEP", "Write autotest result with 0x1 --> Variable set to 0x1");
    debugger_writeLocalVariable("*u8TestResult", "1");
    ExpectedTestResult(debugger_result, "1", "Variable set to 0x1");
  /*********************************************************/
  
  /*********************  STEP 6  **************************/ 
    debugger_deleteRelativeFunctionBpAtLine("PAL_Autotest_CheckMosfetLowSC", "35");
    testStep("STEP", "Set a breakpoint in function PAL_Autotest_CheckMosfetLowSC at the RTE Call for PMP_runGetMotorVp_100ms --> BP reached.");
    debugger_setRelativeFunctionBpAtLine("PAL_Autotest_CheckMosfetLowSC", "48");
    debugger_run();
    debugger_waitUntilBPisReached("5000");
    ExpectedTestResult(debugger_result, IS_CPU_STOP_AT_BP_SUCCESFUL, "CPU is stopped at BP");
  /*********************************************************/
  
    /*********************  STEP 3  **************************/
    testStep("STEP", "Step in.");
    debugger_stepIn();
    /*********************************************************/
  
    /*********************  STEP 7  **************************/ 
    testStep("STEP", "Run until return PMP_runGetMotorVp_100ms and evaluate *pu16Voltage data pointerx --> Variable read from adc.");
    debugger_runUntilReturn("10");
    debugger_readLocalVariable("*pu16Voltage");
    ExpectedTestResult(debugger_result, "pu16Voltage", "Variable read.");
  /*********************************************************/
  
  /*********************  STEP 8  **************************/ 
    debugger_deleteRelativeFunctionBpAtLine("PAL_Autotest_CheckMosfetLowSC", "48");
    testStep("STEP", "Set a breakpoint in function PAL_Autotest_CheckMosfetLowSC at the return of autotest result --> BP reached.");
    debugger_setRelativeFunctionBpAtLine("PAL_Autotest_CheckMosfetLowSC", "97");
    debugger_run();
    debugger_waitUntilBPisReached("5000");
    ExpectedTestResult(debugger_result, IS_CPU_STOP_AT_BP_SUCCESFUL, "CPU is stopped at BP");
  
  /*********************  STEP 9  **************************/
    testStep("STEP", "Overwrite autotest result with KU8_ATM_TEST_OK --> Variable is set to 0x1.");
    debugger_writeLocalVariable("*pu8TestResult", "1");
    ExpectedTestResult(debugger_result, "0x1", "Variable is set to 0x1");
  /*********************************************************/
  
  testCaseComment("Action: ARCH_SW_PAL_0390");
    /*********************  STEP 9  **************************/
    testStep("STEP", "Evaluate PreviousHighSideSWTestResult --> Variable is equal to 0x1.");
    debugger_readLocalVariable("u8PreviousHighSideSWTestResult");
    ExpectedTestResult(debugger_result, "0x1", "Variable is equal to 0x1");
  /*********************************************************/
  
  testCaseComment("Action: ARCH_SW_PAL_0391");
    /*********************  STEP 9  **************************/
    testStep("STEP", "Evaluate FilteredMotorPlusVoltage --> Variable is equal to *pu16Voltage data pointer.");
    debugger_readLocalVariable("u16FilteredMotorPlusVoltage");
    ExpectedTestResult(debugger_result, "u16FilteredMotorPlusVoltage", "Variable is equal to *pu16Voltage data pointer");
  /*********************************************************/
  
  /*********************  STEP 10  **************************/ 
    debugger_deleteRelativeFunctionBpAtLine("PAL_Autotest_CheckMosfetLowSC", "97");
    testStep("STEP", "Set a breakpoint in function PAL_cbk_CheckMosfetLowSC after the return of the autotest result --> BP reached.");
    debugger_setRelativeFunctionBpAtLine("PAL_cbk_CheckMosfetLowSC", "7");
    debugger_run();
    debugger_waitUntilBPisReached("5000");
    ExpectedTestResult(debugger_result, IS_CPU_STOP_AT_BP_SUCCESFUL, "CPU is stopped at BP");
    /*********************************************************/
  
  /*********************  STEP 11  **************************/ 
    testStep("STEP", "Read autotest result transmited from ATM.");
    debugger_readLocalVariable("u8TestResult");
    ExpectedTestResult(debugger_result, "1", "Variable is equal to 0x1");
  /*********************************************************/
  //====================================================
  testCaseComment("Postcondition");
  testStep("STEP", "Return ECU to default values");
  RunPostTs();
}

testcase SW_Int_PAL_Autotest_CheckMosfetHighSC_01()
{ 
  //***********************************Test report header*********************************
  testReportAddMiscInfoBlock("AUTOLIV ELECTRONICS document");
  TestReportAddMiscInfo("Nightly test", "No");
  TestReportAddMiscInfo("Test type", "Requirement-Based test");
  TestReportAddMiscInfo("Regression Test", "Yes");
  TestReportAddMiscInfo("Fault injection method used", "No");
  TestReportAddMiscInfo("Resource usage evaluation", "No");
  TestReportAddMiscInfo("Priority", "No");
  TestReportAddMiscInfo("Safety relevant", "No");

  AddRequirementInfo("Requirement under test", "ARCH_SW_PAL_0372, ARCH_SW_PAL_0395, ARCH_SW_PAL_0396");
  AddRequirementInfo("ARCH_SW_PAL_0372", "The component shall check the Short Circuit failure for High Mosfets and set the result of autotest..");
  AddRequirementInfo("ARCH_SW_PAL_0395", "ATM_runGetTestResult shall be called to get the status of specific tests (inhibiting the execution of the present one if failed).");
  AddRequirementInfo("ARCH_SW_PAL_0396", "PMP_runGetBatteryVoltage_100ms , PMP_runGetMotorVp_100ms and PMP_runGetMotorVn_100ms shall be called to check battery voltage.");

  //***************************************************************************************

  testCaseComment("Preconditions");
  testStep("STEP", "Bench Initialization");
  
  testStep("", "Delete all breakpoints from debugger.");
  debugger_deleteAllBreakpoints();
  
  testStep("", "Reset the debugger.");
  debugger_reset();
  
  testStep("STEP", "Run the debugger.");
  debugger_run();

  RunPreTs();
  //====================================================

  testCaseComment("Action: ARCH_SW_PAL_0372");
    /*********************  STEP 1  **************************/
    testStep("STEP", "Set a breakpoint in function PAL_cbk_CheckMosfetHighSC at the RTE Call for CheckMosfetHighSC autotest --> BP reached.");
    debugger_setRelativeFunctionBpAtLine("PAL_cbk_CheckMosfetHighSC", "4");
    debugger_reset();
    debugger_run();
    debugger_waitUntilBPisReached("5000");
    ExpectedTestResult(debugger_result, IS_CPU_STOP_AT_BP_SUCCESFUL, "CPU is stopped at BP");
    
    testStep("", "Step in.");
    debugger_stepIn();
  
    /*********************  STEP 2  **************************/
    debugger_deleteRelativeFunctionBpAtLine("PAL_cbk_CheckMosfetHighSC", "4");
    testStep("STEP", "Set a breakpoint in function PAL_Autotest_CheckMosfetHighSC at the RTE call for GetTestResult --> BP reached");
    debugger_setRelativeFunctionBpAtLine("PAL_Autotest_CheckMosfetHighSC", "35");
    debugger_run();
    debugger_waitUntilBPisReached("5000");
    ExpectedTestResult(debugger_result, IS_CPU_STOP_AT_BP_SUCCESFUL, "CPU is stopped at BP");
    
    /*********************  STEP 3  **************************/
    testStep("", "Step in.");
    debugger_stepIn();
    /*********************************************************/

    /*********************  STEP 4  **************************/ 
    testStep("", "Run until return in function ATM_runGetTestResult.");
    debugger_runUntilReturn("10");
    /*********************************************************/
  
  /*********************  STEP 5  **************************/ 
    testStep("STEP", "Write autotest result with 0x1 --> Variable overwritten with value 0x1");
    debugger_writeLocalVariable("*u8TestResult", "1");
    ExpectedTestResult(debugger_result, "1", "Variable overwritten with value 0x1");
  /*********************************************************/
  
  /*********************  STEP 6  **************************/ 
    debugger_deleteRelativeFunctionBpAtLine("PAL_Autotest_CheckMosfetHighSC", "35");
    testStep("STEP", "Set a breakpoint in function PAL_Autotest_CheckMosfetHighSC at the RTE Call for PMP_runGetMotorVp_100ms --> BP reached.");
    debugger_setRelativeFunctionBpAtLine("PAL_Autotest_CheckMosfetHighSC", "47");
    debugger_run();
    debugger_waitUntilBPisReached("5000");
    ExpectedTestResult(debugger_result, IS_CPU_STOP_AT_BP_SUCCESFUL, "CPU is stopped at BP");
  /*********************************************************/
  
    /*********************  STEP 3  **************************/
    testStep("STEP", "Step in.");
    debugger_stepIn();
    /*********************************************************/
  
    /*********************  STEP 7  **************************/ 
    testStep("STEP", "Run until return PMP_runGetMotorVp_100ms and evaluate *pu16Voltage data pointer --> Variable read from ADC.");
    debugger_runUntilReturn("10");
    debugger_readLocalVariable("*pu16Voltage");
    ExpectedTestResult(debugger_result, "pu16Voltage", "Variable read.");
  /*********************************************************/
  
  /*********************  STEP 8  **************************/ 
    debugger_deleteRelativeFunctionBpAtLine("PAL_Autotest_CheckMosfetHighSC", "47");
    testStep("STEP", "Set a breakpoint in function PAL_Autotest_CheckMosfetHighSC at the return of autotest result --> BP reached.");
    debugger_setRelativeFunctionBpAtLine("PAL_Autotest_CheckMosfetHighSC", "101");
    debugger_run();
    debugger_waitUntilBPisReached("5000");
    ExpectedTestResult(debugger_result, IS_CPU_STOP_AT_BP_SUCCESFUL, "CPU is stopped at BP");
  
  /*********************  STEP 9  **************************/
    testStep("STEP", "Overwrite autotest result with KU8_ATM_TEST_OK --> Variable is set to 0x1.");
    debugger_writeLocalVariable("*pu8TestResult", "1");
    ExpectedTestResult(debugger_result, "0x1", "Variable is set to 0x1");
  /*********************************************************/
  
  testCaseComment("Action: ARCH_SW_PAL_0395");
    /*********************  STEP 9  **************************/
    testStep("STEP", "Evaluate PreviousHighSideSWTestResult --> Variable is equal to 0x1.");
    debugger_readLocalVariable("u8PreviousHighSideSWTestResult");
    ExpectedTestResult(debugger_result, "0x1", "Variable is equal to 0x1");
  /*********************************************************/
  
  testCaseComment("Action: ARCH_SW_PAL_0396");
    /*********************  STEP 9  **************************/
    testStep("STEP", "Evaluate FilteredMotorPlusVoltage --> Variable is equal to *pu16Voltage data pointer.");
    debugger_readLocalVariable("u16FilteredMotorPlusVoltage");
    ExpectedTestResult(debugger_result, "u16FilteredMotorPlusVoltage", "Variable is equal to *pu16Voltage data pointer");
  /*********************************************************/
  
  /*********************  STEP 10  **************************/ 
    debugger_deleteRelativeFunctionBpAtLine("PAL_Autotest_CheckMosfetHighSC", "101");
    testStep("STEP", "Set a breakpoint in function PAL_cbk_CheckMosfetHighSC after the return of the autotest result --> BP reached.");
    debugger_setRelativeFunctionBpAtLine("PAL_cbk_CheckMosfetHighSC", "7");
    debugger_run();
    debugger_waitUntilBPisReached("5000");
    ExpectedTestResult(debugger_result, IS_CPU_STOP_AT_BP_SUCCESFUL, "CPU is stopped at BP");
    /*********************************************************/
  
  /*********************  STEP 11  **************************/ 
    testStep("STEP", "Read autotest result transmited from ATM.");
    debugger_readLocalVariable("u8TestResult");
    ExpectedTestResult(debugger_result, "1", "Variable is equal to 0x1");
  /*********************************************************/
  //====================================================
  testCaseComment("Postcondition");
  testStep("STEP", "Return ECU to default values");
  RunPostTs();
}

testcase SW_Int_PAL_Autotest_CheckMosfetOCAT_01()
{ 
  //***********************************Test report header*********************************
  testReportAddMiscInfoBlock("AUTOLIV ELECTRONICS document");
  TestReportAddMiscInfo("Nightly test", "No");
  TestReportAddMiscInfo("Test type", "Requirement-Based test");
  TestReportAddMiscInfo("Regression Test", "Yes");
  TestReportAddMiscInfo("Fault injection method used", "No");
  TestReportAddMiscInfo("Resource usage evaluation", "No");
  TestReportAddMiscInfo("Priority", "No");
  TestReportAddMiscInfo("Safety relevant", "No");

  AddRequirementInfo("Requirement under test", "ARCH_SW_PAL_0373, ARCH_SW_PAL_0374, ARCH_SW_PAL_0375");
  AddRequirementInfo("ARCH_SW_PAL_0373", "The Autotest shall be performed in 4 steps in order to set the result.");
  AddRequirementInfo("ARCH_SW_PAL_0374", "The Autotest shall be performed in 4 steps in order to set the result.");
  AddRequirementInfo("ARCH_SW_PAL_0375", "ATM_runGetTestResult shall be called to get the status ot specific tests (inhibiting the execution of the present one if failed).");

  //***************************************************************************************

  testCaseComment("Preconditions");
  testStep("STEP", "Bench Initialization");
  
  testStep("", "Delete all breakpoints from debugger.");
  debugger_deleteAllBreakpoints();
  
  testStep("", "Reset the debugger.");
  debugger_reset();
  
  testStep("STEP", "Run the debugger.");
  debugger_run();

  RunPreTs();
  //====================================================

  testCaseComment("Action: ARCH_SW_PAL_0373, ARCH_SW_PAL_0374");
    /*********************  STEP 1  **************************/
    testStep("STEP", "Set a breakpoint in function PAL_cbk_CheckMosfetOCAT at the RTE Call for CheckMosfetOCAT autotest --> BP reached.");
    debugger_setRelativeFunctionBpAtLine("PAL_cbk_CheckMosfetOCAT", "4");
    debugger_reset();
    debugger_run();
    debugger_waitUntilBPisReached("5000");
    ExpectedTestResult(debugger_result, IS_CPU_STOP_AT_BP_SUCCESFUL, "CPU is stopped at BP");
    
    testStep("STEP", "Step in.");
    debugger_stepIn();
  
    /*********************  STEP 2  **************************/
    debugger_deleteRelativeFunctionBpAtLine("PAL_cbk_CheckMosfetOCAT", "4");
    testStep("STEP", "Set a breakpoint in function PAL_Autotest_CheckMosfetOCAT at the RTE call for GetTestResult --> BP reached.");
    debugger_setRelativeFunctionBpAtLine("PAL_Autotest_CheckMosfetOCAT", "44");
    debugger_run();
    debugger_waitUntilBPisReached("5000");
    ExpectedTestResult(debugger_result, IS_CPU_STOP_AT_BP_SUCCESFUL, "CPU is stopped at BP");
    
    /*********************  STEP 3  **************************/
    testStep("", "Step in.");
    debugger_stepIn();
    /*********************************************************/

    /*********************  STEP 4  **************************/ 
    testStep("", "Run until return in function ATM_runGetTestResult.");
    debugger_runUntilReturn("10");
    /*********************************************************/
  
  /*********************  STEP 5  **************************/ 
    testStep("STEP", "Overwrite autotest result with KU8_ATM_TEST_OK --> Variable overwritten with 0x1");
    debugger_writeLocalVariable("*u8TestResult", "1");
    ExpectedTestResult(debugger_result, "0x1", "Variable overwritten with 0x1");
  /*********************************************************/
  
  /*********************  STEP 8  **************************/ 
    debugger_deleteRelativeFunctionBpAtLine("PAL_Autotest_CheckMosfetOCAT", "44");
    testStep("STEP", "Set a breakpoint in function PAL_Autotest_CheckMosfetHighSC at the return of autotest result --> BP reached.");
    debugger_setRelativeFunctionBpAtLine("PAL_Autotest_CheckMosfetOCAT", "288");
    debugger_run();
    debugger_waitUntilBPisReached("5000");
    ExpectedTestResult(debugger_result, IS_CPU_STOP_AT_BP_SUCCESFUL, "CPU is stopped at BP");
  
  /*********************  STEP 9  **************************/
    testStep("STEP", "Overwrite autotest result with KU8_ATM_TEST_OK --> Variable is set to 0x1.");
    debugger_writeLocalVariable("*pu8TestResult", "1");
    ExpectedTestResult(debugger_result, "0x1", "Variable is set to 0x1");
  /*********************************************************/
  
  testCaseComment("Action: ARCH_SW_PAL_0375");
  /*********************  STEP 9  **************************/
    testStep("STEP", "Evaluate PreviousADCTestresult --> Variable is equal to 0x1.");
    debugger_readLocalVariable("u8PreviousADCTestresult");
    ExpectedTestResult(debugger_result, "0x1", "Variable is equal to 0x1");
  /*********************************************************/
  
  /*********************  STEP 10  **************************/ 
    debugger_deleteRelativeFunctionBpAtLine("PAL_Autotest_CheckMosfetHighSC", "288");
    testStep("STEP", "Set a breakpoint in function PAL_cbk_CheckMosfetOCAT after the return of the autotest result --> BP reached.");
    debugger_setRelativeFunctionBpAtLine("PAL_cbk_CheckMosfetOCAT", "7");
    debugger_run();
    debugger_waitUntilBPisReached("5000");
    ExpectedTestResult(debugger_result, IS_CPU_STOP_AT_BP_SUCCESFUL, "CPU is stopped at BP");
    /*********************************************************/
  
  /*********************  STEP 11  **************************/ 
    testStep("STEP", "Read autotest result transmited from ATM --> Variable is equal to 0x1.");
    debugger_readLocalVariable("u8TestResult");
    ExpectedTestResult(debugger_result, "0x1", "Variable is equal to 0x1");
  /*********************************************************/
  
  //====================================================
  testCaseComment("Postcondition");
  testStep("STEP", "Return ECU to default values");
  RunPostTs();
}

testcase SW_Int_PAL_Autotest_CheckMotorConnection_01()
{ 
  //***********************************Test report header*********************************
  testReportAddMiscInfoBlock("AUTOLIV ELECTRONICS document");
  TestReportAddMiscInfo("Nightly test", "No");
  TestReportAddMiscInfo("Test type", "Requirement-Based test");
  TestReportAddMiscInfo("Regression Test", "Yes");
  TestReportAddMiscInfo("Fault injection method used", "No");
  TestReportAddMiscInfo("Resource usage evaluation", "No");
  TestReportAddMiscInfo("Priority", "No");
  TestReportAddMiscInfo("Safety relevant", "No");

  AddRequirementInfo("Requirement under test", "ARCH_SW_PAL_0376, ARCH_SW_PAL_0377, ARCH_SW_PAL_0410");
  AddRequirementInfo("ARCH_SW_PAL_0376", "The component shall check if the motor is present and connected.");
  AddRequirementInfo("ARCH_SW_PAL_0377", "ATM_runGetTestResult shall be called to get the status of specific tests (inhibiting the execution of the present one if failed).");
  AddRequirementInfo("ARCH_SW_PAL_0410", "PMP_runGetBatteryVoltage_100ms , PMP_runGetMotorVp_100ms and PMP_runGetMotorVn_100ms shall be called to check battery voltage.");

  //***************************************************************************************

  testCaseComment("Preconditions");
  testStep("STEP", "Bench Initialization");
  
  testStep("", "Delete all breakpoints from debugger.");
  debugger_deleteAllBreakpoints();
  
  testStep("", "Reset the debugger.");
  debugger_reset();
  
  testStep("STEP", "Run the debugger.");
  debugger_run();

  RunPreTs();
  //====================================================

  testCaseComment("Action: ARCH_SW_PAL_0376");
    /*********************  STEP 1  **************************/
    testStep("STEP", "Set a breakpoint in function PAL_cbk_CheckMotorConnection at the RTE Call for CheckMotorConnection autotest --> BP reached.");
    debugger_setRelativeFunctionBpAtLine("PAL_cbk_CheckMotorConnection", "4");
    debugger_reset();
    debugger_run();
    debugger_waitUntilBPisReached("5000");
    ExpectedTestResult(debugger_result, IS_CPU_STOP_AT_BP_SUCCESFUL, "CPU is stopped at BP");
    
    testStep("", "Step in.");
    debugger_stepIn();
  
    /*********************  STEP 2  **************************/
    debugger_deleteRelativeFunctionBpAtLine("PAL_cbk_CheckMotorConnection", "4");
    testStep("STEP", "Set a breakpoint in function PAL_Autotest_CheckMotorConnection at the RTE call for GetTestResult --> BP reached.");
    debugger_setRelativeFunctionBpAtLine("PAL_Autotest_CheckMotorConnection", "30");
    debugger_run();
    debugger_waitUntilBPisReached("5000");
    ExpectedTestResult(debugger_result, IS_CPU_STOP_AT_BP_SUCCESFUL, "CPU is stopped at BP");
    
    /*********************  STEP 3  **************************/
    testStep("", "Step in.");
    debugger_stepIn();
    /*********************************************************/

    /*********************  STEP 4  **************************/ 
    testStep("", "Run until return in function ATM_runGetTestResult.");
    debugger_runUntilReturn("10");
    /*********************************************************/
  
  /*********************  STEP 5  **************************/ 
    testStep("STEP", "Write autotest result with 0x1");
    debugger_writeLocalVariable("*u8TestResult", "1");
    ExpectedTestResult(debugger_result, "1", "CPU is stopped at BP");
  /*********************************************************/
  
  /*********************  STEP 6  **************************/ 
    debugger_deleteRelativeFunctionBpAtLine("PAL_Autotest_CheckMotorConnection", "30");
    testStep("STEP", "Set a breakpoint in function PAL_Autotest_CheckMotorConnection at the RTE Call for PMP_runGetMotorVp_100ms --> BP reached.");
    debugger_setRelativeFunctionBpAtLine("PAL_Autotest_CheckMotorConnection", "47");
    debugger_run();
    debugger_waitUntilBPisReached("5000");
    ExpectedTestResult(debugger_result, IS_CPU_STOP_AT_BP_SUCCESFUL, "CPU is stopped at BP");
  /*********************************************************/
  
    /*********************  STEP 3  **************************/
    testStep("", "Step in.");
    debugger_stepIn();
    /*********************************************************/
  
    /*********************  STEP 7  **************************/ 
    testStep("STEP", "Run until return PMP_runGetMotorVp_100ms and evaluate *pu16Voltage data pointer --> Variable read from adc.");
    debugger_runUntilReturn("10");
    debugger_readLocalVariable("*pu16Voltage");
    ExpectedTestResult(debugger_result, "pu16Voltage", "Variable read.");
  /*********************************************************/
  
  /*********************  STEP 8  **************************/ 
    debugger_deleteRelativeFunctionBpAtLine("PAL_Autotest_CheckMotorConnection", "47");
    testStep("STEP", "Set a breakpoint in function PAL_Autotest_CheckMotorConnection at the return of autotest result --> BP reached.");
    debugger_setRelativeFunctionBpAtLine("PAL_Autotest_CheckMotorConnection", "98");
    debugger_run();
    debugger_waitUntilBPisReached("5000");
    ExpectedTestResult(debugger_result, IS_CPU_STOP_AT_BP_SUCCESFUL, "CPU is stopped at BP");
  
  /*********************  STEP 9  **************************/
    testStep("STEP", "Overwrite autotest result with KU8_ATM_TEST_OK --> Variable is set to 0x1.");
    debugger_writeLocalVariable("*pu8TestResult", "1");
    ExpectedTestResult(debugger_result, "0x1", "Variable is set to 0x1");
  /*********************************************************/
  
  testCaseComment("Action: ARCH_SW_PAL_0377");
    /*********************  STEP 9  **************************/
    testStep("STEP", "Evaluate PreviousMosfetHighSCTestResult --> Variable is equal to 0x1.");
    debugger_readLocalVariable("u8PreviousMosfetHighSCTestResult");
    ExpectedTestResult(debugger_result, "0x1", "Variable is equal to 0x1");
  /*********************************************************/
  
  testCaseComment("Action: ARCH_SW_PAL_0410");
    /*********************  STEP 9  **************************/
    testStep("STEP", "Evaluate FilteredMotorPlusVoltage --> Variable is equal to *pu16Voltage data pointer --> Variable is equal to *pu16Voltage data pointer.");
    debugger_readLocalVariable("u16FilteredMotorPlusVoltage");
    ExpectedTestResult(debugger_result, "u16FilteredMotorPlusVoltage", "Variable is equal to *pu16Voltage data pointer");
  /*********************************************************/
  
  /*********************  STEP 10  **************************/ 
    debugger_deleteRelativeFunctionBpAtLine("PAL_Autotest_CheckMotorConnection", "101");
    testStep("STEP", "Set a breakpoint in function PAL_cbk_CheckMotorConnection after the return of the autotest result --> BP reached.");
    debugger_setRelativeFunctionBpAtLine("PAL_cbk_CheckMotorConnection", "7");
    debugger_run();
    debugger_waitUntilBPisReached("5000");
    ExpectedTestResult(debugger_result, IS_CPU_STOP_AT_BP_SUCCESFUL, "CPU is stopped at BP");
    /*********************************************************/
  
  /*********************  STEP 11  **************************/ 
    testStep("STEP", "Read autotest result transmited from ATM --> Variable is equal to 0x1.");
    debugger_readLocalVariable("u8TestResult");
    ExpectedTestResult(debugger_result, "1", "Variable is equal to 0x1");
  /*********************************************************/
  //====================================================
  testCaseComment("Postcondition");
  testStep("STEP", "Return ECU to default values");
  RunPostTs();
}

testcase SW_Int_PAL_Autotest_CheckMotorDisengagement_01()
{ 
  //***********************************Test report header*********************************
  testReportAddMiscInfoBlock("AUTOLIV ELECTRONICS document");
  TestReportAddMiscInfo("Nightly test", "No");
  TestReportAddMiscInfo("Test type", "Requirement-Based test");
  TestReportAddMiscInfo("Regression Test", "Yes");
  TestReportAddMiscInfo("Fault injection method used", "No");
  TestReportAddMiscInfo("Resource usage evaluation", "No");
  TestReportAddMiscInfo("Priority", "No");
  TestReportAddMiscInfo("Safety relevant", "No");

  AddRequirementInfo("Requirement under test", "ARCH_SW_PAL_0080, ARCH_SW_PAL_0380, ARCH_SW_PAL_0378, ARCH_SW_PAL_0379, ARCH_SW_PAL_0400, ARCH_SW_PAL_0401, ARCH_SW_PAL_0402, ARCH_SW_PAL_0403");
  AddRequirementInfo("ARCH_SW_PAL_0380", "The component shall check if the motor is coupled with the mechanic.");
  AddRequirementInfo("ARCH_SW_PAL_0378", "The current executed cycle shall be read from BFE.");
  AddRequirementInfo("ARCH_SW_PAL_0379", "ATM_runGetTestResult shall be called to get the status ot specific tests (inhibiting the execution of the present one if failed).");
  AddRequirementInfo("ARCH_SW_PAL_0400", "PMP_runGetFilteredTemperature_deg shall be called to get the ECU temperature");
  AddRequirementInfo("ARCH_SW_PAL_0401", "PMP_runGetBatteryVoltage_10ms shall be called to get the battery voltage");
  AddRequirementInfo("ARCH_SW_PAL_0402", "PMP_runGetMotorResistance shall be called to get motor resistance");
  AddRequirementInfo("ARCH_SW_PAL_0403", "PAL_runReadMotorCurrentInmA shall be called to get motor current.");
  AddRequirementInfo("ARCH_SW_PAL_0080", "The component shall provide the current in miliamps.");
  AddRequirementInfo("ARCH_SW_PAL_0085", "If the motor rotation direction is “tensioning”, the AdcIf_runGetMotor_Ip function shall be called to read the motor current measured by the half bridge connected to the VP pin of the motor.");
  
  //***************************************************************************************

  testCaseComment("Preconditions");
  testStep("STEP", "Bench Initialization");
  
  testStep("", "Delete all breakpoints from debugger.");
  debugger_deleteAllBreakpoints();
  
  testStep("", "Reset the debugger.");
  debugger_reset();
  
  testStep("STEP", "Run the debugger.");
  debugger_run();

  RunPreTs();
  //====================================================

  testCaseComment("Action: ARCH_SW_PAL_0380, ARCH_SW_PAL_0378");
    /*********************  STEP 1  **************************/
    testStep("STEP", "Set a breakpoint in function PAL_cbk_CheckMotorDisengagement at the RTE Call for CheckMotorDisengagement autotest --> CPU is stopped at BP.");
    debugger_setRelativeFunctionBpAtLine("PAL_cbk_CheckMotorDisengagement", "4");
    debugger_reset();
    debugger_run();
    debugger_waitUntilBPisReached("5000");
    ExpectedTestResult(debugger_result, IS_CPU_STOP_AT_BP_SUCCESFUL, "CPU is stopped at BP");
    
    testStep("", "Step in.");
    debugger_stepIn();
  
    /*********************  STEP 2  **************************/
    debugger_deleteRelativeFunctionBpAtLine("PAL_cbk_CheckMotorDisengagement", "4");
    testStep("STEP", "Set a breakpoint in function PAL_Autotest_CheckMotorDisengagement at the RTE call for GetTestResult --> CPU is stopped at BP.");
    debugger_setRelativeFunctionBpAtLine("PAL_Autotest_CheckMotorDisengagement", "38");
    debugger_run();
    debugger_waitUntilBPisReached("5000");
    ExpectedTestResult(debugger_result, IS_CPU_STOP_AT_BP_SUCCESFUL, "CPU is stopped at BP");
    
    /*********************  STEP 3  **************************/
    testStep("", "Step in.");
    debugger_stepIn();
    /*********************************************************/

    /*********************  STEP 4  **************************/ 
    testStep("", "Run until return in function ATM_runGetTestResult.");
    debugger_runUntilReturn("10");
    /*********************************************************/
  
  /*********************  STEP 5  **************************/ 
    testStep("STEP", "Write autotest result with 0x1 --> Variable written with 0x1");
    debugger_writeLocalVariable("*u8TestResult", "1");
    ExpectedTestResult(debugger_result, "1", "Variable written with 0x1");
  /*********************************************************/
  
  /*********************  STEP 6  **************************/ 
    debugger_deleteRelativeFunctionBpAtLine("PAL_Autotest_CheckMotorDisengagement", "38");
    testStep("STEP", "Set a breakpoint in function PAL_Autotest_CheckMotorDisengagement at the RTE Call for PMP_runGetFilteredTemperature_deg CPU is stopped at BP --> CPU is stopped at BP.");
    debugger_setRelativeFunctionBpAtLine("PAL_Autotest_CheckMotorDisengagement", "56");
    debugger_run();
    debugger_waitUntilBPisReached("1000");
ExpectedTestResult(debugger_result, IS_CPU_STOP_AT_BP_SUCCESFUL, "CPU is stopped at BP");
  /*********************************************************/
  
    /*********************  STEP 3  **************************/
    testStep("", "Step in.");
    debugger_stepIn();
    /*********************************************************/
  
    /*********************  STEP 7  **************************/ 
    testStep("STEP", "Run until return PMP_runGetFilteredTemperature_deg and evaluate *ps16InternalTemperature_deg data pointer --> Variable read from ADC.");
    debugger_runUntilReturn("10");
    debugger_readLocalVariable("*ps16InternalTemperature_deg");
ExpectedTestResult(debugger_result, "ps16InternalTemperature_deg", "Variable read.");
  /*********************************************************/
  
  /*********************  STEP 8  **************************/ 
    debugger_deleteRelativeFunctionBpAtLine("PAL_Autotest_CheckMotorDisengagement", "56");
    testStep("STEP", "Set a breakpoint in function PAL_Autotest_CheckMotorDisengagement at the RTE Call for PMP_runGetBatteryVoltage_10ms --> CPU is stopped at BP.");
    debugger_setRelativeFunctionBpAtLine("PAL_Autotest_CheckMotorDisengagement", "71");
    debugger_run();
    debugger_waitUntilBPisReached("1000");
ExpectedTestResult(debugger_result, IS_CPU_STOP_AT_BP_SUCCESFUL, "CPU is stopped at BP");
  
  /*********************  STEP 3  **************************/
    testStep("", "Step in.");
    debugger_stepIn();
    /*********************************************************/
  
    /*********************  STEP 7  **************************/ 
    testStep("STEP", "Run until return PMP_runGetBatteryVoltage_10ms and evaluate *pu16Voltage data pointer --> Variable read from ADC.");
    debugger_runUntilReturn("10");
    debugger_readLocalVariable("*pu16Voltage");
ExpectedTestResult(debugger_result, "pu16Voltage", "Variable read.");
  /*********************************************************/
  
    /*********************  STEP 8  **************************/ 
    debugger_deleteRelativeFunctionBpAtLine("PAL_Autotest_CheckMotorDisengagement", "71");
    testStep("STEP", "Set a breakpoint in function PAL_Autotest_CheckMotorDisengagement at the RTE Call for PMP_runGetMotorResistance --> CPU is stopped at BP.");
    debugger_setRelativeFunctionBpAtLine("PAL_Autotest_CheckMotorDisengagement", "85");
    debugger_run();
    debugger_waitUntilBPisReached("1000");
ExpectedTestResult(debugger_result, IS_CPU_STOP_AT_BP_SUCCESFUL, "CPU is stopped at BP");
  
  /*********************  STEP 3  **************************/
    testStep("", "Step in.");
    debugger_stepIn();
    /*********************************************************/
  
    /*********************  STEP 7  **************************/ 
    testStep("STEP", "Run until return PMP_runGetMotorResistance and evaluate *pu16Resistance_mOhm data pointer --> Variable read from ADC.");
    debugger_runUntilReturn("10");
    debugger_readLocalVariable("*pu16Resistance_mOhm");
ExpectedTestResult(debugger_result, "pu16Resistance_mOhm", "Variable read.");
  /*********************************************************/
  
    testCaseComment("Action: ARCH_SW_PAL_0085");
    /*********************  STEP 8  **************************/ 
    debugger_deleteRelativeFunctionBpAtLine("PAL_Autotest_CheckMotorDisengagement", "85");
    testStep("STEP", "Set a breakpoint in function PAL_Autotest_CheckMotorDisengagement at the PAL_runReadMotorCurrentInmA function call --> CPU is stopped at BP.");
    debugger_setRelativeFunctionBpAtLine("PAL_Autotest_CheckMotorDisengagement", "99");
    debugger_run();
    debugger_waitUntilBPisReached("1000");
ExpectedTestResult(debugger_result, IS_CPU_STOP_AT_BP_SUCCESFUL, "CPU is stopped at BP");
  
  /*********************  STEP 3  **************************/
    testStep("", "Step in.");
    debugger_stepIn();
    /*********************************************************/
  
  testCaseComment("ARCH_SW_PAL_0080");
    /*********************  STEP 7  **************************/ 
    testStep("STEP", "Run until return PAL_runReadMotorCurrentInmA and evaluate *ps32MotorCurrentInmA data pointer --> Variable read from ADC.");
    debugger_runUntilReturn("10");
    debugger_readLocalVariable("*ps32MotorCurrentInmA");
ExpectedTestResult(debugger_result, "ps32MotorCurrentInmA", "Variable read.");
  /*********************************************************/
 
    /*********************  STEP 8  **************************/ 
    debugger_deleteRelativeFunctionBpAtLine("PAL_Autotest_CheckMotorDisengagement", "99");
    testStep("STEP", "Set a breakpoint in function PAL_Autotest_CheckMotorDisengagement at the autotest result --> CPU is stopped at BP.");
    debugger_setRelativeFunctionBpAtLine("PAL_Autotest_CheckMotorDisengagement", "169");
    debugger_run();
    debugger_waitUntilBPisReached("5000");
    ExpectedTestResult(debugger_result, IS_CPU_STOP_AT_BP_SUCCESFUL, "CPU is stopped at BP");
  
  testCaseComment("Action: ARCH_SW_PAL_0379");
    /*********************  STEP 9  **************************/
    testStep("STEP", "Evaluate PreviousADCTestResult --> Variable is equal to 0x1.");
    debugger_readLocalVariable("u8PreviousADCTestResult");
    ExpectedTestResult(debugger_result, "0x1", "Variable is equal to 0x1");
  /*********************************************************/
  
  /*********************  STEP 9  **************************/
    testStep("STEP", "Evaluate ExecutedCycleNumber --> Variable read.");
    debugger_readLocalVariable("u8ExecutedCycleNumber");
ExpectedTestResult(debugger_result, "u8ExecutedCycleNumber", "Variable read");
  /*********************************************************/
  
  testCaseComment("Action: ARCH_SW_PAL_0400");
    /*********************  STEP 9  **************************/
    testStep("STEP", "Evaluate ECUInternalTemperature --> Variable is equal to *ps16InternalTemperature_deg data pointer.");
    debugger_readLocalVariable("s16ECUInternalTemperature");
    ExpectedTestResult(debugger_result, "s16ECUInternalTemperature", "Variable is equal to *ps16InternalTemperature_deg data pointer");
  /*********************************************************/
  
  testCaseComment("Action: ARCH_SW_PAL_0401");
  /*********************  STEP 9  **************************/
    testStep("STEP", "Evaluate KL30Voltage_mV --> Variable is equal to *pu16Voltage data pointer data pointer.");
    debugger_readLocalVariable("u16KL30Voltage_mV");
    ExpectedTestResult(debugger_result, "u16KL30Voltage_mV", "Variable is equal to *pu16Voltage data pointer data pointer.");
  /*********************************************************/
  
  testCaseComment("Action: ARCH_SW_PAL_0402");
    /*********************  STEP 9  **************************/
    testStep("STEP", "Evaluate MotorResistance_mOhm --> Variable is equal to *pu16Resistance_mOhm data pointer.");
    debugger_readLocalVariable("u16MotorResistance_mOhm");
    ExpectedTestResult(debugger_result, "u16MotorResistance_mOhm", "Variable is equal to *pu16Resistance_mOhm data pointer.");
  /*********************************************************/
  
  
  /*********************  STEP 10  **************************/ 
    debugger_deleteRelativeFunctionBpAtLine("PAL_Autotest_CheckMotorDisengagement", "169");
    testStep("STEP", "Set a breakpoint in function PAL_cbk_CheckMotorDisengagement after the return of the autotest result --> CPU is stopped at BP.");
    debugger_setRelativeFunctionBpAtLine("PAL_cbk_CheckMotorDisengagement", "7");
    debugger_run();
    debugger_waitUntilBPisReached("5000");
    ExpectedTestResult(debugger_result, IS_CPU_STOP_AT_BP_SUCCESFUL, "CPU is stopped at BP");
    /*********************************************************/
  
  /*********************  STEP 11  **************************/ 
    testStep("STEP", "Read autotest result transmited from ATM --> Variable is equal to 0x1.");
    debugger_readLocalVariable("u8TestResult");
ExpectedTestResult(debugger_result, "1", "Variable is equal to 0x1");
  /*********************************************************/
  //====================================================
  testCaseComment("Postcondition");
  testStep("STEP", "Return ECU to default values");
  RunPostTs();
}

testcase SW_Int_PAL_Autotest_CheckMotorCurrent_01()
{ 
  //***********************************Test report header*********************************
  testReportAddMiscInfoBlock("AUTOLIV ELECTRONICS document");
  TestReportAddMiscInfo("Nightly test", "No");
  TestReportAddMiscInfo("Test type", "Requirement-Based test");
  TestReportAddMiscInfo("Regression Test", "Yes");
  TestReportAddMiscInfo("Fault injection method used", "No");
  TestReportAddMiscInfo("Resource usage evaluation", "No");
  TestReportAddMiscInfo("Priority", "No");
  TestReportAddMiscInfo("Safety relevant", "No");

  AddRequirementInfo("Requirement under test", "ARCH_SW_PAL_0340, ARCH_SW_PAL_0343, ARCH_SW_PAL_0341, ARCH_SW_PAL_0342");
  AddRequirementInfo("ARCH_SW_PAL_0340", "The component shall check the current used by the motor.");
  AddRequirementInfo("ARCH_SW_PAL_0343", "The current executed cycle shall be read from BFE.");
  AddRequirementInfo("ARCH_SW_PAL_0341", "Rte_BFE_psrExecutedCycle_u8CycleNumber shall be called  to get the current executed cycle number.");
  AddRequirementInfo("ARCH_SW_PAL_0342", "ATM_runGetTestResult shall be called to get the status ot specific tests (inhibiting the execution of the present one if failed).");
  
  //***************************************************************************************

  testCaseComment("Preconditions");
  testStep("STEP", "Bench Initialization");
  
  testStep("", "Delete all breakpoints from debugger.");
  debugger_deleteAllBreakpoints();
  
  testStep("", "Reset the debugger.");
  debugger_reset();
  
  testStep("STEP", "Run the debugger.");
  debugger_run();

  RunPreTs();
  //====================================================

  testCaseComment("Action: ARCH_SW_PAL_0340, ARCH_SW_PAL_0343");
    /*********************  STEP 1  **************************/
    testStep("STEP", "Set a breakpoint in function PAL_cbk_CheckMotorCurrent at the RTE Call for CheckMotorCurrent autotest --> BP reached.");
    debugger_setRelativeFunctionBpAtLine("PAL_cbk_CheckMotorCurrent", "4");
    debugger_reset();
    debugger_run();
    debugger_waitUntilBPisReached("5000");
    ExpectedTestResult(debugger_result, IS_CPU_STOP_AT_BP_SUCCESFUL, "CPU is stopped at BP");
    
    testStep("", "Step in.");
    debugger_stepIn();
  
    /*********************  STEP 2  **************************/
    debugger_deleteRelativeFunctionBpAtLine("PAL_cbk_CheckMotorCurrent", "4");
    testStep("STEP", "Set a breakpoint in function PAL_Autotest_CheckMotorCurrent at the RTE call for GetTestResult --> BP reached.");
    debugger_setRelativeFunctionBpAtLine("PAL_Autotest_CheckMotorCurrent", "25");
    debugger_run();
    debugger_waitUntilBPisReached("5000");
    ExpectedTestResult(debugger_result, IS_CPU_STOP_AT_BP_SUCCESFUL, "CPU is stopped at BP");
    
    /*********************  STEP 3  **************************/
    testStep("", "Step in.");
    debugger_stepIn();
    /*********************************************************/

    /*********************  STEP 4  **************************/ 
    testStep("", "Run until return in function ATM_runGetTestResult.");
    debugger_runUntilReturn("10");
    /*********************************************************/
  
  /*********************  STEP 5  **************************/ 
    testStep("STEP", "Write autotest result with KU8_ATM_TEST_OK --> Variable set to KU8_ATM_TEST_OK");
    debugger_writeLocalVariable("*u8TestResult", "1");
    ExpectedTestResult(debugger_result, "0x1", "Variable set to KU8_ATM_TEST_OK");
  /*********************************************************/
  
  /*********************  STEP 8  **************************/ 
    debugger_deleteRelativeFunctionBpAtLine("PAL_Autotest_CheckMotorCurrent", "25");
    testStep("STEP", "Set a breakpoint in function PAL_Autotest_CheckMotorCurrent at the return of autotest result --> BP reached.");
    debugger_setRelativeFunctionBpAtLine("PAL_Autotest_CheckMotorCurrent", "117");
    debugger_run();
    debugger_waitUntilBPisReached("5000");
    ExpectedTestResult(debugger_result, IS_CPU_STOP_AT_BP_SUCCESFUL, "CPU is stopped at BP");
  
  /*********************  STEP 9  **************************/
    testStep("STEP", "Overwrite autotest result with KU8_ATM_TEST_OK --> Variable is set to 0x1.");
    debugger_writeLocalVariable("*pu8TestResult", "1");
ExpectedTestResult(debugger_result, "0x1", "Variable is set to 0x1");
  /*********************************************************/
  
  testCaseComment("Action: ARCH_SW_PAL_0341");
    /*********************  STEP 9  **************************/
    testStep("STEP", "Evaluate pal_tMotorCurrentEventStatus --> Variable is equal to 0x1.");
    debugger_readLocalVariable("pal_tMotorCurrentEventStatus");
ExpectedTestResult(debugger_result, "0x1", "Variable is equal to 0x1");
  /*********************************************************/
  
  testCaseComment("Action: ARCH_SW_PAL_0342");
    /*********************  STEP 9  **************************/
    testStep("STEP", "Evaluate ExecutedCycleNumber --> Variable read.");
    debugger_readLocalVariable("u8ExecutedCycleNumber");
ExpectedTestResult(debugger_result, "u8ExecutedCycleNumber", "Variable read");
  /*********************************************************/
  
  
  /*********************  STEP 10  **************************/ 
    debugger_deleteRelativeFunctionBpAtLine("PAL_Autotest_CheckMotorCurrent", "117");
    testStep("STEP", "Set a breakpoint in function PAL_cbk_CheckMotorCurrent after the return of the autotest result --> BP reached.");
    debugger_setRelativeFunctionBpAtLine("PAL_cbk_CheckMotorCurrent", "7");
    debugger_run();
    debugger_waitUntilBPisReached("5000");
    ExpectedTestResult(debugger_result, IS_CPU_STOP_AT_BP_SUCCESFUL, "CPU is stopped at BP");
    /*********************************************************/
  
  /*********************  STEP 11  **************************/ 
    testStep("STEP", "Read autotest result transmited from ATM --> Variable is equal to 0x1.");
    debugger_readLocalVariable("u8TestResult");
    ExpectedTestResult(debugger_result, "1", "Variable is equal to 0x1");
  /*********************************************************/
  //====================================================
  testCaseComment("Postcondition");
  testStep("STEP", "Return ECU to default values");
  RunPostTs();
}

testcase SW_Int_PAL_Autotest_CheckMotorThermalProctection_01()
{ 
  //***********************************Test report header*********************************
  testReportAddMiscInfoBlock("AUTOLIV ELECTRONICS document");
  TestReportAddMiscInfo("Nightly test", "No");
  TestReportAddMiscInfo("Test type", "Requirement-Based test");
  TestReportAddMiscInfo("Regression Test", "Yes");
  TestReportAddMiscInfo("Fault injection method used", "No");
  TestReportAddMiscInfo("Resource usage evaluation", "No");
  TestReportAddMiscInfo("Priority", "No");
  TestReportAddMiscInfo("Safety relevant", "No");

  AddRequirementInfo("Requirement under test", "ARCH_SW_PAL_0361");
  AddRequirementInfo("ARCH_SW_PAL_0361", "PMP_runGetDeficiencyLevel function shall be called to get the estimation of the energy stored in the motor.");
  
  //***************************************************************************************

  testCaseComment("Preconditions");
  testStep("STEP", "Bench Initialization");
  
  testStep("", "Delete all breakpoints from debugger.");
  debugger_deleteAllBreakpoints();
  
  testStep("", "Reset the debugger.");
  debugger_reset();
  
  testStep("STEP", "Run the debugger.");
  debugger_run();

  RunPreTs();
  //====================================================

    /*********************  STEP 1  **************************/
    testStep("STEP", "Set a breakpoint in function PAL_cbk_CheckMotorThermalProctection at the RTE Call for CheckMotorThermalProctection autotest.");
    debugger_setRelativeFunctionBpAtLine("PAL_cbk_CheckMotorThermalProctection", "4");
    debugger_reset();
    debugger_run();
    debugger_waitUntilBPisReached("5000");
    ExpectedTestResult(debugger_result, IS_CPU_STOP_AT_BP_SUCCESFUL, "CPU is stopped at BP");
    
    testStep("STEP", "Step in.");
    debugger_stepIn();
  
    /*********************  STEP 2  **************************/
    debugger_deleteRelativeFunctionBpAtLine("PAL_cbk_CheckMotorThermalProctection", "4");
    testStep("STEP", "Set a breakpoint in function PAL_Autotest_CheckMotorThermalProctection at the RTE call for PMP_runGetDeficiencyLevel.");
    debugger_setRelativeFunctionBpAtLine("PAL_Autotest_CheckMotorThermalProctection", "14");
    debugger_run();
    debugger_waitUntilBPisReached("5000");
    ExpectedTestResult(debugger_result, IS_CPU_STOP_AT_BP_SUCCESFUL, "CPU is stopped at BP");
    
    /*********************  STEP 3  **************************/
    testStep("STEP", "Step in.");
    debugger_stepIn();
    /*********************************************************/

    /*********************  STEP 4  **************************/ 
    testStep("STEP", "Run until return in function PMP_runGetDeficiencyLevel.");
    debugger_runUntilReturn("10");
    /*********************************************************/
  
  /*********************  STEP 5  **************************/ 
    testStep("STEP", "Read DeficiencyLevel.");
    debugger_readLocalVariable("*pu32DeficiencyLevel");
    ExpectedTestResult(debugger_result, "pu32DeficiencyLevel", "Local variable read.");
  /*********************************************************/
  
  /*********************  STEP 8  **************************/ 
    debugger_deleteRelativeFunctionBpAtLine("PAL_Autotest_CheckMotorThermalProctection", "14");
    testStep("STEP", "Set a breakpoint in function PAL_Autotest_CheckMotorThermalProctection at the return of autotest result.");
    debugger_setRelativeFunctionBpAtLine("PAL_Autotest_CheckMotorThermalProctection", "56");
    debugger_run();
    debugger_waitUntilBPisReached("5000");
    ExpectedTestResult(debugger_result, IS_CPU_STOP_AT_BP_SUCCESFUL, "CPU is stopped at BP");
  
  /*********************  STEP 9  **************************/
    testStep("STEP", "Overwrite autotest result with KU8_ATM_TEST_OK.");
    debugger_writeLocalVariable("*pu8TestResult", "1");
    ExpectedTestResult(debugger_result, "0x1", "Variable is set to 0x1");
  /*********************************************************/
  
  testCaseComment("Action: ARCH_SW_PAL_0361");
    /*********************  STEP 9  **************************/
    testStep("STEP", "Evaluate pal_u32DeficiencyLevel.");
    debugger_readLocalVariable("pal_u32DeficiencyLevel");
    ExpectedTestResult(debugger_result, "pal_u32DeficiencyLevel", "Variable equal to *pu32DeficiencyLevel data pointer.");
  /*********************************************************/

  /*********************  STEP 10  **************************/ 
    debugger_deleteRelativeFunctionBpAtLine("PAL_Autotest_CheckMotorThermalProctection", "56");
    testStep("STEP", "Set a breakpoint in function PAL_cbk_CheckMotorThermalProctection after the return of the autotest result.");
    debugger_setRelativeFunctionBpAtLine("PAL_cbk_CheckMotorThermalProctection", "7");
    debugger_run();
    debugger_waitUntilBPisReached("5000");
    ExpectedTestResult(debugger_result, IS_CPU_STOP_AT_BP_SUCCESFUL, "CPU is stopped at BP");
    /*********************************************************/
  
  /*********************  STEP 11  **************************/ 
    testStep("STEP", "Read autotest result transmited from ATM.");
    debugger_readLocalVariable("u8TestResult");
    ExpectedTestResult(debugger_result, "1", "Variable is equal to 0x1");
  /*********************************************************/
  //====================================================
  testCaseComment("Postcondition");
  testStep("STEP", "Return ECU to default values");
  RunPostTs();
}

testcase SW_Int_PAL_Autotest_CheckMotorPowerOrder_01()
{ 
  //***********************************Test report header*********************************
  testReportAddMiscInfoBlock("AUTOLIV ELECTRONICS document");
  TestReportAddMiscInfo("Nightly test", "No");
  TestReportAddMiscInfo("Test type", "Requirement-Based test");
  TestReportAddMiscInfo("Regression Test", "Yes");
  TestReportAddMiscInfo("Fault injection method used", "No");
  TestReportAddMiscInfo("Resource usage evaluation", "No");
  TestReportAddMiscInfo("Priority", "No");
  TestReportAddMiscInfo("Safety relevant", "No");

  AddRequirementInfo("Requirement under test", "ARCH_SW_PAL_0382, ARCH_SW_PAL_0381, ARCH_SW_PAL_0390, ARCH_SW_PAL_0391, ARCH_SW_PAL_0392, ARCH_SW_PAL_0393");
  AddRequirementInfo("ARCH_SW_PAL_0382", "The component shall check if a high PWM duty cycle will not be applied for a too long time.");
  AddRequirementInfo("ARCH_SW_PAL_0381", "The current executed data from BFE shall be an input.");
  AddRequirementInfo("ARCH_SW_PAL_0390", "The ERH_runGetAecStatus function shall be called to get the motor Order AEC status.");
  AddRequirementInfo("ARCH_SW_PAL_0391", "ATM_runGetTestResult shall be called to get the status ot specific tests (inhibiting the execution of the present one if failed).S");
  AddRequirementInfo("ARCH_SW_PAL_0392", "MMG_runCheckModeStatus shall be called to get the context status.");
  AddRequirementInfo("ARCH_SW_PAL_0393", "Rte_Read_prrExecutedCycle_u8CycleNumber shall be called to check if no PRO cycle is running.");
  
  //***************************************************************************************

  testCaseComment("Preconditions");
  testStep("STEP", "Bench Initialization");
  
  testStep("", "Delete all breakpoints from debugger.");
  debugger_deleteAllBreakpoints();
  
  testStep("", "Reset the debugger.");
  debugger_reset();
  
  testStep("STEP", "Run the debugger.");
  debugger_run();

  RunPreTs();
  //====================================================

  testCaseComment("Action: ARCH_SW_PAL_0382, ARCH_SW_PAL_0381, ARCH_SW_PAL_0393");
    /*********************  STEP 1  **************************/
    testStep("STEP", "Set a breakpoint in function PAL_cbk_CheckMotorPowerOrder at the RTE Call for CheckMotorPowerOrder autotest --> BP reached.");
    debugger_setRelativeFunctionBpAtLine("PAL_cbk_CheckMotorPowerOrder", "4");
    debugger_reset();
    debugger_run();
    debugger_waitUntilBPisReached("5000");
    ExpectedTestResult(debugger_result, IS_CPU_STOP_AT_BP_SUCCESFUL, "CPU is stopped at BP");
    
    testStep("STEP", "Step in.");
    debugger_stepIn();
  
    /*********************  STEP 2  **************************/
    debugger_deleteRelativeFunctionBpAtLine("PAL_cbk_CheckMotorPowerOrder", "4");
    testStep("STEP", "Set a breakpoint in function PAL_Autotest_CheckMotorPowerOrder at the RTE call for ERH_runGetAecStatus --> BP reached.");
    debugger_setRelativeFunctionBpAtLine("PAL_Autotest_CheckMotorPowerOrder", "34");
    debugger_run();
    debugger_waitUntilBPisReached("5000");
    ExpectedTestResult(debugger_result, IS_CPU_STOP_AT_BP_SUCCESFUL, "CPU is stopped at BP");
    
    /*********************  STEP 3  **************************/
    testStep("", "Step in.");
    debugger_stepIn();
    /*********************************************************/

    /*********************  STEP 4  **************************/ 
    testStep("", "Run until return in function ERH_runGetAecStatus.");
    debugger_runUntilReturn("10");
    /*********************************************************/
  
  /*********************  STEP 5  **************************/ 
    testStep("STEP", "Read *AecStatus --> Local variable read.");
    debugger_readLocalVariable("*pu8AecStatus");
ExpectedTestResult(debugger_result, "pu8AecStatus", "Local variable read.");
  /*********************************************************/
  
     /*********************  STEP 2  **************************/
    debugger_deleteRelativeFunctionBpAtLine("PAL_Autotest_CheckMotorPowerOrder", "34");
    testStep("STEP", "Set a breakpoint in function PAL_Autotest_CheckMotorPowerOrder at the RTE call for GetTestResult --> BP reached.");
    debugger_setRelativeFunctionBpAtLine("PAL_Autotest_CheckMotorPowerOrder", "37");
    debugger_run();
    debugger_waitUntilBPisReached("5000");
    ExpectedTestResult(debugger_result, IS_CPU_STOP_AT_BP_SUCCESFUL, "CPU is stopped at BP");
    
    /*********************  STEP 3  **************************/
    testStep("", "Step in.");
    debugger_stepIn();
    /*********************************************************/

    /*********************  STEP 4  **************************/ 
    testStep("", "Run until return in function ATM_runGetTestResult.");
    debugger_runUntilReturn("10");
    /*********************************************************/
  
  /*********************  STEP 5  **************************/ 
    testStep("", "Write autotest result with 0x1 --> Variable overwritten with 0x1");
    debugger_writeLocalVariable("*u8TestResult", "1");
    ExpectedTestResult(debugger_result, "0x1", "Variable overwritten with 0x1");
  /*********************************************************/
  
      /*********************  STEP 2  **************************/
    debugger_deleteRelativeFunctionBpAtLine("PAL_Autotest_CheckMotorPowerOrder", "37");
    testStep("STEP", "Set a breakpoint in function PAL_Autotest_CheckMotorPowerOrder at the RTE call for MMG_runCheckModeStatus --> BP reached.");
    debugger_setRelativeFunctionBpAtLine("PAL_Autotest_CheckMotorPowerOrder", "45");
    debugger_run();
    debugger_waitUntilBPisReached("5000");
    ExpectedTestResult(debugger_result, IS_CPU_STOP_AT_BP_SUCCESFUL, "CPU is stopped at BP");
    
    /*********************  STEP 3  **************************/
    testStep("", "Step in.");
    debugger_stepIn();
    /*********************************************************/

    /*********************  STEP 4  **************************/ 
    testStep("", "Run until return in function MMG_runCheckModeStatus.");
    debugger_runUntilReturn("10");
    /*********************************************************/
  
  /*********************  STEP 5  **************************/ 
    testStep("STEP", "Read *ModeStatus --> Local variable read.");
    debugger_readLocalVariable("*bModeStatus");
    ExpectedTestResult(debugger_result, "bModeStatus", "Local variable read.");
  /*********************************************************/

  
  /*********************  STEP 8  **************************/ 
    debugger_deleteRelativeFunctionBpAtLine("PAL_Autotest_CheckMotorPowerOrder", "45");
    testStep("STEP", "Set a breakpoint in function PAL_Autotest_CheckMotorPowerOrder at the return of autotest result --> BP reached.");
    debugger_setRelativeFunctionBpAtLine("PAL_Autotest_CheckMotorPowerOrder", "141");
    debugger_run();
    debugger_waitUntilBPisReached("5000");
    ExpectedTestResult(debugger_result, IS_CPU_STOP_AT_BP_SUCCESFUL, "CPU is stopped at BP");
  
  /*********************  STEP 9  **************************/
    testStep("STEP", "Overwrite autotest result with KU8_ATM_TEST_OK --> Variable is set to 0x1.");
    debugger_writeLocalVariable("*pu8TestResult", "1");
ExpectedTestResult(debugger_result, "0x1", "Variable is set to 0x1");
  /*********************************************************/
  
  testCaseComment("Action: ARCH_SW_PAL_0391");
    /*********************  STEP 9  **************************/
    testStep("STEP", "Evaluate MotorOrderEventStatus --> Variable equal to *pu8AecStatus data pointer.");
    debugger_readLocalVariable("tMotorOrderEventStatus");
ExpectedTestResult(debugger_result, "tMotorOrderEventStatus", "Variable equal to *pu8AecStatus data pointer.");
  /*********************************************************/
  
  testCaseComment("Action: ARCH_SW_PAL_0390");
      /*********************  STEP 9  **************************/
    testStep("STEP", "Evaluate PreviousADCTestResult --> Variable equal to 0x1.");
    debugger_readLocalVariable("u8PreviousADCTestResult");
ExpectedTestResult(debugger_result, "0x1", "Variable equal to 0x1.");
  /*********************************************************/
  
  testCaseComment("Action: ARCH_SW_PAL_0392");
      /*********************  STEP 9  **************************/
    testStep("STEP", "Evaluate TensioningModeStatus --> Variable equal to *ModeStatus data pointer.");
    debugger_readLocalVariable("u8TensioningModeStatus");
ExpectedTestResult(debugger_result, "u8TensioningModeStatus", "Variable equal to *ModeStatus data pointer.");
  /*********************************************************/
  

  /*********************  STEP 10  **************************/ 
    debugger_deleteRelativeFunctionBpAtLine("PAL_Autotest_CheckMotorPowerOrder", "141");
    testStep("STEP", "Set a breakpoint in function PAL_cbk_CheckMotorPowerOrder after the return of the autotest result --> BP reached.");
    debugger_setRelativeFunctionBpAtLine("PAL_cbk_CheckMotorPowerOrder", "7");
    debugger_run();
    debugger_waitUntilBPisReached("5000");
    ExpectedTestResult(debugger_result, IS_CPU_STOP_AT_BP_SUCCESFUL, "CPU is stopped at BP");
    /*********************************************************/
  
  /*********************  STEP 11  **************************/ 
    testStep("STEP", "Read autotest result transmited from ATM --> Variable is equal to 0x1.");
    debugger_readLocalVariable("u8TestResult");
    ExpectedTestResult(debugger_result, "1", "Variable is equal to 0x1");
  /*********************************************************/
  //====================================================
  testCaseComment("Postcondition");
  testStep("STEP", "Return ECU to default values");
  RunPostTs();
}

testcase SW_Int_PAL_Autotest_CheckMotorSC_01()
{ 
  //***********************************Test report header*********************************
  testReportAddMiscInfoBlock("AUTOLIV ELECTRONICS document");
  TestReportAddMiscInfo("Nightly test", "No");
  TestReportAddMiscInfo("Test type", "Requirement-Based test");
  TestReportAddMiscInfo("Regression Test", "Yes");
  TestReportAddMiscInfo("Fault injection method used", "No");
  TestReportAddMiscInfo("Resource usage evaluation", "No");
  TestReportAddMiscInfo("Priority", "No");
  TestReportAddMiscInfo("Safety relevant", "No");

  AddRequirementInfo("Requirement under test", "ARCH_SW_PAL_0386, ARCH_SW_PAL_0383, ARCH_SW_PAL_0384, ARCH_SW_PAL_0385, ARCH_SW_PAL_0386, ARCH_SW_PAL_0387, ARCH_SW_PAL_0388, ARCH_SW_PAL_0389");
  AddRequirementInfo("ARCH_SW_PAL_0386", "The component shall check if the motor is not shortcut with Vbat or GND.");
  AddRequirementInfo("ARCH_SW_PAL_0383", "The current executed cycle data from BFE shall be an input.");
  AddRequirementInfo("ARCH_SW_PAL_0384", "The PMP_runGetBatteryVoltage_10ms function shall be called to get the battery voltage.");
  AddRequirementInfo("ARCH_SW_PAL_0385", "ATM_runGetTestResult shall be called to get the status ot specific tests (inhibiting the execution of the present one if failed).");
  AddRequirementInfo("ARCH_SW_PAL_0386", "PAL_runReadMotorCurrentInmA shall be called to get the Motor current.");
  AddRequirementInfo("ARCH_SW_PAL_0387", "PMP_runGetBatteryVoltage_10ms shall be called to mesure motor SC current.");
  AddRequirementInfo("ARCH_SW_PAL_0388", "PMP_runGetFilteredTemperature_deg shall be called to get the filtred value of the ECU temperature.");
  AddRequirementInfo("ARCH_SW_PAL_0389", "PMP_runGetMotorResistance shall be called to get the value for motor resitance.");
  AddRequirementInfo("ARCH_SW_PAL_0086", "If the motor rotation direction is “releasing”, the AdcIf_runGetMotor_In function shall be called to read the motor current measured by the half bridge connected to the VN pin of the motor.");
  //***************************************************************************************

  testCaseComment("Preconditions");
  testStep("STEP", "Bench Initialization");
  
  testStep("", "Delete all breakpoints from debugger.");
  debugger_deleteAllBreakpoints();
  
  testStep("", "Reset the debugger.");
  debugger_reset();
  
  testStep("STEP", "Run the debugger.");
  debugger_run();

  RunPreTs();
  //====================================================

   testCaseComment("Action: ARCH_SW_PAL_0386, ARCH_SW_PAL_0383");
    /*********************  STEP 1  **************************/
    testStep("STEP", "Set a breakpoint in function PAL_cbk_CheckMotorSC at the RTE Call for CheckMotorSC autotest --> BP reached.");
    debugger_setRelativeFunctionBpAtLine("PAL_cbk_CheckMotorSC", "4");
    debugger_reset();
    debugger_run();
    debugger_waitUntilBPisReached("5000");
    ExpectedTestResult(debugger_result, IS_CPU_STOP_AT_BP_SUCCESFUL, "CPU is stopped at BP");
    
    testStep("STEP", "Step in.");
    debugger_stepIn();
  
    /*********************  STEP 2  **************************/
    debugger_deleteRelativeFunctionBpAtLine("PAL_cbk_CheckMotorSC", "4");
    testStep("STEP", "Set a breakpoint in function PAL_Autotest_CheckMotorSC at the RTE call for GetTestResult --> BP reached.");
    debugger_setRelativeFunctionBpAtLine("PAL_Autotest_CheckMotorSC", "40");
    debugger_run();
    debugger_waitUntilBPisReached("5000");
    ExpectedTestResult(debugger_result, IS_CPU_STOP_AT_BP_SUCCESFUL, "CPU is stopped at BP");
    
    /*********************  STEP 3  **************************/
    testStep("STEP", "Step in.");
    debugger_stepIn();
    /*********************************************************/

    /*********************  STEP 4  **************************/ 
    testStep("STEP", "Run until return in function ATM_runGetTestResult.");
    debugger_runUntilReturn("10");
    /*********************************************************/
  
  /*********************  STEP 5  **************************/ 
    testStep("STEP", "Write autotest result with 0x1");
    debugger_writeLocalVariable("*u8TestResult", "1");
    ExpectedTestResult(debugger_result, "1", "CPU is stopped at BP");
  /*********************************************************/
  
      
    /*********************  STEP 8  **************************/ 
    debugger_deleteRelativeFunctionBpAtLine("PAL_Autotest_CheckMotorSC", "40");
    testStep("STEP", "Set a breakpoint in function PAL_Autotest_CheckMotorSC at the PAL_runReadMotorCurrentInmA function call --> BP reached.");
    debugger_setRelativeFunctionBpAtLine("PAL_Autotest_CheckMotorSC", "140");
    debugger_run();
    debugger_waitUntilBPisReached("5000");
    ExpectedTestResult(debugger_result, IS_CPU_STOP_AT_BP_SUCCESFUL, "CPU is stopped at BP");
  
  /*********************  STEP 3  **************************/
    testStep("", "Step in.");
    debugger_stepIn();
    /*********************************************************/
  
    /*********************  STEP 7  **************************/ 
    testStep("STEP", "Run until return PAL_runReadMotorCurrentInmA and evaluate *ps32MotorCurrentInmA data pointer --> Variable read from ADC.");
    debugger_runUntilReturn("10");
    debugger_readLocalVariable("*ps32MotorCurrentInmA");
    ExpectedTestResult(debugger_result, "ps32MotorCurrentInmA", "Variable read.");
  /*********************************************************/
  
  
   /*********************  STEP 8  **************************/ 
    debugger_deleteRelativeFunctionBpAtLine("PAL_Autotest_CheckMotorSC", "140");
    testStep("STEP", "Set a breakpoint in function PAL_Autotest_CheckMotorSC at the RTE Call for PMP_runGetBatteryVoltage_10ms --> BP reached.");
    debugger_setRelativeFunctionBpAtLine("PAL_Autotest_CheckMotorSC", "154");
    debugger_run();
    debugger_waitUntilBPisReached("5000");
    ExpectedTestResult(debugger_result, IS_CPU_STOP_AT_BP_SUCCESFUL, "CPU is stopped at BP");
  
  /*********************  STEP 3  **************************/
    testStep("", "Step in.");
    debugger_stepIn();
    /*********************************************************/
  
   testCaseComment("Action: ARCH_SW_PAL_0086");
    /*********************  STEP 7  **************************/ 
    testStep("STEP", "Run until return PMP_runGetBatteryVoltage_10ms and evaluate *pu16Voltage data pointer --> Variable read from ADC.");
    debugger_runUntilReturn("10");
    debugger_readLocalVariable("*pu16Voltage");
    ExpectedTestResult(debugger_result, "pu16Voltage", "Variable read.");
  /*********************************************************/
  
  /*********************  STEP 6  **************************/ 
    debugger_deleteRelativeFunctionBpAtLine("PAL_Autotest_CheckMotorSC", "154");
    testStep("STEP", "Set a breakpoint in function PAL_Autotest_CheckMotorSC at the RTE Call for PMP_runGetFilteredTemperature_deg --> BP reached.");
    debugger_setRelativeFunctionBpAtLine("PAL_Autotest_CheckMotorSC", "163");
    debugger_run();
    debugger_waitUntilBPisReached("5000");
    ExpectedTestResult(debugger_result, IS_CPU_STOP_AT_BP_SUCCESFUL, "CPU is stopped at BP");
  /*********************************************************/
  
    /*********************  STEP 3  **************************/
    testStep("", "Step in.");
    debugger_stepIn();
    /*********************************************************/
  
    /*********************  STEP 7  **************************/ 
    testStep("STEP", "Run until return PMP_runGetFilteredTemperature_deg and evaluate *ps16InternalTemperature_deg data pointer --> Variable read from ADC.");
    debugger_runUntilReturn("10");
    debugger_readLocalVariable("*ps16InternalTemperature_deg");
    ExpectedTestResult(debugger_result, "ps16InternalTemperature_deg", "Variable read.");
  /*********************************************************/
  
  
    /*********************  STEP 8  **************************/ 
    debugger_deleteRelativeFunctionBpAtLine("PAL_Autotest_CheckMotorSC", "163");
    testStep("STEP", "Set a breakpoint in function PAL_Autotest_CheckMotorSC at the RTE Call for PMP_runGetMotorResistance --> BP reached.");
    debugger_setRelativeFunctionBpAtLine("PAL_Autotest_CheckMotorSC", "167");
    debugger_run();
    debugger_waitUntilBPisReached("5000");
    ExpectedTestResult(debugger_result, IS_CPU_STOP_AT_BP_SUCCESFUL, "CPU is stopped at BP");
  
  /*********************  STEP 3  **************************/
    testStep("", "Step in.");
    debugger_stepIn();
    /*********************************************************/
  
    /*********************  STEP 7  **************************/ 
    testStep("STEP", "Run until return PMP_runGetMotorResistance and evaluate *pu16Resistance_mOhm data pointer --> Variable read from ADC.");
    debugger_runUntilReturn("10");
    debugger_readLocalVariable("*pu16Resistance_mOhm");
    ExpectedTestResult(debugger_result, "pu16Resistance_mOhm", "Variable read.");
  /*********************************************************/
 
 
    /*********************  STEP 8  **************************/ 
    debugger_deleteRelativeFunctionBpAtLine("PAL_Autotest_CheckMotorSC", "167");
    testStep("STEP", "Set a breakpoint in function PAL_Autotest_CheckMotorSC at the autotest result --> BP reached.");
    debugger_setRelativeFunctionBpAtLine("PAL_Autotest_CheckMotorSC", "246");
    debugger_run();
    debugger_waitUntilBPisReached("5000");
    ExpectedTestResult(debugger_result, IS_CPU_STOP_AT_BP_SUCCESFUL, "CPU is stopped at BP");
  
  testCaseComment("Action: ARCH_SW_PAL_0385");
    /*********************  STEP 9  **************************/
    testStep("STEP", "Evaluate PreviousADCTestResult --> Variable is equal to 0x1.");
    debugger_readLocalVariable("u8PreviousADCTestResult");
    ExpectedTestResult(debugger_result, "0x1", "Variable is equal to 0x1");
  /*********************************************************/
  
  /*********************  STEP 9  **************************/
    testStep("STEP", "Evaluate ExecutedCycleNumber --> Variable read.");
    debugger_readLocalVariable("u8ExecutedCycleNumber");
    ExpectedTestResult(debugger_result, "u8ExecutedCycleNumber", "Variable read");
  /*********************************************************/
  
  testCaseComment("Action: ARCH_SW_PAL_0389");
    /*********************  STEP 9  **************************/
    testStep("STEP", "Evaluate ECUInternalTemperature --> Variable is equal to *ps16InternalTemperature_deg data pointer.");
    debugger_readLocalVariable("s16ECUInternalTemperature");
    ExpectedTestResult(debugger_result, "s16ECUInternalTemperature", "Variable is equal to *ps16InternalTemperature_deg data pointer");
  /*********************************************************/
  
  testCaseComment("Action: ARCH_SW_PAL_0384, ARCH_SW_PAL_0387");
  /*********************  STEP 9  **************************/
    testStep("STEP", "Evaluate KL30Voltage_mV --> Variable is equal to *pu16Voltage data pointer data pointer.");
    debugger_readLocalVariable("u16KL30Voltage_mV");
    ExpectedTestResult(debugger_result, "u16KL30Voltage_mV", "Variable is equal to *pu16Voltage data pointer data pointer.");
  /*********************************************************/
  
  testCaseComment("Action: ARCH_SW_PAL_0388");
    /*********************  STEP 9  **************************/
    testStep("STEP", "Evaluate MotorResistance_mOhm --> Variable is equal to *pu16Resistance_mOhm data pointer.");
    debugger_readLocalVariable("u16MotorResistance_mOhm");
    ExpectedTestResult(debugger_result, "u16MotorResistance_mOhm", "Variable is equal to *pu16Resistance_mOhm data pointer.");
  /*********************************************************/
  
  
  /*********************  STEP 10  **************************/ 
    debugger_deleteRelativeFunctionBpAtLine("PAL_Autotest_CheckMotorSC", "246");
    testStep("STEP", "Set a breakpoint in function PAL_cbk_CheckMotorSC after the return of the autotest result --> BP reached.");
    debugger_setRelativeFunctionBpAtLine("PAL_cbk_CheckMotorSC", "7");
    debugger_run();
    debugger_waitUntilBPisReached("5000");
    ExpectedTestResult(debugger_result, IS_CPU_STOP_AT_BP_SUCCESFUL, "CPU is stopped at BP");
    /*********************************************************/
  
  /*********************  STEP 11  **************************/ 
    testStep("STEP", "Read autotest result transmited from ATM --> Variable is equal to 0x1.");
    debugger_readLocalVariable("u8TestResult");
    ExpectedTestResult(debugger_result, "1", "Variable is equal to 0x1");
  /*********************************************************/
  //====================================================
  testCaseComment("Postcondition");
  testStep("STEP", "Return ECU to default values");
  RunPostTs();
}

testcase SW_Int_PAL_Autotest_CHeckMotorThermalProtection_02()
{ 
  //***********************************Test report header*********************************
  testReportAddMiscInfoBlock("AUTOLIV ELECTRONICS document");
  TestReportAddMiscInfo("Nightly test", "No");
  TestReportAddMiscInfo("Test type", "Requirement-Based test");
  TestReportAddMiscInfo("Regression Test", "Yes");
  TestReportAddMiscInfo("Fault injection method used", "No");
  TestReportAddMiscInfo("Resource usage evaluation", "No");
  TestReportAddMiscInfo("Priority", "No");
  TestReportAddMiscInfo("Safety relevant", "No");

  AddRequirementInfo("Requirement under test", "ARCH_SW_PAL_0360, ARCH_SW_PAL_0366");
  AddRequirementInfo("ARCH_SW_PAL_0360", "The component shall check if an over temperature of the power stage is reached by returning a SW self-protection status.");
  AddRequirementInfo("ARCH_SW_PAL_0366", "The component shall check the state of specific autotests.");
  
  //***************************************************************************************

  testCaseComment("Preconditions");
  testStep("STEP", "Bench Initialization");
  
  testStep("", "Delete all breakpoints from debugger.");
  debugger_deleteAllBreakpoints();
  
  testStep("", "Reset the debugger.");
  debugger_reset();
  
  testStep("STEP", "Run the debugger.");
  debugger_run();

  RunPreTs();
  //====================================================

  testCaseComment("Action: ARCH_SW_PAL_0360");
    /*********************  STEP 1  **************************/
    testStep("STEP", "Set a breakpoint in function PAL_cbk_CheckMotorThermalProctection at the RTE Call for CheckMotorThermalProctection autotest --> BP reached.");
    debugger_setRelativeFunctionBpAtLine("PAL_cbk_CheckMotorThermalProctection", "4");
    debugger_reset();
    debugger_run();
    debugger_waitUntilBPisReached("5000");
    ExpectedTestResult(debugger_result, IS_CPU_STOP_AT_BP_SUCCESFUL, "CPU is stopped at BP");
    
    testStep("", "Step in.");
    debugger_stepIn();
  
    /*********************  STEP 2  **************************/
    debugger_deleteRelativeFunctionBpAtLine("PAL_cbk_CheckMotorThermalProctection", "4");
    testStep("STEP", "Set a breakpoint in function PAL_Autotest_CheckMotorThermalProctection at the RTE call for GetTestResult --> BP reached.");
    debugger_setRelativeFunctionBpAtLine("PAL_Autotest_CheckMotorThermalProctection", "18");
    debugger_run();
    debugger_waitUntilBPisReached("5000");
    ExpectedTestResult(debugger_result, IS_CPU_STOP_AT_BP_SUCCESFUL, "CPU is stopped at BP");
    
    /*********************  STEP 3  **************************/
    testStep("", "Step in.");
    debugger_stepIn();
    /*********************************************************/

    /*********************  STEP 4  **************************/ 
    testStep("", "Run until return in function ATM_runGetTestResult.");
    debugger_runUntilReturn("10");
    /*********************************************************/
  
  /*********************  STEP 5  **************************/ 
    testStep("STEP", "Write autotest result with KU8_ATM_TEST_OK --> Variable set to KU8_ATM_TEST_OK");
    debugger_writeLocalVariable("*u8TestResult", "1");
    ExpectedTestResult(debugger_result, "0x1", "Variable set to KU8_ATM_TEST_OK");
  /*********************************************************/
  
  /*********************  STEP 8  **************************/ 
    debugger_deleteRelativeFunctionBpAtLine("PAL_Autotest_CheckMotorThermalProctection", "18");
    testStep("STEP", "Set a breakpoint in function PAL_Autotest_CheckMotorCurrent at the return of autotest result --> BP reached.");
    debugger_setRelativeFunctionBpAtLine("PAL_Autotest_CheckMotorThermalProctection", "56");
    debugger_run();
    debugger_waitUntilBPisReached("5000");
    ExpectedTestResult(debugger_result, IS_CPU_STOP_AT_BP_SUCCESFUL, "CPU is stopped at BP");
  
  /*********************  STEP 9  **************************/
    testStep("STEP", "Overwrite autotest result with KU8_ATM_TEST_OK --> Variable is set to 0x1.");
    debugger_writeLocalVariable("*pu8TestResult", "1");
    ExpectedTestResult(debugger_result, "0x1", "Variable is set to 0x1");
  /*********************************************************/
  
  testCaseComment("Action: ARCH_SW_PAL_0366");
    /*********************  STEP 9  **************************/
    testStep("STEP", "Evaluate pal_tSwThermalProtectionEventStatus --> Variable is equal to 0x1.");
    debugger_readLocalVariable("pal_tSwThermalProtectionEventStatus");
    ExpectedTestResult(debugger_result, "0x1", "Variable is equal to 0x1");
  /*********************************************************/
  
  
  /*********************  STEP 10  **************************/ 
    debugger_deleteRelativeFunctionBpAtLine("PAL_Autotest_CheckMotorThermalProctection", "56");
    testStep("STEP", "Set a breakpoint in function PAL_cbk_CheckMotorThermalProctection after the return of the autotest result --> BP reached.");
    debugger_setRelativeFunctionBpAtLine("PAL_cbk_CheckMotorThermalProctection", "7");
    debugger_run();
    debugger_waitUntilBPisReached("5000");
    ExpectedTestResult(debugger_result, IS_CPU_STOP_AT_BP_SUCCESFUL, "CPU is stopped at BP");
    /*********************************************************/
  
  /*********************  STEP 11  **************************/ 
    testStep("STEP", "Read autotest result transmited from ATM --> Variable is equal to 0x1.");
    debugger_readLocalVariable("u8TestResult");
    ExpectedTestResult(debugger_result, "1", "Variable is equal to 0x1");
  /*********************************************************/
  //====================================================
  testCaseComment("Postcondition");
  testStep("STEP", "Return ECU to default values");
  RunPostTs();
}

testcase SW_Int_PAL_runSetPowerOrder_01()
{ 
  //***********************************Test report header*********************************
  testReportAddMiscInfoBlock("AUTOLIV ELECTRONICS document");
  TestReportAddMiscInfo("Nightly test", "No");
  TestReportAddMiscInfo("Test type", "Requirement-Based test");
  TestReportAddMiscInfo("Regression Test", "Yes");
  TestReportAddMiscInfo("Fault injection method used", "No");
  TestReportAddMiscInfo("Resource usage evaluation", "No");
  TestReportAddMiscInfo("Priority", "No");
  TestReportAddMiscInfo("Safety relevant", "No");

  AddRequirementInfo("Requirement under test", "ARCH_SW_PAL_0020, ARCH_SW_PAL_0025, ARCH_SW_PAL_0026, ARCH_SW_PAL_0027, ARCH_SW_PAL_0028, ARCH_SW_PAL_0029");
  AddRequirementInfo("ARCH_SW_PAL_0020", "The component shall control the power bridge based on the requested power order.");
  AddRequirementInfo("ARCH_SW_PAL_0025", "The component shall be able to activate/deactivate the half bridge connected to the Vp pin of the motor.");
  AddRequirementInfo("ARCH_SW_PAL_0026", "The component shall be able to activate/deactivate the half bridge connected to the Vn pin of the motor.");
  AddRequirementInfo("ARCH_SW_PAL_0027", "The component shall be able to control the MOSFETs of the half bridge connected to the Vp pin of the motor.");
  AddRequirementInfo("ARCH_SW_PAL_0028", "The component shall be able to control the MOSFETs of the half bridge connected to the Vp pin of the motor.");
  AddRequirementInfo("ARCH_SW_PAL_0029", "The component shall be able to control MOSFET of the high power.");

  //***************************************************************************************

  testCaseComment("Preconditions");
  testStep("STEP", "Bench Initialization");
  
  testStep("", "Delete all breakpoints from debugger.");
  debugger_deleteAllBreakpoints();
  
  testStep("", "Reset the debugger.");
  debugger_reset();
  
  testStep("STEP", "Run the debugger.");
  debugger_run();

  RunPreTs();
  //====================================================

  testCaseComment("Action: ARCH_SW_PAL_0020");
    /*********************  STEP 1  **************************/
    testStep("STEP", "Set a breakpoint in function PAL_runSetPowerOrder at the pal_DriveMotorInReleasing function call --> BP reached.");
    debugger_setRelativeFunctionBpAtLine("PAL_runSetPowerOrder", "29");
    debugger_reset();
    debugger_run();
    debugger_waitUntilBPisReached("1000");
ExpectedTestResult(debugger_result, IS_CPU_STOP_AT_BP_SUCCESFUL, "CPU is stopped at BP");
  
  testCaseComment("Action: ARCH_SW_PAL_0025, ARCH_SW_PAL_0026, ARCH_SW_PAL_0029");
    /*********************  STEP 2  **************************/
    debugger_deleteRelativeFunctionBpAtLine("PAL_runSetPowerOrder", "29");
    testStep("STEP", "Set a breakpoint in function pal_DriveMotorInReleasing at the RTE Call of PwmIf_SetDutyCycle --> BP reached.");
    debugger_setRelativeFunctionBpAtLine("pal_DriveMotorInReleasing", "38");
    debugger_run();
    debugger_waitUntilBPisReached("1000");
ExpectedTestResult(debugger_result, IS_CPU_STOP_AT_BP_SUCCESFUL, "CPU is stopped at BP");
  
  testCaseComment("Action: ARCH_SW_PAL_0027");
    /*********************  STEP 2  **************************/
    debugger_deleteRelativeFunctionBpAtLine("pal_DriveMotorInReleasing", "38");
    testStep("STEP", "Set a breakpoint in function pal_DriveMotorInReleasing at Dio_WriteChannel for Vp function call --> BP reached.");
    debugger_setRelativeFunctionBpAtLine("pal_DriveMotorInReleasing", "42");
    debugger_run();
    debugger_waitUntilBPisReached("1000");
ExpectedTestResult(debugger_result, IS_CPU_STOP_AT_BP_SUCCESFUL, "CPU is stopped at BP");
  
  testCaseComment("Action: ARCH_SW_PAL_0028");
      /*********************  STEP 2  **************************/
    debugger_deleteRelativeFunctionBpAtLine("pal_DriveMotorInReleasing", "42");
    testStep("STEP", "Set a breakpoint in function pal_DriveMotorInReleasing at Dio_WriteChannel for Vn function call --> BP reached.");
    debugger_setRelativeFunctionBpAtLine("pal_DriveMotorInReleasing", "43");
    debugger_run();
    debugger_waitUntilBPisReached("1000");
ExpectedTestResult(debugger_result, IS_CPU_STOP_AT_BP_SUCCESFUL, "CPU is stopped at BP");
  //====================================================
  
  testCaseComment("Postcondition");
  testStep("STEP", "Return ECU to default values");
  RunPostTs();
}

testcase SW_Int_PAL_DisablePowerStage_01()
{ 
  //***********************************Test report header*********************************
  testReportAddMiscInfoBlock("AUTOLIV ELECTRONICS document");
  TestReportAddMiscInfo("Nightly test", "No");
  TestReportAddMiscInfo("Test type", "Requirement-Based test");
  TestReportAddMiscInfo("Regression Test", "Yes");
  TestReportAddMiscInfo("Fault injection method used", "No");
  TestReportAddMiscInfo("Resource usage evaluation", "No");
  TestReportAddMiscInfo("Priority", "No");
  TestReportAddMiscInfo("Safety relevant", "No");

  AddRequirementInfo("Requirement under test", "ARCH_SW_PAL_0070, ARCH_SW_PAL_0075, ARCH_SW_PAL_0076.");
  AddRequirementInfo("ARCH_SW_PAL_0070", "The component shall be able to set the power state to IDLE.");
  AddRequirementInfo("ARCH_SW_PAL_0075", "The component shall be able to activate/deactivate the half bridge connected to the Vp pin of the motor.");
  AddRequirementInfo("ARCH_SW_PAL_0076", "The component shall be able to activate/deactivate the half bridge connected to the Vn pin of the motor.");

  //***************************************************************************************

  testCaseComment("Preconditions");
  testStep("STEP", "Bench Initialization");
  
  testStep("", "Delete all breakpoints from debugger.");
  debugger_deleteAllBreakpoints();
  
  testStep("", "Reset the debugger.");
  debugger_reset();
  
  testStep("STEP", "Run the debugger.");
  debugger_run();

  RunPreTs();
  //====================================================

  testCaseComment("Action: ARCH_SW_PAL_0070");
    /*********************  STEP 1  **************************/
    testStep("STEP", "Set a breakpoint in function PAL_runMainFunction at the IDLE running mode for PAL SWC --> BP reached.");
    debugger_setRelativeFunctionBpAtLine("PAL_runMainFunction", "55");
    debugger_reset();
    debugger_run();
    debugger_waitUntilBPisReached("5000");
    ExpectedTestResult(debugger_result, IS_CPU_STOP_AT_BP_SUCCESFUL, "CPU is stopped at BP");
  
  testCaseComment("Action: ARCH_SW_PAL_0075");
    /*********************  STEP 2  **************************/
    debugger_deleteRelativeFunctionBpAtLine("PAL_runMainFunction", "55");
    testStep("STEP", "Set a breakpoint in function PAL_DisablePowerStage at the Dio_WriteChannel call to to deactivate the half bridge connected to the Vp pin of the motor --> BP reached.");
    debugger_setRelativeFunctionBpAtLine("PAL_DisablePowerStage", "0");
    debugger_run();
    debugger_waitUntilBPisReached("5000");
ExpectedTestResult(debugger_result, IS_CPU_STOP_AT_BP_SUCCESFUL, "CPU is stopped at BP");
  
  testCaseComment("Action: ARCH_SW_PAL_0076");
    /*********************  STEP 2  **************************/
    debugger_deleteRelativeFunctionBpAtLine("PAL_DisablePowerStage", "0");
    testStep("STEP", "Set a breakpoint in function PAL_DisablePowerStage at the Dio_WriteChannel call to to deactivate the half bridge connected to the Vn pin of the motor --> BP reached.");
    debugger_setRelativeFunctionBpAtLine("PAL_DisablePowerStage", "1");
    debugger_run();
    debugger_waitUntilBPisReached("5000");
    ExpectedTestResult(debugger_result, IS_CPU_STOP_AT_BP_SUCCESFUL, "CPU is stopped at BP");
  
  //====================================================
  testCaseComment("Postcondition");
  testStep("STEP", "Return ECU to default values");
  RunPostTs();
}

testcase SW_Int_PAL_StartFreeWheelingState_01()
{ 
  //***********************************Test report header*********************************
  testReportAddMiscInfoBlock("AUTOLIV ELECTRONICS document");
  TestReportAddMiscInfo("Nightly test", "No");
  TestReportAddMiscInfo("Test type", "Requirement-Based test");
  TestReportAddMiscInfo("Regression Test", "Yes");
  TestReportAddMiscInfo("Fault injection method used", "No");
  TestReportAddMiscInfo("Resource usage evaluation", "No");
  TestReportAddMiscInfo("Priority", "No");
  TestReportAddMiscInfo("Safety relevant", "No");

  AddRequirementInfo("Requirement under test", "ARCH_SW_PAL_0077, ARCH_SW_PAL_0075, ARCH_SW_PAL_0076.");
  AddRequirementInfo("ARCH_SW_PAL_0077", "This function shall set the power stage in IDLE state .");
  AddRequirementInfo("ARCH_SW_PAL_0078", "The Dio_WriteChannel function shall be called to activate the half bridge connected to the VP pin of the motor.");
  AddRequirementInfo("ARCH_SW_PAL_0079", "The Dio_WriteChannel function shall be called to activate the half bridge connected to the VN pin of the motor.");

  //***************************************************************************************

  testCaseComment("Preconditions");
  testStep("STEP", "Bench Initialization");
  
  testStep("", "Delete all breakpoints from debugger.");
  debugger_deleteAllBreakpoints();
  
  testStep("", "Reset the debugger.");
  debugger_reset();
  
  testStep("STEP", "Run the debugger.");
  debugger_run();

  RunPreTs();
  //====================================================

  testCaseComment("Action: ARCH_SW_PAL_0077");
    /*********************  STEP 1  **************************/
    testStep("STEP", "Set a breakpoint in function PAL_Autotest_CheckHighSideSwRegulation at the PAL_KU8_HIGH_SIDE_SW_REG_INIT state to add a free wheeling phase --> BP reached.");
    debugger_setRelativeFunctionBpAtLine("PAL_Autotest_CheckHighSideSwRegulation", "32");
    debugger_reset();
    debugger_run();
    debugger_waitUntilBPisReached("5000");
ExpectedTestResult(debugger_result, IS_CPU_STOP_AT_BP_SUCCESFUL, "CPU is stopped at BP");
  
  
    /*********************  STEP 2  **************************/
    debugger_deleteRelativeFunctionBpAtLine("PAL_Autotest_CheckHighSideSwRegulation", "32");
    testStep("STEP", "Set a breakpoint in function pal_HighSideSWRegFreeWheelingPhase at the PAL_StartFreeWheelingState call to set both half bridge in free wheeling state --> BP reached.");
    debugger_setRelativeFunctionBpAtLine("pal_HighSideSWRegFreeWheelingPhase", "6");
    debugger_run();
    debugger_waitUntilBPisReached("5000");
ExpectedTestResult(debugger_result, IS_CPU_STOP_AT_BP_SUCCESFUL, "CPU is stopped at BP");
  
  testCaseComment("Action: ARCH_SW_PAL_0078");
    /*********************  STEP 2  **************************/
    debugger_deleteRelativeFunctionBpAtLine("pal_HighSideSWRegFreeWheelingPhase", "6");
    testStep("STEP", "Set a breakpoint in function PAL_StartFreeWheelingState at the Dio_WriteChannel call to to activate the half bridge connected to the Vn pin of the motor --> BP reached.");
    debugger_setRelativeFunctionBpAtLine("PAL_StartFreeWheelingState", "9");
    debugger_run();
    debugger_waitUntilBPisReached("5000");
ExpectedTestResult(debugger_result, IS_CPU_STOP_AT_BP_SUCCESFUL, "CPU is stopped at BP");
  
  testCaseComment("Action: ARCH_SW_PAL_0079");
      /*********************  STEP 2  **************************/
    debugger_deleteRelativeFunctionBpAtLine("pal_HighSideSWRegFreeWheelingPhase", "9");
    testStep("STEP", "Set a breakpoint in function PAL_StartFreeWheelingState at the Dio_WriteChannel call to to activate the half bridge connected to the Vn pin of the motor --> BP reached.");
    debugger_setRelativeFunctionBpAtLine("PAL_StartFreeWheelingState", "10");
    debugger_run();
    debugger_waitUntilBPisReached("5000");
ExpectedTestResult(debugger_result, IS_CPU_STOP_AT_BP_SUCCESFUL, "CPU is stopped at BP");
 
  
  //====================================================
  testCaseComment("Postcondition");
  testStep("STEP", "Return ECU to default values");
  RunPostTs();
}

testcase SW_Int_PAL_Cfg_Init_01()
{ 
  //***********************************Test report header*********************************
  testReportAddMiscInfoBlock("AUTOLIV ELECTRONICS document");
  TestReportAddMiscInfo("Nightly test", "No");
  TestReportAddMiscInfo("Test type", "Requirement-Based test");
  TestReportAddMiscInfo("Regression Test", "Yes");
  TestReportAddMiscInfo("Fault injection method used", "No");
  TestReportAddMiscInfo("Resource usage evaluation", "No");
  TestReportAddMiscInfo("Priority", "No");
  TestReportAddMiscInfo("Safety relevant", "No");

  AddRequirementInfo("Requirement under test", "ARCH_SW_PAL_0090, ARCH_SW_PAL_0095");
  AddRequirementInfo("ARCH_SW_PAL_0090", "This function shall set the power stage in IDLE state.");
  AddRequirementInfo("ARCH_SW_PAL_0095", "The component shall be able to disable the H-bridge at startup.");

  //***************************************************************************************

  testCaseComment("Preconditions");
  testStep("STEP", "Bench Initialization");
  
  testStep("", "Delete all breakpoints from debugger.");
  debugger_deleteAllBreakpoints();
  
  testStep("", "Reset the debugger.");
  debugger_reset();
  
  testStep("STEP", "Run the debugger.");
  debugger_run();

  RunPreTs();
  //====================================================

  testCaseComment("Action: ARCH_SW_PAL_0090, ARCH_SW_PAL_0095");
    /*********************  STEP 1  **************************/
    testStep("STEP", "Set a breakpoint in function PAL_Init at the pal_Cfg_Init function call to execute config part of initialization --> CPU is stopped at BP.");
    debugger_setRelativeFunctionBpAtLine("PAL_Init", "8");
    debugger_reset();
    debugger_run();
    debugger_waitUntilBPisReached("5000");
    ExpectedTestResult(debugger_result, IS_CPU_STOP_AT_BP_SUCCESFUL, "CPU is stopped at BP");
  
  
    testStep("", "Step in.");
    debugger_stepIn();
  
    /*********************  STEP 2  **************************/
    debugger_deleteRelativeFunctionBpAtLine("PAL_Init", "8");
    testStep("STEP", "Set a breakpoint in function pal_Cfg_Init at the Dio_WriteChannel call to to activate the half bridge --> CPU is stopped at BP.");
    debugger_setRelativeFunctionBpAtLine("pal_Cfg_Init", "9999");
    debugger_run();
    debugger_waitUntilBPisReached("5000");
ExpectedTestResult(debugger_result, IS_CPU_STOP_AT_BP_SUCCESFUL, "CPU is stopped at BP");
   
  //====================================================
  testCaseComment("Postcondition");
  testStep("STEP", "Return ECU to default values");
  RunPostTs();
}

testcase SW_Int_PAL_AT_Init_01()
{ 
  //***********************************Test report header*********************************
  testReportAddMiscInfoBlock("AUTOLIV ELECTRONICS document");
  TestReportAddMiscInfo("Nightly test", "No");
  TestReportAddMiscInfo("Test type", "Requirement-Based test");
  TestReportAddMiscInfo("Regression Test", "Yes");
  TestReportAddMiscInfo("Fault injection method used", "No");
  TestReportAddMiscInfo("Resource usage evaluation", "No");
  TestReportAddMiscInfo("Priority", "No");
  TestReportAddMiscInfo("Safety relevant", "No");

  AddRequirementInfo("Requirement under test", "ARCH_SW_PAL_0110");
  AddRequirementInfo("ARCH_SW_PAL_0110", "The component shall initialize the auto tests data.");

  //***************************************************************************************

  
  testCaseComment("Preconditions");
  testStep("STEP", "Bench Initialization");
  
  testStep("", "Delete all breakpoints from debugger.");
  debugger_deleteAllBreakpoints();
  
  testStep("", "Reset the debugger.");
  debugger_reset();
  
  testStep("STEP", "Run the debugger.");
  debugger_run();

  RunPreTs();
  //====================================================

  testCaseComment("Action: ARCH_SW_PAL_0105");
    /*********************  STEP 1  **************************/
    testStep("STEP", "Set a breakpoint in function pal_Cfg_Init at the pal_AT_Init function call to to initialize static data for auto tests execution.");
    debugger_setRelativeFunctionBpAtLine("pal_Cfg_Init", "36");
    debugger_reset();
    debugger_run();
    debugger_waitUntilBPisReached("5000");
    ExpectedTestResult(debugger_result, IS_CPU_STOP_AT_BP_SUCCESFUL, "CPU is stopped at BP");
  
    testStep("STEP", "Step in.");
    debugger_stepIn();
  
    testStep("STEP", "Run until return of function pal_AT_Init.");
    debugger_runUntilReturn("10");
  
    /*********************  STEP 2  **************************/
    testStep("STEP", "Set a breakpoint in function PAL_Autotest_CheckMosfetLowSC at the RTE call for GetTestResult.");
    debugger_setRelativeFunctionBpAtLine("PAL_Autotest_CheckMosfetLowSC", "35");
    debugger_run();
    debugger_waitUntilBPisReached("5000");
    ExpectedTestResult(debugger_result, IS_CPU_STOP_AT_BP_SUCCESFUL, "CPU is stopped at BP");
  
    testStep("STEP", "Evaluate that (PAL_Cfg_AT_InternalData).u16MotorCurrentErrorResetTimeCounter was initialized with 0x0000.");
    debugger_readVariable("uint16", "PAL_Cfg_AT_InternalData,,app.elf", "15");
    ExpectedTestResult(debugger_result, "0x0", "Variable is equal to 0.");
   
  //====================================================
  testCaseComment("Postcondition");
  testStep("STEP", "Return ECU to default values");
  RunPostTs();
}

testcase SW_Int_PAL_runReadMotorCurrentInA_01()
{ 
  //***********************************Test report header*********************************
  testReportAddMiscInfoBlock("AUTOLIV ELECTRONICS document");
  TestReportAddMiscInfo("Nightly test", "No");
  TestReportAddMiscInfo("Test type", "Requirement-Based test");
  TestReportAddMiscInfo("Regression Test", "Yes");
  TestReportAddMiscInfo("Fault injection method used", "No");
  TestReportAddMiscInfo("Resource usage evaluation", "No");
  TestReportAddMiscInfo("Priority", "No");
  TestReportAddMiscInfo("Safety relevant", "No");

  AddRequirementInfo("Requirement under test", "ARCH_SW_PAL_0105, ARCH_SW_PAL_0106, ARCH_SW_PAL_0100");
  AddRequirementInfo("ARCH_SW_PAL_0105", "If the motor rotation direction is “tensioning”, the AdcIf_runGetMotor_Ip function shall be called to read the motor current measured by the half bridge connected to the VP pin of the motor.");
  AddRequirementInfo("ARCH_SW_PAL_0106", "If the motor rotation direction is “releasing”, the AdcIf_runGetMotor_In function shall be called to read the motor current measured by the half bridge connected to the VN pin of the motor.");
  AddRequirementInfo("ARCH_SW_PAL_0100", "The component shall provide the current in amps.");

  //***************************************************************************************

  
  testCaseComment("Preconditions");
  testStep("STEP", "Bench Initialization");
  
  testStep("", "Delete all breakpoints from debugger.");
  debugger_deleteAllBreakpoints();
  
  testStep("", "Reset the debugger.");
  debugger_reset();
  
  testStep("STEP", "Run the debugger.");
  debugger_run();

  RunPreTs();
  //====================================================

  testCaseComment("Action: ARCH_SW_PAL_0105, ARCH_SW_PAL_0106, ARCH_SW_PAL_0100");
    /*********************  STEP 1  **************************/
    testStep("STEP", "Set a breakpoint in function PAL_runReadMotorCurrentInA at PAL_runReadMotorCurrentInmA function call --> BP reached.");
    debugger_setRelativeFunctionBpAtLine("PAL_runReadMotorCurrentInA", "5");
    debugger_reset();
    debugger_run();
    debugger_waitUntilBPisReached("5000");
    ExpectedTestResult(debugger_result, IS_CPU_STOP_AT_BP_SUCCESFUL, "CPU is stopped at BP");
  
    testStep("", "Step in.");
    debugger_stepIn();
  
    /*********************  STEP 2  **************************/
    debugger_deleteRelativeFunctionBpAtLine("PAL_runReadMotorCurrentInA", "5");
    testStep("STEP", "Set a breakpoint in function PAL_runReadMotorCurrentInmA at the pal_ComputeCurrentHalfBridgeP function call --> BP reached.");
    debugger_setRelativeFunctionBpAtLine("PAL_runReadMotorCurrentInmA", "29");
    debugger_run();
    debugger_waitUntilBPisReached("5000");
ExpectedTestResult(debugger_result, IS_CPU_STOP_AT_BP_SUCCESFUL, "CPU is stopped at BP");
  
    /*********************  STEP 2  **************************/
    debugger_deleteRelativeFunctionBpAtLine("PAL_runReadMotorCurrentInmA", "29");
    testStep("STEP", "Set a breakpoint in function PAL_runReadMotorCurrentInmA at the pal_ComputeCurrentHalfBridgeP function call --> BP reached.");
    debugger_setRelativeFunctionBpAtLine("PAL_runReadMotorCurrentInmA", "30");
    debugger_run();
    debugger_waitUntilBPisReached("5000");
ExpectedTestResult(debugger_result, IS_CPU_STOP_AT_BP_SUCCESFUL, "CPU is stopped at BP");
  
      /*********************  STEP 2  **************************/
    debugger_deleteRelativeFunctionBpAtLine("PAL_runReadMotorCurrentInmA", "30");
    testStep("STEP", "Set a breakpoint in function PAL_runReadMotorCurrentInmA at the pal_ComputeCurrentHalfBridgeN function call --> BP reached.");
    debugger_setRelativeFunctionBpAtLine("PAL_runReadMotorCurrentInmA", "31");
    debugger_run();
    debugger_waitUntilBPisReached("5000");
ExpectedTestResult(debugger_result, IS_CPU_STOP_AT_BP_SUCCESFUL, "CPU is stopped at BP");
  
   
  //====================================================
  testCaseComment("Postcondition");
  testStep("STEP", "Return ECU to default values");
  RunPostTs();
}

void MainTest()
{
  InitTestModule();
  
  SW_Int_PAL_ComponentInit_01();
  SW_Int_PAL_runMainFunction_01();
  SW_Int_PAL_checkPowerSupply_01();
  SW_Int_PAL_HardwareInit_02();
  SW_Int_PAL_Autotest_CheckCommandConsistency_01();
  SW_Int_PAL_Autotest_CheckHighSideSwRegulation_01(); 
  SW_Int_PAL_Autotest_CheckHWSelfProtection_01(); 
  SW_Int_PAL_Autotest_CheckMosfetLowSC_01();
  SW_Int_PAL_Autotest_CheckMosfetHighSC_01(); 
  SW_Int_PAL_Autotest_CheckMosfetOCAT_01();
  SW_Int_PAL_Autotest_CheckMotorConnection_01(); 
  SW_Int_PAL_Autotest_CheckMotorDisengagement_01();
  SW_Int_PAL_Autotest_CheckMotorCurrent_01(); 
  SW_Int_PAL_Autotest_CheckMotorThermalProctection_01();
  SW_Int_PAL_Autotest_CheckMotorPowerOrder_01(); 
  SW_Int_PAL_Autotest_CheckMotorSC_01(); 
  SW_Int_PAL_runSetPowerOrder_01(); 
  SW_Int_PAL_DisablePowerStage_01(); 
  SW_Int_PAL_StartFreeWheelingState_01(); 
  SW_Int_PAL_Cfg_Init_01(); 
  SW_Int_PAL_AT_Init_01();
  SW_Int_PAL_runReadMotorCurrentInA_01(); 
  SW_Int_PAL_Autotest_CHeckMotorThermalProtection_02();
  
}
