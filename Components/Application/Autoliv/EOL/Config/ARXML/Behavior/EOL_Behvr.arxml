AUTOSAR XML (schema 4-2-2)
package /AUTOLIV/SoftwareComponents/EOL
  application sw component type EOL_AC_EndOfLifeManagement: category=SWC
    behavior EOL_IB_EndOfLifeManagement: constant-value-mapping=ConstantsMappingSet_PP4G, data-type-mapping=DataTypeMappingSet_PP4G, handle-termination-and-restart=NO-SUPPORT
      timing event EOL_evMainFunction: start-on-event=EOL_runMainFunction, period=0.01
      5 x operation invoked event:
        oie_pseCheckProductEndOfLifeComfort_AutotestCallback: start-on-event=EOL_Autotest_CheckProductEndOfLifeComfort, operation=pseCheckProductEndOfLifeComfort.AutotestCallback
        oie_pseCheckProductEndOfLifeHapticWarning_AutotestCallback: start-on-event=EOL_Autotest_CheckProductEndOfLifeHapticWarning, operation=pseCheckProductEndOfLifeHapticWarning.AutotestCallback
        oie_pseCheckProductEndOfLifeHighForce_AutotestCallback: start-on-event=EOL_Autotest_CheckProductEndOfLifeHighForce, operation=pseCheckProductEndOfLifeHighForce.AutotestCallback
        oie_pseCheckProductEndOfLifeLowForce_AutotestCallback: start-on-event=EOL_Autotest_CheckProductEndOfLifeLowForce, operation=pseCheckProductEndOfLifeLowForce.AutotestCallback
        oie_pseEolServices_SetCycleCounterDatasetIndex: start-on-event=EOL_runSetDatasetIndex, operation=pseEolServices.SetCycleCounterDatasetIndex
      7 x runnable, all with sw-addr-method=CODE:
        EOL_Autotest_CheckProductEndOfLifeComfort: can-be-invoked-concurrently=true
        EOL_Autotest_CheckProductEndOfLifeHapticWarning: can-be-invoked-concurrently=true
        EOL_Autotest_CheckProductEndOfLifeHighForce: can-be-invoked-concurrently=true
        EOL_Autotest_CheckProductEndOfLifeLowForce: can-be-invoked-concurrently=true
        EOL_Init
          sync call scp_GetBlockLength: operation=pclNvmIfServices.GetNvmBlockLength, timeout=0.0
          sync call scp_WriteBlock: operation=pclNvmServicesExecutionCounters.WriteBlock, timeout=0.0
          sync call scp_WriteBlock1: operation=pclNvmServicesExecutionCounters1.WriteBlock, timeout=0.0
        EOL_runMainFunction
          data-receive-point-by-arguments:
            access DRP_prrExecutedCycle_u8CycleNumber: accessed-variable=prrExecutedCycle.u8CycleNumber
          sync call scp_GetBlockLength: operation=pclNvmIfServices.GetNvmBlockLength, timeout=0.0
          sync call scp_WriteBlock: operation=pclNvmServicesExecutionCounters.WriteBlock, timeout=0.0
          sync call scp_WriteBlock1: operation=pclNvmServicesExecutionCounters1.WriteBlock, timeout=0.0
        EOL_runSetDatasetIndex: can-be-invoked-concurrently=true
  swc implementation EOL_impEndOfLifeManagement: programming-language=C, sw-version=1.0.0, vendor-id=0, behavior=EOL_IB_EndOfLifeManagement
    code-descriptors:
      code EOL_Impl_Code: artifact-descriptors=autosar-engineering-object={short-label=EOL_Impl_Code_CodeDesc, category=SWSRC}
    resource consumption EOL_Impl_ResCons
      memory section CODE: size=0, sw-addrmethod=CODE
      memory section VAR_8: alignment=8, size=0, sw-addrmethod=VAR_ALV
      memory section VAR_INIT_8: alignment=8, size=0, sw-addrmethod=VAR_INIT
