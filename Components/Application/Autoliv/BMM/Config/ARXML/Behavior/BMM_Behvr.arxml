AUTOSAR XML (schema 4-2-2)
package /AUTOLIV/SoftwareComponents/BMM
  ecu abstraction sw component type BMM_AC_BeltMovementMonitoring: category=IO_HW_ABS
    behavior BMM_IB_BobbinRotatingSensor: constant-value-mapping=ConstantsMappingSet_PP4G, data-type-mapping=DataTypeMappingSet_PP4G, handle-termination-and-restart=NO-SUPPORT
      11 x operation invoked event:
        BMM_evDisableHBSMonitoring: start-on-event=BMM_runDisableHBSMonitoring, operation=pseHBSControl.DisableHBSMonitoring
        BMM_evEnableHBSMonitoring: start-on-event=BMM_runEnableHBSMonitoring, operation=pseHBSControl.EnableHBSMonitoring
        BMM_evGetPositionFromMinPos_deg: start-on-event=BMM_runGetPositionFromMinPos_deg, operation=pseBelt_D.GetFromMinPos_deg
        BMM_evGetPositionFromMinPos_mm: start-on-event=BMM_runGetPositionFromMinPos_mm, operation=pseBelt_D.GetFromMinPos_mm
        BMM_evGetPositionFromT0_deg: start-on-event=BMM_runGetPositionFromT0_deg, operation=pseBelt_D.GetFromT0_deg
        BMM_evGetPositionFromT0_mm: start-on-event=BMM_runGetPositionFromT0_mm, operation=pseBelt_D.GetFromT0_mm
        BMM_evGetPositionRange_deg: start-on-event=BMM_runGetPositionRange_deg, operation=pseBelt_D.GetRange_deg
        BMM_evGetPositionRange_mm: start-on-event=BMM_runGetPositionRange_mm, operation=pseBelt_D.GetRange_mm
        BMM_evGetPyroActivationStatus: start-on-event=BMM_runGetPyroActivationStatus, operation=psePyroDevice.GetPyroActivationStatus
        BMM_evGetSpeed_deg_s: start-on-event=BMM_runGetSpeed_deg_s, operation=pseBelt_S.GetSpeed_deg_s
        BMM_evGetSpeed_mm_s: start-on-event=BMM_runGetSpeed_mm_s, operation=pseBelt_S.GetSpeed_mm_s
      timing event BMM_evMainFunction: start-on-event=BMM_runMainFunction, period=0.002
      operation invoked event oie_pseCheckHallEffectSensor_AutotestCallback: start-on-event=BMM_Autotest_CheckHallEffectSensor, operation=pseCheckHallEffectSensor.AutotestCallback
      14 x runnable:
        BMM_Autotest_CheckHallEffectSensor: can-be-invoked-concurrently=true
          4 x sync call, all with timeout=0.0:
            scp_GetTestResult: operation=pclAutotestServices.GetTestResult
            scp_Get_100ms: operation=pclHBS_A_V_raw.Get_100ms
            scp_Get_100ms1: operation=pclHBS_B_V_raw.Get_100ms
            scp_GetEventStatus: operation=pclEvtInfoBatPwrUnderVoltage.GetEventStatus
        BMM_runDisableHBSMonitoring: can-be-invoked-concurrently=true
        BMM_runEnableHBSMonitoring: can-be-invoked-concurrently=true
        BMM_runGetPositionFromMinPos_deg: can-be-invoked-concurrently=true
        BMM_runGetPositionFromMinPos_mm: can-be-invoked-concurrently=true
        BMM_runGetPositionFromT0_deg: can-be-invoked-concurrently=true
        BMM_runGetPositionFromT0_mm: can-be-invoked-concurrently=true
        BMM_runGetPositionRange_deg: can-be-invoked-concurrently=true
        BMM_runGetPositionRange_mm: can-be-invoked-concurrently=true
        BMM_runGetPyroActivationStatus: can-be-invoked-concurrently=true
        BMM_runGetSpeed_deg_s: can-be-invoked-concurrently=true
        BMM_runGetSpeed_mm_s: can-be-invoked-concurrently=true
        BMM_runInit: can-be-invoked-concurrently=true
        BMM_runMainFunction
  swc implementation BMM_impBobbinRotatingSensor: programming-language=C, sw-version=1.0.0, vendor-id=0, behavior=BMM_IB_BobbinRotatingSensor
    code-descriptors:
      code BMM_Impl_Code: artifact-descriptors=autosar-engineering-object={short-label=BMM_Impl_Code_CodeDesc, category=SWSRC}
    resource consumption BMM_Impl_ResCons
      4 x memory section, all with size=0:
        CODE: sw-addrmethod=CODE
        VAR_16: alignment=16, sw-addrmethod=VAR_ALV
        VAR_32: alignment=32, sw-addrmethod=VAR_ALV
        VAR_8: alignment=8, sw-addrmethod=VAR_ALV
