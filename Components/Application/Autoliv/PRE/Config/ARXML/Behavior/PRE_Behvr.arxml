AUTOSAR XML (schema 4-2-2)
package /AUTOLIV/SoftwareComponents/PRE
  application sw component type PRE_AC_PreTensioning: category=SWC
    behavior PRE_IB_PreTensioning: constant-value-mapping=ConstantsMappingSet_PP4G, data-type-mapping=DataTypeMappingSet_PP4G, handle-termination-and-restart=NO-SUPPORT
      timing event PRE_evPreTensioning: start-on-event=PRE_runPreTensioning, period=0.01
      runnable PRE_runPreTensioning: sw-addr-method=CODE
        data-receive-point-by-arguments:
          6 x access:
            DRP_prrCustomerSpecific_b8PreCrashRequestEnable: accessed-variable=prrCustomerSpecific.b8PreCrashRequestEnable
            DRP_prrExecutedCycle_u8CycleNumber: accessed-variable=prrExecutedCycle.u8CycleNumber
            DRP_prrPreCrashSeverityLevel_u8PreCrashSeverityLevel: accessed-variable=prrPreCrashSeverityLevel.u8PreCrashSeverityLevel
            DRP_prrBuckleDoorSwitch_u8BuckleSwitch: accessed-variable=prrBuckleDoorSwitch.u8BuckleSwitch
            DRP_prrCustomerSpecific_b8IsCarCrashDetected: accessed-variable=prrCustomerSpecific.b8IsCarCrashDetected
            DRP_prrGlobalCarAcceleration_b8IsCarAccelerationLow: accessed-variable=prrGlobalCarAcceleration.b8IsCarAccelerationLow
        data-send-points:
          41 x access:
            DSP_psrAlgo_Flags_PRE4_u8TriggeringSource: accessed-variable=psrAlgo_Flags_PRE4.u8TriggeringSource
            DSP_psrAlgo_Flags_PRE8_b8InterruptFlag: accessed-variable=psrAlgo_Flags_PRE8.b8InterruptFlag
            DSP_psrAlgo_Flags_PRE6_b8InterruptFlag: accessed-variable=psrAlgo_Flags_PRE6.b8InterruptFlag
            DSP_psrAlgo_Flags_PRE7_b8InterruptFlag: accessed-variable=psrAlgo_Flags_PRE7.b8InterruptFlag
            DSP_psrAlgo_Flags_PRE5_b8TriggerFlag: accessed-variable=psrAlgo_Flags_PRE5.b8TriggerFlag
            DSP_psrAlgo_Flags_PRE3_b8TriggerFlag: accessed-variable=psrAlgo_Flags_PRE3.b8TriggerFlag
            DSP_psrAlgo_Flags_PRE7_b8TriggerFlag: accessed-variable=psrAlgo_Flags_PRE7.b8TriggerFlag
            DSP_psrAlgo_Flags_PRE3_u8TriggeringSource: accessed-variable=psrAlgo_Flags_PRE3.u8TriggeringSource
            DSP_psrAlgo_Flags_PRE1_u8TriggeringSource: accessed-variable=psrAlgo_Flags_PRE1.u8TriggeringSource
            DSP_psrAlgo_Flags_PRE6_b8PreConditionsFlag: accessed-variable=psrAlgo_Flags_PRE6.b8PreConditionsFlag
            DSP_psrAlgo_Flags_PRE8_b8TriggerFlag: accessed-variable=psrAlgo_Flags_PRE8.b8TriggerFlag
            DSP_psrAlgo_Flags_PRE8_u8TriggeringSource: accessed-variable=psrAlgo_Flags_PRE8.u8TriggeringSource
            DSP_psrAlgo_Flags_PRE1_b8PreActivationFlag: accessed-variable=psrAlgo_Flags_PRE1.b8PreActivationFlag
            DSP_psrAlgo_Flags_PRE2_u8TriggeringSource: accessed-variable=psrAlgo_Flags_PRE2.u8TriggeringSource
            DSP_psrAlgo_Flags_PRE5_b8InterruptFlag: accessed-variable=psrAlgo_Flags_PRE5.b8InterruptFlag
            DSP_psrAlgo_Flags_PRE5_u8TriggeringSource: accessed-variable=psrAlgo_Flags_PRE5.u8TriggeringSource
            DSP_psrAlgo_Flags_PRE7_b8PreActivationFlag: accessed-variable=psrAlgo_Flags_PRE7.b8PreActivationFlag
            DSP_psrAlgo_Flags_PRE2_b8PreActivationFlag: accessed-variable=psrAlgo_Flags_PRE2.b8PreActivationFlag
            DSP_psrAlgo_Flags_PRE4_b8InterruptFlag: accessed-variable=psrAlgo_Flags_PRE4.b8InterruptFlag
            DSP_psrAlgo_Flags_PRE4_b8PreActivationFlag: accessed-variable=psrAlgo_Flags_PRE4.b8PreActivationFlag
            DSP_psrAlgo_Flags_PRE7_b8PreConditionsFlag: accessed-variable=psrAlgo_Flags_PRE7.b8PreConditionsFlag
            DSP_psrAlgo_Flags_PRE4_b8PreConditionsFlag: accessed-variable=psrAlgo_Flags_PRE4.b8PreConditionsFlag
            DSP_psrAlgo_Flags_PRE8_b8PreConditionsFlag: accessed-variable=psrAlgo_Flags_PRE8.b8PreConditionsFlag
            DSP_psrTrigOFF_b8IsCarAccelerationLow: accessed-variable=psrTrigOFF.b8IsCarAccelerationLow
            DSP_psrAlgo_Flags_PRE6_b8TriggerFlag: accessed-variable=psrAlgo_Flags_PRE6.b8TriggerFlag
            DSP_psrAlgo_Flags_PRE3_b8InterruptFlag: accessed-variable=psrAlgo_Flags_PRE3.b8InterruptFlag
            DSP_psrAlgo_Flags_PRE4_b8TriggerFlag: accessed-variable=psrAlgo_Flags_PRE4.b8TriggerFlag
            DSP_psrAlgo_Flags_PRE2_b8InterruptFlag: accessed-variable=psrAlgo_Flags_PRE2.b8InterruptFlag
            DSP_psrAlgo_Flags_PRE2_b8PreConditionsFlag: accessed-variable=psrAlgo_Flags_PRE2.b8PreConditionsFlag
            DSP_psrAlgo_Flags_PRE3_b8PreConditionsFlag: accessed-variable=psrAlgo_Flags_PRE3.b8PreConditionsFlag
            DSP_psrAlgo_Flags_PRE1_b8TriggerFlag: accessed-variable=psrAlgo_Flags_PRE1.b8TriggerFlag
            DSP_psrAlgo_Flags_PRE1_b8InterruptFlag: accessed-variable=psrAlgo_Flags_PRE1.b8InterruptFlag
            DSP_psrAlgo_Flags_PRE3_b8PreActivationFlag: accessed-variable=psrAlgo_Flags_PRE3.b8PreActivationFlag
            DSP_psrAlgo_Flags_PRE1_b8PreConditionsFlag: accessed-variable=psrAlgo_Flags_PRE1.b8PreConditionsFlag
            DSP_psrAlgo_Flags_PRE6_u8TriggeringSource: accessed-variable=psrAlgo_Flags_PRE6.u8TriggeringSource
            DSP_psrAlgo_Flags_PRE2_b8TriggerFlag: accessed-variable=psrAlgo_Flags_PRE2.b8TriggerFlag
            DSP_psrAlgo_Flags_PRE8_b8PreActivationFlag: accessed-variable=psrAlgo_Flags_PRE8.b8PreActivationFlag
            DSP_psrAlgo_Flags_PRE5_b8PreActivationFlag: accessed-variable=psrAlgo_Flags_PRE5.b8PreActivationFlag
            DSP_psrAlgo_Flags_PRE6_b8PreActivationFlag: accessed-variable=psrAlgo_Flags_PRE6.b8PreActivationFlag
            DSP_psrAlgo_Flags_PRE5_b8PreConditionsFlag: accessed-variable=psrAlgo_Flags_PRE5.b8PreConditionsFlag
            DSP_psrAlgo_Flags_PRE7_u8TriggeringSource: accessed-variable=psrAlgo_Flags_PRE7.u8TriggeringSource
        8 x sync call, all with timeout=0.0:
          SSCP_pclDiagRequestCycle_ClearDiagRequestCycle: operation=pclDiagRequestCycle.ClearDiagRequestCycle
          SSCP_pclDiagRequestCycle_GetDiagRequestCycle: operation=pclDiagRequestCycle.GetDiagRequestCycle
          SSCP_pclTestResult_GetTestResult: operation=pclAutotestServices.GetTestResult
          SSCP_pclModeManagement_CheckModeStatus: operation=pclModeManagement.CheckModeStatus
          scp_GetEventStatus: operation=pclEvtInfoBatPwrOverVoltage.GetEventStatus
          scp_GetEventStatus1: operation=pclEvtInfoHighForceEndOfLife.GetEventStatus
          scp_GetEventStatus2: operation=pclEvtInfoLowForceEndOfLife.GetEventStatus
          scp_GetEventStatus3: operation=pclEvtInfoBatPwrUnderVoltageDuringTens.GetEventStatus
  swc implementation PRE_impPreTensioning: programming-language=C, sw-version=1.0.0, vendor-id=0, behavior=PRE_IB_PreTensioning
    code-descriptors:
      code PRE_Impl_Code: artifact-descriptors=autosar-engineering-object={short-label=PRE_Impl_Code_CodeDesc, category=SWSRC}
    resource consumption PRE_Impl_ResCons
      5 x memory section, all with size=0:
        CODE: sw-addrmethod=CODE
        CONST_8: alignment=8, sw-addrmethod=CONST
        VAR_INIT_8: alignment=8, sw-addrmethod=VAR_INIT
        VAR_INIT_UNSPECIFIED: alignment=UNSPECIFIED, sw-addrmethod=VAR_INIT
        VAR_UNSPECIFIED: alignment=UNSPECIFIED, sw-addrmethod=VAR_ALV
